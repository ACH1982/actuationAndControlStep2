/******************************************************************************
* ASAP2 file: crossARINC_out.a2l
* Code generation for model "crossARINC_out".
* Model version : 1.46
* Simulink Coder version : 10.4 R2021b
* C source code generated on : Tue May 17 10:51:37 2022
* Target selection: slrealtime.tlc
* Embedded hardware selection: Intel->x86-64 (Linux 64)
* Code generation objectives: Unspecified
* Validation result: Not run
* (add additional file header information here)
******************************************************************************/ ASAP2_VERSION 1 71
/begin PROJECT ProjectName "Project Comment Goes Here"
/begin HEADER "Header Comments go here" /end HEADER
/begin MODULE ModuleName "Module Comment Goes Here"
/begin IF_DATA XCP
 /begin PROTOCOL_LAYER 0x0100 0x03E8 0x00C8 0x0000 0x0000 0x0000 0x0000 0x0000 0xFC 0x0578 BYTE_ORDER_MSB_LAST ADDRESS_GRANULARITY_BYTE OPTIONAL_CMD ALLOC_ODT_ENTRY OPTIONAL_CMD ALLOC_ODT OPTIONAL_CMD ALLOC_DAQ OPTIONAL_CMD FREE_DAQ OPTIONAL_CMD GET_DAQ_RESOLUTION_INFO OPTIONAL_CMD GET_DAQ_PROCESSOR_INFO OPTIONAL_CMD START_STOP_SYNCH OPTIONAL_CMD START_STOP_DAQ_LIST OPTIONAL_CMD SET_DAQ_LIST_MODE OPTIONAL_CMD WRITE_DAQ OPTIONAL_CMD SET_DAQ_PTR OPTIONAL_CMD GET_CAL_PAGE OPTIONAL_CMD SET_CAL_PAGE OPTIONAL_CMD COPY_CAL_PAGE OPTIONAL_CMD SHORT_DOWNLOAD OPTIONAL_CMD DOWNLOAD_MAX OPTIONAL_CMD DOWNLOAD OPTIONAL_CMD SHORT_UPLOAD OPTIONAL_CMD UPLOAD OPTIONAL_CMD SET_MTA /end PROTOCOL_LAYER
 /begin DAQ DYNAMIC 0x0000 0x0080 0x00 OPTIMISATION_TYPE_DEFAULT ADDRESS_EXTENSION_FREE IDENTIFICATION_FIELD_TYPE_RELATIVE_WORD_ALIGNED GRANULARITY_ODT_ENTRY_SIZE_DAQ_BYTE 0xFF OVERLOAD_INDICATION_PID PRESCALER_SUPPORTED /begin STIM GRANULARITY_ODT_ENTRY_SIZE_STIM_BYTE 0xFF /end STIM /begin TIMESTAMP_SUPPORTED 0x0001 SIZE_DWORD UNIT_1US TIMESTAMP_FIXED /end TIMESTAMP_SUPPORTED /begin EVENT "8 ms" "8 ms" 0x0000 DAQ 0xFF 0x08 0x06 0x00 /end EVENT /end DAQ
 /begin XCP_ON_UDP_IP 0x0100 0x15B3 ADDRESS "192.168.7.2" /end XCP_ON_UDP_IP
/end IF_DATA
/begin MOD_PAR "MOD PAR Comment Goes Here"
 /begin MEMORY_SEGMENT crossARINC_out_cal_impl "crossARINC_out_cal_impl" DATA FLASH INTERN 0x00808020 0xE40 -1 -1 -1 -1 -1
  /begin IF_DATA XCP
   /begin SEGMENT 0x00 0x02 0x00 0x00 0x00
    /begin PAGE 0x00 ECU_ACCESS_DONT_CARE XCP_READ_ACCESS_DONT_CARE XCP_WRITE_ACCESS_NOT_ALLOWED /end PAGE
    /begin PAGE 0x01 ECU_ACCESS_DONT_CARE XCP_READ_ACCESS_DONT_CARE XCP_WRITE_ACCESS_DONT_CARE /end PAGE
   /end SEGMENT
  /end IF_DATA
 /end MEMORY_SEGMENT
/end MOD_PAR
/begin MOD_COMMON "Mod Common Comment Here" BYTE_ORDER MSB_LAST ALIGNMENT_BYTE 1 ALIGNMENT_WORD 2 ALIGNMENT_LONG 4 ALIGNMENT_FLOAT32_IEEE 4 ALIGNMENT_FLOAT64_IEEE 8 ALIGNMENT_INT64 8 /end MOD_COMMON
/begin CHARACTERISTIC crossARINC_out_cal_impl.CCCodeBlock1_P1 "" VALUE 0x00808C18 Scalar_FLOAT64_IEEE 0 crossARINC_out_CM_double -1.7E+308 1.7E+308 /end CHARACTERISTIC
/begin CHARACTERISTIC crossARINC_out_cal_impl.CCCodeBlock1_P2 "" VALUE 0x00808C20 Scalar_FLOAT64_IEEE 0 crossARINC_out_CM_double -1.7E+308 1.7E+308 /end CHARACTERISTIC
/begin CHARACTERISTIC crossARINC_out_cal_impl.CCCodeBlock1_P3 "" VALUE 0x00808E4D Scalar_BOOLEAN 0 crossARINC_out_CM_logical 0 1 /end CHARACTERISTIC
/begin CHARACTERISTIC crossARINC_out_cal_impl.CCCodeBlock1_P4 "" VALUE 0x00808E4E Scalar_BOOLEAN 0 crossARINC_out_CM_logical 0 1 /end CHARACTERISTIC
/begin CHARACTERISTIC crossARINC_out_cal_impl.CCCodeBlock1_P5 "" VALUE 0x00808E3C Scalar_ULONG 0 crossARINC_out_CM_uint32 0 2147483646 /end CHARACTERISTIC
/begin CHARACTERISTIC crossARINC_out_cal_impl.CCCodeBlock4_P1 "" VALUE 0x00808588 Scalar_FLOAT64_IEEE 0 crossARINC_out_CM_double -1.7E+308 1.7E+308 /end CHARACTERISTIC
/begin CHARACTERISTIC crossARINC_out_cal_impl.CCCodeBlock4_P2 "" VALUE 0x00808590 Scalar_FLOAT64_IEEE 0 crossARINC_out_CM_double -1.7E+308 1.7E+308 /end CHARACTERISTIC
/begin CHARACTERISTIC crossARINC_out_cal_impl.CCCodeBlock4_P3 "" VALUE 0x00808E40 Scalar_BOOLEAN 0 crossARINC_out_CM_logical 0 1 /end CHARACTERISTIC
/begin CHARACTERISTIC crossARINC_out_cal_impl.CCCodeBlock4_P4 "" VALUE 0x00808E41 Scalar_BOOLEAN 0 crossARINC_out_CM_logical 0 1 /end CHARACTERISTIC
/begin CHARACTERISTIC crossARINC_out_cal_impl.CCCodeBlock4_P5 "" VALUE 0x00808E30 Scalar_ULONG 0 crossARINC_out_CM_uint32 0 2147483646 /end CHARACTERISTIC
/begin CHARACTERISTIC crossARINC_out_cal_impl.CCCodeBlock5_P1 "" VALUE 0x008087E0 Scalar_FLOAT64_IEEE 0 crossARINC_out_CM_double -1.7E+308 1.7E+308 /end CHARACTERISTIC
/begin CHARACTERISTIC crossARINC_out_cal_impl.CCCodeBlock5_P2 "" VALUE 0x008087E8 Scalar_FLOAT64_IEEE 0 crossARINC_out_CM_double -1.7E+308 1.7E+308 /end CHARACTERISTIC
/begin CHARACTERISTIC crossARINC_out_cal_impl.CCCodeBlock5_P3 "" VALUE 0x00808E44 Scalar_BOOLEAN 0 crossARINC_out_CM_logical 0 1 /end CHARACTERISTIC
/begin CHARACTERISTIC crossARINC_out_cal_impl.CCCodeBlock5_P4 "" VALUE 0x00808E45 Scalar_BOOLEAN 0 crossARINC_out_CM_logical 0 1 /end CHARACTERISTIC
/begin CHARACTERISTIC crossARINC_out_cal_impl.CCCodeBlock5_P5 "" VALUE 0x00808E34 Scalar_ULONG 0 crossARINC_out_CM_uint32 0 2147483646 /end CHARACTERISTIC
/begin CHARACTERISTIC crossARINC_out_cal_impl.CCCodeBlock6_P1 "" VALUE 0x00808A18 Scalar_FLOAT64_IEEE 0 crossARINC_out_CM_double -1.7E+308 1.7E+308 /end CHARACTERISTIC
/begin CHARACTERISTIC crossARINC_out_cal_impl.CCCodeBlock6_P2 "" VALUE 0x00808A20 Scalar_FLOAT64_IEEE 0 crossARINC_out_CM_double -1.7E+308 1.7E+308 /end CHARACTERISTIC
/begin CHARACTERISTIC crossARINC_out_cal_impl.CCCodeBlock6_P3 "" VALUE 0x00808E47 Scalar_BOOLEAN 0 crossARINC_out_CM_logical 0 1 /end CHARACTERISTIC
/begin CHARACTERISTIC crossARINC_out_cal_impl.CCCodeBlock6_P4 "" VALUE 0x00808E48 Scalar_BOOLEAN 0 crossARINC_out_CM_logical 0 1 /end CHARACTERISTIC
/begin CHARACTERISTIC crossARINC_out_cal_impl.CCCodeBlock6_P5 "" VALUE 0x00808E38 Scalar_ULONG 0 crossARINC_out_CM_uint32 0 2147483646 /end CHARACTERISTIC
/begin CHARACTERISTIC crossARINC_out_cal_impl.Constant6_Value "" VALUE 0x00808E18 Scalar_FLOAT64_IEEE 0 crossARINC_out_CM_double -1.7E+308 1.7E+308 /end CHARACTERISTIC
/begin CHARACTERISTIC crossARINC_out_cal_impl.Delay1_InitialCondition "" VALUE 0x00808E43 Scalar_BOOLEAN 0 crossARINC_out_CM_logical 0 1 /end CHARACTERISTIC
/begin CHARACTERISTIC crossARINC_out_cal_impl.Delay2_InitialCondition "" VALUE 0x00808E46 Scalar_BOOLEAN 0 crossARINC_out_CM_logical 0 1 /end CHARACTERISTIC
/begin CHARACTERISTIC crossARINC_out_cal_impl.Delay3_InitialCondition "" VALUE 0x00808E49 Scalar_BOOLEAN 0 crossARINC_out_CM_logical 0 1 /end CHARACTERISTIC
/begin CHARACTERISTIC crossARINC_out_cal_impl.Delay4_InitialCondition "" VALUE 0x00808E4A Scalar_BOOLEAN 0 crossARINC_out_CM_logical 0 1 /end CHARACTERISTIC
/begin CHARACTERISTIC crossARINC_out_cal_impl.Delay5_InitialCondition "" VALUE 0x00808E4B Scalar_BOOLEAN 0 crossARINC_out_CM_logical 0 1 /end CHARACTERISTIC
/begin CHARACTERISTIC crossARINC_out_cal_impl.Delay6_InitialCondition "" VALUE 0x00808E4C Scalar_BOOLEAN 0 crossARINC_out_CM_logical 0 1 /end CHARACTERISTIC
/begin CHARACTERISTIC crossARINC_out_cal_impl.Delay7_InitialCondition "" VALUE 0x00808E4F Scalar_BOOLEAN 0 crossARINC_out_CM_logical 0 1 /end CHARACTERISTIC
/begin CHARACTERISTIC crossARINC_out_cal_impl.Delay8_InitialCondition "" VALUE 0x00808E50 Scalar_BOOLEAN 0 crossARINC_out_CM_logical 0 1 /end CHARACTERISTIC
/begin CHARACTERISTIC crossARINC_out_cal_impl.Delay_InitialCondition "" VALUE 0x00808E42 Scalar_BOOLEAN 0 crossARINC_out_CM_logical 0 1 /end CHARACTERISTIC
/begin CHARACTERISTIC crossARINC_out_cal_impl.Encodev21_P1 "" VALUE 0x00808838 Scalar_FLOAT64_IEEE 0 crossARINC_out_CM_double -1.7E+308 1.7E+308 /end CHARACTERISTIC
/begin CHARACTERISTIC crossARINC_out_cal_impl.Encodev21_P10 "" VALUE 0x00808910 Scalar_FLOAT64_IEEE 0 crossARINC_out_CM_double -1.7E+308 1.7E+308 /end CHARACTERISTIC
/begin CHARACTERISTIC crossARINC_out_cal_impl.Encodev21_P11 "" VAL_BLK 0x00808928 Scalar_FLOAT64_IEEE 0 crossARINC_out_CM_double -1.7E+308 1.7E+308 MATRIX_DIM 2 1 /end CHARACTERISTIC
/begin CHARACTERISTIC crossARINC_out_cal_impl.Encodev21_P12 "" VALUE 0x00808948 Scalar_FLOAT64_IEEE 0 crossARINC_out_CM_double -1.7E+308 1.7E+308 /end CHARACTERISTIC
/begin CHARACTERISTIC crossARINC_out_cal_impl.Encodev21_P13 "" VALUE 0x00808960 Scalar_FLOAT64_IEEE 0 crossARINC_out_CM_double -1.7E+308 1.7E+308 /end CHARACTERISTIC
/begin CHARACTERISTIC crossARINC_out_cal_impl.Encodev21_P14 "" VALUE 0x00808978 Scalar_FLOAT64_IEEE 0 crossARINC_out_CM_double -1.7E+308 1.7E+308 /end CHARACTERISTIC
/begin CHARACTERISTIC crossARINC_out_cal_impl.Encodev21_P15 "" VALUE 0x00808990 Scalar_FLOAT64_IEEE 0 crossARINC_out_CM_double -1.7E+308 1.7E+308 /end CHARACTERISTIC
/begin CHARACTERISTIC crossARINC_out_cal_impl.Encodev21_P2 "" VALUE 0x00808850 Scalar_FLOAT64_IEEE 0 crossARINC_out_CM_double -1.7E+308 1.7E+308 /end CHARACTERISTIC
/begin CHARACTERISTIC crossARINC_out_cal_impl.Encodev21_P3 "" VALUE 0x00808868 Scalar_FLOAT64_IEEE 0 crossARINC_out_CM_double -1.7E+308 1.7E+308 /end CHARACTERISTIC
/begin CHARACTERISTIC crossARINC_out_cal_impl.Encodev21_P4 "" VALUE 0x00808880 Scalar_FLOAT64_IEEE 0 crossARINC_out_CM_double -1.7E+308 1.7E+308 /end CHARACTERISTIC
/begin CHARACTERISTIC crossARINC_out_cal_impl.Encodev21_P5 "" VALUE 0x00808898 Scalar_FLOAT64_IEEE 0 crossARINC_out_CM_double -1.7E+308 1.7E+308 /end CHARACTERISTIC
/begin CHARACTERISTIC crossARINC_out_cal_impl.Encodev21_P6 "" VALUE 0x008088B0 Scalar_FLOAT64_IEEE 0 crossARINC_out_CM_double -1.7E+308 1.7E+308 /end CHARACTERISTIC
/begin CHARACTERISTIC crossARINC_out_cal_impl.Encodev21_P7 "" VALUE 0x008088C8 Scalar_FLOAT64_IEEE 0 crossARINC_out_CM_double -1.7E+308 1.7E+308 /end CHARACTERISTIC
/begin CHARACTERISTIC crossARINC_out_cal_impl.Encodev21_P8 "" VALUE 0x008088E0 Scalar_FLOAT64_IEEE 0 crossARINC_out_CM_double -1.7E+308 1.7E+308 /end CHARACTERISTIC
/begin CHARACTERISTIC crossARINC_out_cal_impl.Encodev21_P9 "" VALUE 0x008088F8 Scalar_FLOAT64_IEEE 0 crossARINC_out_CM_double -1.7E+308 1.7E+308 /end CHARACTERISTIC
/begin CHARACTERISTIC crossARINC_out_cal_impl.Encodev22_P1 "" VALUE 0x00808A38 Scalar_FLOAT64_IEEE 0 crossARINC_out_CM_double -1.7E+308 1.7E+308 /end CHARACTERISTIC
/begin CHARACTERISTIC crossARINC_out_cal_impl.Encodev22_P10 "" VALUE 0x00808B10 Scalar_FLOAT64_IEEE 0 crossARINC_out_CM_double -1.7E+308 1.7E+308 /end CHARACTERISTIC
/begin CHARACTERISTIC crossARINC_out_cal_impl.Encodev22_P11 "" VAL_BLK 0x00808B28 Scalar_FLOAT64_IEEE 0 crossARINC_out_CM_double -1.7E+308 1.7E+308 MATRIX_DIM 2 1 /end CHARACTERISTIC
/begin CHARACTERISTIC crossARINC_out_cal_impl.Encodev22_P12 "" VALUE 0x00808B48 Scalar_FLOAT64_IEEE 0 crossARINC_out_CM_double -1.7E+308 1.7E+308 /end CHARACTERISTIC
/begin CHARACTERISTIC crossARINC_out_cal_impl.Encodev22_P13 "" VALUE 0x00808B60 Scalar_FLOAT64_IEEE 0 crossARINC_out_CM_double -1.7E+308 1.7E+308 /end CHARACTERISTIC
/begin CHARACTERISTIC crossARINC_out_cal_impl.Encodev22_P14 "" VALUE 0x00808B78 Scalar_FLOAT64_IEEE 0 crossARINC_out_CM_double -1.7E+308 1.7E+308 /end CHARACTERISTIC
/begin CHARACTERISTIC crossARINC_out_cal_impl.Encodev22_P15 "" VALUE 0x00808B90 Scalar_FLOAT64_IEEE 0 crossARINC_out_CM_double -1.7E+308 1.7E+308 /end CHARACTERISTIC
/begin CHARACTERISTIC crossARINC_out_cal_impl.Encodev22_P2 "" VALUE 0x00808A50 Scalar_FLOAT64_IEEE 0 crossARINC_out_CM_double -1.7E+308 1.7E+308 /end CHARACTERISTIC
/begin CHARACTERISTIC crossARINC_out_cal_impl.Encodev22_P3 "" VALUE 0x00808A68 Scalar_FLOAT64_IEEE 0 crossARINC_out_CM_double -1.7E+308 1.7E+308 /end CHARACTERISTIC
/begin CHARACTERISTIC crossARINC_out_cal_impl.Encodev22_P4 "" VALUE 0x00808A80 Scalar_FLOAT64_IEEE 0 crossARINC_out_CM_double -1.7E+308 1.7E+308 /end CHARACTERISTIC
/begin CHARACTERISTIC crossARINC_out_cal_impl.Encodev22_P5 "" VALUE 0x00808A98 Scalar_FLOAT64_IEEE 0 crossARINC_out_CM_double -1.7E+308 1.7E+308 /end CHARACTERISTIC
/begin CHARACTERISTIC crossARINC_out_cal_impl.Encodev22_P6 "" VALUE 0x00808AB0 Scalar_FLOAT64_IEEE 0 crossARINC_out_CM_double -1.7E+308 1.7E+308 /end CHARACTERISTIC
/begin CHARACTERISTIC crossARINC_out_cal_impl.Encodev22_P7 "" VALUE 0x00808AC8 Scalar_FLOAT64_IEEE 0 crossARINC_out_CM_double -1.7E+308 1.7E+308 /end CHARACTERISTIC
/begin CHARACTERISTIC crossARINC_out_cal_impl.Encodev22_P8 "" VALUE 0x00808AE0 Scalar_FLOAT64_IEEE 0 crossARINC_out_CM_double -1.7E+308 1.7E+308 /end CHARACTERISTIC
/begin CHARACTERISTIC crossARINC_out_cal_impl.Encodev22_P9 "" VALUE 0x00808AF8 Scalar_FLOAT64_IEEE 0 crossARINC_out_CM_double -1.7E+308 1.7E+308 /end CHARACTERISTIC
/begin CHARACTERISTIC crossARINC_out_cal_impl.Encodev23_P1 "" VALUE 0x00808C70 Scalar_FLOAT64_IEEE 0 crossARINC_out_CM_double -1.7E+308 1.7E+308 /end CHARACTERISTIC
/begin CHARACTERISTIC crossARINC_out_cal_impl.Encodev23_P10 "" VALUE 0x00808D48 Scalar_FLOAT64_IEEE 0 crossARINC_out_CM_double -1.7E+308 1.7E+308 /end CHARACTERISTIC
/begin CHARACTERISTIC crossARINC_out_cal_impl.Encodev23_P11 "" VAL_BLK 0x00808D60 Scalar_FLOAT64_IEEE 0 crossARINC_out_CM_double -1.7E+308 1.7E+308 MATRIX_DIM 2 1 /end CHARACTERISTIC
/begin CHARACTERISTIC crossARINC_out_cal_impl.Encodev23_P12 "" VALUE 0x00808D80 Scalar_FLOAT64_IEEE 0 crossARINC_out_CM_double -1.7E+308 1.7E+308 /end CHARACTERISTIC
/begin CHARACTERISTIC crossARINC_out_cal_impl.Encodev23_P13 "" VALUE 0x00808D98 Scalar_FLOAT64_IEEE 0 crossARINC_out_CM_double -1.7E+308 1.7E+308 /end CHARACTERISTIC
/begin CHARACTERISTIC crossARINC_out_cal_impl.Encodev23_P14 "" VALUE 0x00808DB0 Scalar_FLOAT64_IEEE 0 crossARINC_out_CM_double -1.7E+308 1.7E+308 /end CHARACTERISTIC
/begin CHARACTERISTIC crossARINC_out_cal_impl.Encodev23_P15 "" VALUE 0x00808DC8 Scalar_FLOAT64_IEEE 0 crossARINC_out_CM_double -1.7E+308 1.7E+308 /end CHARACTERISTIC
/begin CHARACTERISTIC crossARINC_out_cal_impl.Encodev23_P2 "" VALUE 0x00808C88 Scalar_FLOAT64_IEEE 0 crossARINC_out_CM_double -1.7E+308 1.7E+308 /end CHARACTERISTIC
/begin CHARACTERISTIC crossARINC_out_cal_impl.Encodev23_P3 "" VALUE 0x00808CA0 Scalar_FLOAT64_IEEE 0 crossARINC_out_CM_double -1.7E+308 1.7E+308 /end CHARACTERISTIC
/begin CHARACTERISTIC crossARINC_out_cal_impl.Encodev23_P4 "" VALUE 0x00808CB8 Scalar_FLOAT64_IEEE 0 crossARINC_out_CM_double -1.7E+308 1.7E+308 /end CHARACTERISTIC
/begin CHARACTERISTIC crossARINC_out_cal_impl.Encodev23_P5 "" VALUE 0x00808CD0 Scalar_FLOAT64_IEEE 0 crossARINC_out_CM_double -1.7E+308 1.7E+308 /end CHARACTERISTIC
/begin CHARACTERISTIC crossARINC_out_cal_impl.Encodev23_P6 "" VALUE 0x00808CE8 Scalar_FLOAT64_IEEE 0 crossARINC_out_CM_double -1.7E+308 1.7E+308 /end CHARACTERISTIC
/begin CHARACTERISTIC crossARINC_out_cal_impl.Encodev23_P7 "" VALUE 0x00808D00 Scalar_FLOAT64_IEEE 0 crossARINC_out_CM_double -1.7E+308 1.7E+308 /end CHARACTERISTIC
/begin CHARACTERISTIC crossARINC_out_cal_impl.Encodev23_P8 "" VALUE 0x00808D18 Scalar_FLOAT64_IEEE 0 crossARINC_out_CM_double -1.7E+308 1.7E+308 /end CHARACTERISTIC
/begin CHARACTERISTIC crossARINC_out_cal_impl.Encodev23_P9 "" VALUE 0x00808D30 Scalar_FLOAT64_IEEE 0 crossARINC_out_CM_double -1.7E+308 1.7E+308 /end CHARACTERISTIC
/begin CHARACTERISTIC crossARINC_out_cal_impl.Encodev2_P1 "" VALUE 0x00808600 Scalar_FLOAT64_IEEE 0 crossARINC_out_CM_double -1.7E+308 1.7E+308 /end CHARACTERISTIC
/begin CHARACTERISTIC crossARINC_out_cal_impl.Encodev2_P10 "" VALUE 0x008086D8 Scalar_FLOAT64_IEEE 0 crossARINC_out_CM_double -1.7E+308 1.7E+308 /end CHARACTERISTIC
/begin CHARACTERISTIC crossARINC_out_cal_impl.Encodev2_P11 "" VAL_BLK 0x008086F0 Scalar_FLOAT64_IEEE 0 crossARINC_out_CM_double -1.7E+308 1.7E+308 MATRIX_DIM 2 1 /end CHARACTERISTIC
/begin CHARACTERISTIC crossARINC_out_cal_impl.Encodev2_P12 "" VALUE 0x00808710 Scalar_FLOAT64_IEEE 0 crossARINC_out_CM_double -1.7E+308 1.7E+308 /end CHARACTERISTIC
/begin CHARACTERISTIC crossARINC_out_cal_impl.Encodev2_P13 "" VALUE 0x00808728 Scalar_FLOAT64_IEEE 0 crossARINC_out_CM_double -1.7E+308 1.7E+308 /end CHARACTERISTIC
/begin CHARACTERISTIC crossARINC_out_cal_impl.Encodev2_P14 "" VALUE 0x00808740 Scalar_FLOAT64_IEEE 0 crossARINC_out_CM_double -1.7E+308 1.7E+308 /end CHARACTERISTIC
/begin CHARACTERISTIC crossARINC_out_cal_impl.Encodev2_P15 "" VALUE 0x00808758 Scalar_FLOAT64_IEEE 0 crossARINC_out_CM_double -1.7E+308 1.7E+308 /end CHARACTERISTIC
/begin CHARACTERISTIC crossARINC_out_cal_impl.Encodev2_P2 "" VALUE 0x00808618 Scalar_FLOAT64_IEEE 0 crossARINC_out_CM_double -1.7E+308 1.7E+308 /end CHARACTERISTIC
/begin CHARACTERISTIC crossARINC_out_cal_impl.Encodev2_P3 "" VALUE 0x00808630 Scalar_FLOAT64_IEEE 0 crossARINC_out_CM_double -1.7E+308 1.7E+308 /end CHARACTERISTIC
/begin CHARACTERISTIC crossARINC_out_cal_impl.Encodev2_P4 "" VALUE 0x00808648 Scalar_FLOAT64_IEEE 0 crossARINC_out_CM_double -1.7E+308 1.7E+308 /end CHARACTERISTIC
/begin CHARACTERISTIC crossARINC_out_cal_impl.Encodev2_P5 "" VALUE 0x00808660 Scalar_FLOAT64_IEEE 0 crossARINC_out_CM_double -1.7E+308 1.7E+308 /end CHARACTERISTIC
/begin CHARACTERISTIC crossARINC_out_cal_impl.Encodev2_P6 "" VALUE 0x00808678 Scalar_FLOAT64_IEEE 0 crossARINC_out_CM_double -1.7E+308 1.7E+308 /end CHARACTERISTIC
/begin CHARACTERISTIC crossARINC_out_cal_impl.Encodev2_P7 "" VALUE 0x00808690 Scalar_FLOAT64_IEEE 0 crossARINC_out_CM_double -1.7E+308 1.7E+308 /end CHARACTERISTIC
/begin CHARACTERISTIC crossARINC_out_cal_impl.Encodev2_P8 "" VALUE 0x008086A8 Scalar_FLOAT64_IEEE 0 crossARINC_out_CM_double -1.7E+308 1.7E+308 /end CHARACTERISTIC
/begin CHARACTERISTIC crossARINC_out_cal_impl.Encodev2_P9 "" VALUE 0x008086C0 Scalar_FLOAT64_IEEE 0 crossARINC_out_CM_double -1.7E+308 1.7E+308 /end CHARACTERISTIC
/begin CHARACTERISTIC crossARINC_out_cal_impl.Gain10_Gain "" VALUE 0x00808E2C Scalar_ULONG 0 crossARINC_out_CM_ufix32_En31 0.0 2 /end CHARACTERISTIC
/begin CHARACTERISTIC crossARINC_out_cal_impl.Gain11_Gain "" VALUE 0x00808E54 Scalar_UBYTE 0 crossARINC_out_CM_ufix8_E5 0.0 8160 /end CHARACTERISTIC
/begin CHARACTERISTIC crossARINC_out_cal_impl.Gain12_Gain "" VALUE 0x00808E55 Scalar_UBYTE 0 crossARINC_out_CM_ufix8_E6 0.0 16320 /end CHARACTERISTIC
/begin CHARACTERISTIC crossARINC_out_cal_impl.Gain13_Gain "" VALUE 0x00808E52 Scalar_UBYTE 0 crossARINC_out_CM_ufix8_E11 0.0 522240 /end CHARACTERISTIC
/begin CHARACTERISTIC crossARINC_out_cal_impl.Gain14_Gain "" VALUE 0x00808E5B Scalar_UBYTE 0 crossARINC_out_CM_ufix8_En7 0.0 1.9922 /end CHARACTERISTIC
/begin CHARACTERISTIC crossARINC_out_cal_impl.Gain15_Gain "" VALUE 0x00808E20 Scalar_ULONG 0 crossARINC_out_CM_ufix32_En30 0.0 4 /end CHARACTERISTIC
/begin CHARACTERISTIC crossARINC_out_cal_impl.Gain16_Gain "" VALUE 0x00808E56 Scalar_UBYTE 0 crossARINC_out_CM_ufix8_E8 0.0 65280 /end CHARACTERISTIC
/begin CHARACTERISTIC crossARINC_out_cal_impl.Gain17_Gain "" VALUE 0x00808E5C Scalar_UBYTE 0 crossARINC_out_CM_ufix8_En7 0.0 1.9922 /end CHARACTERISTIC
/begin CHARACTERISTIC crossARINC_out_cal_impl.Gain18_Gain "" VALUE 0x00808E53 Scalar_UBYTE 0 crossARINC_out_CM_ufix8_E11 0.0 522240 /end CHARACTERISTIC
/begin CHARACTERISTIC crossARINC_out_cal_impl.Gain19_Gain "" VALUE 0x00808E59 Scalar_UBYTE 0 crossARINC_out_CM_ufix8_E9 0.0 130560 /end CHARACTERISTIC
/begin CHARACTERISTIC crossARINC_out_cal_impl.Gain1_Gain "" VALUE 0x00808E5D Scalar_UBYTE 0 crossARINC_out_CM_ufix8_En7 0.0 1.9922 /end CHARACTERISTIC
/begin CHARACTERISTIC crossARINC_out_cal_impl.Gain20_Gain "" VALUE 0x00808E57 Scalar_UBYTE 0 crossARINC_out_CM_ufix8_E8 0.0 65280 /end CHARACTERISTIC
/begin CHARACTERISTIC crossARINC_out_cal_impl.Gain21_Gain "" VALUE 0x00808E24 Scalar_ULONG 0 crossARINC_out_CM_ufix32_En30 0.0 4 /end CHARACTERISTIC
/begin CHARACTERISTIC crossARINC_out_cal_impl.Gain2_Gain "" VALUE 0x00808E51 Scalar_UBYTE 0 crossARINC_out_CM_ufix8_E10 0.0 261120 /end CHARACTERISTIC
/begin CHARACTERISTIC crossARINC_out_cal_impl.Gain3_Gain "" VALUE 0x00808E5A Scalar_UBYTE 0 crossARINC_out_CM_ufix8_E9 0.0 130560 /end CHARACTERISTIC
/begin CHARACTERISTIC crossARINC_out_cal_impl.Gain4_Gain "" VALUE 0x00808E58 Scalar_UBYTE 0 crossARINC_out_CM_ufix8_E8 0.0 65280 /end CHARACTERISTIC
/begin CHARACTERISTIC crossARINC_out_cal_impl.Gain5_Gain "" VALUE 0x00808E28 Scalar_ULONG 0 crossARINC_out_CM_ufix32_En30 0.0 4 /end CHARACTERISTIC
/begin CHARACTERISTIC crossARINC_out_cal_impl.PulseGenerator_Amp "" VALUE 0x00808598 Scalar_FLOAT64_IEEE 0 crossARINC_out_CM_double -1.7E+308 1.7E+308 /end CHARACTERISTIC
/begin CHARACTERISTIC crossARINC_out_cal_impl.PulseGenerator_Duty "" VALUE 0x008085A8 Scalar_FLOAT64_IEEE 0 crossARINC_out_CM_double -1.7E+308 1.7E+308 /end CHARACTERISTIC
/begin CHARACTERISTIC crossARINC_out_cal_impl.PulseGenerator_Period "" VALUE 0x008085A0 Scalar_FLOAT64_IEEE 0 crossARINC_out_CM_double -1.7E+308 1.7E+308 /end CHARACTERISTIC
/begin CHARACTERISTIC crossARINC_out_cal_impl.PulseGenerator_PhaseDelay "" VALUE 0x008085B0 Scalar_FLOAT64_IEEE 0 crossARINC_out_CM_double -1.7E+308 1.7E+308 /end CHARACTERISTIC
/begin CHARACTERISTIC crossARINC_out_cal_impl.Sendv31_P1 "" VALUE 0x008089A8 Scalar_FLOAT64_IEEE 0 crossARINC_out_CM_double -1.7E+308 1.7E+308 /end CHARACTERISTIC
/begin CHARACTERISTIC crossARINC_out_cal_impl.Sendv31_P2 "" VALUE 0x008089C0 Scalar_FLOAT64_IEEE 0 crossARINC_out_CM_double -1.7E+308 1.7E+308 /end CHARACTERISTIC
/begin CHARACTERISTIC crossARINC_out_cal_impl.Sendv31_P3 "" VALUE 0x008089D8 Scalar_FLOAT64_IEEE 0 crossARINC_out_CM_double -1.7E+308 1.7E+308 /end CHARACTERISTIC
/begin CHARACTERISTIC crossARINC_out_cal_impl.Sendv32_P1 "" VALUE 0x00808BA8 Scalar_FLOAT64_IEEE 0 crossARINC_out_CM_double -1.7E+308 1.7E+308 /end CHARACTERISTIC
/begin CHARACTERISTIC crossARINC_out_cal_impl.Sendv32_P2 "" VALUE 0x00808BC0 Scalar_FLOAT64_IEEE 0 crossARINC_out_CM_double -1.7E+308 1.7E+308 /end CHARACTERISTIC
/begin CHARACTERISTIC crossARINC_out_cal_impl.Sendv32_P3 "" VALUE 0x00808BD8 Scalar_FLOAT64_IEEE 0 crossARINC_out_CM_double -1.7E+308 1.7E+308 /end CHARACTERISTIC
/begin CHARACTERISTIC crossARINC_out_cal_impl.Sendv33_P1 "" VALUE 0x00808DE0 Scalar_FLOAT64_IEEE 0 crossARINC_out_CM_double -1.7E+308 1.7E+308 /end CHARACTERISTIC
/begin CHARACTERISTIC crossARINC_out_cal_impl.Sendv33_P2 "" VALUE 0x00808DF8 Scalar_FLOAT64_IEEE 0 crossARINC_out_CM_double -1.7E+308 1.7E+308 /end CHARACTERISTIC
/begin CHARACTERISTIC crossARINC_out_cal_impl.Sendv33_P3 "" VALUE 0x00808E10 Scalar_FLOAT64_IEEE 0 crossARINC_out_CM_double -1.7E+308 1.7E+308 /end CHARACTERISTIC
/begin CHARACTERISTIC crossARINC_out_cal_impl.Sendv3_P1 "" VALUE 0x00808770 Scalar_FLOAT64_IEEE 0 crossARINC_out_CM_double -1.7E+308 1.7E+308 /end CHARACTERISTIC
/begin CHARACTERISTIC crossARINC_out_cal_impl.Sendv3_P2 "" VALUE 0x00808788 Scalar_FLOAT64_IEEE 0 crossARINC_out_CM_double -1.7E+308 1.7E+308 /end CHARACTERISTIC
/begin CHARACTERISTIC crossARINC_out_cal_impl.Sendv3_P3 "" VALUE 0x008087A0 Scalar_FLOAT64_IEEE 0 crossARINC_out_CM_double -1.7E+308 1.7E+308 /end CHARACTERISTIC
/begin CHARACTERISTIC crossARINC_out_cal_impl.Setupv2_P1 "" VALUE 0x00808030 Scalar_FLOAT64_IEEE 0 crossARINC_out_CM_double -1.7E+308 1.7E+308 /end CHARACTERISTIC
/begin CHARACTERISTIC crossARINC_out_cal_impl.Setupv2_P2 "" VALUE 0x00808048 Scalar_FLOAT64_IEEE 0 crossARINC_out_CM_double -1.7E+308 1.7E+308 /end CHARACTERISTIC
/begin CHARACTERISTIC crossARINC_out_cal_impl.Setupv2_P3 "" VALUE 0x00808060 Scalar_FLOAT64_IEEE 0 crossARINC_out_CM_double -1.7E+308 1.7E+308 /end CHARACTERISTIC
/begin CHARACTERISTIC crossARINC_out_cal_impl.Setupv2_P4 "" VALUE 0x00808078 Scalar_FLOAT64_IEEE 0 crossARINC_out_CM_double -1.7E+308 1.7E+308 /end CHARACTERISTIC
/begin CHARACTERISTIC crossARINC_out_cal_impl.Setupv2_P5 "" VALUE 0x00808090 Scalar_FLOAT64_IEEE 0 crossARINC_out_CM_double -1.7E+308 1.7E+308 /end CHARACTERISTIC
/begin CHARACTERISTIC crossARINC_out_cal_impl.Setupv2_P6 "" VALUE 0x008080A8 Scalar_FLOAT64_IEEE 0 crossARINC_out_CM_double -1.7E+308 1.7E+308 /end CHARACTERISTIC
/begin CHARACTERISTIC crossARINC_out_cal_impl.Setupv2_P7 "" VAL_BLK 0x008080C0 Scalar_FLOAT64_IEEE 0 crossARINC_out_CM_double -1.7E+308 1.7E+308 MATRIX_DIM 5 16 /end CHARACTERISTIC
/begin CHARACTERISTIC crossARINC_out_cal_impl.Setupv2_P8 "" VAL_BLK 0x00808350 Scalar_FLOAT64_IEEE 0 crossARINC_out_CM_double -1.7E+308 1.7E+308 MATRIX_DIM 4 16 /end CHARACTERISTIC
/begin CHARACTERISTIC crossARINC_out_cal_impl.SineWave1_Amp "" VALUE 0x008087A8 Scalar_FLOAT64_IEEE 0 crossARINC_out_CM_double -1.7E+308 1.7E+308 /end CHARACTERISTIC
/begin CHARACTERISTIC crossARINC_out_cal_impl.SineWave1_Bias "" VALUE 0x008087B0 Scalar_FLOAT64_IEEE 0 crossARINC_out_CM_double -1.7E+308 1.7E+308 /end CHARACTERISTIC
/begin CHARACTERISTIC crossARINC_out_cal_impl.SineWave1_Freq "" VALUE 0x008087B8 Scalar_FLOAT64_IEEE 0 crossARINC_out_CM_double -1.7E+308 1.7E+308 /end CHARACTERISTIC
/begin CHARACTERISTIC crossARINC_out_cal_impl.SineWave1_HCos "" VALUE 0x008087C8 Scalar_FLOAT64_IEEE 0 crossARINC_out_CM_double -1.7E+308 1.7E+308 /end CHARACTERISTIC
/begin CHARACTERISTIC crossARINC_out_cal_impl.SineWave1_Hsin "" VALUE 0x008087C0 Scalar_FLOAT64_IEEE 0 crossARINC_out_CM_double -1.7E+308 1.7E+308 /end CHARACTERISTIC
/begin CHARACTERISTIC crossARINC_out_cal_impl.SineWave1_PCos "" VALUE 0x008087D8 Scalar_FLOAT64_IEEE 0 crossARINC_out_CM_double -1.7E+308 1.7E+308 /end CHARACTERISTIC
/begin CHARACTERISTIC crossARINC_out_cal_impl.SineWave1_PSin "" VALUE 0x008087D0 Scalar_FLOAT64_IEEE 0 crossARINC_out_CM_double -1.7E+308 1.7E+308 /end CHARACTERISTIC
/begin CHARACTERISTIC crossARINC_out_cal_impl.SineWave2_Amp "" VALUE 0x008087F0 Scalar_FLOAT64_IEEE 0 crossARINC_out_CM_double -1.7E+308 1.7E+308 /end CHARACTERISTIC
/begin CHARACTERISTIC crossARINC_out_cal_impl.SineWave2_Bias "" VALUE 0x008087F8 Scalar_FLOAT64_IEEE 0 crossARINC_out_CM_double -1.7E+308 1.7E+308 /end CHARACTERISTIC
/begin CHARACTERISTIC crossARINC_out_cal_impl.SineWave2_Freq "" VALUE 0x00808800 Scalar_FLOAT64_IEEE 0 crossARINC_out_CM_double -1.7E+308 1.7E+308 /end CHARACTERISTIC
/begin CHARACTERISTIC crossARINC_out_cal_impl.SineWave2_HCos "" VALUE 0x00808810 Scalar_FLOAT64_IEEE 0 crossARINC_out_CM_double -1.7E+308 1.7E+308 /end CHARACTERISTIC
/begin CHARACTERISTIC crossARINC_out_cal_impl.SineWave2_Hsin "" VALUE 0x00808808 Scalar_FLOAT64_IEEE 0 crossARINC_out_CM_double -1.7E+308 1.7E+308 /end CHARACTERISTIC
/begin CHARACTERISTIC crossARINC_out_cal_impl.SineWave2_PCos "" VALUE 0x00808820 Scalar_FLOAT64_IEEE 0 crossARINC_out_CM_double -1.7E+308 1.7E+308 /end CHARACTERISTIC
/begin CHARACTERISTIC crossARINC_out_cal_impl.SineWave2_PSin "" VALUE 0x00808818 Scalar_FLOAT64_IEEE 0 crossARINC_out_CM_double -1.7E+308 1.7E+308 /end CHARACTERISTIC
/begin CHARACTERISTIC crossARINC_out_cal_impl.SineWave3_Amp "" VALUE 0x008089E0 Scalar_FLOAT64_IEEE 0 crossARINC_out_CM_double -1.7E+308 1.7E+308 /end CHARACTERISTIC
/begin CHARACTERISTIC crossARINC_out_cal_impl.SineWave3_Bias "" VALUE 0x008089E8 Scalar_FLOAT64_IEEE 0 crossARINC_out_CM_double -1.7E+308 1.7E+308 /end CHARACTERISTIC
/begin CHARACTERISTIC crossARINC_out_cal_impl.SineWave3_Freq "" VALUE 0x008089F0 Scalar_FLOAT64_IEEE 0 crossARINC_out_CM_double -1.7E+308 1.7E+308 /end CHARACTERISTIC
/begin CHARACTERISTIC crossARINC_out_cal_impl.SineWave3_HCos "" VALUE 0x00808A00 Scalar_FLOAT64_IEEE 0 crossARINC_out_CM_double -1.7E+308 1.7E+308 /end CHARACTERISTIC
/begin CHARACTERISTIC crossARINC_out_cal_impl.SineWave3_Hsin "" VALUE 0x008089F8 Scalar_FLOAT64_IEEE 0 crossARINC_out_CM_double -1.7E+308 1.7E+308 /end CHARACTERISTIC
/begin CHARACTERISTIC crossARINC_out_cal_impl.SineWave3_PCos "" VALUE 0x00808A10 Scalar_FLOAT64_IEEE 0 crossARINC_out_CM_double -1.7E+308 1.7E+308 /end CHARACTERISTIC
/begin CHARACTERISTIC crossARINC_out_cal_impl.SineWave3_PSin "" VALUE 0x00808A08 Scalar_FLOAT64_IEEE 0 crossARINC_out_CM_double -1.7E+308 1.7E+308 /end CHARACTERISTIC
/begin CHARACTERISTIC crossARINC_out_cal_impl.SineWave4_Amp "" VALUE 0x00808BE0 Scalar_FLOAT64_IEEE 0 crossARINC_out_CM_double -1.7E+308 1.7E+308 /end CHARACTERISTIC
/begin CHARACTERISTIC crossARINC_out_cal_impl.SineWave4_Bias "" VALUE 0x00808BE8 Scalar_FLOAT64_IEEE 0 crossARINC_out_CM_double -1.7E+308 1.7E+308 /end CHARACTERISTIC
/begin CHARACTERISTIC crossARINC_out_cal_impl.SineWave4_Freq "" VALUE 0x00808BF0 Scalar_FLOAT64_IEEE 0 crossARINC_out_CM_double -1.7E+308 1.7E+308 /end CHARACTERISTIC
/begin CHARACTERISTIC crossARINC_out_cal_impl.SineWave4_HCos "" VALUE 0x00808C00 Scalar_FLOAT64_IEEE 0 crossARINC_out_CM_double -1.7E+308 1.7E+308 /end CHARACTERISTIC
/begin CHARACTERISTIC crossARINC_out_cal_impl.SineWave4_Hsin "" VALUE 0x00808BF8 Scalar_FLOAT64_IEEE 0 crossARINC_out_CM_double -1.7E+308 1.7E+308 /end CHARACTERISTIC
/begin CHARACTERISTIC crossARINC_out_cal_impl.SineWave4_PCos "" VALUE 0x00808C10 Scalar_FLOAT64_IEEE 0 crossARINC_out_CM_double -1.7E+308 1.7E+308 /end CHARACTERISTIC
/begin CHARACTERISTIC crossARINC_out_cal_impl.SineWave4_PSin "" VALUE 0x00808C08 Scalar_FLOAT64_IEEE 0 crossARINC_out_CM_double -1.7E+308 1.7E+308 /end CHARACTERISTIC
/begin CHARACTERISTIC crossARINC_out_cal_impl.SineWave5_Amp "" VALUE 0x00808C28 Scalar_FLOAT64_IEEE 0 crossARINC_out_CM_double -1.7E+308 1.7E+308 /end CHARACTERISTIC
/begin CHARACTERISTIC crossARINC_out_cal_impl.SineWave5_Bias "" VALUE 0x00808C30 Scalar_FLOAT64_IEEE 0 crossARINC_out_CM_double -1.7E+308 1.7E+308 /end CHARACTERISTIC
/begin CHARACTERISTIC crossARINC_out_cal_impl.SineWave5_Freq "" VALUE 0x00808C38 Scalar_FLOAT64_IEEE 0 crossARINC_out_CM_double -1.7E+308 1.7E+308 /end CHARACTERISTIC
/begin CHARACTERISTIC crossARINC_out_cal_impl.SineWave5_HCos "" VALUE 0x00808C48 Scalar_FLOAT64_IEEE 0 crossARINC_out_CM_double -1.7E+308 1.7E+308 /end CHARACTERISTIC
/begin CHARACTERISTIC crossARINC_out_cal_impl.SineWave5_Hsin "" VALUE 0x00808C40 Scalar_FLOAT64_IEEE 0 crossARINC_out_CM_double -1.7E+308 1.7E+308 /end CHARACTERISTIC
/begin CHARACTERISTIC crossARINC_out_cal_impl.SineWave5_PCos "" VALUE 0x00808C58 Scalar_FLOAT64_IEEE 0 crossARINC_out_CM_double -1.7E+308 1.7E+308 /end CHARACTERISTIC
/begin CHARACTERISTIC crossARINC_out_cal_impl.SineWave5_PSin "" VALUE 0x00808C50 Scalar_FLOAT64_IEEE 0 crossARINC_out_CM_double -1.7E+308 1.7E+308 /end CHARACTERISTIC
/begin CHARACTERISTIC crossARINC_out_cal_impl.SineWave6_Amp "" VALUE 0x008085B8 Scalar_FLOAT64_IEEE 0 crossARINC_out_CM_double -1.7E+308 1.7E+308 /end CHARACTERISTIC
/begin CHARACTERISTIC crossARINC_out_cal_impl.SineWave6_Bias "" VALUE 0x008085C0 Scalar_FLOAT64_IEEE 0 crossARINC_out_CM_double -1.7E+308 1.7E+308 /end CHARACTERISTIC
/begin CHARACTERISTIC crossARINC_out_cal_impl.SineWave6_Freq "" VALUE 0x008085C8 Scalar_FLOAT64_IEEE 0 crossARINC_out_CM_double -1.7E+308 1.7E+308 /end CHARACTERISTIC
/begin CHARACTERISTIC crossARINC_out_cal_impl.SineWave6_HCos "" VALUE 0x008085D8 Scalar_FLOAT64_IEEE 0 crossARINC_out_CM_double -1.7E+308 1.7E+308 /end CHARACTERISTIC
/begin CHARACTERISTIC crossARINC_out_cal_impl.SineWave6_Hsin "" VALUE 0x008085D0 Scalar_FLOAT64_IEEE 0 crossARINC_out_CM_double -1.7E+308 1.7E+308 /end CHARACTERISTIC
/begin CHARACTERISTIC crossARINC_out_cal_impl.SineWave6_PCos "" VALUE 0x008085E8 Scalar_FLOAT64_IEEE 0 crossARINC_out_CM_double -1.7E+308 1.7E+308 /end CHARACTERISTIC
/begin CHARACTERISTIC crossARINC_out_cal_impl.SineWave6_PSin "" VALUE 0x008085E0 Scalar_FLOAT64_IEEE 0 crossARINC_out_CM_double -1.7E+308 1.7E+308 /end CHARACTERISTIC
/begin CHARACTERISTIC crossARINC_out_cal_impl.SineWave_Amp "" VALUE 0x00808550 Scalar_FLOAT64_IEEE 0 crossARINC_out_CM_double -1.7E+308 1.7E+308 /end CHARACTERISTIC
/begin CHARACTERISTIC crossARINC_out_cal_impl.SineWave_Bias "" VALUE 0x00808558 Scalar_FLOAT64_IEEE 0 crossARINC_out_CM_double -1.7E+308 1.7E+308 /end CHARACTERISTIC
/begin CHARACTERISTIC crossARINC_out_cal_impl.SineWave_Freq "" VALUE 0x00808560 Scalar_FLOAT64_IEEE 0 crossARINC_out_CM_double -1.7E+308 1.7E+308 /end CHARACTERISTIC
/begin CHARACTERISTIC crossARINC_out_cal_impl.SineWave_HCos "" VALUE 0x00808570 Scalar_FLOAT64_IEEE 0 crossARINC_out_CM_double -1.7E+308 1.7E+308 /end CHARACTERISTIC
/begin CHARACTERISTIC crossARINC_out_cal_impl.SineWave_Hsin "" VALUE 0x00808568 Scalar_FLOAT64_IEEE 0 crossARINC_out_CM_double -1.7E+308 1.7E+308 /end CHARACTERISTIC
/begin CHARACTERISTIC crossARINC_out_cal_impl.SineWave_PCos "" VALUE 0x00808580 Scalar_FLOAT64_IEEE 0 crossARINC_out_CM_double -1.7E+308 1.7E+308 /end CHARACTERISTIC
/begin CHARACTERISTIC crossARINC_out_cal_impl.SineWave_PSin "" VALUE 0x00808578 Scalar_FLOAT64_IEEE 0 crossARINC_out_CM_double -1.7E+308 1.7E+308 /end CHARACTERISTIC
/begin MEASUREMENT crossARINC_out_B.Add1 "" ULONG crossARINC_out_CM_uint32 0 0 0 2147483646 ECU_ADDRESS 0x0080DC08 /end MEASUREMENT
/begin MEASUREMENT crossARINC_out_B.Add3 "" ULONG crossARINC_out_CM_uint32 0 0 0 2147483646 ECU_ADDRESS 0x0080DBBC /end MEASUREMENT
/begin MEASUREMENT crossARINC_out_B.Add4 "" ULONG crossARINC_out_CM_uint32 0 0 0 2147483646 ECU_ADDRESS 0x0080DBD0 /end MEASUREMENT
/begin MEASUREMENT crossARINC_out_B.Add5 "" ULONG crossARINC_out_CM_uint32 0 0 0 2147483646 ECU_ADDRESS 0x0080DBEC /end MEASUREMENT
/begin MEASUREMENT crossARINC_out_B.CCCodeBlock1 "" ULONG crossARINC_out_CM_uint32 0 0 0 2147483646 ECU_ADDRESS 0x0080DBF4 /end MEASUREMENT
/begin MEASUREMENT crossARINC_out_B.CCCodeBlock4 "" ULONG crossARINC_out_CM_uint32 0 0 0 2147483646 ECU_ADDRESS 0x0080DBA8 /end MEASUREMENT
/begin MEASUREMENT crossARINC_out_B.CCCodeBlock5 "" ULONG crossARINC_out_CM_uint32 0 0 0 2147483646 ECU_ADDRESS 0x0080DBC4 /end MEASUREMENT
/begin MEASUREMENT crossARINC_out_B.CCCodeBlock6 "" ULONG crossARINC_out_CM_uint32 0 0 0 2147483646 ECU_ADDRESS 0x0080DBD8 /end MEASUREMENT
/begin MEASUREMENT crossARINC_out_B.Constant6 "" FLOAT64_IEEE crossARINC_out_CM_double 0 0 -1.7E+308 1.7E+308 ECU_ADDRESS 0x0080DBA0 /end MEASUREMENT
/begin MEASUREMENT crossARINC_out_B.DataTypeConversion1 "" FLOAT64_IEEE crossARINC_out_CM_double 0 0 -1.7E+308 1.7E+308 ECU_ADDRESS 0x0080DB88 /end MEASUREMENT
/begin MEASUREMENT crossARINC_out_B.DataTypeConversion10 "" FLOAT32_IEEE crossARINC_out_CM_single 0 0 -3.4E+38 3.4E+38 ECU_ADDRESS 0x0080DC18 /end MEASUREMENT
/begin MEASUREMENT crossARINC_out_B.DataTypeConversion11 "" UBYTE crossARINC_out_CM_uint8 0 0 0 255 ECU_ADDRESS 0x0080DC1E /end MEASUREMENT
/begin MEASUREMENT crossARINC_out_B.DataTypeConversion12 "" UBYTE crossARINC_out_CM_uint8 0 0 0 255 ECU_ADDRESS 0x0080DC1C /end MEASUREMENT
/begin MEASUREMENT crossARINC_out_B.DataTypeConversion2 "" FLOAT32_IEEE crossARINC_out_CM_single 0 0 -3.4E+38 3.4E+38 ECU_ADDRESS 0x0080DC0C /end MEASUREMENT
/begin MEASUREMENT crossARINC_out_B.DataTypeConversion3 "" FLOAT64_IEEE crossARINC_out_CM_double 0 0 -1.7E+308 1.7E+308 ECU_ADDRESS 0x0080DB28 /end MEASUREMENT
/begin MEASUREMENT crossARINC_out_B.DataTypeConversion4 "" FLOAT64_IEEE crossARINC_out_CM_double 0 0 -1.7E+308 1.7E+308 ECU_ADDRESS 0x0080DB50 /end MEASUREMENT
/begin MEASUREMENT crossARINC_out_B.DataTypeConversion5 "" FLOAT64_IEEE crossARINC_out_CM_double 0 0 -1.7E+308 1.7E+308 ECU_ADDRESS 0x0080DB70 /end MEASUREMENT
/begin MEASUREMENT crossARINC_out_B.DataTypeConversion6 "" UBYTE crossARINC_out_CM_logical 0 0 0 1 ECU_ADDRESS 0x0080DC1F /end MEASUREMENT
/begin MEASUREMENT crossARINC_out_B.DataTypeConversion7 "" FLOAT32_IEEE crossARINC_out_CM_single 0 0 -3.4E+38 3.4E+38 ECU_ADDRESS 0x0080DC10 /end MEASUREMENT
/begin MEASUREMENT crossARINC_out_B.DataTypeConversion8 "" UBYTE crossARINC_out_CM_uint8 0 0 0 255 ECU_ADDRESS 0x0080DC1D /end MEASUREMENT
/begin MEASUREMENT crossARINC_out_B.DataTypeConversion9 "" FLOAT32_IEEE crossARINC_out_CM_single 0 0 -3.4E+38 3.4E+38 ECU_ADDRESS 0x0080DC14 /end MEASUREMENT
/begin MEASUREMENT crossARINC_out_B.Delay "" UBYTE crossARINC_out_CM_logical 0 0 0 1 ECU_ADDRESS 0x0080DC20 /end MEASUREMENT
/begin MEASUREMENT crossARINC_out_B.Delay1 "" UBYTE crossARINC_out_CM_logical 0 0 0 1 ECU_ADDRESS 0x0080DC21 /end MEASUREMENT
/begin MEASUREMENT crossARINC_out_B.Delay2 "" UBYTE crossARINC_out_CM_logical 0 0 0 1 ECU_ADDRESS 0x0080DC22 /end MEASUREMENT
/begin MEASUREMENT crossARINC_out_B.Delay3 "" UBYTE crossARINC_out_CM_logical 0 0 0 1 ECU_ADDRESS 0x0080DC23 /end MEASUREMENT
/begin MEASUREMENT crossARINC_out_B.Delay4 "" UBYTE crossARINC_out_CM_logical 0 0 0 1 ECU_ADDRESS 0x0080DC24 /end MEASUREMENT
/begin MEASUREMENT crossARINC_out_B.Delay5 "" UBYTE crossARINC_out_CM_logical 0 0 0 1 ECU_ADDRESS 0x0080DC25 /end MEASUREMENT
/begin MEASUREMENT crossARINC_out_B.Delay6 "" UBYTE crossARINC_out_CM_logical 0 0 0 1 ECU_ADDRESS 0x0080DC26 /end MEASUREMENT
/begin MEASUREMENT crossARINC_out_B.Delay7 "" UBYTE crossARINC_out_CM_logical 0 0 0 1 ECU_ADDRESS 0x0080DC27 /end MEASUREMENT
/begin MEASUREMENT crossARINC_out_B.Delay8 "" UBYTE crossARINC_out_CM_logical 0 0 0 1 ECU_ADDRESS 0x0080DC28 /end MEASUREMENT
/begin MEASUREMENT crossARINC_out_B.Encodev2 "" FLOAT64_IEEE crossARINC_out_CM_double 0 0 -1.7E+308 1.7E+308 ECU_ADDRESS 0x0080DB40 /end MEASUREMENT
/begin MEASUREMENT crossARINC_out_B.Encodev21 "" FLOAT64_IEEE crossARINC_out_CM_double 0 0 -1.7E+308 1.7E+308 ECU_ADDRESS 0x0080DB60 /end MEASUREMENT
/begin MEASUREMENT crossARINC_out_B.Encodev22 "" FLOAT64_IEEE crossARINC_out_CM_double 0 0 -1.7E+308 1.7E+308 ECU_ADDRESS 0x0080DB78 /end MEASUREMENT
/begin MEASUREMENT crossARINC_out_B.Encodev23 "" FLOAT64_IEEE crossARINC_out_CM_double 0 0 -1.7E+308 1.7E+308 ECU_ADDRESS 0x0080DB98 /end MEASUREMENT
/begin MEASUREMENT crossARINC_out_B.Gain1 "" ULONG crossARINC_out_CM_uint32 0 0 0 2147483646 ECU_ADDRESS 0x0080DBF0 /end MEASUREMENT
/begin MEASUREMENT crossARINC_out_B.Gain10 "" ULONG crossARINC_out_CM_uint32 0 0 0 2147483646 ECU_ADDRESS 0x0080DBAC /end MEASUREMENT
/begin MEASUREMENT crossARINC_out_B.Gain11 "" ULONG crossARINC_out_CM_uint32 0 0 0 2147483646 ECU_ADDRESS 0x0080DBB0 /end MEASUREMENT
/begin MEASUREMENT crossARINC_out_B.Gain12 "" ULONG crossARINC_out_CM_uint32 0 0 0 2147483646 ECU_ADDRESS 0x0080DBB4 /end MEASUREMENT
/begin MEASUREMENT crossARINC_out_B.Gain13 "" ULONG crossARINC_out_CM_uint32 0 0 0 2147483646 ECU_ADDRESS 0x0080DBB8 /end MEASUREMENT
/begin MEASUREMENT crossARINC_out_B.Gain14 "" ULONG crossARINC_out_CM_uint32 0 0 0 2147483646 ECU_ADDRESS 0x0080DBC0 /end MEASUREMENT
/begin MEASUREMENT crossARINC_out_B.Gain15 "" ULONG crossARINC_out_CM_uint32 0 0 0 2147483646 ECU_ADDRESS 0x0080DBC8 /end MEASUREMENT
/begin MEASUREMENT crossARINC_out_B.Gain16 "" ULONG crossARINC_out_CM_uint32 0 0 0 2147483646 ECU_ADDRESS 0x0080DBCC /end MEASUREMENT
/begin MEASUREMENT crossARINC_out_B.Gain17 "" ULONG crossARINC_out_CM_uint32 0 0 0 2147483646 ECU_ADDRESS 0x0080DBD4 /end MEASUREMENT
/begin MEASUREMENT crossARINC_out_B.Gain18 "" ULONG crossARINC_out_CM_uint32 0 0 0 2147483646 ECU_ADDRESS 0x0080DBE8 /end MEASUREMENT
/begin MEASUREMENT crossARINC_out_B.Gain19 "" ULONG crossARINC_out_CM_uint32 0 0 0 2147483646 ECU_ADDRESS 0x0080DBE4 /end MEASUREMENT
/begin MEASUREMENT crossARINC_out_B.Gain2 "" ULONG crossARINC_out_CM_uint32 0 0 0 2147483646 ECU_ADDRESS 0x0080DC04 /end MEASUREMENT
/begin MEASUREMENT crossARINC_out_B.Gain20 "" ULONG crossARINC_out_CM_uint32 0 0 0 2147483646 ECU_ADDRESS 0x0080DBE0 /end MEASUREMENT
/begin MEASUREMENT crossARINC_out_B.Gain21 "" ULONG crossARINC_out_CM_uint32 0 0 0 2147483646 ECU_ADDRESS 0x0080DBDC /end MEASUREMENT
/begin MEASUREMENT crossARINC_out_B.Gain3 "" ULONG crossARINC_out_CM_uint32 0 0 0 2147483646 ECU_ADDRESS 0x0080DC00 /end MEASUREMENT
/begin MEASUREMENT crossARINC_out_B.Gain4 "" ULONG crossARINC_out_CM_uint32 0 0 0 2147483646 ECU_ADDRESS 0x0080DBFC /end MEASUREMENT
/begin MEASUREMENT crossARINC_out_B.Gain5 "" ULONG crossARINC_out_CM_uint32 0 0 0 2147483646 ECU_ADDRESS 0x0080DBF8 /end MEASUREMENT
/begin MEASUREMENT crossARINC_out_B.PulseGenerator "" FLOAT64_IEEE crossARINC_out_CM_double 0 0 -1.7E+308 1.7E+308 ECU_ADDRESS 0x0080DB30 /end MEASUREMENT
/begin MEASUREMENT crossARINC_out_B.SineWave "" FLOAT64_IEEE crossARINC_out_CM_double 0 0 -1.7E+308 1.7E+308 ECU_ADDRESS 0x0080DB20 /end MEASUREMENT
/begin MEASUREMENT crossARINC_out_B.SineWave1 "" FLOAT64_IEEE crossARINC_out_CM_double 0 0 -1.7E+308 1.7E+308 ECU_ADDRESS 0x0080DB48 /end MEASUREMENT
/begin MEASUREMENT crossARINC_out_B.SineWave2 "" FLOAT64_IEEE crossARINC_out_CM_double 0 0 -1.7E+308 1.7E+308 ECU_ADDRESS 0x0080DB58 /end MEASUREMENT
/begin MEASUREMENT crossARINC_out_B.SineWave3 "" FLOAT64_IEEE crossARINC_out_CM_double 0 0 -1.7E+308 1.7E+308 ECU_ADDRESS 0x0080DB68 /end MEASUREMENT
/begin MEASUREMENT crossARINC_out_B.SineWave4 "" FLOAT64_IEEE crossARINC_out_CM_double 0 0 -1.7E+308 1.7E+308 ECU_ADDRESS 0x0080DB80 /end MEASUREMENT
/begin MEASUREMENT crossARINC_out_B.SineWave5 "" FLOAT64_IEEE crossARINC_out_CM_double 0 0 -1.7E+308 1.7E+308 ECU_ADDRESS 0x0080DB90 /end MEASUREMENT
/begin MEASUREMENT crossARINC_out_B.SineWave6 "" FLOAT64_IEEE crossARINC_out_CM_double 0 0 -1.7E+308 1.7E+308 ECU_ADDRESS 0x0080DB38 /end MEASUREMENT
/begin MEASUREMENT crossARINC_out_DW.Delay1_DSTATE "" UBYTE crossARINC_out_CM_logical 0 0 0 1 ECU_ADDRESS 0x0080DB09 /end MEASUREMENT
/begin MEASUREMENT crossARINC_out_DW.Delay2_DSTATE "" UBYTE crossARINC_out_CM_logical 0 0 0 1 ECU_ADDRESS 0x0080DB0A /end MEASUREMENT
/begin MEASUREMENT crossARINC_out_DW.Delay3_DSTATE "" UBYTE crossARINC_out_CM_logical 0 0 0 1 ECU_ADDRESS 0x0080DB0B /end MEASUREMENT
/begin MEASUREMENT crossARINC_out_DW.Delay4_DSTATE "" UBYTE crossARINC_out_CM_logical 0 0 0 1 ECU_ADDRESS 0x0080DB0C /end MEASUREMENT
/begin MEASUREMENT crossARINC_out_DW.Delay5_DSTATE "" UBYTE crossARINC_out_CM_logical 0 0 0 1 ECU_ADDRESS 0x0080DB0D /end MEASUREMENT
/begin MEASUREMENT crossARINC_out_DW.Delay6_DSTATE "" UBYTE crossARINC_out_CM_logical 0 0 0 1 ECU_ADDRESS 0x0080DB0E /end MEASUREMENT
/begin MEASUREMENT crossARINC_out_DW.Delay7_DSTATE "" UBYTE crossARINC_out_CM_logical 0 0 0 1 ECU_ADDRESS 0x0080DB0F /end MEASUREMENT
/begin MEASUREMENT crossARINC_out_DW.Delay8_DSTATE "" UBYTE crossARINC_out_CM_logical 0 0 0 1 ECU_ADDRESS 0x0080DB10 /end MEASUREMENT
/begin MEASUREMENT crossARINC_out_DW.Delay_DSTATE "" UBYTE crossARINC_out_CM_logical 0 0 0 1 ECU_ADDRESS 0x0080DB08 /end MEASUREMENT
/begin MEASUREMENT crossARINC_out_DW.clockTickCounter "" SLONG crossARINC_out_CM_int32 0 0 -2147483648 2147483647 ECU_ADDRESS 0x0080DAEC /end MEASUREMENT
/begin MEASUREMENT crossARINC_out_DW.lastCos "" FLOAT64_IEEE crossARINC_out_CM_double 0 0 -1.7E+308 1.7E+308 ECU_ADDRESS 0x0080D9A8 /end MEASUREMENT
/begin MEASUREMENT crossARINC_out_DW.lastCos_b "" FLOAT64_IEEE crossARINC_out_CM_double 0 0 -1.7E+308 1.7E+308 ECU_ADDRESS 0x0080D9C8 /end MEASUREMENT
/begin MEASUREMENT crossARINC_out_DW.lastCos_f "" FLOAT64_IEEE crossARINC_out_CM_double 0 0 -1.7E+308 1.7E+308 ECU_ADDRESS 0x0080D9F8 /end MEASUREMENT
/begin MEASUREMENT crossARINC_out_DW.lastCos_g "" FLOAT64_IEEE crossARINC_out_CM_double 0 0 -1.7E+308 1.7E+308 ECU_ADDRESS 0x0080D9B8 /end MEASUREMENT
/begin MEASUREMENT crossARINC_out_DW.lastCos_k "" FLOAT64_IEEE crossARINC_out_CM_double 0 0 -1.7E+308 1.7E+308 ECU_ADDRESS 0x0080D9E8 /end MEASUREMENT
/begin MEASUREMENT crossARINC_out_DW.lastCos_kh "" FLOAT64_IEEE crossARINC_out_CM_double 0 0 -1.7E+308 1.7E+308 ECU_ADDRESS 0x0080DA08 /end MEASUREMENT
/begin MEASUREMENT crossARINC_out_DW.lastCos_p "" FLOAT64_IEEE crossARINC_out_CM_double 0 0 -1.7E+308 1.7E+308 ECU_ADDRESS 0x0080D9D8 /end MEASUREMENT
/begin MEASUREMENT crossARINC_out_DW.lastSin "" FLOAT64_IEEE crossARINC_out_CM_double 0 0 -1.7E+308 1.7E+308 ECU_ADDRESS 0x0080D9A0 /end MEASUREMENT
/begin MEASUREMENT crossARINC_out_DW.lastSin_a "" FLOAT64_IEEE crossARINC_out_CM_double 0 0 -1.7E+308 1.7E+308 ECU_ADDRESS 0x0080D9C0 /end MEASUREMENT
/begin MEASUREMENT crossARINC_out_DW.lastSin_b "" FLOAT64_IEEE crossARINC_out_CM_double 0 0 -1.7E+308 1.7E+308 ECU_ADDRESS 0x0080D9F0 /end MEASUREMENT
/begin MEASUREMENT crossARINC_out_DW.lastSin_c "" FLOAT64_IEEE crossARINC_out_CM_double 0 0 -1.7E+308 1.7E+308 ECU_ADDRESS 0x0080D9D0 /end MEASUREMENT
/begin MEASUREMENT crossARINC_out_DW.lastSin_d "" FLOAT64_IEEE crossARINC_out_CM_double 0 0 -1.7E+308 1.7E+308 ECU_ADDRESS 0x0080D9B0 /end MEASUREMENT
/begin MEASUREMENT crossARINC_out_DW.lastSin_f "" FLOAT64_IEEE crossARINC_out_CM_double 0 0 -1.7E+308 1.7E+308 ECU_ADDRESS 0x0080D9E0 /end MEASUREMENT
/begin MEASUREMENT crossARINC_out_DW.lastSin_h "" FLOAT64_IEEE crossARINC_out_CM_double 0 0 -1.7E+308 1.7E+308 ECU_ADDRESS 0x0080DA00 /end MEASUREMENT
/begin MEASUREMENT crossARINC_out_DW.systemEnable "" SLONG crossARINC_out_CM_int32 0 0 -2147483648 2147483647 ECU_ADDRESS 0x0080DAE8 /end MEASUREMENT
/begin MEASUREMENT crossARINC_out_DW.systemEnable_a "" SLONG crossARINC_out_CM_int32 0 0 -2147483648 2147483647 ECU_ADDRESS 0x0080DAF4 /end MEASUREMENT
/begin MEASUREMENT crossARINC_out_DW.systemEnable_c "" SLONG crossARINC_out_CM_int32 0 0 -2147483648 2147483647 ECU_ADDRESS 0x0080DB04 /end MEASUREMENT
/begin MEASUREMENT crossARINC_out_DW.systemEnable_e "" SLONG crossARINC_out_CM_int32 0 0 -2147483648 2147483647 ECU_ADDRESS 0x0080DAFC /end MEASUREMENT
/begin MEASUREMENT crossARINC_out_DW.systemEnable_g "" SLONG crossARINC_out_CM_int32 0 0 -2147483648 2147483647 ECU_ADDRESS 0x0080DB00 /end MEASUREMENT
/begin MEASUREMENT crossARINC_out_DW.systemEnable_m "" SLONG crossARINC_out_CM_int32 0 0 -2147483648 2147483647 ECU_ADDRESS 0x0080DAF0 /end MEASUREMENT
/begin MEASUREMENT crossARINC_out_DW.systemEnable_n "" SLONG crossARINC_out_CM_int32 0 0 -2147483648 2147483647 ECU_ADDRESS 0x0080DAF8 /end MEASUREMENT
/begin MEASUREMENT crossARINC_out_U.In1.ACE9C_ACE8x_DELTA_P_C "" FLOAT32_IEEE crossARINC_out_CM_single 0 0 -3.4E+38 3.4E+38 ECU_ADDRESS 0x0080D998 /end MEASUREMENT
/begin MEASUREMENT crossARINC_out_U.In1.ACE9C_ACE8x_DELTA_P_FAILURE "" UBYTE crossARINC_out_CM_logical 0 0 0 1 ECU_ADDRESS 0x0080D997 /end MEASUREMENT
/begin MEASUREMENT crossARINC_out_U.In1.ACE9C_ACE8x_GEARING_APPLIED "" FLOAT32_IEEE crossARINC_out_CM_single 0 0 -3.4E+38 3.4E+38 ECU_ADDRESS 0x0080D980 /end MEASUREMENT
/begin MEASUREMENT crossARINC_out_U.In1.ACE9C_ACE8x_GEARING_APP_F_C "" UBYTE crossARINC_out_CM_logical 0 0 0 1 ECU_ADDRESS 0x0080D984 /end MEASUREMENT
/begin MEASUREMENT crossARINC_out_U.In1.ACE9C_ACE8x_INC_DEMAND_FAIL "" UBYTE crossARINC_out_CM_logical 0 0 0 1 ECU_ADDRESS 0x0080D994 /end MEASUREMENT
/begin MEASUREMENT crossARINC_out_U.In1.ACE9C_ACE8x_MODE_C "" UBYTE crossARINC_out_CM_uint8 0 0 0 255 ECU_ADDRESS 0x0080D98C /end MEASUREMENT
/begin MEASUREMENT crossARINC_out_U.In1.ACE9C_ACE8x_PPROG "" UBYTE crossARINC_out_CM_uint8 0 0 0 255 ECU_ADDRESS 0x0080D985 /end MEASUREMENT
/begin MEASUREMENT crossARINC_out_U.In1.ACE9C_ACE8x_PPROG_FAILURE "" UBYTE crossARINC_out_CM_logical 0 0 0 1 ECU_ADDRESS 0x0080D986 /end MEASUREMENT
/begin MEASUREMENT crossARINC_out_U.In1.ACE9C_ACE8x_RAM_POS_C "" FLOAT32_IEEE crossARINC_out_CM_single 0 0 -3.4E+38 3.4E+38 ECU_ADDRESS 0x0080D988 /end MEASUREMENT
/begin MEASUREMENT crossARINC_out_U.In1.ACE9C_ACE8x_RAM_POS_C_FAILURE "" UBYTE crossARINC_out_CM_logical 0 0 0 1 ECU_ADDRESS 0x0080D987 /end MEASUREMENT
/begin MEASUREMENT crossARINC_out_U.In1.ACE9C_ACE8x_ROLL_POS_C "" FLOAT32_IEEE crossARINC_out_CM_single 0 0 -3.4E+38 3.4E+38 ECU_ADDRESS 0x0080D990 /end MEASUREMENT
/begin MEASUREMENT crossARINC_out_U.In1.ACE9C_ACE8x_ROLL_POS_C_FAILURE "" UBYTE crossARINC_out_CM_logical 0 0 0 1 ECU_ADDRESS 0x0080D98D /end MEASUREMENT
/begin MEASUREMENT crossARINC_out_U.In1.ACE9C_ACE8x_SPD_C "" UBYTE crossARINC_out_CM_uint8 0 0 0 255 ECU_ADDRESS 0x0080D99E /end MEASUREMENT
/begin MEASUREMENT crossARINC_out_U.In1.ACE9C_ACE8x_SPD_C_FAILURE "" UBYTE crossARINC_out_CM_logical 0 0 0 1 ECU_ADDRESS 0x0080D996 /end MEASUREMENT
/begin MEASUREMENT crossARINC_out_U.In1.ACE9C_ACE8x_TBI_FLAG_APP "" UBYTE crossARINC_out_CM_logical 0 0 0 1 ECU_ADDRESS 0x0080D995 /end MEASUREMENT
/begin MEASUREMENT crossARINC_out_U.In1.ACE9C_ACE8x_WOW1_C "" UBYTE crossARINC_out_CM_logical 0 0 0 1 ECU_ADDRESS 0x0080D99C /end MEASUREMENT
/begin MEASUREMENT crossARINC_out_U.In1.ACE9C_ACE8x_WOW2_C "" UBYTE crossARINC_out_CM_logical 0 0 0 1 ECU_ADDRESS 0x0080D99D /end MEASUREMENT
/begin COMPU_METHOD crossARINC_out_CM_double "" IDENTICAL "%15.10" "" /end COMPU_METHOD
/begin COMPU_METHOD crossARINC_out_CM_int32 "" IDENTICAL "%10.0" "" /end COMPU_METHOD
/begin COMPU_METHOD crossARINC_out_CM_logical "" IDENTICAL "%1.0" "" /end COMPU_METHOD
/begin COMPU_METHOD crossARINC_out_CM_single "" IDENTICAL "%8.6" "" /end COMPU_METHOD
/begin COMPU_METHOD crossARINC_out_CM_ufix32_En30 "" LINEAR "%17.16" "" COEFFS_LINEAR 9.31323e-10 0.000000 /end COMPU_METHOD
/begin COMPU_METHOD crossARINC_out_CM_ufix32_En31 "" LINEAR "%17.16" "" COEFFS_LINEAR 4.65661e-10 0.000000 /end COMPU_METHOD
/begin COMPU_METHOD crossARINC_out_CM_ufix8_E10 "" LINEAR "%6.0" "" COEFFS_LINEAR 1024.00 0.000000 /end COMPU_METHOD
/begin COMPU_METHOD crossARINC_out_CM_ufix8_E11 "" LINEAR "%6.0" "" COEFFS_LINEAR 2048.00 0.000000 /end COMPU_METHOD
/begin COMPU_METHOD crossARINC_out_CM_ufix8_E5 "" LINEAR "%4.0" "" COEFFS_LINEAR 32.0000 0.000000 /end COMPU_METHOD
/begin COMPU_METHOD crossARINC_out_CM_ufix8_E6 "" LINEAR "%5.0" "" COEFFS_LINEAR 64.0000 0.000000 /end COMPU_METHOD
/begin COMPU_METHOD crossARINC_out_CM_ufix8_E8 "" LINEAR "%5.0" "" COEFFS_LINEAR 256.000 0.000000 /end COMPU_METHOD
/begin COMPU_METHOD crossARINC_out_CM_ufix8_E9 "" LINEAR "%6.0" "" COEFFS_LINEAR 512.000 0.000000 /end COMPU_METHOD
/begin COMPU_METHOD crossARINC_out_CM_ufix8_En7 "" LINEAR "%8.7" "" COEFFS_LINEAR 0.00781250 0.000000 /end COMPU_METHOD
/begin COMPU_METHOD crossARINC_out_CM_uint32 "" IDENTICAL "%10.0" "" /end COMPU_METHOD
/begin COMPU_METHOD crossARINC_out_CM_uint8 "" IDENTICAL "%3.0" "" /end COMPU_METHOD
/begin RECORD_LAYOUT Scalar_BOOLEAN FNC_VALUES 1 UBYTE COLUMN_DIR DIRECT /end RECORD_LAYOUT
/begin RECORD_LAYOUT Scalar_FLOAT32_IEEE FNC_VALUES 1 FLOAT32_IEEE COLUMN_DIR DIRECT /end RECORD_LAYOUT
/begin RECORD_LAYOUT Scalar_FLOAT64_IEEE FNC_VALUES 1 FLOAT64_IEEE COLUMN_DIR DIRECT /end RECORD_LAYOUT
/begin RECORD_LAYOUT Scalar_SLONG FNC_VALUES 1 SLONG COLUMN_DIR DIRECT /end RECORD_LAYOUT
/begin RECORD_LAYOUT Scalar_UBYTE FNC_VALUES 1 UBYTE COLUMN_DIR DIRECT /end RECORD_LAYOUT
/begin RECORD_LAYOUT Scalar_ULONG FNC_VALUES 1 ULONG COLUMN_DIR DIRECT /end RECORD_LAYOUT
/begin GROUP crossARINC_out "crossARINC_out" ROOT /begin SUB_GROUP crossARINC_out_U.In1 /end SUB_GROUP
 /begin REF_CHARACTERISTIC crossARINC_out_cal_impl.CCCodeBlock1_P1 crossARINC_out_cal_impl.CCCodeBlock1_P2 crossARINC_out_cal_impl.CCCodeBlock1_P3 crossARINC_out_cal_impl.CCCodeBlock1_P4 crossARINC_out_cal_impl.CCCodeBlock1_P5 crossARINC_out_cal_impl.CCCodeBlock4_P1 crossARINC_out_cal_impl.CCCodeBlock4_P2 crossARINC_out_cal_impl.CCCodeBlock4_P3 crossARINC_out_cal_impl.CCCodeBlock4_P4 crossARINC_out_cal_impl.CCCodeBlock4_P5 crossARINC_out_cal_impl.CCCodeBlock5_P1 crossARINC_out_cal_impl.CCCodeBlock5_P2 crossARINC_out_cal_impl.CCCodeBlock5_P3 crossARINC_out_cal_impl.CCCodeBlock5_P4 crossARINC_out_cal_impl.CCCodeBlock5_P5 crossARINC_out_cal_impl.CCCodeBlock6_P1 crossARINC_out_cal_impl.CCCodeBlock6_P2 crossARINC_out_cal_impl.CCCodeBlock6_P3 crossARINC_out_cal_impl.CCCodeBlock6_P4 crossARINC_out_cal_impl.CCCodeBlock6_P5 crossARINC_out_cal_impl.Constant6_Value crossARINC_out_cal_impl.Delay1_InitialCondition crossARINC_out_cal_impl.Delay2_InitialCondition crossARINC_out_cal_impl.Delay3_InitialCondition crossARINC_out_cal_impl.Delay4_InitialCondition crossARINC_out_cal_impl.Delay5_InitialCondition crossARINC_out_cal_impl.Delay6_InitialCondition crossARINC_out_cal_impl.Delay7_InitialCondition crossARINC_out_cal_impl.Delay8_InitialCondition crossARINC_out_cal_impl.Delay_InitialCondition crossARINC_out_cal_impl.Encodev21_P1 crossARINC_out_cal_impl.Encodev21_P10 crossARINC_out_cal_impl.Encodev21_P11 crossARINC_out_cal_impl.Encodev21_P12 crossARINC_out_cal_impl.Encodev21_P13 crossARINC_out_cal_impl.Encodev21_P14 crossARINC_out_cal_impl.Encodev21_P15 crossARINC_out_cal_impl.Encodev21_P2 crossARINC_out_cal_impl.Encodev21_P3 crossARINC_out_cal_impl.Encodev21_P4 crossARINC_out_cal_impl.Encodev21_P5 crossARINC_out_cal_impl.Encodev21_P6 crossARINC_out_cal_impl.Encodev21_P7 crossARINC_out_cal_impl.Encodev21_P8 crossARINC_out_cal_impl.Encodev21_P9 crossARINC_out_cal_impl.Encodev22_P1 crossARINC_out_cal_impl.Encodev22_P10 crossARINC_out_cal_impl.Encodev22_P11 crossARINC_out_cal_impl.Encodev22_P12 crossARINC_out_cal_impl.Encodev22_P13 crossARINC_out_cal_impl.Encodev22_P14 crossARINC_out_cal_impl.Encodev22_P15 crossARINC_out_cal_impl.Encodev22_P2 crossARINC_out_cal_impl.Encodev22_P3 crossARINC_out_cal_impl.Encodev22_P4 crossARINC_out_cal_impl.Encodev22_P5 crossARINC_out_cal_impl.Encodev22_P6 crossARINC_out_cal_impl.Encodev22_P7 crossARINC_out_cal_impl.Encodev22_P8 crossARINC_out_cal_impl.Encodev22_P9 crossARINC_out_cal_impl.Encodev23_P1 crossARINC_out_cal_impl.Encodev23_P10 crossARINC_out_cal_impl.Encodev23_P11 crossARINC_out_cal_impl.Encodev23_P12 crossARINC_out_cal_impl.Encodev23_P13 crossARINC_out_cal_impl.Encodev23_P14 crossARINC_out_cal_impl.Encodev23_P15 crossARINC_out_cal_impl.Encodev23_P2 crossARINC_out_cal_impl.Encodev23_P3 crossARINC_out_cal_impl.Encodev23_P4 crossARINC_out_cal_impl.Encodev23_P5 crossARINC_out_cal_impl.Encodev23_P6 crossARINC_out_cal_impl.Encodev23_P7 crossARINC_out_cal_impl.Encodev23_P8 crossARINC_out_cal_impl.Encodev23_P9 crossARINC_out_cal_impl.Encodev2_P1 crossARINC_out_cal_impl.Encodev2_P10 crossARINC_out_cal_impl.Encodev2_P11 crossARINC_out_cal_impl.Encodev2_P12 crossARINC_out_cal_impl.Encodev2_P13 crossARINC_out_cal_impl.Encodev2_P14 crossARINC_out_cal_impl.Encodev2_P15 crossARINC_out_cal_impl.Encodev2_P2 crossARINC_out_cal_impl.Encodev2_P3 crossARINC_out_cal_impl.Encodev2_P4 crossARINC_out_cal_impl.Encodev2_P5 crossARINC_out_cal_impl.Encodev2_P6 crossARINC_out_cal_impl.Encodev2_P7 crossARINC_out_cal_impl.Encodev2_P8 crossARINC_out_cal_impl.Encodev2_P9 crossARINC_out_cal_impl.Gain10_Gain crossARINC_out_cal_impl.Gain11_Gain crossARINC_out_cal_impl.Gain12_Gain crossARINC_out_cal_impl.Gain13_Gain crossARINC_out_cal_impl.Gain14_Gain crossARINC_out_cal_impl.Gain15_Gain crossARINC_out_cal_impl.Gain16_Gain crossARINC_out_cal_impl.Gain17_Gain crossARINC_out_cal_impl.Gain18_Gain crossARINC_out_cal_impl.Gain19_Gain crossARINC_out_cal_impl.Gain1_Gain crossARINC_out_cal_impl.Gain20_Gain crossARINC_out_cal_impl.Gain21_Gain crossARINC_out_cal_impl.Gain2_Gain crossARINC_out_cal_impl.Gain3_Gain crossARINC_out_cal_impl.Gain4_Gain crossARINC_out_cal_impl.Gain5_Gain crossARINC_out_cal_impl.PulseGenerator_Amp crossARINC_out_cal_impl.PulseGenerator_Duty crossARINC_out_cal_impl.PulseGenerator_Period crossARINC_out_cal_impl.PulseGenerator_PhaseDelay crossARINC_out_cal_impl.Sendv31_P1 crossARINC_out_cal_impl.Sendv31_P2 crossARINC_out_cal_impl.Sendv31_P3 crossARINC_out_cal_impl.Sendv32_P1 crossARINC_out_cal_impl.Sendv32_P2 crossARINC_out_cal_impl.Sendv32_P3 crossARINC_out_cal_impl.Sendv33_P1 crossARINC_out_cal_impl.Sendv33_P2 crossARINC_out_cal_impl.Sendv33_P3 crossARINC_out_cal_impl.Sendv3_P1 crossARINC_out_cal_impl.Sendv3_P2 crossARINC_out_cal_impl.Sendv3_P3 crossARINC_out_cal_impl.Setupv2_P1 crossARINC_out_cal_impl.Setupv2_P2 crossARINC_out_cal_impl.Setupv2_P3 crossARINC_out_cal_impl.Setupv2_P4 crossARINC_out_cal_impl.Setupv2_P5 crossARINC_out_cal_impl.Setupv2_P6 crossARINC_out_cal_impl.Setupv2_P7 crossARINC_out_cal_impl.Setupv2_P8 crossARINC_out_cal_impl.SineWave1_Amp crossARINC_out_cal_impl.SineWave1_Bias crossARINC_out_cal_impl.SineWave1_Freq crossARINC_out_cal_impl.SineWave1_HCos crossARINC_out_cal_impl.SineWave1_Hsin crossARINC_out_cal_impl.SineWave1_PCos crossARINC_out_cal_impl.SineWave1_PSin crossARINC_out_cal_impl.SineWave2_Amp crossARINC_out_cal_impl.SineWave2_Bias crossARINC_out_cal_impl.SineWave2_Freq crossARINC_out_cal_impl.SineWave2_HCos crossARINC_out_cal_impl.SineWave2_Hsin crossARINC_out_cal_impl.SineWave2_PCos crossARINC_out_cal_impl.SineWave2_PSin crossARINC_out_cal_impl.SineWave3_Amp crossARINC_out_cal_impl.SineWave3_Bias crossARINC_out_cal_impl.SineWave3_Freq crossARINC_out_cal_impl.SineWave3_HCos crossARINC_out_cal_impl.SineWave3_Hsin crossARINC_out_cal_impl.SineWave3_PCos crossARINC_out_cal_impl.SineWave3_PSin crossARINC_out_cal_impl.SineWave4_Amp crossARINC_out_cal_impl.SineWave4_Bias crossARINC_out_cal_impl.SineWave4_Freq crossARINC_out_cal_impl.SineWave4_HCos crossARINC_out_cal_impl.SineWave4_Hsin crossARINC_out_cal_impl.SineWave4_PCos crossARINC_out_cal_impl.SineWave4_PSin crossARINC_out_cal_impl.SineWave5_Amp crossARINC_out_cal_impl.SineWave5_Bias crossARINC_out_cal_impl.SineWave5_Freq crossARINC_out_cal_impl.SineWave5_HCos crossARINC_out_cal_impl.SineWave5_Hsin crossARINC_out_cal_impl.SineWave5_PCos crossARINC_out_cal_impl.SineWave5_PSin crossARINC_out_cal_impl.SineWave6_Amp crossARINC_out_cal_impl.SineWave6_Bias crossARINC_out_cal_impl.SineWave6_Freq crossARINC_out_cal_impl.SineWave6_HCos crossARINC_out_cal_impl.SineWave6_Hsin crossARINC_out_cal_impl.SineWave6_PCos crossARINC_out_cal_impl.SineWave6_PSin crossARINC_out_cal_impl.SineWave_Amp crossARINC_out_cal_impl.SineWave_Bias crossARINC_out_cal_impl.SineWave_Freq crossARINC_out_cal_impl.SineWave_HCos crossARINC_out_cal_impl.SineWave_Hsin crossARINC_out_cal_impl.SineWave_PCos crossARINC_out_cal_impl.SineWave_PSin /end REF_CHARACTERISTIC
 /begin REF_MEASUREMENT crossARINC_out_B.Add1 crossARINC_out_B.Add3 crossARINC_out_B.Add4 crossARINC_out_B.Add5 crossARINC_out_B.CCCodeBlock1 crossARINC_out_B.CCCodeBlock4 crossARINC_out_B.CCCodeBlock5 crossARINC_out_B.CCCodeBlock6 crossARINC_out_B.DataTypeConversion1 crossARINC_out_B.DataTypeConversion10 crossARINC_out_B.DataTypeConversion11 crossARINC_out_B.DataTypeConversion12 crossARINC_out_B.DataTypeConversion2 crossARINC_out_B.DataTypeConversion3 crossARINC_out_B.DataTypeConversion4 crossARINC_out_B.DataTypeConversion5 crossARINC_out_B.DataTypeConversion6 crossARINC_out_B.DataTypeConversion7 crossARINC_out_B.DataTypeConversion8 crossARINC_out_B.DataTypeConversion9 crossARINC_out_B.Delay crossARINC_out_B.Delay1 crossARINC_out_B.Delay2 crossARINC_out_B.Delay3 crossARINC_out_B.Delay4 crossARINC_out_B.Delay5 crossARINC_out_B.Delay6 crossARINC_out_B.Delay7 crossARINC_out_B.Delay8 crossARINC_out_B.Encodev2 crossARINC_out_B.Encodev21 crossARINC_out_B.Encodev22 crossARINC_out_B.Encodev23 crossARINC_out_B.Gain1 crossARINC_out_B.Gain10 crossARINC_out_B.Gain11 crossARINC_out_B.Gain12 crossARINC_out_B.Gain13 crossARINC_out_B.Gain14 crossARINC_out_B.Gain15 crossARINC_out_B.Gain16 crossARINC_out_B.Gain17 crossARINC_out_B.Gain18 crossARINC_out_B.Gain19 crossARINC_out_B.Gain2 crossARINC_out_B.Gain20 crossARINC_out_B.Gain21 crossARINC_out_B.Gain3 crossARINC_out_B.Gain4 crossARINC_out_B.Gain5 crossARINC_out_B.PulseGenerator crossARINC_out_B.SineWave crossARINC_out_B.SineWave1 crossARINC_out_B.SineWave2 crossARINC_out_B.SineWave3 crossARINC_out_B.SineWave4 crossARINC_out_B.SineWave5 crossARINC_out_B.SineWave6 crossARINC_out_DW.Delay1_DSTATE crossARINC_out_DW.Delay2_DSTATE crossARINC_out_DW.Delay3_DSTATE crossARINC_out_DW.Delay4_DSTATE crossARINC_out_DW.Delay5_DSTATE crossARINC_out_DW.Delay6_DSTATE crossARINC_out_DW.Delay7_DSTATE crossARINC_out_DW.Delay8_DSTATE crossARINC_out_DW.Delay_DSTATE crossARINC_out_DW.Sendv31_PWORK crossARINC_out_DW.Sendv32_PWORK crossARINC_out_DW.Sendv33_PWORK crossARINC_out_DW.Sendv3_PWORK crossARINC_out_DW.Setupv2_PWORK crossARINC_out_DW.clockTickCounter crossARINC_out_DW.lastCos crossARINC_out_DW.lastCos_b crossARINC_out_DW.lastCos_f crossARINC_out_DW.lastCos_g crossARINC_out_DW.lastCos_k crossARINC_out_DW.lastCos_kh crossARINC_out_DW.lastCos_p crossARINC_out_DW.lastSin crossARINC_out_DW.lastSin_a crossARINC_out_DW.lastSin_b crossARINC_out_DW.lastSin_c crossARINC_out_DW.lastSin_d crossARINC_out_DW.lastSin_f crossARINC_out_DW.lastSin_h crossARINC_out_DW.systemEnable crossARINC_out_DW.systemEnable_a crossARINC_out_DW.systemEnable_c crossARINC_out_DW.systemEnable_e crossARINC_out_DW.systemEnable_g crossARINC_out_DW.systemEnable_m crossARINC_out_DW.systemEnable_n /end REF_MEASUREMENT
/end GROUP
/begin GROUP crossARINC_out_U.In1 ""
 /begin REF_MEASUREMENT crossARINC_out_U.In1.ACE9C_ACE8x_GEARING_APPLIED crossARINC_out_U.In1.ACE9C_ACE8x_GEARING_APP_F_C crossARINC_out_U.In1.ACE9C_ACE8x_PPROG crossARINC_out_U.In1.ACE9C_ACE8x_PPROG_FAILURE crossARINC_out_U.In1.ACE9C_ACE8x_RAM_POS_C_FAILURE crossARINC_out_U.In1.ACE9C_ACE8x_RAM_POS_C crossARINC_out_U.In1.ACE9C_ACE8x_MODE_C crossARINC_out_U.In1.ACE9C_ACE8x_ROLL_POS_C_FAILURE crossARINC_out_U.In1.ACE9C_ACE8x_ROLL_POS_C crossARINC_out_U.In1.ACE9C_ACE8x_INC_DEMAND_FAIL crossARINC_out_U.In1.ACE9C_ACE8x_TBI_FLAG_APP crossARINC_out_U.In1.ACE9C_ACE8x_SPD_C_FAILURE crossARINC_out_U.In1.ACE9C_ACE8x_DELTA_P_FAILURE crossARINC_out_U.In1.ACE9C_ACE8x_DELTA_P_C crossARINC_out_U.In1.ACE9C_ACE8x_WOW1_C crossARINC_out_U.In1.ACE9C_ACE8x_WOW2_C crossARINC_out_U.In1.ACE9C_ACE8x_SPD_C /end REF_MEASUREMENT
/end GROUP
/end MODULE
/end PROJECT
