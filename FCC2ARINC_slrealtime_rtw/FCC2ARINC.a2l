/******************************************************************************
* ASAP2 file: FCC2ARINC.a2l
* Code generation for model "FCC2ARINC".
* Model version : 1.33
* Simulink Coder version : 10.4 R2021b
* C source code generated on : Tue May 17 11:53:07 2022
* Target selection: slrealtime.tlc
* Embedded hardware selection: Intel->x86-64 (Linux 64)
* Code generation objectives: Unspecified
* Validation result: Not run
* (add additional file header information here)
******************************************************************************/ ASAP2_VERSION 1 71
/begin PROJECT ProjectName "Project Comment Goes Here"
/begin HEADER "Header Comments go here" /end HEADER
/begin MODULE ModuleName "Module Comment Goes Here"
/begin IF_DATA XCP
 /begin PROTOCOL_LAYER 0x0100 0x03E8 0x00C8 0x0000 0x0000 0x0000 0x0000 0x0000 0xFC 0x0578 BYTE_ORDER_MSB_LAST ADDRESS_GRANULARITY_BYTE OPTIONAL_CMD ALLOC_ODT_ENTRY OPTIONAL_CMD ALLOC_ODT OPTIONAL_CMD ALLOC_DAQ OPTIONAL_CMD FREE_DAQ OPTIONAL_CMD GET_DAQ_RESOLUTION_INFO OPTIONAL_CMD GET_DAQ_PROCESSOR_INFO OPTIONAL_CMD START_STOP_SYNCH OPTIONAL_CMD START_STOP_DAQ_LIST OPTIONAL_CMD SET_DAQ_LIST_MODE OPTIONAL_CMD WRITE_DAQ OPTIONAL_CMD SET_DAQ_PTR OPTIONAL_CMD GET_CAL_PAGE OPTIONAL_CMD SET_CAL_PAGE OPTIONAL_CMD COPY_CAL_PAGE OPTIONAL_CMD SHORT_DOWNLOAD OPTIONAL_CMD DOWNLOAD_MAX OPTIONAL_CMD DOWNLOAD OPTIONAL_CMD SHORT_UPLOAD OPTIONAL_CMD UPLOAD OPTIONAL_CMD SET_MTA /end PROTOCOL_LAYER
 /begin DAQ DYNAMIC 0x0000 0x0080 0x00 OPTIMISATION_TYPE_DEFAULT ADDRESS_EXTENSION_FREE IDENTIFICATION_FIELD_TYPE_RELATIVE_WORD_ALIGNED GRANULARITY_ODT_ENTRY_SIZE_DAQ_BYTE 0xFF OVERLOAD_INDICATION_PID PRESCALER_SUPPORTED /begin STIM GRANULARITY_ODT_ENTRY_SIZE_STIM_BYTE 0xFF /end STIM /begin TIMESTAMP_SUPPORTED 0x0001 SIZE_DWORD UNIT_1US TIMESTAMP_FIXED /end TIMESTAMP_SUPPORTED /begin EVENT "8 ms" "8 ms" 0x0000 DAQ 0xFF 0x08 0x06 0x00 /end EVENT /end DAQ
 /begin XCP_ON_UDP_IP 0x0100 0x15B3 ADDRESS "192.168.7.2" /end XCP_ON_UDP_IP
/end IF_DATA
/begin MOD_PAR "MOD PAR Comment Goes Here"
 /begin MEMORY_SEGMENT FCC2ARINC_cal_impl "FCC2ARINC_cal_impl" DATA FLASH INTERN 0x00808020 0x1068 -1 -1 -1 -1 -1
  /begin IF_DATA XCP
   /begin SEGMENT 0x00 0x02 0x00 0x00 0x00
    /begin PAGE 0x00 ECU_ACCESS_DONT_CARE XCP_READ_ACCESS_DONT_CARE XCP_WRITE_ACCESS_NOT_ALLOWED /end PAGE
    /begin PAGE 0x01 ECU_ACCESS_DONT_CARE XCP_READ_ACCESS_DONT_CARE XCP_WRITE_ACCESS_DONT_CARE /end PAGE
   /end SEGMENT
  /end IF_DATA
 /end MEMORY_SEGMENT
/end MOD_PAR
/begin MOD_COMMON "Mod Common Comment Here" BYTE_ORDER MSB_LAST ALIGNMENT_BYTE 1 ALIGNMENT_WORD 2 ALIGNMENT_LONG 4 ALIGNMENT_FLOAT32_IEEE 4 ALIGNMENT_FLOAT64_IEEE 8 ALIGNMENT_INT64 8 /end MOD_COMMON
/begin CHARACTERISTIC FCC2ARINC_cal_impl.CCCodeBlock4_P1 "" VALUE 0x008088E8 Scalar_FLOAT64_IEEE 0 FCC2ARINC_CM_double -1.7E+308 1.7E+308 /end CHARACTERISTIC
/begin CHARACTERISTIC FCC2ARINC_cal_impl.CCCodeBlock4_P2 "" VALUE 0x008088F0 Scalar_FLOAT64_IEEE 0 FCC2ARINC_CM_double -1.7E+308 1.7E+308 /end CHARACTERISTIC
/begin CHARACTERISTIC FCC2ARINC_cal_impl.CCCodeBlock4_P3 "" VALUE 0x00809082 Scalar_BOOLEAN 0 FCC2ARINC_CM_logical 0 1 /end CHARACTERISTIC
/begin CHARACTERISTIC FCC2ARINC_cal_impl.CCCodeBlock4_P4 "" VALUE 0x00809083 Scalar_BOOLEAN 0 FCC2ARINC_CM_logical 0 1 /end CHARACTERISTIC
/begin CHARACTERISTIC FCC2ARINC_cal_impl.CCCodeBlock4_P5 "" VALUE 0x0080907C Scalar_ULONG 0 FCC2ARINC_CM_uint32 0 2147483646 /end CHARACTERISTIC
/begin CHARACTERISTIC FCC2ARINC_cal_impl.CCCodeBlock_P1 "" VALUE 0x00808758 Scalar_FLOAT64_IEEE 0 FCC2ARINC_CM_double -1.7E+308 1.7E+308 /end CHARACTERISTIC
/begin CHARACTERISTIC FCC2ARINC_cal_impl.CCCodeBlock_P2 "" VALUE 0x00808760 Scalar_FLOAT64_IEEE 0 FCC2ARINC_CM_double -1.7E+308 1.7E+308 /end CHARACTERISTIC
/begin CHARACTERISTIC FCC2ARINC_cal_impl.CCCodeBlock_P3 "" VALUE 0x00809080 Scalar_BOOLEAN 0 FCC2ARINC_CM_logical 0 1 /end CHARACTERISTIC
/begin CHARACTERISTIC FCC2ARINC_cal_impl.CCCodeBlock_P4 "" VALUE 0x00809081 Scalar_BOOLEAN 0 FCC2ARINC_CM_logical 0 1 /end CHARACTERISTIC
/begin CHARACTERISTIC FCC2ARINC_cal_impl.CCCodeBlock_P5 "" VALUE 0x00809078 Scalar_ULONG 0 FCC2ARINC_CM_uint32 0 2147483646 /end CHARACTERISTIC
/begin CHARACTERISTIC FCC2ARINC_cal_impl.Constant_Value "" VALUE 0x00808020 Scalar_FLOAT64_IEEE 0 FCC2ARINC_CM_double -1.7E+308 1.7E+308 /end CHARACTERISTIC
/begin CHARACTERISTIC FCC2ARINC_cal_impl.Decode1_P1 "" VALUE 0x008085E0 Scalar_FLOAT64_IEEE 0 FCC2ARINC_CM_double -1.7E+308 1.7E+308 /end CHARACTERISTIC
/begin CHARACTERISTIC FCC2ARINC_cal_impl.Decode1_P10 "" VAL_BLK 0x008086B8 Scalar_FLOAT64_IEEE 0 FCC2ARINC_CM_double -1.7E+308 1.7E+308 MATRIX_DIM 2 1 /end CHARACTERISTIC
/begin CHARACTERISTIC FCC2ARINC_cal_impl.Decode1_P11 "" VALUE 0x008086D8 Scalar_FLOAT64_IEEE 0 FCC2ARINC_CM_double -1.7E+308 1.7E+308 /end CHARACTERISTIC
/begin CHARACTERISTIC FCC2ARINC_cal_impl.Decode1_P12 "" VALUE 0x008086F0 Scalar_FLOAT64_IEEE 0 FCC2ARINC_CM_double -1.7E+308 1.7E+308 /end CHARACTERISTIC
/begin CHARACTERISTIC FCC2ARINC_cal_impl.Decode1_P13 "" VALUE 0x00808708 Scalar_FLOAT64_IEEE 0 FCC2ARINC_CM_double -1.7E+308 1.7E+308 /end CHARACTERISTIC
/begin CHARACTERISTIC FCC2ARINC_cal_impl.Decode1_P14 "" VALUE 0x00808720 Scalar_FLOAT64_IEEE 0 FCC2ARINC_CM_double -1.7E+308 1.7E+308 /end CHARACTERISTIC
/begin CHARACTERISTIC FCC2ARINC_cal_impl.Decode1_P15 "" VALUE 0x00808738 Scalar_FLOAT64_IEEE 0 FCC2ARINC_CM_double -1.7E+308 1.7E+308 /end CHARACTERISTIC
/begin CHARACTERISTIC FCC2ARINC_cal_impl.Decode1_P16 "" VALUE 0x00808750 Scalar_FLOAT64_IEEE 0 FCC2ARINC_CM_double -1.7E+308 1.7E+308 /end CHARACTERISTIC
/begin CHARACTERISTIC FCC2ARINC_cal_impl.Decode1_P2 "" VALUE 0x008085F8 Scalar_FLOAT64_IEEE 0 FCC2ARINC_CM_double -1.7E+308 1.7E+308 /end CHARACTERISTIC
/begin CHARACTERISTIC FCC2ARINC_cal_impl.Decode1_P3 "" VALUE 0x00808610 Scalar_FLOAT64_IEEE 0 FCC2ARINC_CM_double -1.7E+308 1.7E+308 /end CHARACTERISTIC
/begin CHARACTERISTIC FCC2ARINC_cal_impl.Decode1_P4 "" VALUE 0x00808628 Scalar_FLOAT64_IEEE 0 FCC2ARINC_CM_double -1.7E+308 1.7E+308 /end CHARACTERISTIC
/begin CHARACTERISTIC FCC2ARINC_cal_impl.Decode1_P5 "" VALUE 0x00808640 Scalar_FLOAT64_IEEE 0 FCC2ARINC_CM_double -1.7E+308 1.7E+308 /end CHARACTERISTIC
/begin CHARACTERISTIC FCC2ARINC_cal_impl.Decode1_P6 "" VALUE 0x00808658 Scalar_FLOAT64_IEEE 0 FCC2ARINC_CM_double -1.7E+308 1.7E+308 /end CHARACTERISTIC
/begin CHARACTERISTIC FCC2ARINC_cal_impl.Decode1_P7 "" VALUE 0x00808670 Scalar_FLOAT64_IEEE 0 FCC2ARINC_CM_double -1.7E+308 1.7E+308 /end CHARACTERISTIC
/begin CHARACTERISTIC FCC2ARINC_cal_impl.Decode1_P8 "" VALUE 0x00808688 Scalar_FLOAT64_IEEE 0 FCC2ARINC_CM_double -1.7E+308 1.7E+308 /end CHARACTERISTIC
/begin CHARACTERISTIC FCC2ARINC_cal_impl.Decode1_P9 "" VALUE 0x008086A0 Scalar_FLOAT64_IEEE 0 FCC2ARINC_CM_double -1.7E+308 1.7E+308 /end CHARACTERISTIC
/begin CHARACTERISTIC FCC2ARINC_cal_impl.Decode2_P1 "" VALUE 0x00808908 Scalar_FLOAT64_IEEE 0 FCC2ARINC_CM_double -1.7E+308 1.7E+308 /end CHARACTERISTIC
/begin CHARACTERISTIC FCC2ARINC_cal_impl.Decode2_P10 "" VALUE 0x008089E0 Scalar_FLOAT64_IEEE 0 FCC2ARINC_CM_double -1.7E+308 1.7E+308 /end CHARACTERISTIC
/begin CHARACTERISTIC FCC2ARINC_cal_impl.Decode2_P11 "" VALUE 0x008089F8 Scalar_FLOAT64_IEEE 0 FCC2ARINC_CM_double -1.7E+308 1.7E+308 /end CHARACTERISTIC
/begin CHARACTERISTIC FCC2ARINC_cal_impl.Decode2_P12 "" VALUE 0x00808A10 Scalar_FLOAT64_IEEE 0 FCC2ARINC_CM_double -1.7E+308 1.7E+308 /end CHARACTERISTIC
/begin CHARACTERISTIC FCC2ARINC_cal_impl.Decode2_P13 "" VALUE 0x00808A28 Scalar_FLOAT64_IEEE 0 FCC2ARINC_CM_double -1.7E+308 1.7E+308 /end CHARACTERISTIC
/begin CHARACTERISTIC FCC2ARINC_cal_impl.Decode2_P14 "" VALUE 0x00808A40 Scalar_FLOAT64_IEEE 0 FCC2ARINC_CM_double -1.7E+308 1.7E+308 /end CHARACTERISTIC
/begin CHARACTERISTIC FCC2ARINC_cal_impl.Decode2_P15 "" VALUE 0x00808A58 Scalar_FLOAT64_IEEE 0 FCC2ARINC_CM_double -1.7E+308 1.7E+308 /end CHARACTERISTIC
/begin CHARACTERISTIC FCC2ARINC_cal_impl.Decode2_P16 "" VALUE 0x00808A70 Scalar_FLOAT64_IEEE 0 FCC2ARINC_CM_double -1.7E+308 1.7E+308 /end CHARACTERISTIC
/begin CHARACTERISTIC FCC2ARINC_cal_impl.Decode2_P2 "" VALUE 0x00808920 Scalar_FLOAT64_IEEE 0 FCC2ARINC_CM_double -1.7E+308 1.7E+308 /end CHARACTERISTIC
/begin CHARACTERISTIC FCC2ARINC_cal_impl.Decode2_P3 "" VALUE 0x00808938 Scalar_FLOAT64_IEEE 0 FCC2ARINC_CM_double -1.7E+308 1.7E+308 /end CHARACTERISTIC
/begin CHARACTERISTIC FCC2ARINC_cal_impl.Decode2_P4 "" VALUE 0x00808950 Scalar_FLOAT64_IEEE 0 FCC2ARINC_CM_double -1.7E+308 1.7E+308 /end CHARACTERISTIC
/begin CHARACTERISTIC FCC2ARINC_cal_impl.Decode2_P5 "" VALUE 0x00808968 Scalar_FLOAT64_IEEE 0 FCC2ARINC_CM_double -1.7E+308 1.7E+308 /end CHARACTERISTIC
/begin CHARACTERISTIC FCC2ARINC_cal_impl.Decode2_P6 "" VALUE 0x00808980 Scalar_FLOAT64_IEEE 0 FCC2ARINC_CM_double -1.7E+308 1.7E+308 /end CHARACTERISTIC
/begin CHARACTERISTIC FCC2ARINC_cal_impl.Decode2_P7 "" VALUE 0x00808998 Scalar_FLOAT64_IEEE 0 FCC2ARINC_CM_double -1.7E+308 1.7E+308 /end CHARACTERISTIC
/begin CHARACTERISTIC FCC2ARINC_cal_impl.Decode2_P8 "" VALUE 0x008089B0 Scalar_FLOAT64_IEEE 0 FCC2ARINC_CM_double -1.7E+308 1.7E+308 /end CHARACTERISTIC
/begin CHARACTERISTIC FCC2ARINC_cal_impl.Decode2_P9 "" VALUE 0x008089C8 Scalar_FLOAT64_IEEE 0 FCC2ARINC_CM_double -1.7E+308 1.7E+308 /end CHARACTERISTIC
/begin CHARACTERISTIC FCC2ARINC_cal_impl.Decode3_P1 "" VALUE 0x00808C08 Scalar_FLOAT64_IEEE 0 FCC2ARINC_CM_double -1.7E+308 1.7E+308 /end CHARACTERISTIC
/begin CHARACTERISTIC FCC2ARINC_cal_impl.Decode3_P10 "" VALUE 0x00808CE0 Scalar_FLOAT64_IEEE 0 FCC2ARINC_CM_double -1.7E+308 1.7E+308 /end CHARACTERISTIC
/begin CHARACTERISTIC FCC2ARINC_cal_impl.Decode3_P11 "" VALUE 0x00808CF8 Scalar_FLOAT64_IEEE 0 FCC2ARINC_CM_double -1.7E+308 1.7E+308 /end CHARACTERISTIC
/begin CHARACTERISTIC FCC2ARINC_cal_impl.Decode3_P12 "" VALUE 0x00808D10 Scalar_FLOAT64_IEEE 0 FCC2ARINC_CM_double -1.7E+308 1.7E+308 /end CHARACTERISTIC
/begin CHARACTERISTIC FCC2ARINC_cal_impl.Decode3_P13 "" VALUE 0x00808D28 Scalar_FLOAT64_IEEE 0 FCC2ARINC_CM_double -1.7E+308 1.7E+308 /end CHARACTERISTIC
/begin CHARACTERISTIC FCC2ARINC_cal_impl.Decode3_P14 "" VALUE 0x00808D40 Scalar_FLOAT64_IEEE 0 FCC2ARINC_CM_double -1.7E+308 1.7E+308 /end CHARACTERISTIC
/begin CHARACTERISTIC FCC2ARINC_cal_impl.Decode3_P15 "" VALUE 0x00808D58 Scalar_FLOAT64_IEEE 0 FCC2ARINC_CM_double -1.7E+308 1.7E+308 /end CHARACTERISTIC
/begin CHARACTERISTIC FCC2ARINC_cal_impl.Decode3_P16 "" VALUE 0x00808D70 Scalar_FLOAT64_IEEE 0 FCC2ARINC_CM_double -1.7E+308 1.7E+308 /end CHARACTERISTIC
/begin CHARACTERISTIC FCC2ARINC_cal_impl.Decode3_P2 "" VALUE 0x00808C20 Scalar_FLOAT64_IEEE 0 FCC2ARINC_CM_double -1.7E+308 1.7E+308 /end CHARACTERISTIC
/begin CHARACTERISTIC FCC2ARINC_cal_impl.Decode3_P3 "" VALUE 0x00808C38 Scalar_FLOAT64_IEEE 0 FCC2ARINC_CM_double -1.7E+308 1.7E+308 /end CHARACTERISTIC
/begin CHARACTERISTIC FCC2ARINC_cal_impl.Decode3_P4 "" VALUE 0x00808C50 Scalar_FLOAT64_IEEE 0 FCC2ARINC_CM_double -1.7E+308 1.7E+308 /end CHARACTERISTIC
/begin CHARACTERISTIC FCC2ARINC_cal_impl.Decode3_P5 "" VALUE 0x00808C68 Scalar_FLOAT64_IEEE 0 FCC2ARINC_CM_double -1.7E+308 1.7E+308 /end CHARACTERISTIC
/begin CHARACTERISTIC FCC2ARINC_cal_impl.Decode3_P6 "" VALUE 0x00808C80 Scalar_FLOAT64_IEEE 0 FCC2ARINC_CM_double -1.7E+308 1.7E+308 /end CHARACTERISTIC
/begin CHARACTERISTIC FCC2ARINC_cal_impl.Decode3_P7 "" VALUE 0x00808C98 Scalar_FLOAT64_IEEE 0 FCC2ARINC_CM_double -1.7E+308 1.7E+308 /end CHARACTERISTIC
/begin CHARACTERISTIC FCC2ARINC_cal_impl.Decode3_P8 "" VALUE 0x00808CB0 Scalar_FLOAT64_IEEE 0 FCC2ARINC_CM_double -1.7E+308 1.7E+308 /end CHARACTERISTIC
/begin CHARACTERISTIC FCC2ARINC_cal_impl.Decode3_P9 "" VALUE 0x00808CC8 Scalar_FLOAT64_IEEE 0 FCC2ARINC_CM_double -1.7E+308 1.7E+308 /end CHARACTERISTIC
/begin CHARACTERISTIC FCC2ARINC_cal_impl.Decode4_P1 "" VALUE 0x00808D88 Scalar_FLOAT64_IEEE 0 FCC2ARINC_CM_double -1.7E+308 1.7E+308 /end CHARACTERISTIC
/begin CHARACTERISTIC FCC2ARINC_cal_impl.Decode4_P10 "" VALUE 0x00808E60 Scalar_FLOAT64_IEEE 0 FCC2ARINC_CM_double -1.7E+308 1.7E+308 /end CHARACTERISTIC
/begin CHARACTERISTIC FCC2ARINC_cal_impl.Decode4_P11 "" VALUE 0x00808E78 Scalar_FLOAT64_IEEE 0 FCC2ARINC_CM_double -1.7E+308 1.7E+308 /end CHARACTERISTIC
/begin CHARACTERISTIC FCC2ARINC_cal_impl.Decode4_P12 "" VALUE 0x00808E90 Scalar_FLOAT64_IEEE 0 FCC2ARINC_CM_double -1.7E+308 1.7E+308 /end CHARACTERISTIC
/begin CHARACTERISTIC FCC2ARINC_cal_impl.Decode4_P13 "" VALUE 0x00808EA8 Scalar_FLOAT64_IEEE 0 FCC2ARINC_CM_double -1.7E+308 1.7E+308 /end CHARACTERISTIC
/begin CHARACTERISTIC FCC2ARINC_cal_impl.Decode4_P14 "" VALUE 0x00808EC0 Scalar_FLOAT64_IEEE 0 FCC2ARINC_CM_double -1.7E+308 1.7E+308 /end CHARACTERISTIC
/begin CHARACTERISTIC FCC2ARINC_cal_impl.Decode4_P15 "" VALUE 0x00808ED8 Scalar_FLOAT64_IEEE 0 FCC2ARINC_CM_double -1.7E+308 1.7E+308 /end CHARACTERISTIC
/begin CHARACTERISTIC FCC2ARINC_cal_impl.Decode4_P16 "" VALUE 0x00808EF0 Scalar_FLOAT64_IEEE 0 FCC2ARINC_CM_double -1.7E+308 1.7E+308 /end CHARACTERISTIC
/begin CHARACTERISTIC FCC2ARINC_cal_impl.Decode4_P2 "" VALUE 0x00808DA0 Scalar_FLOAT64_IEEE 0 FCC2ARINC_CM_double -1.7E+308 1.7E+308 /end CHARACTERISTIC
/begin CHARACTERISTIC FCC2ARINC_cal_impl.Decode4_P3 "" VALUE 0x00808DB8 Scalar_FLOAT64_IEEE 0 FCC2ARINC_CM_double -1.7E+308 1.7E+308 /end CHARACTERISTIC
/begin CHARACTERISTIC FCC2ARINC_cal_impl.Decode4_P4 "" VALUE 0x00808DD0 Scalar_FLOAT64_IEEE 0 FCC2ARINC_CM_double -1.7E+308 1.7E+308 /end CHARACTERISTIC
/begin CHARACTERISTIC FCC2ARINC_cal_impl.Decode4_P5 "" VALUE 0x00808DE8 Scalar_FLOAT64_IEEE 0 FCC2ARINC_CM_double -1.7E+308 1.7E+308 /end CHARACTERISTIC
/begin CHARACTERISTIC FCC2ARINC_cal_impl.Decode4_P6 "" VALUE 0x00808E00 Scalar_FLOAT64_IEEE 0 FCC2ARINC_CM_double -1.7E+308 1.7E+308 /end CHARACTERISTIC
/begin CHARACTERISTIC FCC2ARINC_cal_impl.Decode4_P7 "" VALUE 0x00808E18 Scalar_FLOAT64_IEEE 0 FCC2ARINC_CM_double -1.7E+308 1.7E+308 /end CHARACTERISTIC
/begin CHARACTERISTIC FCC2ARINC_cal_impl.Decode4_P8 "" VALUE 0x00808E30 Scalar_FLOAT64_IEEE 0 FCC2ARINC_CM_double -1.7E+308 1.7E+308 /end CHARACTERISTIC
/begin CHARACTERISTIC FCC2ARINC_cal_impl.Decode4_P9 "" VALUE 0x00808E48 Scalar_FLOAT64_IEEE 0 FCC2ARINC_CM_double -1.7E+308 1.7E+308 /end CHARACTERISTIC
/begin CHARACTERISTIC FCC2ARINC_cal_impl.Decode5_P1 "" VALUE 0x00808778 Scalar_FLOAT64_IEEE 0 FCC2ARINC_CM_double -1.7E+308 1.7E+308 /end CHARACTERISTIC
/begin CHARACTERISTIC FCC2ARINC_cal_impl.Decode5_P10 "" VALUE 0x00808850 Scalar_FLOAT64_IEEE 0 FCC2ARINC_CM_double -1.7E+308 1.7E+308 /end CHARACTERISTIC
/begin CHARACTERISTIC FCC2ARINC_cal_impl.Decode5_P11 "" VALUE 0x00808868 Scalar_FLOAT64_IEEE 0 FCC2ARINC_CM_double -1.7E+308 1.7E+308 /end CHARACTERISTIC
/begin CHARACTERISTIC FCC2ARINC_cal_impl.Decode5_P12 "" VALUE 0x00808880 Scalar_FLOAT64_IEEE 0 FCC2ARINC_CM_double -1.7E+308 1.7E+308 /end CHARACTERISTIC
/begin CHARACTERISTIC FCC2ARINC_cal_impl.Decode5_P13 "" VALUE 0x00808898 Scalar_FLOAT64_IEEE 0 FCC2ARINC_CM_double -1.7E+308 1.7E+308 /end CHARACTERISTIC
/begin CHARACTERISTIC FCC2ARINC_cal_impl.Decode5_P14 "" VALUE 0x008088B0 Scalar_FLOAT64_IEEE 0 FCC2ARINC_CM_double -1.7E+308 1.7E+308 /end CHARACTERISTIC
/begin CHARACTERISTIC FCC2ARINC_cal_impl.Decode5_P15 "" VALUE 0x008088C8 Scalar_FLOAT64_IEEE 0 FCC2ARINC_CM_double -1.7E+308 1.7E+308 /end CHARACTERISTIC
/begin CHARACTERISTIC FCC2ARINC_cal_impl.Decode5_P16 "" VALUE 0x008088E0 Scalar_FLOAT64_IEEE 0 FCC2ARINC_CM_double -1.7E+308 1.7E+308 /end CHARACTERISTIC
/begin CHARACTERISTIC FCC2ARINC_cal_impl.Decode5_P2 "" VALUE 0x00808790 Scalar_FLOAT64_IEEE 0 FCC2ARINC_CM_double -1.7E+308 1.7E+308 /end CHARACTERISTIC
/begin CHARACTERISTIC FCC2ARINC_cal_impl.Decode5_P3 "" VALUE 0x008087A8 Scalar_FLOAT64_IEEE 0 FCC2ARINC_CM_double -1.7E+308 1.7E+308 /end CHARACTERISTIC
/begin CHARACTERISTIC FCC2ARINC_cal_impl.Decode5_P4 "" VALUE 0x008087C0 Scalar_FLOAT64_IEEE 0 FCC2ARINC_CM_double -1.7E+308 1.7E+308 /end CHARACTERISTIC
/begin CHARACTERISTIC FCC2ARINC_cal_impl.Decode5_P5 "" VALUE 0x008087D8 Scalar_FLOAT64_IEEE 0 FCC2ARINC_CM_double -1.7E+308 1.7E+308 /end CHARACTERISTIC
/begin CHARACTERISTIC FCC2ARINC_cal_impl.Decode5_P6 "" VALUE 0x008087F0 Scalar_FLOAT64_IEEE 0 FCC2ARINC_CM_double -1.7E+308 1.7E+308 /end CHARACTERISTIC
/begin CHARACTERISTIC FCC2ARINC_cal_impl.Decode5_P7 "" VALUE 0x00808808 Scalar_FLOAT64_IEEE 0 FCC2ARINC_CM_double -1.7E+308 1.7E+308 /end CHARACTERISTIC
/begin CHARACTERISTIC FCC2ARINC_cal_impl.Decode5_P8 "" VALUE 0x00808820 Scalar_FLOAT64_IEEE 0 FCC2ARINC_CM_double -1.7E+308 1.7E+308 /end CHARACTERISTIC
/begin CHARACTERISTIC FCC2ARINC_cal_impl.Decode5_P9 "" VALUE 0x00808838 Scalar_FLOAT64_IEEE 0 FCC2ARINC_CM_double -1.7E+308 1.7E+308 /end CHARACTERISTIC
/begin CHARACTERISTIC FCC2ARINC_cal_impl.Decode6_P1 "" VALUE 0x00808A88 Scalar_FLOAT64_IEEE 0 FCC2ARINC_CM_double -1.7E+308 1.7E+308 /end CHARACTERISTIC
/begin CHARACTERISTIC FCC2ARINC_cal_impl.Decode6_P10 "" VALUE 0x00808B60 Scalar_FLOAT64_IEEE 0 FCC2ARINC_CM_double -1.7E+308 1.7E+308 /end CHARACTERISTIC
/begin CHARACTERISTIC FCC2ARINC_cal_impl.Decode6_P11 "" VALUE 0x00808B78 Scalar_FLOAT64_IEEE 0 FCC2ARINC_CM_double -1.7E+308 1.7E+308 /end CHARACTERISTIC
/begin CHARACTERISTIC FCC2ARINC_cal_impl.Decode6_P12 "" VALUE 0x00808B90 Scalar_FLOAT64_IEEE 0 FCC2ARINC_CM_double -1.7E+308 1.7E+308 /end CHARACTERISTIC
/begin CHARACTERISTIC FCC2ARINC_cal_impl.Decode6_P13 "" VALUE 0x00808BA8 Scalar_FLOAT64_IEEE 0 FCC2ARINC_CM_double -1.7E+308 1.7E+308 /end CHARACTERISTIC
/begin CHARACTERISTIC FCC2ARINC_cal_impl.Decode6_P14 "" VALUE 0x00808BC0 Scalar_FLOAT64_IEEE 0 FCC2ARINC_CM_double -1.7E+308 1.7E+308 /end CHARACTERISTIC
/begin CHARACTERISTIC FCC2ARINC_cal_impl.Decode6_P15 "" VALUE 0x00808BD8 Scalar_FLOAT64_IEEE 0 FCC2ARINC_CM_double -1.7E+308 1.7E+308 /end CHARACTERISTIC
/begin CHARACTERISTIC FCC2ARINC_cal_impl.Decode6_P16 "" VALUE 0x00808BF0 Scalar_FLOAT64_IEEE 0 FCC2ARINC_CM_double -1.7E+308 1.7E+308 /end CHARACTERISTIC
/begin CHARACTERISTIC FCC2ARINC_cal_impl.Decode6_P2 "" VALUE 0x00808AA0 Scalar_FLOAT64_IEEE 0 FCC2ARINC_CM_double -1.7E+308 1.7E+308 /end CHARACTERISTIC
/begin CHARACTERISTIC FCC2ARINC_cal_impl.Decode6_P3 "" VALUE 0x00808AB8 Scalar_FLOAT64_IEEE 0 FCC2ARINC_CM_double -1.7E+308 1.7E+308 /end CHARACTERISTIC
/begin CHARACTERISTIC FCC2ARINC_cal_impl.Decode6_P4 "" VALUE 0x00808AD0 Scalar_FLOAT64_IEEE 0 FCC2ARINC_CM_double -1.7E+308 1.7E+308 /end CHARACTERISTIC
/begin CHARACTERISTIC FCC2ARINC_cal_impl.Decode6_P5 "" VALUE 0x00808AE8 Scalar_FLOAT64_IEEE 0 FCC2ARINC_CM_double -1.7E+308 1.7E+308 /end CHARACTERISTIC
/begin CHARACTERISTIC FCC2ARINC_cal_impl.Decode6_P6 "" VALUE 0x00808B00 Scalar_FLOAT64_IEEE 0 FCC2ARINC_CM_double -1.7E+308 1.7E+308 /end CHARACTERISTIC
/begin CHARACTERISTIC FCC2ARINC_cal_impl.Decode6_P7 "" VALUE 0x00808B18 Scalar_FLOAT64_IEEE 0 FCC2ARINC_CM_double -1.7E+308 1.7E+308 /end CHARACTERISTIC
/begin CHARACTERISTIC FCC2ARINC_cal_impl.Decode6_P8 "" VALUE 0x00808B30 Scalar_FLOAT64_IEEE 0 FCC2ARINC_CM_double -1.7E+308 1.7E+308 /end CHARACTERISTIC
/begin CHARACTERISTIC FCC2ARINC_cal_impl.Decode6_P9 "" VALUE 0x00808B48 Scalar_FLOAT64_IEEE 0 FCC2ARINC_CM_double -1.7E+308 1.7E+308 /end CHARACTERISTIC
/begin CHARACTERISTIC FCC2ARINC_cal_impl.Decode7_P1 "" VALUE 0x00808F08 Scalar_FLOAT64_IEEE 0 FCC2ARINC_CM_double -1.7E+308 1.7E+308 /end CHARACTERISTIC
/begin CHARACTERISTIC FCC2ARINC_cal_impl.Decode7_P10 "" VALUE 0x00808FE0 Scalar_FLOAT64_IEEE 0 FCC2ARINC_CM_double -1.7E+308 1.7E+308 /end CHARACTERISTIC
/begin CHARACTERISTIC FCC2ARINC_cal_impl.Decode7_P11 "" VALUE 0x00808FF8 Scalar_FLOAT64_IEEE 0 FCC2ARINC_CM_double -1.7E+308 1.7E+308 /end CHARACTERISTIC
/begin CHARACTERISTIC FCC2ARINC_cal_impl.Decode7_P12 "" VALUE 0x00809010 Scalar_FLOAT64_IEEE 0 FCC2ARINC_CM_double -1.7E+308 1.7E+308 /end CHARACTERISTIC
/begin CHARACTERISTIC FCC2ARINC_cal_impl.Decode7_P13 "" VALUE 0x00809028 Scalar_FLOAT64_IEEE 0 FCC2ARINC_CM_double -1.7E+308 1.7E+308 /end CHARACTERISTIC
/begin CHARACTERISTIC FCC2ARINC_cal_impl.Decode7_P14 "" VALUE 0x00809040 Scalar_FLOAT64_IEEE 0 FCC2ARINC_CM_double -1.7E+308 1.7E+308 /end CHARACTERISTIC
/begin CHARACTERISTIC FCC2ARINC_cal_impl.Decode7_P15 "" VALUE 0x00809058 Scalar_FLOAT64_IEEE 0 FCC2ARINC_CM_double -1.7E+308 1.7E+308 /end CHARACTERISTIC
/begin CHARACTERISTIC FCC2ARINC_cal_impl.Decode7_P16 "" VALUE 0x00809070 Scalar_FLOAT64_IEEE 0 FCC2ARINC_CM_double -1.7E+308 1.7E+308 /end CHARACTERISTIC
/begin CHARACTERISTIC FCC2ARINC_cal_impl.Decode7_P2 "" VALUE 0x00808F20 Scalar_FLOAT64_IEEE 0 FCC2ARINC_CM_double -1.7E+308 1.7E+308 /end CHARACTERISTIC
/begin CHARACTERISTIC FCC2ARINC_cal_impl.Decode7_P3 "" VALUE 0x00808F38 Scalar_FLOAT64_IEEE 0 FCC2ARINC_CM_double -1.7E+308 1.7E+308 /end CHARACTERISTIC
/begin CHARACTERISTIC FCC2ARINC_cal_impl.Decode7_P4 "" VALUE 0x00808F50 Scalar_FLOAT64_IEEE 0 FCC2ARINC_CM_double -1.7E+308 1.7E+308 /end CHARACTERISTIC
/begin CHARACTERISTIC FCC2ARINC_cal_impl.Decode7_P5 "" VALUE 0x00808F68 Scalar_FLOAT64_IEEE 0 FCC2ARINC_CM_double -1.7E+308 1.7E+308 /end CHARACTERISTIC
/begin CHARACTERISTIC FCC2ARINC_cal_impl.Decode7_P6 "" VALUE 0x00808F80 Scalar_FLOAT64_IEEE 0 FCC2ARINC_CM_double -1.7E+308 1.7E+308 /end CHARACTERISTIC
/begin CHARACTERISTIC FCC2ARINC_cal_impl.Decode7_P7 "" VALUE 0x00808F98 Scalar_FLOAT64_IEEE 0 FCC2ARINC_CM_double -1.7E+308 1.7E+308 /end CHARACTERISTIC
/begin CHARACTERISTIC FCC2ARINC_cal_impl.Decode7_P8 "" VALUE 0x00808FB0 Scalar_FLOAT64_IEEE 0 FCC2ARINC_CM_double -1.7E+308 1.7E+308 /end CHARACTERISTIC
/begin CHARACTERISTIC FCC2ARINC_cal_impl.Decode7_P9 "" VALUE 0x00808FC8 Scalar_FLOAT64_IEEE 0 FCC2ARINC_CM_double -1.7E+308 1.7E+308 /end CHARACTERISTIC
/begin CHARACTERISTIC FCC2ARINC_cal_impl.Receivev2_P1 "" VALUE 0x00808568 Scalar_FLOAT64_IEEE 0 FCC2ARINC_CM_double -1.7E+308 1.7E+308 /end CHARACTERISTIC
/begin CHARACTERISTIC FCC2ARINC_cal_impl.Receivev2_P2 "" VALUE 0x00808580 Scalar_FLOAT64_IEEE 0 FCC2ARINC_CM_double -1.7E+308 1.7E+308 /end CHARACTERISTIC
/begin CHARACTERISTIC FCC2ARINC_cal_impl.Receivev2_P3 "" VALUE 0x00808598 Scalar_FLOAT64_IEEE 0 FCC2ARINC_CM_double -1.7E+308 1.7E+308 /end CHARACTERISTIC
/begin CHARACTERISTIC FCC2ARINC_cal_impl.Receivev2_P4 "" VALUE 0x008085B0 Scalar_FLOAT64_IEEE 0 FCC2ARINC_CM_double -1.7E+308 1.7E+308 /end CHARACTERISTIC
/begin CHARACTERISTIC FCC2ARINC_cal_impl.Receivev2_P5 "" VALUE 0x008085C8 Scalar_FLOAT64_IEEE 0 FCC2ARINC_CM_double -1.7E+308 1.7E+308 /end CHARACTERISTIC
/begin CHARACTERISTIC FCC2ARINC_cal_impl.Setupv2_P1 "" VALUE 0x00808038 Scalar_FLOAT64_IEEE 0 FCC2ARINC_CM_double -1.7E+308 1.7E+308 /end CHARACTERISTIC
/begin CHARACTERISTIC FCC2ARINC_cal_impl.Setupv2_P2 "" VALUE 0x00808050 Scalar_FLOAT64_IEEE 0 FCC2ARINC_CM_double -1.7E+308 1.7E+308 /end CHARACTERISTIC
/begin CHARACTERISTIC FCC2ARINC_cal_impl.Setupv2_P3 "" VALUE 0x00808068 Scalar_FLOAT64_IEEE 0 FCC2ARINC_CM_double -1.7E+308 1.7E+308 /end CHARACTERISTIC
/begin CHARACTERISTIC FCC2ARINC_cal_impl.Setupv2_P4 "" VALUE 0x00808080 Scalar_FLOAT64_IEEE 0 FCC2ARINC_CM_double -1.7E+308 1.7E+308 /end CHARACTERISTIC
/begin CHARACTERISTIC FCC2ARINC_cal_impl.Setupv2_P5 "" VALUE 0x00808098 Scalar_FLOAT64_IEEE 0 FCC2ARINC_CM_double -1.7E+308 1.7E+308 /end CHARACTERISTIC
/begin CHARACTERISTIC FCC2ARINC_cal_impl.Setupv2_P6 "" VALUE 0x008080B0 Scalar_FLOAT64_IEEE 0 FCC2ARINC_CM_double -1.7E+308 1.7E+308 /end CHARACTERISTIC
/begin CHARACTERISTIC FCC2ARINC_cal_impl.Setupv2_P7 "" VAL_BLK 0x008080C8 Scalar_FLOAT64_IEEE 0 FCC2ARINC_CM_double -1.7E+308 1.7E+308 MATRIX_DIM 5 16 /end CHARACTERISTIC
/begin CHARACTERISTIC FCC2ARINC_cal_impl.Setupv2_P8 "" VAL_BLK 0x00808358 Scalar_FLOAT64_IEEE 0 FCC2ARINC_CM_double -1.7E+308 1.7E+308 MATRIX_DIM 4 16 /end CHARACTERISTIC
/begin MEASUREMENT FCC2ARINC_B.CCCodeBlock "" FLOAT64_IEEE FCC2ARINC_CM_double 0 0 -1.7E+308 1.7E+308 ECU_ADDRESS 0x0080E138 /end MEASUREMENT
/begin MEASUREMENT FCC2ARINC_B.CCCodeBlock4 "" FLOAT64_IEEE FCC2ARINC_CM_double 0 0 -1.7E+308 1.7E+308 ECU_ADDRESS 0x0080E140 /end MEASUREMENT
/begin MEASUREMENT FCC2ARINC_B.Compare "" UBYTE FCC2ARINC_CM_logical 0 0 0 1 ECU_ADDRESS 0x0080E165 /end MEASUREMENT
/begin MEASUREMENT FCC2ARINC_B.Decode1 "" ULONG FCC2ARINC_CM_uint32 0 0 0 2147483646 ECU_ADDRESS 0x0080E148 /end MEASUREMENT
/begin MEASUREMENT FCC2ARINC_B.Decode2 "" UBYTE FCC2ARINC_CM_logical 0 0 0 1 ECU_ADDRESS 0x0080E15C /end MEASUREMENT
/begin MEASUREMENT FCC2ARINC_B.Decode3 "" UBYTE FCC2ARINC_CM_logical 0 0 0 1 ECU_ADDRESS 0x0080E15F /end MEASUREMENT
/begin MEASUREMENT FCC2ARINC_B.Decode4 "" UBYTE FCC2ARINC_CM_logical 0 0 0 1 ECU_ADDRESS 0x0080E161 /end MEASUREMENT
/begin MEASUREMENT FCC2ARINC_B.Decode5 "" ULONG FCC2ARINC_CM_uint32 0 0 0 2147483646 ECU_ADDRESS 0x0080E14C /end MEASUREMENT
/begin MEASUREMENT FCC2ARINC_B.Decode6 "" UBYTE FCC2ARINC_CM_logical 0 0 0 1 ECU_ADDRESS 0x0080E15D /end MEASUREMENT
/begin MEASUREMENT FCC2ARINC_B.Decode7 "" UBYTE FCC2ARINC_CM_logical 0 0 0 1 ECU_ADDRESS 0x0080E163 /end MEASUREMENT
/begin MEASUREMENT FCC2ARINC_B.FCC2_ACExxxA_GEARING_ROLL_HB "" UBYTE FCC2ARINC_CM_logical 0 0 0 1 ECU_ADDRESS 0x0080E160 /end MEASUREMENT
/begin MEASUREMENT FCC2ARINC_B.FCC2_ACExxxA_SUR_POS_2_AIL "" FLOAT32_IEEE FCC2ARINC_CM_single 0 0 -3.4E+38 3.4E+38 ECU_ADDRESS 0x0080E154 /end MEASUREMENT
/begin MEASUREMENT FCC2ARINC_B.FCC2_ACExxxA_SUR_POS_2_AIL_FAIL "" UBYTE FCC2ARINC_CM_logical 0 0 0 1 ECU_ADDRESS 0x0080E15E /end MEASUREMENT
/begin MEASUREMENT FCC2ARINC_B.FCC2_ACExxxA_TBI_HB "" UBYTE FCC2ARINC_CM_logical 0 0 0 1 ECU_ADDRESS 0x0080E162 /end MEASUREMENT
/begin MEASUREMENT FCC2ARINC_B.FCC2_ACExxxA_TBI_INCREMENTAL_DE "" UBYTE FCC2ARINC_CM_logical 0 0 0 1 ECU_ADDRESS 0x0080E164 /end MEASUREMENT
/begin MEASUREMENT FCC2ARINC_B.FCC2_ACExxxA_WHEEL_POS_2 "" FLOAT32_IEEE FCC2ARINC_CM_single 0 0 -3.4E+38 3.4E+38 ECU_ADDRESS 0x0080E150 /end MEASUREMENT
/begin MEASUREMENT FCC2ARINC_B.FCC2_ACExxxA_WHEEL_POS_2_FAIL "" FLOAT32_IEEE FCC2ARINC_CM_single 0 0 -3.4E+38 3.4E+38 ECU_ADDRESS 0x0080E158 /end MEASUREMENT
/begin MEASUREMENT FCC2ARINC_B.Receivev2 "" FLOAT64_IEEE FCC2ARINC_CM_double 0 0 -1.7E+308 1.7E+308 LAYOUT COLUMN_DIR MATRIX_DIM 11 ECU_ADDRESS 0x0080E0E0 /end MEASUREMENT
/begin COMPU_METHOD FCC2ARINC_CM_double "" IDENTICAL "%15.10" "" /end COMPU_METHOD
/begin COMPU_METHOD FCC2ARINC_CM_logical "" IDENTICAL "%1.0" "" /end COMPU_METHOD
/begin COMPU_METHOD FCC2ARINC_CM_single "" IDENTICAL "%8.6" "" /end COMPU_METHOD
/begin COMPU_METHOD FCC2ARINC_CM_uint32 "" IDENTICAL "%10.0" "" /end COMPU_METHOD
/begin RECORD_LAYOUT Scalar_BOOLEAN FNC_VALUES 1 UBYTE COLUMN_DIR DIRECT /end RECORD_LAYOUT
/begin RECORD_LAYOUT Scalar_FLOAT32_IEEE FNC_VALUES 1 FLOAT32_IEEE COLUMN_DIR DIRECT /end RECORD_LAYOUT
/begin RECORD_LAYOUT Scalar_FLOAT64_IEEE FNC_VALUES 1 FLOAT64_IEEE COLUMN_DIR DIRECT /end RECORD_LAYOUT
/begin RECORD_LAYOUT Scalar_ULONG FNC_VALUES 1 ULONG COLUMN_DIR DIRECT /end RECORD_LAYOUT
/begin GROUP FCC2ARINC "FCC2ARINC" ROOT /begin SUB_GROUP FCC2ARINC_Decode_Channel_1 /end SUB_GROUP
 /begin REF_CHARACTERISTIC FCC2ARINC_cal_impl.Receivev2_P1 FCC2ARINC_cal_impl.Receivev2_P2 FCC2ARINC_cal_impl.Receivev2_P3 FCC2ARINC_cal_impl.Receivev2_P4 FCC2ARINC_cal_impl.Receivev2_P5 FCC2ARINC_cal_impl.Setupv2_P1 FCC2ARINC_cal_impl.Setupv2_P2 FCC2ARINC_cal_impl.Setupv2_P3 FCC2ARINC_cal_impl.Setupv2_P4 FCC2ARINC_cal_impl.Setupv2_P5 FCC2ARINC_cal_impl.Setupv2_P6 FCC2ARINC_cal_impl.Setupv2_P7 FCC2ARINC_cal_impl.Setupv2_P8 /end REF_CHARACTERISTIC
 /begin REF_MEASUREMENT FCC2ARINC_B.Receivev2 FCC2ARINC_DW.Receivev2_PWORK FCC2ARINC_DW.Setupv2_PWORK /end REF_MEASUREMENT
/end GROUP
/begin GROUP FCC2ARINC_Decode_Channel_1 "FCC2ARINC/Decode Channel 1" /begin SUB_GROUP FCC2ARINC_Decode_Channel_1_Compare_To_Zero /end SUB_GROUP
 /begin REF_CHARACTERISTIC FCC2ARINC_cal_impl.CCCodeBlock4_P1 FCC2ARINC_cal_impl.CCCodeBlock4_P2 FCC2ARINC_cal_impl.CCCodeBlock4_P3 FCC2ARINC_cal_impl.CCCodeBlock4_P4 FCC2ARINC_cal_impl.CCCodeBlock4_P5 FCC2ARINC_cal_impl.CCCodeBlock_P1 FCC2ARINC_cal_impl.CCCodeBlock_P2 FCC2ARINC_cal_impl.CCCodeBlock_P3 FCC2ARINC_cal_impl.CCCodeBlock_P4 FCC2ARINC_cal_impl.CCCodeBlock_P5 FCC2ARINC_cal_impl.Decode1_P1 FCC2ARINC_cal_impl.Decode1_P10 FCC2ARINC_cal_impl.Decode1_P11 FCC2ARINC_cal_impl.Decode1_P12 FCC2ARINC_cal_impl.Decode1_P13 FCC2ARINC_cal_impl.Decode1_P14 FCC2ARINC_cal_impl.Decode1_P15 FCC2ARINC_cal_impl.Decode1_P16 FCC2ARINC_cal_impl.Decode1_P2 FCC2ARINC_cal_impl.Decode1_P3 FCC2ARINC_cal_impl.Decode1_P4 FCC2ARINC_cal_impl.Decode1_P5 FCC2ARINC_cal_impl.Decode1_P6 FCC2ARINC_cal_impl.Decode1_P7 FCC2ARINC_cal_impl.Decode1_P8 FCC2ARINC_cal_impl.Decode1_P9 FCC2ARINC_cal_impl.Decode2_P1 FCC2ARINC_cal_impl.Decode2_P10 FCC2ARINC_cal_impl.Decode2_P11 FCC2ARINC_cal_impl.Decode2_P12 FCC2ARINC_cal_impl.Decode2_P13 FCC2ARINC_cal_impl.Decode2_P14 FCC2ARINC_cal_impl.Decode2_P15 FCC2ARINC_cal_impl.Decode2_P16 FCC2ARINC_cal_impl.Decode2_P2 FCC2ARINC_cal_impl.Decode2_P3 FCC2ARINC_cal_impl.Decode2_P4 FCC2ARINC_cal_impl.Decode2_P5 FCC2ARINC_cal_impl.Decode2_P6 FCC2ARINC_cal_impl.Decode2_P7 FCC2ARINC_cal_impl.Decode2_P8 FCC2ARINC_cal_impl.Decode2_P9 FCC2ARINC_cal_impl.Decode3_P1 FCC2ARINC_cal_impl.Decode3_P10 FCC2ARINC_cal_impl.Decode3_P11 FCC2ARINC_cal_impl.Decode3_P12 FCC2ARINC_cal_impl.Decode3_P13 FCC2ARINC_cal_impl.Decode3_P14 FCC2ARINC_cal_impl.Decode3_P15 FCC2ARINC_cal_impl.Decode3_P16 FCC2ARINC_cal_impl.Decode3_P2 FCC2ARINC_cal_impl.Decode3_P3 FCC2ARINC_cal_impl.Decode3_P4 FCC2ARINC_cal_impl.Decode3_P5 FCC2ARINC_cal_impl.Decode3_P6 FCC2ARINC_cal_impl.Decode3_P7 FCC2ARINC_cal_impl.Decode3_P8 FCC2ARINC_cal_impl.Decode3_P9 FCC2ARINC_cal_impl.Decode4_P1 FCC2ARINC_cal_impl.Decode4_P10 FCC2ARINC_cal_impl.Decode4_P11 FCC2ARINC_cal_impl.Decode4_P12 FCC2ARINC_cal_impl.Decode4_P13 FCC2ARINC_cal_impl.Decode4_P14 FCC2ARINC_cal_impl.Decode4_P15 FCC2ARINC_cal_impl.Decode4_P16 FCC2ARINC_cal_impl.Decode4_P2 FCC2ARINC_cal_impl.Decode4_P3 FCC2ARINC_cal_impl.Decode4_P4 FCC2ARINC_cal_impl.Decode4_P5 FCC2ARINC_cal_impl.Decode4_P6 FCC2ARINC_cal_impl.Decode4_P7 FCC2ARINC_cal_impl.Decode4_P8 FCC2ARINC_cal_impl.Decode4_P9 FCC2ARINC_cal_impl.Decode5_P1 FCC2ARINC_cal_impl.Decode5_P10 FCC2ARINC_cal_impl.Decode5_P11 FCC2ARINC_cal_impl.Decode5_P12 FCC2ARINC_cal_impl.Decode5_P13 FCC2ARINC_cal_impl.Decode5_P14 FCC2ARINC_cal_impl.Decode5_P15 FCC2ARINC_cal_impl.Decode5_P16 FCC2ARINC_cal_impl.Decode5_P2 FCC2ARINC_cal_impl.Decode5_P3 FCC2ARINC_cal_impl.Decode5_P4 FCC2ARINC_cal_impl.Decode5_P5 FCC2ARINC_cal_impl.Decode5_P6 FCC2ARINC_cal_impl.Decode5_P7 FCC2ARINC_cal_impl.Decode5_P8 FCC2ARINC_cal_impl.Decode5_P9 FCC2ARINC_cal_impl.Decode6_P1 FCC2ARINC_cal_impl.Decode6_P10 FCC2ARINC_cal_impl.Decode6_P11 FCC2ARINC_cal_impl.Decode6_P12 FCC2ARINC_cal_impl.Decode6_P13 FCC2ARINC_cal_impl.Decode6_P14 FCC2ARINC_cal_impl.Decode6_P15 FCC2ARINC_cal_impl.Decode6_P16 FCC2ARINC_cal_impl.Decode6_P2 FCC2ARINC_cal_impl.Decode6_P3 FCC2ARINC_cal_impl.Decode6_P4 FCC2ARINC_cal_impl.Decode6_P5 FCC2ARINC_cal_impl.Decode6_P6 FCC2ARINC_cal_impl.Decode6_P7 FCC2ARINC_cal_impl.Decode6_P8 FCC2ARINC_cal_impl.Decode6_P9 FCC2ARINC_cal_impl.Decode7_P1 FCC2ARINC_cal_impl.Decode7_P10 FCC2ARINC_cal_impl.Decode7_P11 FCC2ARINC_cal_impl.Decode7_P12 FCC2ARINC_cal_impl.Decode7_P13 FCC2ARINC_cal_impl.Decode7_P14 FCC2ARINC_cal_impl.Decode7_P15 FCC2ARINC_cal_impl.Decode7_P16 FCC2ARINC_cal_impl.Decode7_P2 FCC2ARINC_cal_impl.Decode7_P3 FCC2ARINC_cal_impl.Decode7_P4 FCC2ARINC_cal_impl.Decode7_P5 FCC2ARINC_cal_impl.Decode7_P6 FCC2ARINC_cal_impl.Decode7_P7 FCC2ARINC_cal_impl.Decode7_P8 FCC2ARINC_cal_impl.Decode7_P9 /end REF_CHARACTERISTIC
 /begin REF_MEASUREMENT FCC2ARINC_B.CCCodeBlock FCC2ARINC_B.CCCodeBlock4 FCC2ARINC_B.Decode1 FCC2ARINC_B.Decode2 FCC2ARINC_B.Decode3 FCC2ARINC_B.Decode4 FCC2ARINC_B.Decode5 FCC2ARINC_B.Decode6 FCC2ARINC_B.Decode7 FCC2ARINC_B.FCC2_ACExxxA_GEARING_ROLL_HB FCC2ARINC_B.FCC2_ACExxxA_SUR_POS_2_AIL FCC2ARINC_B.FCC2_ACExxxA_SUR_POS_2_AIL_FAIL FCC2ARINC_B.FCC2_ACExxxA_TBI_HB FCC2ARINC_B.FCC2_ACExxxA_TBI_INCREMENTAL_DE FCC2ARINC_B.FCC2_ACExxxA_WHEEL_POS_2 FCC2ARINC_B.FCC2_ACExxxA_WHEEL_POS_2_FAIL FCC2ARINC_B.Receivev2 /end REF_MEASUREMENT
/end GROUP
/begin GROUP FCC2ARINC_Decode_Channel_1_Compare_To_Zero "FCC2ARINC/Decode Channel 1/Compare
To Zero" /begin REF_CHARACTERISTIC FCC2ARINC_cal_impl.Constant_Value /end REF_CHARACTERISTIC /begin REF_MEASUREMENT FCC2ARINC_B.Compare FCC2ARINC_B.Receivev2 /end REF_MEASUREMENT /end GROUP
/end MODULE
/end PROJECT
