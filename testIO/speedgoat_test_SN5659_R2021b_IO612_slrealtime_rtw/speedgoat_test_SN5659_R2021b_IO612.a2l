/******************************************************************************
* ASAP2 file: speedgoat_test_SN5659_R2021b_IO612.a2l
* Code generation for model "speedgoat_test_SN5659_R2021b_IO612".
* Model version : 3.5
* Simulink Coder version : 10.4 R2021b
* C source code generated on : Fri Apr 08 17:08:59 2022
* Target selection: slrealtime.tlc
* Embedded hardware selection: Intel->x86-64 (Linux 64)
* Code generation objectives: Unspecified
* Validation result: Not run
* (add additional file header information here)
******************************************************************************/ ASAP2_VERSION 1 71
/begin PROJECT ProjectName "Project Comment Goes Here"
/begin HEADER "Header Comments go here" /end HEADER
/begin MODULE ModuleName "Module Comment Goes Here"
/begin IF_DATA XCP
 /begin PROTOCOL_LAYER 0x0100 0x03E8 0x00C8 0x0000 0x0000 0x0000 0x0000 0x0000 0xFC 0x0578 BYTE_ORDER_MSB_LAST ADDRESS_GRANULARITY_BYTE OPTIONAL_CMD ALLOC_ODT_ENTRY OPTIONAL_CMD ALLOC_ODT OPTIONAL_CMD ALLOC_DAQ OPTIONAL_CMD FREE_DAQ OPTIONAL_CMD GET_DAQ_RESOLUTION_INFO OPTIONAL_CMD GET_DAQ_PROCESSOR_INFO OPTIONAL_CMD START_STOP_SYNCH OPTIONAL_CMD START_STOP_DAQ_LIST OPTIONAL_CMD SET_DAQ_LIST_MODE OPTIONAL_CMD WRITE_DAQ OPTIONAL_CMD SET_DAQ_PTR OPTIONAL_CMD GET_CAL_PAGE OPTIONAL_CMD SET_CAL_PAGE OPTIONAL_CMD COPY_CAL_PAGE OPTIONAL_CMD SHORT_DOWNLOAD OPTIONAL_CMD DOWNLOAD_MAX OPTIONAL_CMD DOWNLOAD OPTIONAL_CMD SHORT_UPLOAD OPTIONAL_CMD UPLOAD OPTIONAL_CMD SET_MTA /end PROTOCOL_LAYER
 /begin DAQ DYNAMIC 0x0000 0x0080 0x00 OPTIMISATION_TYPE_DEFAULT ADDRESS_EXTENSION_FREE IDENTIFICATION_FIELD_TYPE_RELATIVE_WORD_ALIGNED GRANULARITY_ODT_ENTRY_SIZE_DAQ_BYTE 0xFF OVERLOAD_INDICATION_PID PRESCALER_SUPPORTED /begin STIM GRANULARITY_ODT_ENTRY_SIZE_STIM_BYTE 0xFF /end STIM /begin TIMESTAMP_SUPPORTED 0x0001 SIZE_DWORD UNIT_1US TIMESTAMP_FIXED /end TIMESTAMP_SUPPORTED /begin EVENT "1 ms" "1 ms" 0x0000 DAQ 0xFF 0x01 0x06 0x00 /end EVENT /end DAQ
 /begin XCP_ON_UDP_IP 0x0100 0x15B3 ADDRESS "192.168.7.2" /end XCP_ON_UDP_IP
/end IF_DATA
/begin MOD_PAR "MOD PAR Comment Goes Here"
 /begin MEMORY_SEGMENT speedgoat_test_SN5659__cal_impl "speedgoat_test_SN5659__cal_impl" DATA FLASH INTERN 0x00295020 0xC58 -1 -1 -1 -1 -1
  /begin IF_DATA XCP
   /begin SEGMENT 0x00 0x02 0x00 0x00 0x00
    /begin PAGE 0x00 ECU_ACCESS_DONT_CARE XCP_READ_ACCESS_DONT_CARE XCP_WRITE_ACCESS_NOT_ALLOWED /end PAGE
    /begin PAGE 0x01 ECU_ACCESS_DONT_CARE XCP_READ_ACCESS_DONT_CARE XCP_WRITE_ACCESS_DONT_CARE /end PAGE
   /end SEGMENT
  /end IF_DATA
 /end MEMORY_SEGMENT
/end MOD_PAR
/begin MOD_COMMON "Mod Common Comment Here" BYTE_ORDER MSB_LAST ALIGNMENT_BYTE 1 ALIGNMENT_WORD 2 ALIGNMENT_LONG 4 ALIGNMENT_FLOAT32_IEEE 4 ALIGNMENT_FLOAT64_IEEE 8 ALIGNMENT_INT64 8 /end MOD_COMMON
/begin CHARACTERISTIC speedgoat_test_SN5659__cal_impl.CANRead1_P1 "" VALUE 0x00295128 Scalar_FLOAT64_IEEE 0 speedgoat_test_SN5659_R2021b_IO612_CM_double -1.7E+308 1.7E+308 /end CHARACTERISTIC
/begin CHARACTERISTIC speedgoat_test_SN5659__cal_impl.CANRead1_P2 "" VALUE 0x00295140 Scalar_FLOAT64_IEEE 0 speedgoat_test_SN5659_R2021b_IO612_CM_double -1.7E+308 1.7E+308 /end CHARACTERISTIC
/begin CHARACTERISTIC speedgoat_test_SN5659__cal_impl.CANRead1_P3 "" VALUE 0x00295158 Scalar_FLOAT64_IEEE 0 speedgoat_test_SN5659_R2021b_IO612_CM_double -1.7E+308 1.7E+308 /end CHARACTERISTIC
/begin CHARACTERISTIC speedgoat_test_SN5659__cal_impl.CANRead1_P4 "" VAL_BLK 0x00295170 Scalar_FLOAT64_IEEE 0 speedgoat_test_SN5659_R2021b_IO612_CM_double -1.7E+308 1.7E+308 MATRIX_DIM 5 1 /end CHARACTERISTIC
/begin CHARACTERISTIC speedgoat_test_SN5659__cal_impl.CANRead1_P5 "" VALUE 0x002951A8 Scalar_FLOAT64_IEEE 0 speedgoat_test_SN5659_R2021b_IO612_CM_double -1.7E+308 1.7E+308 /end CHARACTERISTIC
/begin CHARACTERISTIC speedgoat_test_SN5659__cal_impl.CANRead1_P6 "" VALUE 0x002951C0 Scalar_FLOAT64_IEEE 0 speedgoat_test_SN5659_R2021b_IO612_CM_double -1.7E+308 1.7E+308 /end CHARACTERISTIC
/begin CHARACTERISTIC speedgoat_test_SN5659__cal_impl.CANRead1_P7 "" VALUE 0x002951D8 Scalar_FLOAT64_IEEE 0 speedgoat_test_SN5659_R2021b_IO612_CM_double -1.7E+308 1.7E+308 /end CHARACTERISTIC
/begin CHARACTERISTIC speedgoat_test_SN5659__cal_impl.CANRead_P1 "" VALUE 0x00295048 Scalar_FLOAT64_IEEE 0 speedgoat_test_SN5659_R2021b_IO612_CM_double -1.7E+308 1.7E+308 /end CHARACTERISTIC
/begin CHARACTERISTIC speedgoat_test_SN5659__cal_impl.CANRead_P2 "" VALUE 0x00295060 Scalar_FLOAT64_IEEE 0 speedgoat_test_SN5659_R2021b_IO612_CM_double -1.7E+308 1.7E+308 /end CHARACTERISTIC
/begin CHARACTERISTIC speedgoat_test_SN5659__cal_impl.CANRead_P3 "" VALUE 0x00295078 Scalar_FLOAT64_IEEE 0 speedgoat_test_SN5659_R2021b_IO612_CM_double -1.7E+308 1.7E+308 /end CHARACTERISTIC
/begin CHARACTERISTIC speedgoat_test_SN5659__cal_impl.CANRead_P4 "" VAL_BLK 0x00295090 Scalar_FLOAT64_IEEE 0 speedgoat_test_SN5659_R2021b_IO612_CM_double -1.7E+308 1.7E+308 MATRIX_DIM 5 1 /end CHARACTERISTIC
/begin CHARACTERISTIC speedgoat_test_SN5659__cal_impl.CANRead_P5 "" VALUE 0x002950C8 Scalar_FLOAT64_IEEE 0 speedgoat_test_SN5659_R2021b_IO612_CM_double -1.7E+308 1.7E+308 /end CHARACTERISTIC
/begin CHARACTERISTIC speedgoat_test_SN5659__cal_impl.CANRead_P6 "" VALUE 0x002950E0 Scalar_FLOAT64_IEEE 0 speedgoat_test_SN5659_R2021b_IO612_CM_double -1.7E+308 1.7E+308 /end CHARACTERISTIC
/begin CHARACTERISTIC speedgoat_test_SN5659__cal_impl.CANRead_P7 "" VALUE 0x002950F8 Scalar_FLOAT64_IEEE 0 speedgoat_test_SN5659_R2021b_IO612_CM_double -1.7E+308 1.7E+308 /end CHARACTERISTIC
/begin CHARACTERISTIC speedgoat_test_SN5659__cal_impl.CANSetup_P1 "" VALUE 0x002951F0 Scalar_FLOAT64_IEEE 0 speedgoat_test_SN5659_R2021b_IO612_CM_double -1.7E+308 1.7E+308 /end CHARACTERISTIC
/begin CHARACTERISTIC speedgoat_test_SN5659__cal_impl.CANSetup_P10 "" VAL_BLK 0x002952E8 Scalar_FLOAT64_IEEE 0 speedgoat_test_SN5659_R2021b_IO612_CM_double -1.7E+308 1.7E+308 MATRIX_DIM 2 1 /end CHARACTERISTIC
/begin CHARACTERISTIC speedgoat_test_SN5659__cal_impl.CANSetup_P11 "" VAL_BLK 0x00295308 Scalar_FLOAT64_IEEE 0 speedgoat_test_SN5659_R2021b_IO612_CM_double -1.7E+308 1.7E+308 MATRIX_DIM 2 1 /end CHARACTERISTIC
/begin CHARACTERISTIC speedgoat_test_SN5659__cal_impl.CANSetup_P12 "" VALUE 0x00295328 Scalar_FLOAT64_IEEE 0 speedgoat_test_SN5659_R2021b_IO612_CM_double -1.7E+308 1.7E+308 /end CHARACTERISTIC
/begin CHARACTERISTIC speedgoat_test_SN5659__cal_impl.CANSetup_P13 "" VAL_BLK 0x00295340 Scalar_FLOAT64_IEEE 0 speedgoat_test_SN5659_R2021b_IO612_CM_double -1.7E+308 1.7E+308 MATRIX_DIM 4 1 /end CHARACTERISTIC
/begin CHARACTERISTIC speedgoat_test_SN5659__cal_impl.CANSetup_P14 "" VAL_BLK 0x00295370 Scalar_FLOAT64_IEEE 0 speedgoat_test_SN5659_R2021b_IO612_CM_double -1.7E+308 1.7E+308 MATRIX_DIM 2 1 /end CHARACTERISTIC
/begin CHARACTERISTIC speedgoat_test_SN5659__cal_impl.CANSetup_P15 "" VAL_BLK 0x00295390 Scalar_FLOAT64_IEEE 0 speedgoat_test_SN5659_R2021b_IO612_CM_double -1.7E+308 1.7E+308 MATRIX_DIM 2 1 /end CHARACTERISTIC
/begin CHARACTERISTIC speedgoat_test_SN5659__cal_impl.CANSetup_P16 "" VALUE 0x002953B0 Scalar_FLOAT64_IEEE 0 speedgoat_test_SN5659_R2021b_IO612_CM_double -1.7E+308 1.7E+308 /end CHARACTERISTIC
/begin CHARACTERISTIC speedgoat_test_SN5659__cal_impl.CANSetup_P17 "" VAL_BLK 0x002953C8 Scalar_FLOAT64_IEEE 0 speedgoat_test_SN5659_R2021b_IO612_CM_double -1.7E+308 1.7E+308 MATRIX_DIM 4 1 /end CHARACTERISTIC
/begin CHARACTERISTIC speedgoat_test_SN5659__cal_impl.CANSetup_P18 "" VAL_BLK 0x002953F8 Scalar_FLOAT64_IEEE 0 speedgoat_test_SN5659_R2021b_IO612_CM_double -1.7E+308 1.7E+308 MATRIX_DIM 2 1 /end CHARACTERISTIC
/begin CHARACTERISTIC speedgoat_test_SN5659__cal_impl.CANSetup_P19 "" VAL_BLK 0x00295418 Scalar_FLOAT64_IEEE 0 speedgoat_test_SN5659_R2021b_IO612_CM_double -1.7E+308 1.7E+308 MATRIX_DIM 2 1 /end CHARACTERISTIC
/begin CHARACTERISTIC speedgoat_test_SN5659__cal_impl.CANSetup_P2 "" VAL_BLK 0x00295208 Scalar_FLOAT64_IEEE 0 speedgoat_test_SN5659_R2021b_IO612_CM_double -1.7E+308 1.7E+308 MATRIX_DIM 2 1 /end CHARACTERISTIC
/begin CHARACTERISTIC speedgoat_test_SN5659__cal_impl.CANSetup_P20 "" VALUE 0x00295438 Scalar_FLOAT64_IEEE 0 speedgoat_test_SN5659_R2021b_IO612_CM_double -1.7E+308 1.7E+308 /end CHARACTERISTIC
/begin CHARACTERISTIC speedgoat_test_SN5659__cal_impl.CANSetup_P21 "" VAL_BLK 0x00295450 Scalar_FLOAT64_IEEE 0 speedgoat_test_SN5659_R2021b_IO612_CM_double -1.7E+308 1.7E+308 MATRIX_DIM 4 1 /end CHARACTERISTIC
/begin CHARACTERISTIC speedgoat_test_SN5659__cal_impl.CANSetup_P22 "" VAL_BLK 0x00295480 Scalar_FLOAT64_IEEE 0 speedgoat_test_SN5659_R2021b_IO612_CM_double -1.7E+308 1.7E+308 MATRIX_DIM 2 1 /end CHARACTERISTIC
/begin CHARACTERISTIC speedgoat_test_SN5659__cal_impl.CANSetup_P23 "" VAL_BLK 0x002954A0 Scalar_FLOAT64_IEEE 0 speedgoat_test_SN5659_R2021b_IO612_CM_double -1.7E+308 1.7E+308 MATRIX_DIM 2 1 /end CHARACTERISTIC
/begin CHARACTERISTIC speedgoat_test_SN5659__cal_impl.CANSetup_P24 "" VALUE 0x002954C0 Scalar_FLOAT64_IEEE 0 speedgoat_test_SN5659_R2021b_IO612_CM_double -1.7E+308 1.7E+308 /end CHARACTERISTIC
/begin CHARACTERISTIC speedgoat_test_SN5659__cal_impl.CANSetup_P25 "" VALUE 0x002954D8 Scalar_FLOAT64_IEEE 0 speedgoat_test_SN5659_R2021b_IO612_CM_double -1.7E+308 1.7E+308 /end CHARACTERISTIC
/begin CHARACTERISTIC speedgoat_test_SN5659__cal_impl.CANSetup_P26 "" VAL_BLK 0x002954F0 Scalar_FLOAT64_IEEE 0 speedgoat_test_SN5659_R2021b_IO612_CM_double -1.7E+308 1.7E+308 MATRIX_DIM 5 1 /end CHARACTERISTIC
/begin CHARACTERISTIC speedgoat_test_SN5659__cal_impl.CANSetup_P27 "" VALUE 0x00295528 Scalar_FLOAT64_IEEE 0 speedgoat_test_SN5659_R2021b_IO612_CM_double -1.7E+308 1.7E+308 /end CHARACTERISTIC
/begin CHARACTERISTIC speedgoat_test_SN5659__cal_impl.CANSetup_P28 "" VAL_BLK 0x00295540 Scalar_FLOAT64_IEEE 0 speedgoat_test_SN5659_R2021b_IO612_CM_double -1.7E+308 1.7E+308 MATRIX_DIM 4 1 /end CHARACTERISTIC
/begin CHARACTERISTIC speedgoat_test_SN5659__cal_impl.CANSetup_P29 "" VAL_BLK 0x00295570 Scalar_FLOAT64_IEEE 0 speedgoat_test_SN5659_R2021b_IO612_CM_double -1.7E+308 1.7E+308 MATRIX_DIM 4 1 /end CHARACTERISTIC
/begin CHARACTERISTIC speedgoat_test_SN5659__cal_impl.CANSetup_P3 "" VALUE 0x00295228 Scalar_FLOAT64_IEEE 0 speedgoat_test_SN5659_R2021b_IO612_CM_double -1.7E+308 1.7E+308 /end CHARACTERISTIC
/begin CHARACTERISTIC speedgoat_test_SN5659__cal_impl.CANSetup_P30 "" VAL_BLK 0x002955A0 Scalar_FLOAT64_IEEE 0 speedgoat_test_SN5659_R2021b_IO612_CM_double -1.7E+308 1.7E+308 MATRIX_DIM 4 1 /end CHARACTERISTIC
/begin CHARACTERISTIC speedgoat_test_SN5659__cal_impl.CANSetup_P31 "" VALUE 0x002955D0 Scalar_FLOAT64_IEEE 0 speedgoat_test_SN5659_R2021b_IO612_CM_double -1.7E+308 1.7E+308 /end CHARACTERISTIC
/begin CHARACTERISTIC speedgoat_test_SN5659__cal_impl.CANSetup_P4 "" VALUE 0x00295240 Scalar_FLOAT64_IEEE 0 speedgoat_test_SN5659_R2021b_IO612_CM_double -1.7E+308 1.7E+308 /end CHARACTERISTIC
/begin CHARACTERISTIC speedgoat_test_SN5659__cal_impl.CANSetup_P5 "" VALUE 0x00295258 Scalar_FLOAT64_IEEE 0 speedgoat_test_SN5659_R2021b_IO612_CM_double -1.7E+308 1.7E+308 /end CHARACTERISTIC
/begin CHARACTERISTIC speedgoat_test_SN5659__cal_impl.CANSetup_P6 "" VALUE 0x00295270 Scalar_FLOAT64_IEEE 0 speedgoat_test_SN5659_R2021b_IO612_CM_double -1.7E+308 1.7E+308 /end CHARACTERISTIC
/begin CHARACTERISTIC speedgoat_test_SN5659__cal_impl.CANSetup_P7 "" VALUE 0x00295288 Scalar_FLOAT64_IEEE 0 speedgoat_test_SN5659_R2021b_IO612_CM_double -1.7E+308 1.7E+308 /end CHARACTERISTIC
/begin CHARACTERISTIC speedgoat_test_SN5659__cal_impl.CANSetup_P8 "" VALUE 0x002952A0 Scalar_FLOAT64_IEEE 0 speedgoat_test_SN5659_R2021b_IO612_CM_double -1.7E+308 1.7E+308 /end CHARACTERISTIC
/begin CHARACTERISTIC speedgoat_test_SN5659__cal_impl.CANSetup_P9 "" VAL_BLK 0x002952B8 Scalar_FLOAT64_IEEE 0 speedgoat_test_SN5659_R2021b_IO612_CM_double -1.7E+308 1.7E+308 MATRIX_DIM 4 1 /end CHARACTERISTIC
/begin CHARACTERISTIC speedgoat_test_SN5659__cal_impl.CANWrite1_P1 "" VALUE 0x00295968 Scalar_FLOAT64_IEEE 0 speedgoat_test_SN5659_R2021b_IO612_CM_double -1.7E+308 1.7E+308 /end CHARACTERISTIC
/begin CHARACTERISTIC speedgoat_test_SN5659__cal_impl.CANWrite1_P2 "" VALUE 0x00295980 Scalar_FLOAT64_IEEE 0 speedgoat_test_SN5659_R2021b_IO612_CM_double -1.7E+308 1.7E+308 /end CHARACTERISTIC
/begin CHARACTERISTIC speedgoat_test_SN5659__cal_impl.CANWrite1_P3 "" VALUE 0x00295998 Scalar_FLOAT64_IEEE 0 speedgoat_test_SN5659_R2021b_IO612_CM_double -1.7E+308 1.7E+308 /end CHARACTERISTIC
/begin CHARACTERISTIC speedgoat_test_SN5659__cal_impl.CANWrite1_P4 "" VALUE 0x002959B0 Scalar_FLOAT64_IEEE 0 speedgoat_test_SN5659_R2021b_IO612_CM_double -1.7E+308 1.7E+308 /end CHARACTERISTIC
/begin CHARACTERISTIC speedgoat_test_SN5659__cal_impl.CANWrite1_P5 "" VAL_BLK 0x002959C8 Scalar_FLOAT64_IEEE 0 speedgoat_test_SN5659_R2021b_IO612_CM_double -1.7E+308 1.7E+308 MATRIX_DIM 5 1 /end CHARACTERISTIC
/begin CHARACTERISTIC speedgoat_test_SN5659__cal_impl.CANWrite1_P6 "" VALUE 0x00295A00 Scalar_FLOAT64_IEEE 0 speedgoat_test_SN5659_R2021b_IO612_CM_double -1.7E+308 1.7E+308 /end CHARACTERISTIC
/begin CHARACTERISTIC speedgoat_test_SN5659__cal_impl.CANWrite1_P7 "" VALUE 0x00295A18 Scalar_FLOAT64_IEEE 0 speedgoat_test_SN5659_R2021b_IO612_CM_double -1.7E+308 1.7E+308 /end CHARACTERISTIC
/begin CHARACTERISTIC speedgoat_test_SN5659__cal_impl.CANWrite1_P8 "" VALUE 0x00295A30 Scalar_FLOAT64_IEEE 0 speedgoat_test_SN5659_R2021b_IO612_CM_double -1.7E+308 1.7E+308 /end CHARACTERISTIC
/begin CHARACTERISTIC speedgoat_test_SN5659__cal_impl.CANWrite2_P1 "" VALUE 0x00295738 Scalar_FLOAT64_IEEE 0 speedgoat_test_SN5659_R2021b_IO612_CM_double -1.7E+308 1.7E+308 /end CHARACTERISTIC
/begin CHARACTERISTIC speedgoat_test_SN5659__cal_impl.CANWrite2_P2 "" VALUE 0x00295750 Scalar_FLOAT64_IEEE 0 speedgoat_test_SN5659_R2021b_IO612_CM_double -1.7E+308 1.7E+308 /end CHARACTERISTIC
/begin CHARACTERISTIC speedgoat_test_SN5659__cal_impl.CANWrite2_P3 "" VALUE 0x00295768 Scalar_FLOAT64_IEEE 0 speedgoat_test_SN5659_R2021b_IO612_CM_double -1.7E+308 1.7E+308 /end CHARACTERISTIC
/begin CHARACTERISTIC speedgoat_test_SN5659__cal_impl.CANWrite2_P4 "" VALUE 0x00295780 Scalar_FLOAT64_IEEE 0 speedgoat_test_SN5659_R2021b_IO612_CM_double -1.7E+308 1.7E+308 /end CHARACTERISTIC
/begin CHARACTERISTIC speedgoat_test_SN5659__cal_impl.CANWrite2_P5 "" VAL_BLK 0x00295798 Scalar_FLOAT64_IEEE 0 speedgoat_test_SN5659_R2021b_IO612_CM_double -1.7E+308 1.7E+308 MATRIX_DIM 5 1 /end CHARACTERISTIC
/begin CHARACTERISTIC speedgoat_test_SN5659__cal_impl.CANWrite2_P6 "" VALUE 0x002957D0 Scalar_FLOAT64_IEEE 0 speedgoat_test_SN5659_R2021b_IO612_CM_double -1.7E+308 1.7E+308 /end CHARACTERISTIC
/begin CHARACTERISTIC speedgoat_test_SN5659__cal_impl.CANWrite2_P7 "" VALUE 0x002957E8 Scalar_FLOAT64_IEEE 0 speedgoat_test_SN5659_R2021b_IO612_CM_double -1.7E+308 1.7E+308 /end CHARACTERISTIC
/begin CHARACTERISTIC speedgoat_test_SN5659__cal_impl.CANWrite2_P8 "" VALUE 0x00295800 Scalar_FLOAT64_IEEE 0 speedgoat_test_SN5659_R2021b_IO612_CM_double -1.7E+308 1.7E+308 /end CHARACTERISTIC
/begin CHARACTERISTIC speedgoat_test_SN5659__cal_impl.CANWrite3_P1 "" VALUE 0x00295850 Scalar_FLOAT64_IEEE 0 speedgoat_test_SN5659_R2021b_IO612_CM_double -1.7E+308 1.7E+308 /end CHARACTERISTIC
/begin CHARACTERISTIC speedgoat_test_SN5659__cal_impl.CANWrite3_P2 "" VALUE 0x00295868 Scalar_FLOAT64_IEEE 0 speedgoat_test_SN5659_R2021b_IO612_CM_double -1.7E+308 1.7E+308 /end CHARACTERISTIC
/begin CHARACTERISTIC speedgoat_test_SN5659__cal_impl.CANWrite3_P3 "" VALUE 0x00295880 Scalar_FLOAT64_IEEE 0 speedgoat_test_SN5659_R2021b_IO612_CM_double -1.7E+308 1.7E+308 /end CHARACTERISTIC
/begin CHARACTERISTIC speedgoat_test_SN5659__cal_impl.CANWrite3_P4 "" VALUE 0x00295898 Scalar_FLOAT64_IEEE 0 speedgoat_test_SN5659_R2021b_IO612_CM_double -1.7E+308 1.7E+308 /end CHARACTERISTIC
/begin CHARACTERISTIC speedgoat_test_SN5659__cal_impl.CANWrite3_P5 "" VAL_BLK 0x002958B0 Scalar_FLOAT64_IEEE 0 speedgoat_test_SN5659_R2021b_IO612_CM_double -1.7E+308 1.7E+308 MATRIX_DIM 5 1 /end CHARACTERISTIC
/begin CHARACTERISTIC speedgoat_test_SN5659__cal_impl.CANWrite3_P6 "" VALUE 0x002958E8 Scalar_FLOAT64_IEEE 0 speedgoat_test_SN5659_R2021b_IO612_CM_double -1.7E+308 1.7E+308 /end CHARACTERISTIC
/begin CHARACTERISTIC speedgoat_test_SN5659__cal_impl.CANWrite3_P7 "" VALUE 0x00295900 Scalar_FLOAT64_IEEE 0 speedgoat_test_SN5659_R2021b_IO612_CM_double -1.7E+308 1.7E+308 /end CHARACTERISTIC
/begin CHARACTERISTIC speedgoat_test_SN5659__cal_impl.CANWrite3_P8 "" VALUE 0x00295918 Scalar_FLOAT64_IEEE 0 speedgoat_test_SN5659_R2021b_IO612_CM_double -1.7E+308 1.7E+308 /end CHARACTERISTIC
/begin CHARACTERISTIC speedgoat_test_SN5659__cal_impl.CANWrite4_P1 "" VALUE 0x00295A80 Scalar_FLOAT64_IEEE 0 speedgoat_test_SN5659_R2021b_IO612_CM_double -1.7E+308 1.7E+308 /end CHARACTERISTIC
/begin CHARACTERISTIC speedgoat_test_SN5659__cal_impl.CANWrite4_P2 "" VALUE 0x00295A98 Scalar_FLOAT64_IEEE 0 speedgoat_test_SN5659_R2021b_IO612_CM_double -1.7E+308 1.7E+308 /end CHARACTERISTIC
/begin CHARACTERISTIC speedgoat_test_SN5659__cal_impl.CANWrite4_P3 "" VALUE 0x00295AB0 Scalar_FLOAT64_IEEE 0 speedgoat_test_SN5659_R2021b_IO612_CM_double -1.7E+308 1.7E+308 /end CHARACTERISTIC
/begin CHARACTERISTIC speedgoat_test_SN5659__cal_impl.CANWrite4_P4 "" VALUE 0x00295AC8 Scalar_FLOAT64_IEEE 0 speedgoat_test_SN5659_R2021b_IO612_CM_double -1.7E+308 1.7E+308 /end CHARACTERISTIC
/begin CHARACTERISTIC speedgoat_test_SN5659__cal_impl.CANWrite4_P5 "" VAL_BLK 0x00295AE0 Scalar_FLOAT64_IEEE 0 speedgoat_test_SN5659_R2021b_IO612_CM_double -1.7E+308 1.7E+308 MATRIX_DIM 5 1 /end CHARACTERISTIC
/begin CHARACTERISTIC speedgoat_test_SN5659__cal_impl.CANWrite4_P6 "" VALUE 0x00295B18 Scalar_FLOAT64_IEEE 0 speedgoat_test_SN5659_R2021b_IO612_CM_double -1.7E+308 1.7E+308 /end CHARACTERISTIC
/begin CHARACTERISTIC speedgoat_test_SN5659__cal_impl.CANWrite4_P7 "" VALUE 0x00295B30 Scalar_FLOAT64_IEEE 0 speedgoat_test_SN5659_R2021b_IO612_CM_double -1.7E+308 1.7E+308 /end CHARACTERISTIC
/begin CHARACTERISTIC speedgoat_test_SN5659__cal_impl.CANWrite4_P8 "" VALUE 0x00295B48 Scalar_FLOAT64_IEEE 0 speedgoat_test_SN5659_R2021b_IO612_CM_double -1.7E+308 1.7E+308 /end CHARACTERISTIC
/begin CHARACTERISTIC speedgoat_test_SN5659__cal_impl.CANWrite5_P1 "" VALUE 0x00295B98 Scalar_FLOAT64_IEEE 0 speedgoat_test_SN5659_R2021b_IO612_CM_double -1.7E+308 1.7E+308 /end CHARACTERISTIC
/begin CHARACTERISTIC speedgoat_test_SN5659__cal_impl.CANWrite5_P2 "" VALUE 0x00295BB0 Scalar_FLOAT64_IEEE 0 speedgoat_test_SN5659_R2021b_IO612_CM_double -1.7E+308 1.7E+308 /end CHARACTERISTIC
/begin CHARACTERISTIC speedgoat_test_SN5659__cal_impl.CANWrite5_P3 "" VALUE 0x00295BC8 Scalar_FLOAT64_IEEE 0 speedgoat_test_SN5659_R2021b_IO612_CM_double -1.7E+308 1.7E+308 /end CHARACTERISTIC
/begin CHARACTERISTIC speedgoat_test_SN5659__cal_impl.CANWrite5_P4 "" VALUE 0x00295BE0 Scalar_FLOAT64_IEEE 0 speedgoat_test_SN5659_R2021b_IO612_CM_double -1.7E+308 1.7E+308 /end CHARACTERISTIC
/begin CHARACTERISTIC speedgoat_test_SN5659__cal_impl.CANWrite5_P5 "" VAL_BLK 0x00295BF8 Scalar_FLOAT64_IEEE 0 speedgoat_test_SN5659_R2021b_IO612_CM_double -1.7E+308 1.7E+308 MATRIX_DIM 5 1 /end CHARACTERISTIC
/begin CHARACTERISTIC speedgoat_test_SN5659__cal_impl.CANWrite5_P6 "" VALUE 0x00295C30 Scalar_FLOAT64_IEEE 0 speedgoat_test_SN5659_R2021b_IO612_CM_double -1.7E+308 1.7E+308 /end CHARACTERISTIC
/begin CHARACTERISTIC speedgoat_test_SN5659__cal_impl.CANWrite5_P7 "" VALUE 0x00295C48 Scalar_FLOAT64_IEEE 0 speedgoat_test_SN5659_R2021b_IO612_CM_double -1.7E+308 1.7E+308 /end CHARACTERISTIC
/begin CHARACTERISTIC speedgoat_test_SN5659__cal_impl.CANWrite5_P8 "" VALUE 0x00295C60 Scalar_FLOAT64_IEEE 0 speedgoat_test_SN5659_R2021b_IO612_CM_double -1.7E+308 1.7E+308 /end CHARACTERISTIC
/begin CHARACTERISTIC speedgoat_test_SN5659__cal_impl.CANWrite_P1 "" VALUE 0x00295620 Scalar_FLOAT64_IEEE 0 speedgoat_test_SN5659_R2021b_IO612_CM_double -1.7E+308 1.7E+308 /end CHARACTERISTIC
/begin CHARACTERISTIC speedgoat_test_SN5659__cal_impl.CANWrite_P2 "" VALUE 0x00295638 Scalar_FLOAT64_IEEE 0 speedgoat_test_SN5659_R2021b_IO612_CM_double -1.7E+308 1.7E+308 /end CHARACTERISTIC
/begin CHARACTERISTIC speedgoat_test_SN5659__cal_impl.CANWrite_P3 "" VALUE 0x00295650 Scalar_FLOAT64_IEEE 0 speedgoat_test_SN5659_R2021b_IO612_CM_double -1.7E+308 1.7E+308 /end CHARACTERISTIC
/begin CHARACTERISTIC speedgoat_test_SN5659__cal_impl.CANWrite_P4 "" VALUE 0x00295668 Scalar_FLOAT64_IEEE 0 speedgoat_test_SN5659_R2021b_IO612_CM_double -1.7E+308 1.7E+308 /end CHARACTERISTIC
/begin CHARACTERISTIC speedgoat_test_SN5659__cal_impl.CANWrite_P5 "" VAL_BLK 0x00295680 Scalar_FLOAT64_IEEE 0 speedgoat_test_SN5659_R2021b_IO612_CM_double -1.7E+308 1.7E+308 MATRIX_DIM 5 1 /end CHARACTERISTIC
/begin CHARACTERISTIC speedgoat_test_SN5659__cal_impl.CANWrite_P6 "" VALUE 0x002956B8 Scalar_FLOAT64_IEEE 0 speedgoat_test_SN5659_R2021b_IO612_CM_double -1.7E+308 1.7E+308 /end CHARACTERISTIC
/begin CHARACTERISTIC speedgoat_test_SN5659__cal_impl.CANWrite_P7 "" VALUE 0x002956D0 Scalar_FLOAT64_IEEE 0 speedgoat_test_SN5659_R2021b_IO612_CM_double -1.7E+308 1.7E+308 /end CHARACTERISTIC
/begin CHARACTERISTIC speedgoat_test_SN5659__cal_impl.CANWrite_P8 "" VALUE 0x002956E8 Scalar_FLOAT64_IEEE 0 speedgoat_test_SN5659_R2021b_IO612_CM_double -1.7E+308 1.7E+308 /end CHARACTERISTIC
/begin CHARACTERISTIC speedgoat_test_SN5659__cal_impl.ID100_Signal1_Y0 "" VALUE 0x00295020 Scalar_FLOAT64_IEEE 0 speedgoat_test_SN5659_R2021b_IO612_CM_double -1.7E+308 1.7E+308 /end CHARACTERISTIC
/begin CHARACTERISTIC speedgoat_test_SN5659__cal_impl.ID100_Signal1_Y0_j "" VALUE 0x00295100 Scalar_FLOAT64_IEEE 0 speedgoat_test_SN5659_R2021b_IO612_CM_double -1.7E+308 1.7E+308 /end CHARACTERISTIC
/begin CHARACTERISTIC speedgoat_test_SN5659__cal_impl.ID101_Signal1_Y0 "" VALUE 0x00295028 Scalar_FLOAT64_IEEE 0 speedgoat_test_SN5659_R2021b_IO612_CM_double -1.7E+308 1.7E+308 /end CHARACTERISTIC
/begin CHARACTERISTIC speedgoat_test_SN5659__cal_impl.ID101_Signal1_Y0_o "" VALUE 0x00295108 Scalar_FLOAT64_IEEE 0 speedgoat_test_SN5659_R2021b_IO612_CM_double -1.7E+308 1.7E+308 /end CHARACTERISTIC
/begin CHARACTERISTIC speedgoat_test_SN5659__cal_impl.ID102_Signal1_Y0 "" VALUE 0x00295030 Scalar_FLOAT64_IEEE 0 speedgoat_test_SN5659_R2021b_IO612_CM_double -1.7E+308 1.7E+308 /end CHARACTERISTIC
/begin CHARACTERISTIC speedgoat_test_SN5659__cal_impl.ID102_Signal1_Y0_i "" VALUE 0x00295110 Scalar_FLOAT64_IEEE 0 speedgoat_test_SN5659_R2021b_IO612_CM_double -1.7E+308 1.7E+308 /end CHARACTERISTIC
/begin CHARACTERISTIC speedgoat_test_SN5659__cal_impl.RXSampleTime1_Value "" VALUE 0x00295C70 Scalar_FLOAT64_IEEE 0 speedgoat_test_SN5659_R2021b_IO612_CM_double -1.7E+308 1.7E+308 /end CHARACTERISTIC
/begin CHARACTERISTIC speedgoat_test_SN5659__cal_impl.RXSampleTime_Value "" VALUE 0x00295C68 Scalar_FLOAT64_IEEE 0 speedgoat_test_SN5659_R2021b_IO612_CM_double -1.7E+308 1.7E+308 /end CHARACTERISTIC
/begin CHARACTERISTIC speedgoat_test_SN5659__cal_impl.SineWave1_Amp "" VALUE 0x002956F0 Scalar_FLOAT64_IEEE 0 speedgoat_test_SN5659_R2021b_IO612_CM_double -1.7E+308 1.7E+308 /end CHARACTERISTIC
/begin CHARACTERISTIC speedgoat_test_SN5659__cal_impl.SineWave1_Bias "" VALUE 0x002956F8 Scalar_FLOAT64_IEEE 0 speedgoat_test_SN5659_R2021b_IO612_CM_double -1.7E+308 1.7E+308 /end CHARACTERISTIC
/begin CHARACTERISTIC speedgoat_test_SN5659__cal_impl.SineWave1_Freq "" VALUE 0x00295700 Scalar_FLOAT64_IEEE 0 speedgoat_test_SN5659_R2021b_IO612_CM_double -1.7E+308 1.7E+308 /end CHARACTERISTIC
/begin CHARACTERISTIC speedgoat_test_SN5659__cal_impl.SineWave1_HCos "" VALUE 0x00295710 Scalar_FLOAT64_IEEE 0 speedgoat_test_SN5659_R2021b_IO612_CM_double -1.7E+308 1.7E+308 /end CHARACTERISTIC
/begin CHARACTERISTIC speedgoat_test_SN5659__cal_impl.SineWave1_Hsin "" VALUE 0x00295708 Scalar_FLOAT64_IEEE 0 speedgoat_test_SN5659_R2021b_IO612_CM_double -1.7E+308 1.7E+308 /end CHARACTERISTIC
/begin CHARACTERISTIC speedgoat_test_SN5659__cal_impl.SineWave1_PCos "" VALUE 0x00295720 Scalar_FLOAT64_IEEE 0 speedgoat_test_SN5659_R2021b_IO612_CM_double -1.7E+308 1.7E+308 /end CHARACTERISTIC
/begin CHARACTERISTIC speedgoat_test_SN5659__cal_impl.SineWave1_PSin "" VALUE 0x00295718 Scalar_FLOAT64_IEEE 0 speedgoat_test_SN5659_R2021b_IO612_CM_double -1.7E+308 1.7E+308 /end CHARACTERISTIC
/begin CHARACTERISTIC speedgoat_test_SN5659__cal_impl.SineWave2_Amp "" VALUE 0x00295808 Scalar_FLOAT64_IEEE 0 speedgoat_test_SN5659_R2021b_IO612_CM_double -1.7E+308 1.7E+308 /end CHARACTERISTIC
/begin CHARACTERISTIC speedgoat_test_SN5659__cal_impl.SineWave2_Bias "" VALUE 0x00295810 Scalar_FLOAT64_IEEE 0 speedgoat_test_SN5659_R2021b_IO612_CM_double -1.7E+308 1.7E+308 /end CHARACTERISTIC
/begin CHARACTERISTIC speedgoat_test_SN5659__cal_impl.SineWave2_Freq "" VALUE 0x00295818 Scalar_FLOAT64_IEEE 0 speedgoat_test_SN5659_R2021b_IO612_CM_double -1.7E+308 1.7E+308 /end CHARACTERISTIC
/begin CHARACTERISTIC speedgoat_test_SN5659__cal_impl.SineWave2_HCos "" VALUE 0x00295828 Scalar_FLOAT64_IEEE 0 speedgoat_test_SN5659_R2021b_IO612_CM_double -1.7E+308 1.7E+308 /end CHARACTERISTIC
/begin CHARACTERISTIC speedgoat_test_SN5659__cal_impl.SineWave2_Hsin "" VALUE 0x00295820 Scalar_FLOAT64_IEEE 0 speedgoat_test_SN5659_R2021b_IO612_CM_double -1.7E+308 1.7E+308 /end CHARACTERISTIC
/begin CHARACTERISTIC speedgoat_test_SN5659__cal_impl.SineWave2_PCos "" VALUE 0x00295838 Scalar_FLOAT64_IEEE 0 speedgoat_test_SN5659_R2021b_IO612_CM_double -1.7E+308 1.7E+308 /end CHARACTERISTIC
/begin CHARACTERISTIC speedgoat_test_SN5659__cal_impl.SineWave2_PSin "" VALUE 0x00295830 Scalar_FLOAT64_IEEE 0 speedgoat_test_SN5659_R2021b_IO612_CM_double -1.7E+308 1.7E+308 /end CHARACTERISTIC
/begin CHARACTERISTIC speedgoat_test_SN5659__cal_impl.SineWave3_Amp "" VALUE 0x00295920 Scalar_FLOAT64_IEEE 0 speedgoat_test_SN5659_R2021b_IO612_CM_double -1.7E+308 1.7E+308 /end CHARACTERISTIC
/begin CHARACTERISTIC speedgoat_test_SN5659__cal_impl.SineWave3_Bias "" VALUE 0x00295928 Scalar_FLOAT64_IEEE 0 speedgoat_test_SN5659_R2021b_IO612_CM_double -1.7E+308 1.7E+308 /end CHARACTERISTIC
/begin CHARACTERISTIC speedgoat_test_SN5659__cal_impl.SineWave3_Freq "" VALUE 0x00295930 Scalar_FLOAT64_IEEE 0 speedgoat_test_SN5659_R2021b_IO612_CM_double -1.7E+308 1.7E+308 /end CHARACTERISTIC
/begin CHARACTERISTIC speedgoat_test_SN5659__cal_impl.SineWave3_HCos "" VALUE 0x00295940 Scalar_FLOAT64_IEEE 0 speedgoat_test_SN5659_R2021b_IO612_CM_double -1.7E+308 1.7E+308 /end CHARACTERISTIC
/begin CHARACTERISTIC speedgoat_test_SN5659__cal_impl.SineWave3_Hsin "" VALUE 0x00295938 Scalar_FLOAT64_IEEE 0 speedgoat_test_SN5659_R2021b_IO612_CM_double -1.7E+308 1.7E+308 /end CHARACTERISTIC
/begin CHARACTERISTIC speedgoat_test_SN5659__cal_impl.SineWave3_PCos "" VALUE 0x00295950 Scalar_FLOAT64_IEEE 0 speedgoat_test_SN5659_R2021b_IO612_CM_double -1.7E+308 1.7E+308 /end CHARACTERISTIC
/begin CHARACTERISTIC speedgoat_test_SN5659__cal_impl.SineWave3_PSin "" VALUE 0x00295948 Scalar_FLOAT64_IEEE 0 speedgoat_test_SN5659_R2021b_IO612_CM_double -1.7E+308 1.7E+308 /end CHARACTERISTIC
/begin CHARACTERISTIC speedgoat_test_SN5659__cal_impl.SineWave4_Amp "" VALUE 0x00295A38 Scalar_FLOAT64_IEEE 0 speedgoat_test_SN5659_R2021b_IO612_CM_double -1.7E+308 1.7E+308 /end CHARACTERISTIC
/begin CHARACTERISTIC speedgoat_test_SN5659__cal_impl.SineWave4_Bias "" VALUE 0x00295A40 Scalar_FLOAT64_IEEE 0 speedgoat_test_SN5659_R2021b_IO612_CM_double -1.7E+308 1.7E+308 /end CHARACTERISTIC
/begin CHARACTERISTIC speedgoat_test_SN5659__cal_impl.SineWave4_Freq "" VALUE 0x00295A48 Scalar_FLOAT64_IEEE 0 speedgoat_test_SN5659_R2021b_IO612_CM_double -1.7E+308 1.7E+308 /end CHARACTERISTIC
/begin CHARACTERISTIC speedgoat_test_SN5659__cal_impl.SineWave4_HCos "" VALUE 0x00295A58 Scalar_FLOAT64_IEEE 0 speedgoat_test_SN5659_R2021b_IO612_CM_double -1.7E+308 1.7E+308 /end CHARACTERISTIC
/begin CHARACTERISTIC speedgoat_test_SN5659__cal_impl.SineWave4_Hsin "" VALUE 0x00295A50 Scalar_FLOAT64_IEEE 0 speedgoat_test_SN5659_R2021b_IO612_CM_double -1.7E+308 1.7E+308 /end CHARACTERISTIC
/begin CHARACTERISTIC speedgoat_test_SN5659__cal_impl.SineWave4_PCos "" VALUE 0x00295A68 Scalar_FLOAT64_IEEE 0 speedgoat_test_SN5659_R2021b_IO612_CM_double -1.7E+308 1.7E+308 /end CHARACTERISTIC
/begin CHARACTERISTIC speedgoat_test_SN5659__cal_impl.SineWave4_PSin "" VALUE 0x00295A60 Scalar_FLOAT64_IEEE 0 speedgoat_test_SN5659_R2021b_IO612_CM_double -1.7E+308 1.7E+308 /end CHARACTERISTIC
/begin CHARACTERISTIC speedgoat_test_SN5659__cal_impl.SineWave5_Amp "" VALUE 0x00295B50 Scalar_FLOAT64_IEEE 0 speedgoat_test_SN5659_R2021b_IO612_CM_double -1.7E+308 1.7E+308 /end CHARACTERISTIC
/begin CHARACTERISTIC speedgoat_test_SN5659__cal_impl.SineWave5_Bias "" VALUE 0x00295B58 Scalar_FLOAT64_IEEE 0 speedgoat_test_SN5659_R2021b_IO612_CM_double -1.7E+308 1.7E+308 /end CHARACTERISTIC
/begin CHARACTERISTIC speedgoat_test_SN5659__cal_impl.SineWave5_Freq "" VALUE 0x00295B60 Scalar_FLOAT64_IEEE 0 speedgoat_test_SN5659_R2021b_IO612_CM_double -1.7E+308 1.7E+308 /end CHARACTERISTIC
/begin CHARACTERISTIC speedgoat_test_SN5659__cal_impl.SineWave5_HCos "" VALUE 0x00295B70 Scalar_FLOAT64_IEEE 0 speedgoat_test_SN5659_R2021b_IO612_CM_double -1.7E+308 1.7E+308 /end CHARACTERISTIC
/begin CHARACTERISTIC speedgoat_test_SN5659__cal_impl.SineWave5_Hsin "" VALUE 0x00295B68 Scalar_FLOAT64_IEEE 0 speedgoat_test_SN5659_R2021b_IO612_CM_double -1.7E+308 1.7E+308 /end CHARACTERISTIC
/begin CHARACTERISTIC speedgoat_test_SN5659__cal_impl.SineWave5_PCos "" VALUE 0x00295B80 Scalar_FLOAT64_IEEE 0 speedgoat_test_SN5659_R2021b_IO612_CM_double -1.7E+308 1.7E+308 /end CHARACTERISTIC
/begin CHARACTERISTIC speedgoat_test_SN5659__cal_impl.SineWave5_PSin "" VALUE 0x00295B78 Scalar_FLOAT64_IEEE 0 speedgoat_test_SN5659_R2021b_IO612_CM_double -1.7E+308 1.7E+308 /end CHARACTERISTIC
/begin CHARACTERISTIC speedgoat_test_SN5659__cal_impl.SineWave_Amp "" VALUE 0x002955D8 Scalar_FLOAT64_IEEE 0 speedgoat_test_SN5659_R2021b_IO612_CM_double -1.7E+308 1.7E+308 /end CHARACTERISTIC
/begin CHARACTERISTIC speedgoat_test_SN5659__cal_impl.SineWave_Bias "" VALUE 0x002955E0 Scalar_FLOAT64_IEEE 0 speedgoat_test_SN5659_R2021b_IO612_CM_double -1.7E+308 1.7E+308 /end CHARACTERISTIC
/begin CHARACTERISTIC speedgoat_test_SN5659__cal_impl.SineWave_Freq "" VALUE 0x002955E8 Scalar_FLOAT64_IEEE 0 speedgoat_test_SN5659_R2021b_IO612_CM_double -1.7E+308 1.7E+308 /end CHARACTERISTIC
/begin CHARACTERISTIC speedgoat_test_SN5659__cal_impl.SineWave_HCos "" VALUE 0x002955F8 Scalar_FLOAT64_IEEE 0 speedgoat_test_SN5659_R2021b_IO612_CM_double -1.7E+308 1.7E+308 /end CHARACTERISTIC
/begin CHARACTERISTIC speedgoat_test_SN5659__cal_impl.SineWave_Hsin "" VALUE 0x002955F0 Scalar_FLOAT64_IEEE 0 speedgoat_test_SN5659_R2021b_IO612_CM_double -1.7E+308 1.7E+308 /end CHARACTERISTIC
/begin CHARACTERISTIC speedgoat_test_SN5659__cal_impl.SineWave_PCos "" VALUE 0x00295608 Scalar_FLOAT64_IEEE 0 speedgoat_test_SN5659_R2021b_IO612_CM_double -1.7E+308 1.7E+308 /end CHARACTERISTIC
/begin CHARACTERISTIC speedgoat_test_SN5659__cal_impl.SineWave_PSin "" VALUE 0x00295600 Scalar_FLOAT64_IEEE 0 speedgoat_test_SN5659_R2021b_IO612_CM_double -1.7E+308 1.7E+308 /end CHARACTERISTIC
/begin MEASUREMENT speedgoat_test_SN5659_R2021b_IO612_B.CANRead1_o1 "" UBYTE speedgoat_test_SN5659_R2021b_IO612_CM_logical 0 0 0 1 ECU_ADDRESS 0x0029AB30 /end MEASUREMENT
/begin MEASUREMENT speedgoat_test_SN5659_R2021b_IO612_B.CANRead_o1 "" UBYTE speedgoat_test_SN5659_R2021b_IO612_CM_logical 0 0 0 1 ECU_ADDRESS 0x0029AB31 /end MEASUREMENT
/begin MEASUREMENT speedgoat_test_SN5659_R2021b_IO612_B.CANUnpack "" FLOAT64_IEEE speedgoat_test_SN5659_R2021b_IO612_CM_double 0 0 -1.7E+308 1.7E+308 ECU_ADDRESS 0x0029AB00 /end MEASUREMENT
/begin MEASUREMENT speedgoat_test_SN5659_R2021b_IO612_B.CANUnpack1 "" FLOAT64_IEEE speedgoat_test_SN5659_R2021b_IO612_CM_double 0 0 -1.7E+308 1.7E+308 ECU_ADDRESS 0x0029AB08 /end MEASUREMENT
/begin MEASUREMENT speedgoat_test_SN5659_R2021b_IO612_B.CANUnpack1_o "" FLOAT64_IEEE speedgoat_test_SN5659_R2021b_IO612_CM_double 0 0 -1.7E+308 1.7E+308 ECU_ADDRESS 0x0029AB20 /end MEASUREMENT
/begin MEASUREMENT speedgoat_test_SN5659_R2021b_IO612_B.CANUnpack2 "" FLOAT64_IEEE speedgoat_test_SN5659_R2021b_IO612_CM_double 0 0 -1.7E+308 1.7E+308 ECU_ADDRESS 0x0029AB10 /end MEASUREMENT
/begin MEASUREMENT speedgoat_test_SN5659_R2021b_IO612_B.CANUnpack2_j "" FLOAT64_IEEE speedgoat_test_SN5659_R2021b_IO612_CM_double 0 0 -1.7E+308 1.7E+308 ECU_ADDRESS 0x0029AB28 /end MEASUREMENT
/begin MEASUREMENT speedgoat_test_SN5659_R2021b_IO612_B.CANUnpack_c "" FLOAT64_IEEE speedgoat_test_SN5659_R2021b_IO612_CM_double 0 0 -1.7E+308 1.7E+308 ECU_ADDRESS 0x0029AB18 /end MEASUREMENT
/begin MEASUREMENT speedgoat_test_SN5659_R2021b_IO612_B.RXSampleTime "" FLOAT64_IEEE speedgoat_test_SN5659_R2021b_IO612_CM_double 0 0 -1.7E+308 1.7E+308 ECU_ADDRESS 0x0029AAF0 /end MEASUREMENT
/begin MEASUREMENT speedgoat_test_SN5659_R2021b_IO612_B.RXSampleTime1 "" FLOAT64_IEEE speedgoat_test_SN5659_R2021b_IO612_CM_double 0 0 -1.7E+308 1.7E+308 ECU_ADDRESS 0x0029AAF8 /end MEASUREMENT
/begin MEASUREMENT speedgoat_test_SN5659_R2021b_IO612_B.SineWave "" FLOAT64_IEEE speedgoat_test_SN5659_R2021b_IO612_CM_double 0 0 -1.7E+308 1.7E+308 ECU_ADDRESS 0x0029AAC0 /end MEASUREMENT
/begin MEASUREMENT speedgoat_test_SN5659_R2021b_IO612_B.SineWave1 "" FLOAT64_IEEE speedgoat_test_SN5659_R2021b_IO612_CM_double 0 0 -1.7E+308 1.7E+308 ECU_ADDRESS 0x0029AAC8 /end MEASUREMENT
/begin MEASUREMENT speedgoat_test_SN5659_R2021b_IO612_B.SineWave2 "" FLOAT64_IEEE speedgoat_test_SN5659_R2021b_IO612_CM_double 0 0 -1.7E+308 1.7E+308 ECU_ADDRESS 0x0029AAD0 /end MEASUREMENT
/begin MEASUREMENT speedgoat_test_SN5659_R2021b_IO612_B.SineWave3 "" FLOAT64_IEEE speedgoat_test_SN5659_R2021b_IO612_CM_double 0 0 -1.7E+308 1.7E+308 ECU_ADDRESS 0x0029AAD8 /end MEASUREMENT
/begin MEASUREMENT speedgoat_test_SN5659_R2021b_IO612_B.SineWave4 "" FLOAT64_IEEE speedgoat_test_SN5659_R2021b_IO612_CM_double 0 0 -1.7E+308 1.7E+308 ECU_ADDRESS 0x0029AAE0 /end MEASUREMENT
/begin MEASUREMENT speedgoat_test_SN5659_R2021b_IO612_B.SineWave5 "" FLOAT64_IEEE speedgoat_test_SN5659_R2021b_IO612_CM_double 0 0 -1.7E+308 1.7E+308 ECU_ADDRESS 0x0029AAE8 /end MEASUREMENT
/begin MEASUREMENT speedgoat_test_SN5659_R2021b_IO612_DW.CANPack1_ModeSignalID "" SLONG speedgoat_test_SN5659_R2021b_IO612_CM_int_T 0 0 -2147483648 2147483647 ECU_ADDRESS 0x0029A984 /end MEASUREMENT
/begin MEASUREMENT speedgoat_test_SN5659_R2021b_IO612_DW.CANPack2_ModeSignalID "" SLONG speedgoat_test_SN5659_R2021b_IO612_CM_int_T 0 0 -2147483648 2147483647 ECU_ADDRESS 0x0029A98C /end MEASUREMENT
/begin MEASUREMENT speedgoat_test_SN5659_R2021b_IO612_DW.CANPack3_ModeSignalID "" SLONG speedgoat_test_SN5659_R2021b_IO612_CM_int_T 0 0 -2147483648 2147483647 ECU_ADDRESS 0x0029A994 /end MEASUREMENT
/begin MEASUREMENT speedgoat_test_SN5659_R2021b_IO612_DW.CANPack4_ModeSignalID "" SLONG speedgoat_test_SN5659_R2021b_IO612_CM_int_T 0 0 -2147483648 2147483647 ECU_ADDRESS 0x0029A99C /end MEASUREMENT
/begin MEASUREMENT speedgoat_test_SN5659_R2021b_IO612_DW.CANPack5_ModeSignalID "" SLONG speedgoat_test_SN5659_R2021b_IO612_CM_int_T 0 0 -2147483648 2147483647 ECU_ADDRESS 0x0029A9A4 /end MEASUREMENT
/begin MEASUREMENT speedgoat_test_SN5659_R2021b_IO612_DW.CANPack_ModeSignalID "" SLONG speedgoat_test_SN5659_R2021b_IO612_CM_int_T 0 0 -2147483648 2147483647 ECU_ADDRESS 0x0029A97C /end MEASUREMENT
/begin MEASUREMENT speedgoat_test_SN5659_R2021b_IO612_DW.CANUnpack1_ModeSignalID "" SLONG speedgoat_test_SN5659_R2021b_IO612_CM_int_T 0 0 -2147483648 2147483647 ECU_ADDRESS 0x0029A9B8 /end MEASUREMENT
/begin MEASUREMENT speedgoat_test_SN5659_R2021b_IO612_DW.CANUnpack1_ModeSignalID_i "" SLONG speedgoat_test_SN5659_R2021b_IO612_CM_int_T 0 0 -2147483648 2147483647 ECU_ADDRESS 0x0029A9D4 /end MEASUREMENT
/begin MEASUREMENT speedgoat_test_SN5659_R2021b_IO612_DW.CANUnpack1_StatusPortID "" SLONG speedgoat_test_SN5659_R2021b_IO612_CM_int_T 0 0 -2147483648 2147483647 ECU_ADDRESS 0x0029A9BC /end MEASUREMENT
/begin MEASUREMENT speedgoat_test_SN5659_R2021b_IO612_DW.CANUnpack1_StatusPortID_o "" SLONG speedgoat_test_SN5659_R2021b_IO612_CM_int_T 0 0 -2147483648 2147483647 ECU_ADDRESS 0x0029A9D8 /end MEASUREMENT
/begin MEASUREMENT speedgoat_test_SN5659_R2021b_IO612_DW.CANUnpack2_ModeSignalID "" SLONG speedgoat_test_SN5659_R2021b_IO612_CM_int_T 0 0 -2147483648 2147483647 ECU_ADDRESS 0x0029A9C0 /end MEASUREMENT
/begin MEASUREMENT speedgoat_test_SN5659_R2021b_IO612_DW.CANUnpack2_ModeSignalID_g "" SLONG speedgoat_test_SN5659_R2021b_IO612_CM_int_T 0 0 -2147483648 2147483647 ECU_ADDRESS 0x0029A9DC /end MEASUREMENT
/begin MEASUREMENT speedgoat_test_SN5659_R2021b_IO612_DW.CANUnpack2_StatusPortID "" SLONG speedgoat_test_SN5659_R2021b_IO612_CM_int_T 0 0 -2147483648 2147483647 ECU_ADDRESS 0x0029A9C4 /end MEASUREMENT
/begin MEASUREMENT speedgoat_test_SN5659_R2021b_IO612_DW.CANUnpack2_StatusPortID_m "" SLONG speedgoat_test_SN5659_R2021b_IO612_CM_int_T 0 0 -2147483648 2147483647 ECU_ADDRESS 0x0029A9E0 /end MEASUREMENT
/begin MEASUREMENT speedgoat_test_SN5659_R2021b_IO612_DW.CANUnpack_ModeSignalID "" SLONG speedgoat_test_SN5659_R2021b_IO612_CM_int_T 0 0 -2147483648 2147483647 ECU_ADDRESS 0x0029A9B0 /end MEASUREMENT
/begin MEASUREMENT speedgoat_test_SN5659_R2021b_IO612_DW.CANUnpack_ModeSignalID_b "" SLONG speedgoat_test_SN5659_R2021b_IO612_CM_int_T 0 0 -2147483648 2147483647 ECU_ADDRESS 0x0029A9CC /end MEASUREMENT
/begin MEASUREMENT speedgoat_test_SN5659_R2021b_IO612_DW.CANUnpack_StatusPortID "" SLONG speedgoat_test_SN5659_R2021b_IO612_CM_int_T 0 0 -2147483648 2147483647 ECU_ADDRESS 0x0029A9B4 /end MEASUREMENT
/begin MEASUREMENT speedgoat_test_SN5659_R2021b_IO612_DW.CANUnpack_StatusPortID_g "" SLONG speedgoat_test_SN5659_R2021b_IO612_CM_int_T 0 0 -2147483648 2147483647 ECU_ADDRESS 0x0029A9D0 /end MEASUREMENT
/begin MEASUREMENT speedgoat_test_SN5659_R2021b_IO612_DW.lastCos "" FLOAT64_IEEE speedgoat_test_SN5659_R2021b_IO612_CM_double 0 0 -1.7E+308 1.7E+308 ECU_ADDRESS 0x0029A8A8 /end MEASUREMENT
/begin MEASUREMENT speedgoat_test_SN5659_R2021b_IO612_DW.lastCos_b "" FLOAT64_IEEE speedgoat_test_SN5659_R2021b_IO612_CM_double 0 0 -1.7E+308 1.7E+308 ECU_ADDRESS 0x0029A8D8 /end MEASUREMENT
/begin MEASUREMENT speedgoat_test_SN5659_R2021b_IO612_DW.lastCos_c "" FLOAT64_IEEE speedgoat_test_SN5659_R2021b_IO612_CM_double 0 0 -1.7E+308 1.7E+308 ECU_ADDRESS 0x0029A8F8 /end MEASUREMENT
/begin MEASUREMENT speedgoat_test_SN5659_R2021b_IO612_DW.lastCos_g "" FLOAT64_IEEE speedgoat_test_SN5659_R2021b_IO612_CM_double 0 0 -1.7E+308 1.7E+308 ECU_ADDRESS 0x0029A8B8 /end MEASUREMENT
/begin MEASUREMENT speedgoat_test_SN5659_R2021b_IO612_DW.lastCos_i "" FLOAT64_IEEE speedgoat_test_SN5659_R2021b_IO612_CM_double 0 0 -1.7E+308 1.7E+308 ECU_ADDRESS 0x0029A8C8 /end MEASUREMENT
/begin MEASUREMENT speedgoat_test_SN5659_R2021b_IO612_DW.lastCos_j "" FLOAT64_IEEE speedgoat_test_SN5659_R2021b_IO612_CM_double 0 0 -1.7E+308 1.7E+308 ECU_ADDRESS 0x0029A8E8 /end MEASUREMENT
/begin MEASUREMENT speedgoat_test_SN5659_R2021b_IO612_DW.lastSin "" FLOAT64_IEEE speedgoat_test_SN5659_R2021b_IO612_CM_double 0 0 -1.7E+308 1.7E+308 ECU_ADDRESS 0x0029A8A0 /end MEASUREMENT
/begin MEASUREMENT speedgoat_test_SN5659_R2021b_IO612_DW.lastSin_c "" FLOAT64_IEEE speedgoat_test_SN5659_R2021b_IO612_CM_double 0 0 -1.7E+308 1.7E+308 ECU_ADDRESS 0x0029A8B0 /end MEASUREMENT
/begin MEASUREMENT speedgoat_test_SN5659_R2021b_IO612_DW.lastSin_cd "" FLOAT64_IEEE speedgoat_test_SN5659_R2021b_IO612_CM_double 0 0 -1.7E+308 1.7E+308 ECU_ADDRESS 0x0029A8F0 /end MEASUREMENT
/begin MEASUREMENT speedgoat_test_SN5659_R2021b_IO612_DW.lastSin_d "" FLOAT64_IEEE speedgoat_test_SN5659_R2021b_IO612_CM_double 0 0 -1.7E+308 1.7E+308 ECU_ADDRESS 0x0029A8D0 /end MEASUREMENT
/begin MEASUREMENT speedgoat_test_SN5659_R2021b_IO612_DW.lastSin_h "" FLOAT64_IEEE speedgoat_test_SN5659_R2021b_IO612_CM_double 0 0 -1.7E+308 1.7E+308 ECU_ADDRESS 0x0029A8E0 /end MEASUREMENT
/begin MEASUREMENT speedgoat_test_SN5659_R2021b_IO612_DW.lastSin_i "" FLOAT64_IEEE speedgoat_test_SN5659_R2021b_IO612_CM_double 0 0 -1.7E+308 1.7E+308 ECU_ADDRESS 0x0029A8C0 /end MEASUREMENT
/begin MEASUREMENT speedgoat_test_SN5659_R2021b_IO612_DW.systemEnable "" SLONG speedgoat_test_SN5659_R2021b_IO612_CM_int32 0 0 -2147483648 2147483647 ECU_ADDRESS 0x0029A960 /end MEASUREMENT
/begin MEASUREMENT speedgoat_test_SN5659_R2021b_IO612_DW.systemEnable_b "" SLONG speedgoat_test_SN5659_R2021b_IO612_CM_int32 0 0 -2147483648 2147483647 ECU_ADDRESS 0x0029A970 /end MEASUREMENT
/begin MEASUREMENT speedgoat_test_SN5659_R2021b_IO612_DW.systemEnable_h "" SLONG speedgoat_test_SN5659_R2021b_IO612_CM_int32 0 0 -2147483648 2147483647 ECU_ADDRESS 0x0029A96C /end MEASUREMENT
/begin MEASUREMENT speedgoat_test_SN5659_R2021b_IO612_DW.systemEnable_i "" SLONG speedgoat_test_SN5659_R2021b_IO612_CM_int32 0 0 -2147483648 2147483647 ECU_ADDRESS 0x0029A968 /end MEASUREMENT
/begin MEASUREMENT speedgoat_test_SN5659_R2021b_IO612_DW.systemEnable_p "" SLONG speedgoat_test_SN5659_R2021b_IO612_CM_int32 0 0 -2147483648 2147483647 ECU_ADDRESS 0x0029A964 /end MEASUREMENT
/begin MEASUREMENT speedgoat_test_SN5659_R2021b_IO612_DW.systemEnable_py "" SLONG speedgoat_test_SN5659_R2021b_IO612_CM_int32 0 0 -2147483648 2147483647 ECU_ADDRESS 0x0029A974 /end MEASUREMENT
/begin COMPU_METHOD speedgoat_test_SN5659_R2021b_IO612_CM_double "" IDENTICAL "%15.10" "" /end COMPU_METHOD
/begin COMPU_METHOD speedgoat_test_SN5659_R2021b_IO612_CM_int32 "" IDENTICAL "%10.0" "" /end COMPU_METHOD
/begin COMPU_METHOD speedgoat_test_SN5659_R2021b_IO612_CM_int_T "" IDENTICAL "customformat" "" /end COMPU_METHOD
/begin COMPU_METHOD speedgoat_test_SN5659_R2021b_IO612_CM_logical "" IDENTICAL "%1.0" "" /end COMPU_METHOD
/begin RECORD_LAYOUT Scalar_BOOLEAN FNC_VALUES 1 UBYTE COLUMN_DIR DIRECT /end RECORD_LAYOUT
/begin RECORD_LAYOUT Scalar_FLOAT64_IEEE FNC_VALUES 1 FLOAT64_IEEE COLUMN_DIR DIRECT /end RECORD_LAYOUT
/begin RECORD_LAYOUT Scalar_SLONG FNC_VALUES 1 SLONG COLUMN_DIR DIRECT /end RECORD_LAYOUT
/begin GROUP speedgoat_test_SN5659_R2021b_IO612 "speedgoat_test_SN5659_R2021b_IO612" ROOT /begin SUB_GROUP speedgoat_test_SN5659_R2021b_IO612_IO612 /end SUB_GROUP /end GROUP
/begin GROUP speedgoat_test_SN5659_R2021b_IO612_IO612 "speedgoat_test_SN5659_R2021b_IO612/IO612"
 /begin SUB_GROUP speedgoat_test_SN5659_R2021b_IO612_IO612_CAN_Read_Loop___Port_3 speedgoat_test_SN5659_R2021b_IO612_IO612_CAN_Read_Loop___Port_4 /end SUB_GROUP
 /begin REF_CHARACTERISTIC speedgoat_test_SN5659__cal_impl.CANSetup_P1 speedgoat_test_SN5659__cal_impl.CANSetup_P10 speedgoat_test_SN5659__cal_impl.CANSetup_P11 speedgoat_test_SN5659__cal_impl.CANSetup_P12 speedgoat_test_SN5659__cal_impl.CANSetup_P13 speedgoat_test_SN5659__cal_impl.CANSetup_P14 speedgoat_test_SN5659__cal_impl.CANSetup_P15 speedgoat_test_SN5659__cal_impl.CANSetup_P16 speedgoat_test_SN5659__cal_impl.CANSetup_P17 speedgoat_test_SN5659__cal_impl.CANSetup_P18 speedgoat_test_SN5659__cal_impl.CANSetup_P19 speedgoat_test_SN5659__cal_impl.CANSetup_P2 speedgoat_test_SN5659__cal_impl.CANSetup_P20 speedgoat_test_SN5659__cal_impl.CANSetup_P21 speedgoat_test_SN5659__cal_impl.CANSetup_P22 speedgoat_test_SN5659__cal_impl.CANSetup_P23 speedgoat_test_SN5659__cal_impl.CANSetup_P24 speedgoat_test_SN5659__cal_impl.CANSetup_P25 speedgoat_test_SN5659__cal_impl.CANSetup_P26 speedgoat_test_SN5659__cal_impl.CANSetup_P27 speedgoat_test_SN5659__cal_impl.CANSetup_P28 speedgoat_test_SN5659__cal_impl.CANSetup_P29 speedgoat_test_SN5659__cal_impl.CANSetup_P3 speedgoat_test_SN5659__cal_impl.CANSetup_P30 speedgoat_test_SN5659__cal_impl.CANSetup_P31 speedgoat_test_SN5659__cal_impl.CANSetup_P4 speedgoat_test_SN5659__cal_impl.CANSetup_P5 speedgoat_test_SN5659__cal_impl.CANSetup_P6 speedgoat_test_SN5659__cal_impl.CANSetup_P7 speedgoat_test_SN5659__cal_impl.CANSetup_P8 speedgoat_test_SN5659__cal_impl.CANSetup_P9 speedgoat_test_SN5659__cal_impl.CANWrite1_P1 speedgoat_test_SN5659__cal_impl.CANWrite1_P2 speedgoat_test_SN5659__cal_impl.CANWrite1_P3 speedgoat_test_SN5659__cal_impl.CANWrite1_P4 speedgoat_test_SN5659__cal_impl.CANWrite1_P5 speedgoat_test_SN5659__cal_impl.CANWrite1_P6 speedgoat_test_SN5659__cal_impl.CANWrite1_P7 speedgoat_test_SN5659__cal_impl.CANWrite1_P8 speedgoat_test_SN5659__cal_impl.CANWrite2_P1 speedgoat_test_SN5659__cal_impl.CANWrite2_P2 speedgoat_test_SN5659__cal_impl.CANWrite2_P3 speedgoat_test_SN5659__cal_impl.CANWrite2_P4 speedgoat_test_SN5659__cal_impl.CANWrite2_P5 speedgoat_test_SN5659__cal_impl.CANWrite2_P6 speedgoat_test_SN5659__cal_impl.CANWrite2_P7 speedgoat_test_SN5659__cal_impl.CANWrite2_P8 speedgoat_test_SN5659__cal_impl.CANWrite3_P1 speedgoat_test_SN5659__cal_impl.CANWrite3_P2 speedgoat_test_SN5659__cal_impl.CANWrite3_P3 speedgoat_test_SN5659__cal_impl.CANWrite3_P4 speedgoat_test_SN5659__cal_impl.CANWrite3_P5 speedgoat_test_SN5659__cal_impl.CANWrite3_P6 speedgoat_test_SN5659__cal_impl.CANWrite3_P7 speedgoat_test_SN5659__cal_impl.CANWrite3_P8 speedgoat_test_SN5659__cal_impl.CANWrite4_P1 speedgoat_test_SN5659__cal_impl.CANWrite4_P2 speedgoat_test_SN5659__cal_impl.CANWrite4_P3 speedgoat_test_SN5659__cal_impl.CANWrite4_P4 speedgoat_test_SN5659__cal_impl.CANWrite4_P5 speedgoat_test_SN5659__cal_impl.CANWrite4_P6 speedgoat_test_SN5659__cal_impl.CANWrite4_P7 speedgoat_test_SN5659__cal_impl.CANWrite4_P8 speedgoat_test_SN5659__cal_impl.CANWrite5_P1 speedgoat_test_SN5659__cal_impl.CANWrite5_P2 speedgoat_test_SN5659__cal_impl.CANWrite5_P3 speedgoat_test_SN5659__cal_impl.CANWrite5_P4 speedgoat_test_SN5659__cal_impl.CANWrite5_P5 speedgoat_test_SN5659__cal_impl.CANWrite5_P6 speedgoat_test_SN5659__cal_impl.CANWrite5_P7 speedgoat_test_SN5659__cal_impl.CANWrite5_P8 speedgoat_test_SN5659__cal_impl.CANWrite_P1 speedgoat_test_SN5659__cal_impl.CANWrite_P2 speedgoat_test_SN5659__cal_impl.CANWrite_P3 speedgoat_test_SN5659__cal_impl.CANWrite_P4 speedgoat_test_SN5659__cal_impl.CANWrite_P5 speedgoat_test_SN5659__cal_impl.CANWrite_P6 speedgoat_test_SN5659__cal_impl.CANWrite_P7 speedgoat_test_SN5659__cal_impl.CANWrite_P8 speedgoat_test_SN5659__cal_impl.RXSampleTime1_Value speedgoat_test_SN5659__cal_impl.RXSampleTime_Value speedgoat_test_SN5659__cal_impl.SineWave1_Amp speedgoat_test_SN5659__cal_impl.SineWave1_Bias speedgoat_test_SN5659__cal_impl.SineWave1_Freq speedgoat_test_SN5659__cal_impl.SineWave1_HCos speedgoat_test_SN5659__cal_impl.SineWave1_Hsin speedgoat_test_SN5659__cal_impl.SineWave1_PCos speedgoat_test_SN5659__cal_impl.SineWave1_PSin speedgoat_test_SN5659__cal_impl.SineWave2_Amp speedgoat_test_SN5659__cal_impl.SineWave2_Bias speedgoat_test_SN5659__cal_impl.SineWave2_Freq speedgoat_test_SN5659__cal_impl.SineWave2_HCos speedgoat_test_SN5659__cal_impl.SineWave2_Hsin speedgoat_test_SN5659__cal_impl.SineWave2_PCos speedgoat_test_SN5659__cal_impl.SineWave2_PSin speedgoat_test_SN5659__cal_impl.SineWave3_Amp speedgoat_test_SN5659__cal_impl.SineWave3_Bias speedgoat_test_SN5659__cal_impl.SineWave3_Freq speedgoat_test_SN5659__cal_impl.SineWave3_HCos speedgoat_test_SN5659__cal_impl.SineWave3_Hsin speedgoat_test_SN5659__cal_impl.SineWave3_PCos speedgoat_test_SN5659__cal_impl.SineWave3_PSin speedgoat_test_SN5659__cal_impl.SineWave4_Amp speedgoat_test_SN5659__cal_impl.SineWave4_Bias speedgoat_test_SN5659__cal_impl.SineWave4_Freq speedgoat_test_SN5659__cal_impl.SineWave4_HCos speedgoat_test_SN5659__cal_impl.SineWave4_Hsin speedgoat_test_SN5659__cal_impl.SineWave4_PCos speedgoat_test_SN5659__cal_impl.SineWave4_PSin speedgoat_test_SN5659__cal_impl.SineWave5_Amp speedgoat_test_SN5659__cal_impl.SineWave5_Bias speedgoat_test_SN5659__cal_impl.SineWave5_Freq speedgoat_test_SN5659__cal_impl.SineWave5_HCos speedgoat_test_SN5659__cal_impl.SineWave5_Hsin speedgoat_test_SN5659__cal_impl.SineWave5_PCos speedgoat_test_SN5659__cal_impl.SineWave5_PSin speedgoat_test_SN5659__cal_impl.SineWave_Amp speedgoat_test_SN5659__cal_impl.SineWave_Bias speedgoat_test_SN5659__cal_impl.SineWave_Freq speedgoat_test_SN5659__cal_impl.SineWave_HCos speedgoat_test_SN5659__cal_impl.SineWave_Hsin speedgoat_test_SN5659__cal_impl.SineWave_PCos speedgoat_test_SN5659__cal_impl.SineWave_PSin /end REF_CHARACTERISTIC
 /begin REF_MEASUREMENT speedgoat_test_SN5659_R2021b_IO612_B.CANUnpack speedgoat_test_SN5659_R2021b_IO612_B.CANUnpack1 speedgoat_test_SN5659_R2021b_IO612_B.CANUnpack1_o speedgoat_test_SN5659_R2021b_IO612_B.CANUnpack2 speedgoat_test_SN5659_R2021b_IO612_B.CANUnpack2_j speedgoat_test_SN5659_R2021b_IO612_B.CANUnpack_c speedgoat_test_SN5659_R2021b_IO612_B.RXSampleTime speedgoat_test_SN5659_R2021b_IO612_B.RXSampleTime1 speedgoat_test_SN5659_R2021b_IO612_B.SineWave speedgoat_test_SN5659_R2021b_IO612_B.SineWave1 speedgoat_test_SN5659_R2021b_IO612_B.SineWave2 speedgoat_test_SN5659_R2021b_IO612_B.SineWave3 speedgoat_test_SN5659_R2021b_IO612_B.SineWave4 speedgoat_test_SN5659_R2021b_IO612_B.SineWave5 speedgoat_test_SN5659_R2021b_IO612_DW.CANPack1_ModeSignalID speedgoat_test_SN5659_R2021b_IO612_DW.CANPack2_ModeSignalID speedgoat_test_SN5659_R2021b_IO612_DW.CANPack3_ModeSignalID speedgoat_test_SN5659_R2021b_IO612_DW.CANPack4_ModeSignalID speedgoat_test_SN5659_R2021b_IO612_DW.CANPack5_ModeSignalID speedgoat_test_SN5659_R2021b_IO612_DW.CANPack_ModeSignalID speedgoat_test_SN5659_R2021b_IO612_DW.CANWrite1_PWORK speedgoat_test_SN5659_R2021b_IO612_DW.CANWrite2_PWORK speedgoat_test_SN5659_R2021b_IO612_DW.CANWrite3_PWORK speedgoat_test_SN5659_R2021b_IO612_DW.CANWrite4_PWORK speedgoat_test_SN5659_R2021b_IO612_DW.CANWrite5_PWORK speedgoat_test_SN5659_R2021b_IO612_DW.CANWrite_PWORK speedgoat_test_SN5659_R2021b_IO612_DW.Scope_PWORK speedgoat_test_SN5659_R2021b_IO612_DW.lastCos speedgoat_test_SN5659_R2021b_IO612_DW.lastCos_b speedgoat_test_SN5659_R2021b_IO612_DW.lastCos_c speedgoat_test_SN5659_R2021b_IO612_DW.lastCos_g speedgoat_test_SN5659_R2021b_IO612_DW.lastCos_i speedgoat_test_SN5659_R2021b_IO612_DW.lastCos_j speedgoat_test_SN5659_R2021b_IO612_DW.lastSin speedgoat_test_SN5659_R2021b_IO612_DW.lastSin_c speedgoat_test_SN5659_R2021b_IO612_DW.lastSin_cd speedgoat_test_SN5659_R2021b_IO612_DW.lastSin_d speedgoat_test_SN5659_R2021b_IO612_DW.lastSin_h speedgoat_test_SN5659_R2021b_IO612_DW.lastSin_i speedgoat_test_SN5659_R2021b_IO612_DW.systemEnable speedgoat_test_SN5659_R2021b_IO612_DW.systemEnable_b speedgoat_test_SN5659_R2021b_IO612_DW.systemEnable_h speedgoat_test_SN5659_R2021b_IO612_DW.systemEnable_i speedgoat_test_SN5659_R2021b_IO612_DW.systemEnable_p speedgoat_test_SN5659_R2021b_IO612_DW.systemEnable_py /end REF_MEASUREMENT
/end GROUP
/begin GROUP speedgoat_test_SN5659_R2021b_IO612_IO612_CAN_Read_Loop___Port_3 "speedgoat_test_SN5659_R2021b_IO612/IO612/CAN Read Loop - Port 3"
 /begin REF_CHARACTERISTIC speedgoat_test_SN5659__cal_impl.CANRead_P1 speedgoat_test_SN5659__cal_impl.CANRead_P2 speedgoat_test_SN5659__cal_impl.CANRead_P3 speedgoat_test_SN5659__cal_impl.CANRead_P4 speedgoat_test_SN5659__cal_impl.CANRead_P5 speedgoat_test_SN5659__cal_impl.CANRead_P6 speedgoat_test_SN5659__cal_impl.CANRead_P7 speedgoat_test_SN5659__cal_impl.ID100_Signal1_Y0 speedgoat_test_SN5659__cal_impl.ID101_Signal1_Y0 speedgoat_test_SN5659__cal_impl.ID102_Signal1_Y0 /end REF_CHARACTERISTIC
 /begin REF_MEASUREMENT speedgoat_test_SN5659_R2021b_IO612_B.CANRead_o1 speedgoat_test_SN5659_R2021b_IO612_B.CANUnpack1_o speedgoat_test_SN5659_R2021b_IO612_B.CANUnpack2_j speedgoat_test_SN5659_R2021b_IO612_B.CANUnpack_c speedgoat_test_SN5659_R2021b_IO612_DW.CANUnpack1_ModeSignalID_i speedgoat_test_SN5659_R2021b_IO612_DW.CANUnpack1_StatusPortID_o speedgoat_test_SN5659_R2021b_IO612_DW.CANUnpack2_ModeSignalID_g speedgoat_test_SN5659_R2021b_IO612_DW.CANUnpack2_StatusPortID_m speedgoat_test_SN5659_R2021b_IO612_DW.CANUnpack_ModeSignalID_b speedgoat_test_SN5659_R2021b_IO612_DW.CANUnpack_StatusPortID_g /end REF_MEASUREMENT
/end GROUP
/begin GROUP speedgoat_test_SN5659_R2021b_IO612_IO612_CAN_Read_Loop___Port_4 "speedgoat_test_SN5659_R2021b_IO612/IO612/CAN Read Loop - Port 4"
 /begin REF_CHARACTERISTIC speedgoat_test_SN5659__cal_impl.CANRead1_P1 speedgoat_test_SN5659__cal_impl.CANRead1_P2 speedgoat_test_SN5659__cal_impl.CANRead1_P3 speedgoat_test_SN5659__cal_impl.CANRead1_P4 speedgoat_test_SN5659__cal_impl.CANRead1_P5 speedgoat_test_SN5659__cal_impl.CANRead1_P6 speedgoat_test_SN5659__cal_impl.CANRead1_P7 speedgoat_test_SN5659__cal_impl.ID100_Signal1_Y0_j speedgoat_test_SN5659__cal_impl.ID101_Signal1_Y0_o speedgoat_test_SN5659__cal_impl.ID102_Signal1_Y0_i /end REF_CHARACTERISTIC
 /begin REF_MEASUREMENT speedgoat_test_SN5659_R2021b_IO612_B.CANRead1_o1 speedgoat_test_SN5659_R2021b_IO612_B.CANUnpack speedgoat_test_SN5659_R2021b_IO612_B.CANUnpack1 speedgoat_test_SN5659_R2021b_IO612_B.CANUnpack2 speedgoat_test_SN5659_R2021b_IO612_DW.CANUnpack1_ModeSignalID speedgoat_test_SN5659_R2021b_IO612_DW.CANUnpack1_StatusPortID speedgoat_test_SN5659_R2021b_IO612_DW.CANUnpack2_ModeSignalID speedgoat_test_SN5659_R2021b_IO612_DW.CANUnpack2_StatusPortID speedgoat_test_SN5659_R2021b_IO612_DW.CANUnpack_ModeSignalID speedgoat_test_SN5659_R2021b_IO612_DW.CANUnpack_StatusPortID /end REF_MEASUREMENT
/end GROUP
/end MODULE
/end PROJECT
