/******************************************************************************
* ASAP2 file: speedgoat_test_SN5659_R2021b_IO107.a2l
* Code generation for model "speedgoat_test_SN5659_R2021b_IO107".
* Model version : 3.3
* Simulink Coder version : 10.4 R2021b
* C source code generated on : Fri Apr 08 15:32:19 2022
* Target selection: slrealtime.tlc
* Embedded hardware selection: Intel->x86-64 (Linux 64)
* Code generation objectives: Unspecified
* Validation result: Not run
* (add additional file header information here)
******************************************************************************/ ASAP2_VERSION 1 71
/begin PROJECT ProjectName "Project Comment Goes Here"
/begin HEADER "Header Comments go here" /end HEADER
/begin MODULE ModuleName "Module Comment Goes Here"
/begin IF_DATA XCP
 /begin PROTOCOL_LAYER 0x0100 0x03E8 0x00C8 0x0000 0x0000 0x0000 0x0000 0x0000 0xFC 0x0578 BYTE_ORDER_MSB_LAST ADDRESS_GRANULARITY_BYTE OPTIONAL_CMD ALLOC_ODT_ENTRY OPTIONAL_CMD ALLOC_ODT OPTIONAL_CMD ALLOC_DAQ OPTIONAL_CMD FREE_DAQ OPTIONAL_CMD GET_DAQ_RESOLUTION_INFO OPTIONAL_CMD GET_DAQ_PROCESSOR_INFO OPTIONAL_CMD START_STOP_SYNCH OPTIONAL_CMD START_STOP_DAQ_LIST OPTIONAL_CMD SET_DAQ_LIST_MODE OPTIONAL_CMD WRITE_DAQ OPTIONAL_CMD SET_DAQ_PTR OPTIONAL_CMD GET_CAL_PAGE OPTIONAL_CMD SET_CAL_PAGE OPTIONAL_CMD COPY_CAL_PAGE OPTIONAL_CMD SHORT_DOWNLOAD OPTIONAL_CMD DOWNLOAD_MAX OPTIONAL_CMD DOWNLOAD OPTIONAL_CMD SHORT_UPLOAD OPTIONAL_CMD UPLOAD OPTIONAL_CMD SET_MTA /end PROTOCOL_LAYER
 /begin DAQ DYNAMIC 0x0000 0x0080 0x00 OPTIMISATION_TYPE_DEFAULT ADDRESS_EXTENSION_FREE IDENTIFICATION_FIELD_TYPE_RELATIVE_WORD_ALIGNED GRANULARITY_ODT_ENTRY_SIZE_DAQ_BYTE 0xFF OVERLOAD_INDICATION_PID PRESCALER_SUPPORTED /begin STIM GRANULARITY_ODT_ENTRY_SIZE_STIM_BYTE 0xFF /end STIM /begin TIMESTAMP_SUPPORTED 0x0001 SIZE_DWORD UNIT_1US TIMESTAMP_FIXED /end TIMESTAMP_SUPPORTED /begin EVENT "1 ms" "1 ms" 0x0000 DAQ 0xFF 0x01 0x06 0x00 /end EVENT /end DAQ
 /begin XCP_ON_UDP_IP 0x0100 0x15B3 ADDRESS "192.168.7.2" /end XCP_ON_UDP_IP
/end IF_DATA
/begin MOD_PAR "MOD PAR Comment Goes Here"
 /begin MEMORY_SEGMENT speedgoat_test_SN5659__cal_impl "speedgoat_test_SN5659__cal_impl" DATA FLASH INTERN 0x00207020 0x970 -1 -1 -1 -1 -1
  /begin IF_DATA XCP
   /begin SEGMENT 0x00 0x02 0x00 0x00 0x00
    /begin PAGE 0x00 ECU_ACCESS_DONT_CARE XCP_READ_ACCESS_DONT_CARE XCP_WRITE_ACCESS_NOT_ALLOWED /end PAGE
    /begin PAGE 0x01 ECU_ACCESS_DONT_CARE XCP_READ_ACCESS_DONT_CARE XCP_WRITE_ACCESS_DONT_CARE /end PAGE
   /end SEGMENT
  /end IF_DATA
 /end MEMORY_SEGMENT
/end MOD_PAR
/begin MOD_COMMON "Mod Common Comment Here" BYTE_ORDER MSB_LAST ALIGNMENT_BYTE 1 ALIGNMENT_WORD 2 ALIGNMENT_LONG 4 ALIGNMENT_FLOAT32_IEEE 4 ALIGNMENT_FLOAT64_IEEE 8 ALIGNMENT_INT64 8 /end MOD_COMMON
/begin CHARACTERISTIC speedgoat_test_SN5659__cal_impl.Analogoutput1_P1 "" VALUE 0x00207238 Scalar_FLOAT64_IEEE 0 speedgoat_test_SN5659_R2021b_IO107_CM_double -1.7E+308 1.7E+308 /end CHARACTERISTIC
/begin CHARACTERISTIC speedgoat_test_SN5659__cal_impl.Analogoutput1_P2 "" VAL_BLK 0x00207250 Scalar_FLOAT64_IEEE 0 speedgoat_test_SN5659_R2021b_IO107_CM_double -1.7E+308 1.7E+308 MATRIX_DIM 16 1 /end CHARACTERISTIC
/begin CHARACTERISTIC speedgoat_test_SN5659__cal_impl.Analogoutput1_P3 "" VAL_BLK 0x002072E0 Scalar_FLOAT64_IEEE 0 speedgoat_test_SN5659_R2021b_IO107_CM_double -1.7E+308 1.7E+308 MATRIX_DIM 16 1 /end CHARACTERISTIC
/begin CHARACTERISTIC speedgoat_test_SN5659__cal_impl.Analogoutput1_P4 "" VALUE 0x00207370 Scalar_FLOAT64_IEEE 0 speedgoat_test_SN5659_R2021b_IO107_CM_double -1.7E+308 1.7E+308 /end CHARACTERISTIC
/begin CHARACTERISTIC speedgoat_test_SN5659__cal_impl.Analogoutput1_P5 "" VALUE 0x00207388 Scalar_FLOAT64_IEEE 0 speedgoat_test_SN5659_R2021b_IO107_CM_double -1.7E+308 1.7E+308 /end CHARACTERISTIC
/begin CHARACTERISTIC speedgoat_test_SN5659__cal_impl.Analogoutput1_P6 "" VALUE 0x002073A0 Scalar_FLOAT64_IEEE 0 speedgoat_test_SN5659_R2021b_IO107_CM_double -1.7E+308 1.7E+308 /end CHARACTERISTIC
/begin CHARACTERISTIC speedgoat_test_SN5659__cal_impl.Analogoutput1_P7 "" VALUE 0x002073B8 Scalar_FLOAT64_IEEE 0 speedgoat_test_SN5659_R2021b_IO107_CM_double -1.7E+308 1.7E+308 /end CHARACTERISTIC
/begin CHARACTERISTIC speedgoat_test_SN5659__cal_impl.Analogoutput_P1 "" VALUE 0x00207068 Scalar_FLOAT64_IEEE 0 speedgoat_test_SN5659_R2021b_IO107_CM_double -1.7E+308 1.7E+308 /end CHARACTERISTIC
/begin CHARACTERISTIC speedgoat_test_SN5659__cal_impl.Analogoutput_P2 "" VAL_BLK 0x00207080 Scalar_FLOAT64_IEEE 0 speedgoat_test_SN5659_R2021b_IO107_CM_double -1.7E+308 1.7E+308 MATRIX_DIM 16 1 /end CHARACTERISTIC
/begin CHARACTERISTIC speedgoat_test_SN5659__cal_impl.Analogoutput_P3 "" VAL_BLK 0x00207110 Scalar_FLOAT64_IEEE 0 speedgoat_test_SN5659_R2021b_IO107_CM_double -1.7E+308 1.7E+308 MATRIX_DIM 16 1 /end CHARACTERISTIC
/begin CHARACTERISTIC speedgoat_test_SN5659__cal_impl.Analogoutput_P4 "" VALUE 0x002071A0 Scalar_FLOAT64_IEEE 0 speedgoat_test_SN5659_R2021b_IO107_CM_double -1.7E+308 1.7E+308 /end CHARACTERISTIC
/begin CHARACTERISTIC speedgoat_test_SN5659__cal_impl.Analogoutput_P5 "" VALUE 0x002071B8 Scalar_FLOAT64_IEEE 0 speedgoat_test_SN5659_R2021b_IO107_CM_double -1.7E+308 1.7E+308 /end CHARACTERISTIC
/begin CHARACTERISTIC speedgoat_test_SN5659__cal_impl.Analogoutput_P6 "" VALUE 0x002071D0 Scalar_FLOAT64_IEEE 0 speedgoat_test_SN5659_R2021b_IO107_CM_double -1.7E+308 1.7E+308 /end CHARACTERISTIC
/begin CHARACTERISTIC speedgoat_test_SN5659__cal_impl.Analogoutput_P7 "" VALUE 0x002071E8 Scalar_FLOAT64_IEEE 0 speedgoat_test_SN5659_R2021b_IO107_CM_double -1.7E+308 1.7E+308 /end CHARACTERISTIC
/begin CHARACTERISTIC speedgoat_test_SN5659__cal_impl.Setup1_P1 "" VALUE 0x002076B8 Scalar_FLOAT64_IEEE 0 speedgoat_test_SN5659_R2021b_IO107_CM_double -1.7E+308 1.7E+308 /end CHARACTERISTIC
/begin CHARACTERISTIC speedgoat_test_SN5659__cal_impl.Setup1_P10 "" VAL_BLK 0x002078F8 Scalar_FLOAT64_IEEE 0 speedgoat_test_SN5659_R2021b_IO107_CM_double -1.7E+308 1.7E+308 MATRIX_DIM 16 1 /end CHARACTERISTIC
/begin CHARACTERISTIC speedgoat_test_SN5659__cal_impl.Setup1_P11 "" VALUE 0x00207988 Scalar_FLOAT64_IEEE 0 speedgoat_test_SN5659_R2021b_IO107_CM_double -1.7E+308 1.7E+308 /end CHARACTERISTIC
/begin CHARACTERISTIC speedgoat_test_SN5659__cal_impl.Setup1_P2 "" VALUE 0x002076D0 Scalar_FLOAT64_IEEE 0 speedgoat_test_SN5659_R2021b_IO107_CM_double -1.7E+308 1.7E+308 /end CHARACTERISTIC
/begin CHARACTERISTIC speedgoat_test_SN5659__cal_impl.Setup1_P3 "" VALUE 0x002076E8 Scalar_FLOAT64_IEEE 0 speedgoat_test_SN5659_R2021b_IO107_CM_double -1.7E+308 1.7E+308 /end CHARACTERISTIC
/begin CHARACTERISTIC speedgoat_test_SN5659__cal_impl.Setup1_P4 "" VALUE 0x00207700 Scalar_FLOAT64_IEEE 0 speedgoat_test_SN5659_R2021b_IO107_CM_double -1.7E+308 1.7E+308 /end CHARACTERISTIC
/begin CHARACTERISTIC speedgoat_test_SN5659__cal_impl.Setup1_P5 "" VALUE 0x00207718 Scalar_FLOAT64_IEEE 0 speedgoat_test_SN5659_R2021b_IO107_CM_double -1.7E+308 1.7E+308 /end CHARACTERISTIC
/begin CHARACTERISTIC speedgoat_test_SN5659__cal_impl.Setup1_P6 "" VALUE 0x00207730 Scalar_FLOAT64_IEEE 0 speedgoat_test_SN5659_R2021b_IO107_CM_double -1.7E+308 1.7E+308 /end CHARACTERISTIC
/begin CHARACTERISTIC speedgoat_test_SN5659__cal_impl.Setup1_P7 "" VAL_BLK 0x00207748 Scalar_FLOAT64_IEEE 0 speedgoat_test_SN5659_R2021b_IO107_CM_double -1.7E+308 1.7E+308 MATRIX_DIM 16 1 /end CHARACTERISTIC
/begin CHARACTERISTIC speedgoat_test_SN5659__cal_impl.Setup1_P8 "" VAL_BLK 0x002077D8 Scalar_FLOAT64_IEEE 0 speedgoat_test_SN5659_R2021b_IO107_CM_double -1.7E+308 1.7E+308 MATRIX_DIM 16 1 /end CHARACTERISTIC
/begin CHARACTERISTIC speedgoat_test_SN5659__cal_impl.Setup1_P9 "" VAL_BLK 0x00207868 Scalar_FLOAT64_IEEE 0 speedgoat_test_SN5659_R2021b_IO107_CM_double -1.7E+308 1.7E+308 MATRIX_DIM 16 1 /end CHARACTERISTIC
/begin CHARACTERISTIC speedgoat_test_SN5659__cal_impl.Setup_P1 "" VALUE 0x002073D0 Scalar_FLOAT64_IEEE 0 speedgoat_test_SN5659_R2021b_IO107_CM_double -1.7E+308 1.7E+308 /end CHARACTERISTIC
/begin CHARACTERISTIC speedgoat_test_SN5659__cal_impl.Setup_P10 "" VAL_BLK 0x00207610 Scalar_FLOAT64_IEEE 0 speedgoat_test_SN5659_R2021b_IO107_CM_double -1.7E+308 1.7E+308 MATRIX_DIM 16 1 /end CHARACTERISTIC
/begin CHARACTERISTIC speedgoat_test_SN5659__cal_impl.Setup_P11 "" VALUE 0x002076A0 Scalar_FLOAT64_IEEE 0 speedgoat_test_SN5659_R2021b_IO107_CM_double -1.7E+308 1.7E+308 /end CHARACTERISTIC
/begin CHARACTERISTIC speedgoat_test_SN5659__cal_impl.Setup_P2 "" VALUE 0x002073E8 Scalar_FLOAT64_IEEE 0 speedgoat_test_SN5659_R2021b_IO107_CM_double -1.7E+308 1.7E+308 /end CHARACTERISTIC
/begin CHARACTERISTIC speedgoat_test_SN5659__cal_impl.Setup_P3 "" VALUE 0x00207400 Scalar_FLOAT64_IEEE 0 speedgoat_test_SN5659_R2021b_IO107_CM_double -1.7E+308 1.7E+308 /end CHARACTERISTIC
/begin CHARACTERISTIC speedgoat_test_SN5659__cal_impl.Setup_P4 "" VALUE 0x00207418 Scalar_FLOAT64_IEEE 0 speedgoat_test_SN5659_R2021b_IO107_CM_double -1.7E+308 1.7E+308 /end CHARACTERISTIC
/begin CHARACTERISTIC speedgoat_test_SN5659__cal_impl.Setup_P5 "" VALUE 0x00207430 Scalar_FLOAT64_IEEE 0 speedgoat_test_SN5659_R2021b_IO107_CM_double -1.7E+308 1.7E+308 /end CHARACTERISTIC
/begin CHARACTERISTIC speedgoat_test_SN5659__cal_impl.Setup_P6 "" VALUE 0x00207448 Scalar_FLOAT64_IEEE 0 speedgoat_test_SN5659_R2021b_IO107_CM_double -1.7E+308 1.7E+308 /end CHARACTERISTIC
/begin CHARACTERISTIC speedgoat_test_SN5659__cal_impl.Setup_P7 "" VAL_BLK 0x00207460 Scalar_FLOAT64_IEEE 0 speedgoat_test_SN5659_R2021b_IO107_CM_double -1.7E+308 1.7E+308 MATRIX_DIM 16 1 /end CHARACTERISTIC
/begin CHARACTERISTIC speedgoat_test_SN5659__cal_impl.Setup_P8 "" VAL_BLK 0x002074F0 Scalar_FLOAT64_IEEE 0 speedgoat_test_SN5659_R2021b_IO107_CM_double -1.7E+308 1.7E+308 MATRIX_DIM 16 1 /end CHARACTERISTIC
/begin CHARACTERISTIC speedgoat_test_SN5659__cal_impl.Setup_P9 "" VAL_BLK 0x00207580 Scalar_FLOAT64_IEEE 0 speedgoat_test_SN5659_R2021b_IO107_CM_double -1.7E+308 1.7E+308 MATRIX_DIM 16 1 /end CHARACTERISTIC
/begin CHARACTERISTIC speedgoat_test_SN5659__cal_impl.SineWave1_Amp "" VALUE 0x002071F0 Scalar_FLOAT64_IEEE 0 speedgoat_test_SN5659_R2021b_IO107_CM_double -1.7E+308 1.7E+308 /end CHARACTERISTIC
/begin CHARACTERISTIC speedgoat_test_SN5659__cal_impl.SineWave1_Bias "" VALUE 0x002071F8 Scalar_FLOAT64_IEEE 0 speedgoat_test_SN5659_R2021b_IO107_CM_double -1.7E+308 1.7E+308 /end CHARACTERISTIC
/begin CHARACTERISTIC speedgoat_test_SN5659__cal_impl.SineWave1_Freq "" VALUE 0x00207200 Scalar_FLOAT64_IEEE 0 speedgoat_test_SN5659_R2021b_IO107_CM_double -1.7E+308 1.7E+308 /end CHARACTERISTIC
/begin CHARACTERISTIC speedgoat_test_SN5659__cal_impl.SineWave1_HCos "" VALUE 0x00207210 Scalar_FLOAT64_IEEE 0 speedgoat_test_SN5659_R2021b_IO107_CM_double -1.7E+308 1.7E+308 /end CHARACTERISTIC
/begin CHARACTERISTIC speedgoat_test_SN5659__cal_impl.SineWave1_Hsin "" VALUE 0x00207208 Scalar_FLOAT64_IEEE 0 speedgoat_test_SN5659_R2021b_IO107_CM_double -1.7E+308 1.7E+308 /end CHARACTERISTIC
/begin CHARACTERISTIC speedgoat_test_SN5659__cal_impl.SineWave1_PCos "" VALUE 0x00207220 Scalar_FLOAT64_IEEE 0 speedgoat_test_SN5659_R2021b_IO107_CM_double -1.7E+308 1.7E+308 /end CHARACTERISTIC
/begin CHARACTERISTIC speedgoat_test_SN5659__cal_impl.SineWave1_PSin "" VALUE 0x00207218 Scalar_FLOAT64_IEEE 0 speedgoat_test_SN5659_R2021b_IO107_CM_double -1.7E+308 1.7E+308 /end CHARACTERISTIC
/begin CHARACTERISTIC speedgoat_test_SN5659__cal_impl.SineWave_Amp "" VALUE 0x00207020 Scalar_FLOAT64_IEEE 0 speedgoat_test_SN5659_R2021b_IO107_CM_double -1.7E+308 1.7E+308 /end CHARACTERISTIC
/begin CHARACTERISTIC speedgoat_test_SN5659__cal_impl.SineWave_Bias "" VALUE 0x00207028 Scalar_FLOAT64_IEEE 0 speedgoat_test_SN5659_R2021b_IO107_CM_double -1.7E+308 1.7E+308 /end CHARACTERISTIC
/begin CHARACTERISTIC speedgoat_test_SN5659__cal_impl.SineWave_Freq "" VALUE 0x00207030 Scalar_FLOAT64_IEEE 0 speedgoat_test_SN5659_R2021b_IO107_CM_double -1.7E+308 1.7E+308 /end CHARACTERISTIC
/begin CHARACTERISTIC speedgoat_test_SN5659__cal_impl.SineWave_HCos "" VALUE 0x00207040 Scalar_FLOAT64_IEEE 0 speedgoat_test_SN5659_R2021b_IO107_CM_double -1.7E+308 1.7E+308 /end CHARACTERISTIC
/begin CHARACTERISTIC speedgoat_test_SN5659__cal_impl.SineWave_Hsin "" VALUE 0x00207038 Scalar_FLOAT64_IEEE 0 speedgoat_test_SN5659_R2021b_IO107_CM_double -1.7E+308 1.7E+308 /end CHARACTERISTIC
/begin CHARACTERISTIC speedgoat_test_SN5659__cal_impl.SineWave_PCos "" VALUE 0x00207050 Scalar_FLOAT64_IEEE 0 speedgoat_test_SN5659_R2021b_IO107_CM_double -1.7E+308 1.7E+308 /end CHARACTERISTIC
/begin CHARACTERISTIC speedgoat_test_SN5659__cal_impl.SineWave_PSin "" VALUE 0x00207048 Scalar_FLOAT64_IEEE 0 speedgoat_test_SN5659_R2021b_IO107_CM_double -1.7E+308 1.7E+308 /end CHARACTERISTIC
/begin MEASUREMENT speedgoat_test_SN5659_R2021b_IO107_B.SineWave "" FLOAT64_IEEE speedgoat_test_SN5659_R2021b_IO107_CM_double 0 0 -1.7E+308 1.7E+308 ECU_ADDRESS 0x0020A880 /end MEASUREMENT
/begin MEASUREMENT speedgoat_test_SN5659_R2021b_IO107_B.SineWave1 "" FLOAT64_IEEE speedgoat_test_SN5659_R2021b_IO107_CM_double 0 0 -1.7E+308 1.7E+308 ECU_ADDRESS 0x0020A888 /end MEASUREMENT
/begin MEASUREMENT speedgoat_test_SN5659_R2021b_IO107_DW.lastCos "" FLOAT64_IEEE speedgoat_test_SN5659_R2021b_IO107_CM_double 0 0 -1.7E+308 1.7E+308 ECU_ADDRESS 0x0020A7E8 /end MEASUREMENT
/begin MEASUREMENT speedgoat_test_SN5659_R2021b_IO107_DW.lastCos_o "" FLOAT64_IEEE speedgoat_test_SN5659_R2021b_IO107_CM_double 0 0 -1.7E+308 1.7E+308 ECU_ADDRESS 0x0020A7F8 /end MEASUREMENT
/begin MEASUREMENT speedgoat_test_SN5659_R2021b_IO107_DW.lastSin "" FLOAT64_IEEE speedgoat_test_SN5659_R2021b_IO107_CM_double 0 0 -1.7E+308 1.7E+308 ECU_ADDRESS 0x0020A7E0 /end MEASUREMENT
/begin MEASUREMENT speedgoat_test_SN5659_R2021b_IO107_DW.lastSin_d "" FLOAT64_IEEE speedgoat_test_SN5659_R2021b_IO107_CM_double 0 0 -1.7E+308 1.7E+308 ECU_ADDRESS 0x0020A7F0 /end MEASUREMENT
/begin MEASUREMENT speedgoat_test_SN5659_R2021b_IO107_DW.systemEnable "" SLONG speedgoat_test_SN5659_R2021b_IO107_CM_int32 0 0 -2147483648 2147483647 ECU_ADDRESS 0x0020A860 /end MEASUREMENT
/begin MEASUREMENT speedgoat_test_SN5659_R2021b_IO107_DW.systemEnable_o "" SLONG speedgoat_test_SN5659_R2021b_IO107_CM_int32 0 0 -2147483648 2147483647 ECU_ADDRESS 0x0020A864 /end MEASUREMENT
/begin COMPU_METHOD speedgoat_test_SN5659_R2021b_IO107_CM_double "" IDENTICAL "%15.10" "" /end COMPU_METHOD
/begin COMPU_METHOD speedgoat_test_SN5659_R2021b_IO107_CM_int32 "" IDENTICAL "%10.0" "" /end COMPU_METHOD
/begin RECORD_LAYOUT Scalar_FLOAT64_IEEE FNC_VALUES 1 FLOAT64_IEEE COLUMN_DIR DIRECT /end RECORD_LAYOUT
/begin RECORD_LAYOUT Scalar_SLONG FNC_VALUES 1 SLONG COLUMN_DIR DIRECT /end RECORD_LAYOUT
/begin GROUP speedgoat_test_SN5659_R2021b_IO107 "speedgoat_test_SN5659_R2021b_IO107" ROOT /begin SUB_GROUP speedgoat_test_SN5659_R2021b_IO107_IO107__1_2_ /end SUB_GROUP /end GROUP
/begin GROUP speedgoat_test_SN5659_R2021b_IO107_IO107__1_2_ "speedgoat_test_SN5659_R2021b_IO107/IO107 (1-2)"
 /begin REF_CHARACTERISTIC speedgoat_test_SN5659__cal_impl.Analogoutput1_P1 speedgoat_test_SN5659__cal_impl.Analogoutput1_P2 speedgoat_test_SN5659__cal_impl.Analogoutput1_P3 speedgoat_test_SN5659__cal_impl.Analogoutput1_P4 speedgoat_test_SN5659__cal_impl.Analogoutput1_P5 speedgoat_test_SN5659__cal_impl.Analogoutput1_P6 speedgoat_test_SN5659__cal_impl.Analogoutput1_P7 speedgoat_test_SN5659__cal_impl.Analogoutput_P1 speedgoat_test_SN5659__cal_impl.Analogoutput_P2 speedgoat_test_SN5659__cal_impl.Analogoutput_P3 speedgoat_test_SN5659__cal_impl.Analogoutput_P4 speedgoat_test_SN5659__cal_impl.Analogoutput_P5 speedgoat_test_SN5659__cal_impl.Analogoutput_P6 speedgoat_test_SN5659__cal_impl.Analogoutput_P7 speedgoat_test_SN5659__cal_impl.Setup1_P1 speedgoat_test_SN5659__cal_impl.Setup1_P10 speedgoat_test_SN5659__cal_impl.Setup1_P11 speedgoat_test_SN5659__cal_impl.Setup1_P2 speedgoat_test_SN5659__cal_impl.Setup1_P3 speedgoat_test_SN5659__cal_impl.Setup1_P4 speedgoat_test_SN5659__cal_impl.Setup1_P5 speedgoat_test_SN5659__cal_impl.Setup1_P6 speedgoat_test_SN5659__cal_impl.Setup1_P7 speedgoat_test_SN5659__cal_impl.Setup1_P8 speedgoat_test_SN5659__cal_impl.Setup1_P9 speedgoat_test_SN5659__cal_impl.Setup_P1 speedgoat_test_SN5659__cal_impl.Setup_P10 speedgoat_test_SN5659__cal_impl.Setup_P11 speedgoat_test_SN5659__cal_impl.Setup_P2 speedgoat_test_SN5659__cal_impl.Setup_P3 speedgoat_test_SN5659__cal_impl.Setup_P4 speedgoat_test_SN5659__cal_impl.Setup_P5 speedgoat_test_SN5659__cal_impl.Setup_P6 speedgoat_test_SN5659__cal_impl.Setup_P7 speedgoat_test_SN5659__cal_impl.Setup_P8 speedgoat_test_SN5659__cal_impl.Setup_P9 speedgoat_test_SN5659__cal_impl.SineWave1_Amp speedgoat_test_SN5659__cal_impl.SineWave1_Bias speedgoat_test_SN5659__cal_impl.SineWave1_Freq speedgoat_test_SN5659__cal_impl.SineWave1_HCos speedgoat_test_SN5659__cal_impl.SineWave1_Hsin speedgoat_test_SN5659__cal_impl.SineWave1_PCos speedgoat_test_SN5659__cal_impl.SineWave1_PSin speedgoat_test_SN5659__cal_impl.SineWave_Amp speedgoat_test_SN5659__cal_impl.SineWave_Bias speedgoat_test_SN5659__cal_impl.SineWave_Freq speedgoat_test_SN5659__cal_impl.SineWave_HCos speedgoat_test_SN5659__cal_impl.SineWave_Hsin speedgoat_test_SN5659__cal_impl.SineWave_PCos speedgoat_test_SN5659__cal_impl.SineWave_PSin /end REF_CHARACTERISTIC
 /begin REF_MEASUREMENT speedgoat_test_SN5659_R2021b_IO107_B.SineWave speedgoat_test_SN5659_R2021b_IO107_B.SineWave1 speedgoat_test_SN5659_R2021b_IO107_DW.Analogoutput1_PWORK speedgoat_test_SN5659_R2021b_IO107_DW.Analogoutput_PWORK speedgoat_test_SN5659_R2021b_IO107_DW.Setup1_PWORK speedgoat_test_SN5659_R2021b_IO107_DW.Setup_PWORK speedgoat_test_SN5659_R2021b_IO107_DW.lastCos speedgoat_test_SN5659_R2021b_IO107_DW.lastCos_o speedgoat_test_SN5659_R2021b_IO107_DW.lastSin speedgoat_test_SN5659_R2021b_IO107_DW.lastSin_d speedgoat_test_SN5659_R2021b_IO107_DW.systemEnable speedgoat_test_SN5659_R2021b_IO107_DW.systemEnable_o /end REF_MEASUREMENT
/end GROUP
/end MODULE
/end PROJECT
