/******************************************************************************
* ASAP2 file: speedgoat_test_SN5659_R2021b_IO133.a2l
* Code generation for model "speedgoat_test_SN5659_R2021b_IO133".
* Model version : 3.5
* Simulink Coder version : 10.4 R2021b
* C source code generated on : Fri Apr 08 16:37:14 2022
* Target selection: slrealtime.tlc
* Embedded hardware selection: Intel->x86-64 (Linux 64)
* Code generation objectives: Unspecified
* Validation result: Not run
* (add additional file header information here)
******************************************************************************/ ASAP2_VERSION 1 71
/begin PROJECT ProjectName "Project Comment Goes Here"
/begin HEADER "Header Comments go here" /end HEADER
/begin MODULE ModuleName "Module Comment Goes Here"
/begin IF_DATA XCP
 /begin PROTOCOL_LAYER 0x0100 0x03E8 0x00C8 0x0000 0x0000 0x0000 0x0000 0x0000 0xFC 0x0578 BYTE_ORDER_MSB_LAST ADDRESS_GRANULARITY_BYTE OPTIONAL_CMD ALLOC_ODT_ENTRY OPTIONAL_CMD ALLOC_ODT OPTIONAL_CMD ALLOC_DAQ OPTIONAL_CMD FREE_DAQ OPTIONAL_CMD GET_DAQ_RESOLUTION_INFO OPTIONAL_CMD GET_DAQ_PROCESSOR_INFO OPTIONAL_CMD START_STOP_SYNCH OPTIONAL_CMD START_STOP_DAQ_LIST OPTIONAL_CMD SET_DAQ_LIST_MODE OPTIONAL_CMD WRITE_DAQ OPTIONAL_CMD SET_DAQ_PTR OPTIONAL_CMD GET_CAL_PAGE OPTIONAL_CMD SET_CAL_PAGE OPTIONAL_CMD COPY_CAL_PAGE OPTIONAL_CMD SHORT_DOWNLOAD OPTIONAL_CMD DOWNLOAD_MAX OPTIONAL_CMD DOWNLOAD OPTIONAL_CMD SHORT_UPLOAD OPTIONAL_CMD UPLOAD OPTIONAL_CMD SET_MTA /end PROTOCOL_LAYER
 /begin DAQ DYNAMIC 0x0000 0x0080 0x00 OPTIMISATION_TYPE_DEFAULT ADDRESS_EXTENSION_FREE IDENTIFICATION_FIELD_TYPE_RELATIVE_WORD_ALIGNED GRANULARITY_ODT_ENTRY_SIZE_DAQ_BYTE 0xFF OVERLOAD_INDICATION_PID PRESCALER_SUPPORTED /begin STIM GRANULARITY_ODT_ENTRY_SIZE_STIM_BYTE 0xFF /end STIM /begin TIMESTAMP_SUPPORTED 0x0001 SIZE_DWORD UNIT_1US TIMESTAMP_FIXED /end TIMESTAMP_SUPPORTED /begin EVENT "1 ms" "1 ms" 0x0000 DAQ 0xFF 0x01 0x06 0x00 /end EVENT /end DAQ
 /begin XCP_ON_UDP_IP 0x0100 0x15B3 ADDRESS "192.168.7.2" /end XCP_ON_UDP_IP
/end IF_DATA
/begin MOD_PAR "MOD PAR Comment Goes Here"
 /begin MEMORY_SEGMENT speedgoat_test_SN5659__cal_impl "speedgoat_test_SN5659__cal_impl" DATA FLASH INTERN 0x0020B020 0x898 -1 -1 -1 -1 -1
  /begin IF_DATA XCP
   /begin SEGMENT 0x00 0x02 0x00 0x00 0x00
    /begin PAGE 0x00 ECU_ACCESS_DONT_CARE XCP_READ_ACCESS_DONT_CARE XCP_WRITE_ACCESS_NOT_ALLOWED /end PAGE
    /begin PAGE 0x01 ECU_ACCESS_DONT_CARE XCP_READ_ACCESS_DONT_CARE XCP_WRITE_ACCESS_DONT_CARE /end PAGE
   /end SEGMENT
  /end IF_DATA
 /end MEMORY_SEGMENT
/end MOD_PAR
/begin MOD_COMMON "Mod Common Comment Here" BYTE_ORDER MSB_LAST ALIGNMENT_BYTE 1 ALIGNMENT_WORD 2 ALIGNMENT_LONG 4 ALIGNMENT_FLOAT32_IEEE 4 ALIGNMENT_FLOAT64_IEEE 8 ALIGNMENT_INT64 8 /end MOD_COMMON
/begin CHARACTERISTIC speedgoat_test_SN5659__cal_impl.Analoginputv2_P1 "" VALUE 0x0020B410 Scalar_FLOAT64_IEEE 0 speedgoat_test_SN5659_R2021b_IO133_CM_double -1.7E+308 1.7E+308 /end CHARACTERISTIC
/begin CHARACTERISTIC speedgoat_test_SN5659__cal_impl.Analoginputv2_P10 "" VAL_BLK 0x0020B510 Scalar_FLOAT64_IEEE 0 speedgoat_test_SN5659_R2021b_IO133_CM_double -1.7E+308 1.7E+308 MATRIX_DIM 2 1 /end CHARACTERISTIC
/begin CHARACTERISTIC speedgoat_test_SN5659__cal_impl.Analoginputv2_P11 "" VALUE 0x0020B530 Scalar_FLOAT64_IEEE 0 speedgoat_test_SN5659_R2021b_IO133_CM_double -1.7E+308 1.7E+308 /end CHARACTERISTIC
/begin CHARACTERISTIC speedgoat_test_SN5659__cal_impl.Analoginputv2_P2 "" VALUE 0x0020B428 Scalar_FLOAT64_IEEE 0 speedgoat_test_SN5659_R2021b_IO133_CM_double -1.7E+308 1.7E+308 /end CHARACTERISTIC
/begin CHARACTERISTIC speedgoat_test_SN5659__cal_impl.Analoginputv2_P3 "" VALUE 0x0020B440 Scalar_FLOAT64_IEEE 0 speedgoat_test_SN5659_R2021b_IO133_CM_double -1.7E+308 1.7E+308 /end CHARACTERISTIC
/begin CHARACTERISTIC speedgoat_test_SN5659__cal_impl.Analoginputv2_P4 "" VALUE 0x0020B458 Scalar_FLOAT64_IEEE 0 speedgoat_test_SN5659_R2021b_IO133_CM_double -1.7E+308 1.7E+308 /end CHARACTERISTIC
/begin CHARACTERISTIC speedgoat_test_SN5659__cal_impl.Analoginputv2_P5 "" VAL_BLK 0x0020B470 Scalar_FLOAT64_IEEE 0 speedgoat_test_SN5659_R2021b_IO133_CM_double -1.7E+308 1.7E+308 MATRIX_DIM 4 1 /end CHARACTERISTIC
/begin CHARACTERISTIC speedgoat_test_SN5659__cal_impl.Analoginputv2_P6 "" VAL_BLK 0x0020B4A0 Scalar_FLOAT64_IEEE 0 speedgoat_test_SN5659_R2021b_IO133_CM_double -1.7E+308 1.7E+308 MATRIX_DIM 2 1 /end CHARACTERISTIC
/begin CHARACTERISTIC speedgoat_test_SN5659__cal_impl.Analoginputv2_P7 "" VAL_BLK 0x0020B4C0 Scalar_FLOAT64_IEEE 0 speedgoat_test_SN5659_R2021b_IO133_CM_double -1.7E+308 1.7E+308 MATRIX_DIM 2 1 /end CHARACTERISTIC
/begin CHARACTERISTIC speedgoat_test_SN5659__cal_impl.Analoginputv2_P8 "" VALUE 0x0020B4E0 Scalar_FLOAT64_IEEE 0 speedgoat_test_SN5659_R2021b_IO133_CM_double -1.7E+308 1.7E+308 /end CHARACTERISTIC
/begin CHARACTERISTIC speedgoat_test_SN5659__cal_impl.Analoginputv2_P9 "" VALUE 0x0020B4F8 Scalar_FLOAT64_IEEE 0 speedgoat_test_SN5659_R2021b_IO133_CM_double -1.7E+308 1.7E+308 /end CHARACTERISTIC
/begin CHARACTERISTIC speedgoat_test_SN5659__cal_impl.Analogoutputv2_P1 "" VALUE 0x0020B588 Scalar_FLOAT64_IEEE 0 speedgoat_test_SN5659_R2021b_IO133_CM_double -1.7E+308 1.7E+308 /end CHARACTERISTIC
/begin CHARACTERISTIC speedgoat_test_SN5659__cal_impl.Analogoutputv2_P10 "" VALUE 0x0020B6E0 Scalar_FLOAT64_IEEE 0 speedgoat_test_SN5659_R2021b_IO133_CM_double -1.7E+308 1.7E+308 /end CHARACTERISTIC
/begin CHARACTERISTIC speedgoat_test_SN5659__cal_impl.Analogoutputv2_P11 "" VAL_BLK 0x0020B6F8 Scalar_FLOAT64_IEEE 0 speedgoat_test_SN5659_R2021b_IO133_CM_double -1.7E+308 1.7E+308 MATRIX_DIM 2 1 /end CHARACTERISTIC
/begin CHARACTERISTIC speedgoat_test_SN5659__cal_impl.Analogoutputv2_P12 "" VALUE 0x0020B718 Scalar_FLOAT64_IEEE 0 speedgoat_test_SN5659_R2021b_IO133_CM_double -1.7E+308 1.7E+308 /end CHARACTERISTIC
/begin CHARACTERISTIC speedgoat_test_SN5659__cal_impl.Analogoutputv2_P13 "" VALUE 0x0020B730 Scalar_FLOAT64_IEEE 0 speedgoat_test_SN5659_R2021b_IO133_CM_double -1.7E+308 1.7E+308 /end CHARACTERISTIC
/begin CHARACTERISTIC speedgoat_test_SN5659__cal_impl.Analogoutputv2_P2 "" VALUE 0x0020B5A0 Scalar_FLOAT64_IEEE 0 speedgoat_test_SN5659_R2021b_IO133_CM_double -1.7E+308 1.7E+308 /end CHARACTERISTIC
/begin CHARACTERISTIC speedgoat_test_SN5659__cal_impl.Analogoutputv2_P3 "" VALUE 0x0020B5B8 Scalar_FLOAT64_IEEE 0 speedgoat_test_SN5659_R2021b_IO133_CM_double -1.7E+308 1.7E+308 /end CHARACTERISTIC
/begin CHARACTERISTIC speedgoat_test_SN5659__cal_impl.Analogoutputv2_P4 "" VALUE 0x0020B5D0 Scalar_FLOAT64_IEEE 0 speedgoat_test_SN5659_R2021b_IO133_CM_double -1.7E+308 1.7E+308 /end CHARACTERISTIC
/begin CHARACTERISTIC speedgoat_test_SN5659__cal_impl.Analogoutputv2_P5 "" VAL_BLK 0x0020B5E8 Scalar_FLOAT64_IEEE 0 speedgoat_test_SN5659_R2021b_IO133_CM_double -1.7E+308 1.7E+308 MATRIX_DIM 4 1 /end CHARACTERISTIC
/begin CHARACTERISTIC speedgoat_test_SN5659__cal_impl.Analogoutputv2_P6 "" VAL_BLK 0x0020B618 Scalar_FLOAT64_IEEE 0 speedgoat_test_SN5659_R2021b_IO133_CM_double -1.7E+308 1.7E+308 MATRIX_DIM 8 1 /end CHARACTERISTIC
/begin CHARACTERISTIC speedgoat_test_SN5659__cal_impl.Analogoutputv2_P7 "" VAL_BLK 0x0020B668 Scalar_FLOAT64_IEEE 0 speedgoat_test_SN5659_R2021b_IO133_CM_double -1.7E+308 1.7E+308 MATRIX_DIM 4 1 /end CHARACTERISTIC
/begin CHARACTERISTIC speedgoat_test_SN5659__cal_impl.Analogoutputv2_P8 "" VAL_BLK 0x0020B698 Scalar_FLOAT64_IEEE 0 speedgoat_test_SN5659_R2021b_IO133_CM_double -1.7E+308 1.7E+308 MATRIX_DIM 4 1 /end CHARACTERISTIC
/begin CHARACTERISTIC speedgoat_test_SN5659__cal_impl.Analogoutputv2_P9 "" VALUE 0x0020B6C8 Scalar_FLOAT64_IEEE 0 speedgoat_test_SN5659_R2021b_IO133_CM_double -1.7E+308 1.7E+308 /end CHARACTERISTIC
/begin CHARACTERISTIC speedgoat_test_SN5659__cal_impl.Digitalinputv2_P1 "" VALUE 0x0020B748 Scalar_FLOAT64_IEEE 0 speedgoat_test_SN5659_R2021b_IO133_CM_double -1.7E+308 1.7E+308 /end CHARACTERISTIC
/begin CHARACTERISTIC speedgoat_test_SN5659__cal_impl.Digitalinputv2_P2 "" VALUE 0x0020B760 Scalar_FLOAT64_IEEE 0 speedgoat_test_SN5659_R2021b_IO133_CM_double -1.7E+308 1.7E+308 /end CHARACTERISTIC
/begin CHARACTERISTIC speedgoat_test_SN5659__cal_impl.Digitalinputv2_P3 "" VALUE 0x0020B778 Scalar_FLOAT64_IEEE 0 speedgoat_test_SN5659_R2021b_IO133_CM_double -1.7E+308 1.7E+308 /end CHARACTERISTIC
/begin CHARACTERISTIC speedgoat_test_SN5659__cal_impl.Digitalinputv2_P4 "" VALUE 0x0020B790 Scalar_FLOAT64_IEEE 0 speedgoat_test_SN5659_R2021b_IO133_CM_double -1.7E+308 1.7E+308 /end CHARACTERISTIC
/begin CHARACTERISTIC speedgoat_test_SN5659__cal_impl.Digitalinputv2_P5 "" VAL_BLK 0x0020B7A8 Scalar_FLOAT64_IEEE 0 speedgoat_test_SN5659_R2021b_IO133_CM_double -1.7E+308 1.7E+308 MATRIX_DIM 2 1 /end CHARACTERISTIC
/begin CHARACTERISTIC speedgoat_test_SN5659__cal_impl.Digitaloutputv2_P1 "" VALUE 0x0020B808 Scalar_FLOAT64_IEEE 0 speedgoat_test_SN5659_R2021b_IO133_CM_double -1.7E+308 1.7E+308 /end CHARACTERISTIC
/begin CHARACTERISTIC speedgoat_test_SN5659__cal_impl.Digitaloutputv2_P2 "" VALUE 0x0020B820 Scalar_FLOAT64_IEEE 0 speedgoat_test_SN5659_R2021b_IO133_CM_double -1.7E+308 1.7E+308 /end CHARACTERISTIC
/begin CHARACTERISTIC speedgoat_test_SN5659__cal_impl.Digitaloutputv2_P3 "" VALUE 0x0020B838 Scalar_FLOAT64_IEEE 0 speedgoat_test_SN5659_R2021b_IO133_CM_double -1.7E+308 1.7E+308 /end CHARACTERISTIC
/begin CHARACTERISTIC speedgoat_test_SN5659__cal_impl.Digitaloutputv2_P4 "" VALUE 0x0020B850 Scalar_FLOAT64_IEEE 0 speedgoat_test_SN5659_R2021b_IO133_CM_double -1.7E+308 1.7E+308 /end CHARACTERISTIC
/begin CHARACTERISTIC speedgoat_test_SN5659__cal_impl.Digitaloutputv2_P5 "" VAL_BLK 0x0020B868 Scalar_FLOAT64_IEEE 0 speedgoat_test_SN5659_R2021b_IO133_CM_double -1.7E+308 1.7E+308 MATRIX_DIM 2 1 /end CHARACTERISTIC
/begin CHARACTERISTIC speedgoat_test_SN5659__cal_impl.Digitaloutputv2_P6 "" VAL_BLK 0x0020B888 Scalar_FLOAT64_IEEE 0 speedgoat_test_SN5659_R2021b_IO133_CM_double -1.7E+308 1.7E+308 MATRIX_DIM 2 1 /end CHARACTERISTIC
/begin CHARACTERISTIC speedgoat_test_SN5659__cal_impl.Digitaloutputv2_P7 "" VAL_BLK 0x0020B8A8 Scalar_FLOAT64_IEEE 0 speedgoat_test_SN5659_R2021b_IO133_CM_double -1.7E+308 1.7E+308 MATRIX_DIM 2 1 /end CHARACTERISTIC
/begin CHARACTERISTIC speedgoat_test_SN5659__cal_impl.Gain1_Gain "" VALUE 0x0020B560 Scalar_FLOAT64_IEEE 0 speedgoat_test_SN5659_R2021b_IO133_CM_double -1.7E+308 1.7E+308 /end CHARACTERISTIC
/begin CHARACTERISTIC speedgoat_test_SN5659__cal_impl.Gain2_Gain "" VALUE 0x0020B568 Scalar_FLOAT64_IEEE 0 speedgoat_test_SN5659_R2021b_IO133_CM_double -1.7E+308 1.7E+308 /end CHARACTERISTIC
/begin CHARACTERISTIC speedgoat_test_SN5659__cal_impl.Gain3_Gain "" VALUE 0x0020B570 Scalar_FLOAT64_IEEE 0 speedgoat_test_SN5659_R2021b_IO133_CM_double -1.7E+308 1.7E+308 /end CHARACTERISTIC
/begin CHARACTERISTIC speedgoat_test_SN5659__cal_impl.Gain_Gain "" VALUE 0x0020B558 Scalar_FLOAT64_IEEE 0 speedgoat_test_SN5659_R2021b_IO133_CM_double -1.7E+308 1.7E+308 /end CHARACTERISTIC
/begin CHARACTERISTIC speedgoat_test_SN5659__cal_impl.PulseGenerator1_Amp "" VALUE 0x0020B7D8 Scalar_FLOAT64_IEEE 0 speedgoat_test_SN5659_R2021b_IO133_CM_double -1.7E+308 1.7E+308 /end CHARACTERISTIC
/begin CHARACTERISTIC speedgoat_test_SN5659__cal_impl.PulseGenerator1_Duty "" VALUE 0x0020B7E8 Scalar_FLOAT64_IEEE 0 speedgoat_test_SN5659_R2021b_IO133_CM_double -1.7E+308 1.7E+308 /end CHARACTERISTIC
/begin CHARACTERISTIC speedgoat_test_SN5659__cal_impl.PulseGenerator1_Period "" VALUE 0x0020B7E0 Scalar_FLOAT64_IEEE 0 speedgoat_test_SN5659_R2021b_IO133_CM_double -1.7E+308 1.7E+308 /end CHARACTERISTIC
/begin CHARACTERISTIC speedgoat_test_SN5659__cal_impl.PulseGenerator1_PhaseDelay "" VALUE 0x0020B7F0 Scalar_FLOAT64_IEEE 0 speedgoat_test_SN5659_R2021b_IO133_CM_double -1.7E+308 1.7E+308 /end CHARACTERISTIC
/begin CHARACTERISTIC speedgoat_test_SN5659__cal_impl.PulseGenerator_Amp "" VALUE 0x0020B7B8 Scalar_FLOAT64_IEEE 0 speedgoat_test_SN5659_R2021b_IO133_CM_double -1.7E+308 1.7E+308 /end CHARACTERISTIC
/begin CHARACTERISTIC speedgoat_test_SN5659__cal_impl.PulseGenerator_Duty "" VALUE 0x0020B7C8 Scalar_FLOAT64_IEEE 0 speedgoat_test_SN5659_R2021b_IO133_CM_double -1.7E+308 1.7E+308 /end CHARACTERISTIC
/begin CHARACTERISTIC speedgoat_test_SN5659__cal_impl.PulseGenerator_Period "" VALUE 0x0020B7C0 Scalar_FLOAT64_IEEE 0 speedgoat_test_SN5659_R2021b_IO133_CM_double -1.7E+308 1.7E+308 /end CHARACTERISTIC
/begin CHARACTERISTIC speedgoat_test_SN5659__cal_impl.PulseGenerator_PhaseDelay "" VALUE 0x0020B7D0 Scalar_FLOAT64_IEEE 0 speedgoat_test_SN5659_R2021b_IO133_CM_double -1.7E+308 1.7E+308 /end CHARACTERISTIC
/begin CHARACTERISTIC speedgoat_test_SN5659__cal_impl.Setupv2_P1 "" VALUE 0x0020B030 Scalar_FLOAT64_IEEE 0 speedgoat_test_SN5659_R2021b_IO133_CM_double -1.7E+308 1.7E+308 /end CHARACTERISTIC
/begin CHARACTERISTIC speedgoat_test_SN5659__cal_impl.Setupv2_P10 "" VALUE 0x0020B130 Scalar_FLOAT64_IEEE 0 speedgoat_test_SN5659_R2021b_IO133_CM_double -1.7E+308 1.7E+308 /end CHARACTERISTIC
/begin CHARACTERISTIC speedgoat_test_SN5659__cal_impl.Setupv2_P11 "" VAL_BLK 0x0020B148 Scalar_FLOAT64_IEEE 0 speedgoat_test_SN5659_R2021b_IO133_CM_double -1.7E+308 1.7E+308 MATRIX_DIM 2 1 /end CHARACTERISTIC
/begin CHARACTERISTIC speedgoat_test_SN5659__cal_impl.Setupv2_P12 "" VALUE 0x0020B168 Scalar_FLOAT64_IEEE 0 speedgoat_test_SN5659_R2021b_IO133_CM_double -1.7E+308 1.7E+308 /end CHARACTERISTIC
/begin CHARACTERISTIC speedgoat_test_SN5659__cal_impl.Setupv2_P13 "" VALUE 0x0020B180 Scalar_FLOAT64_IEEE 0 speedgoat_test_SN5659_R2021b_IO133_CM_double -1.7E+308 1.7E+308 /end CHARACTERISTIC
/begin CHARACTERISTIC speedgoat_test_SN5659__cal_impl.Setupv2_P14 "" VALUE 0x0020B198 Scalar_FLOAT64_IEEE 0 speedgoat_test_SN5659_R2021b_IO133_CM_double -1.7E+308 1.7E+308 /end CHARACTERISTIC
/begin CHARACTERISTIC speedgoat_test_SN5659__cal_impl.Setupv2_P15 "" VAL_BLK 0x0020B1B0 Scalar_FLOAT64_IEEE 0 speedgoat_test_SN5659_R2021b_IO133_CM_double -1.7E+308 1.7E+308 MATRIX_DIM 4 1 /end CHARACTERISTIC
/begin CHARACTERISTIC speedgoat_test_SN5659__cal_impl.Setupv2_P16 "" VAL_BLK 0x0020B1E0 Scalar_FLOAT64_IEEE 0 speedgoat_test_SN5659_R2021b_IO133_CM_double -1.7E+308 1.7E+308 MATRIX_DIM 8 1 /end CHARACTERISTIC
/begin CHARACTERISTIC speedgoat_test_SN5659__cal_impl.Setupv2_P17 "" VALUE 0x0020B230 Scalar_FLOAT64_IEEE 0 speedgoat_test_SN5659_R2021b_IO133_CM_double -1.7E+308 1.7E+308 /end CHARACTERISTIC
/begin CHARACTERISTIC speedgoat_test_SN5659__cal_impl.Setupv2_P18 "" VALUE 0x0020B248 Scalar_FLOAT64_IEEE 0 speedgoat_test_SN5659_R2021b_IO133_CM_double -1.7E+308 1.7E+308 /end CHARACTERISTIC
/begin CHARACTERISTIC speedgoat_test_SN5659__cal_impl.Setupv2_P19 "" VALUE 0x0020B260 Scalar_FLOAT64_IEEE 0 speedgoat_test_SN5659_R2021b_IO133_CM_double -1.7E+308 1.7E+308 /end CHARACTERISTIC
/begin CHARACTERISTIC speedgoat_test_SN5659__cal_impl.Setupv2_P2 "" VALUE 0x0020B048 Scalar_FLOAT64_IEEE 0 speedgoat_test_SN5659_R2021b_IO133_CM_double -1.7E+308 1.7E+308 /end CHARACTERISTIC
/begin CHARACTERISTIC speedgoat_test_SN5659__cal_impl.Setupv2_P20 "" VAL_BLK 0x0020B278 Scalar_FLOAT64_IEEE 0 speedgoat_test_SN5659_R2021b_IO133_CM_double -1.7E+308 1.7E+308 MATRIX_DIM 2 1 /end CHARACTERISTIC
/begin CHARACTERISTIC speedgoat_test_SN5659__cal_impl.Setupv2_P21 "" VALUE 0x0020B298 Scalar_FLOAT64_IEEE 0 speedgoat_test_SN5659_R2021b_IO133_CM_double -1.7E+308 1.7E+308 /end CHARACTERISTIC
/begin CHARACTERISTIC speedgoat_test_SN5659__cal_impl.Setupv2_P22 "" VALUE 0x0020B2B0 Scalar_FLOAT64_IEEE 0 speedgoat_test_SN5659_R2021b_IO133_CM_double -1.7E+308 1.7E+308 /end CHARACTERISTIC
/begin CHARACTERISTIC speedgoat_test_SN5659__cal_impl.Setupv2_P23 "" VALUE 0x0020B2C8 Scalar_FLOAT64_IEEE 0 speedgoat_test_SN5659_R2021b_IO133_CM_double -1.7E+308 1.7E+308 /end CHARACTERISTIC
/begin CHARACTERISTIC speedgoat_test_SN5659__cal_impl.Setupv2_P24 "" VALUE 0x0020B2E0 Scalar_FLOAT64_IEEE 0 speedgoat_test_SN5659_R2021b_IO133_CM_double -1.7E+308 1.7E+308 /end CHARACTERISTIC
/begin CHARACTERISTIC speedgoat_test_SN5659__cal_impl.Setupv2_P25 "" VALUE 0x0020B2F8 Scalar_FLOAT64_IEEE 0 speedgoat_test_SN5659_R2021b_IO133_CM_double -1.7E+308 1.7E+308 /end CHARACTERISTIC
/begin CHARACTERISTIC speedgoat_test_SN5659__cal_impl.Setupv2_P26 "" VALUE 0x0020B310 Scalar_FLOAT64_IEEE 0 speedgoat_test_SN5659_R2021b_IO133_CM_double -1.7E+308 1.7E+308 /end CHARACTERISTIC
/begin CHARACTERISTIC speedgoat_test_SN5659__cal_impl.Setupv2_P27 "" VALUE 0x0020B328 Scalar_FLOAT64_IEEE 0 speedgoat_test_SN5659_R2021b_IO133_CM_double -1.7E+308 1.7E+308 /end CHARACTERISTIC
/begin CHARACTERISTIC speedgoat_test_SN5659__cal_impl.Setupv2_P28 "" VALUE 0x0020B340 Scalar_FLOAT64_IEEE 0 speedgoat_test_SN5659_R2021b_IO133_CM_double -1.7E+308 1.7E+308 /end CHARACTERISTIC
/begin CHARACTERISTIC speedgoat_test_SN5659__cal_impl.Setupv2_P29 "" VALUE 0x0020B358 Scalar_FLOAT64_IEEE 0 speedgoat_test_SN5659_R2021b_IO133_CM_double -1.7E+308 1.7E+308 /end CHARACTERISTIC
/begin CHARACTERISTIC speedgoat_test_SN5659__cal_impl.Setupv2_P3 "" VALUE 0x0020B060 Scalar_FLOAT64_IEEE 0 speedgoat_test_SN5659_R2021b_IO133_CM_double -1.7E+308 1.7E+308 /end CHARACTERISTIC
/begin CHARACTERISTIC speedgoat_test_SN5659__cal_impl.Setupv2_P30 "" VALUE 0x0020B370 Scalar_FLOAT64_IEEE 0 speedgoat_test_SN5659_R2021b_IO133_CM_double -1.7E+308 1.7E+308 /end CHARACTERISTIC
/begin CHARACTERISTIC speedgoat_test_SN5659__cal_impl.Setupv2_P31 "" VAL_BLK 0x0020B388 Scalar_FLOAT64_IEEE 0 speedgoat_test_SN5659_R2021b_IO133_CM_double -1.7E+308 1.7E+308 MATRIX_DIM 2 1 /end CHARACTERISTIC
/begin CHARACTERISTIC speedgoat_test_SN5659__cal_impl.Setupv2_P32 "" VAL_BLK 0x0020B3A8 Scalar_FLOAT64_IEEE 0 speedgoat_test_SN5659_R2021b_IO133_CM_double -1.7E+308 1.7E+308 MATRIX_DIM 2 1 /end CHARACTERISTIC
/begin CHARACTERISTIC speedgoat_test_SN5659__cal_impl.Setupv2_P33 "" VALUE 0x0020B3C8 Scalar_FLOAT64_IEEE 0 speedgoat_test_SN5659_R2021b_IO133_CM_double -1.7E+308 1.7E+308 /end CHARACTERISTIC
/begin CHARACTERISTIC speedgoat_test_SN5659__cal_impl.Setupv2_P34 "" VALUE 0x0020B3E0 Scalar_FLOAT64_IEEE 0 speedgoat_test_SN5659_R2021b_IO133_CM_double -1.7E+308 1.7E+308 /end CHARACTERISTIC
/begin CHARACTERISTIC speedgoat_test_SN5659__cal_impl.Setupv2_P35 "" VALUE 0x0020B3F8 Scalar_FLOAT64_IEEE 0 speedgoat_test_SN5659_R2021b_IO133_CM_double -1.7E+308 1.7E+308 /end CHARACTERISTIC
/begin CHARACTERISTIC speedgoat_test_SN5659__cal_impl.Setupv2_P4 "" VALUE 0x0020B078 Scalar_FLOAT64_IEEE 0 speedgoat_test_SN5659_R2021b_IO133_CM_double -1.7E+308 1.7E+308 /end CHARACTERISTIC
/begin CHARACTERISTIC speedgoat_test_SN5659__cal_impl.Setupv2_P5 "" VAL_BLK 0x0020B090 Scalar_FLOAT64_IEEE 0 speedgoat_test_SN5659_R2021b_IO133_CM_double -1.7E+308 1.7E+308 MATRIX_DIM 4 1 /end CHARACTERISTIC
/begin CHARACTERISTIC speedgoat_test_SN5659__cal_impl.Setupv2_P6 "" VAL_BLK 0x0020B0C0 Scalar_FLOAT64_IEEE 0 speedgoat_test_SN5659_R2021b_IO133_CM_double -1.7E+308 1.7E+308 MATRIX_DIM 2 1 /end CHARACTERISTIC
/begin CHARACTERISTIC speedgoat_test_SN5659__cal_impl.Setupv2_P7 "" VAL_BLK 0x0020B0E0 Scalar_FLOAT64_IEEE 0 speedgoat_test_SN5659_R2021b_IO133_CM_double -1.7E+308 1.7E+308 MATRIX_DIM 2 1 /end CHARACTERISTIC
/begin CHARACTERISTIC speedgoat_test_SN5659__cal_impl.Setupv2_P8 "" VALUE 0x0020B100 Scalar_FLOAT64_IEEE 0 speedgoat_test_SN5659_R2021b_IO133_CM_double -1.7E+308 1.7E+308 /end CHARACTERISTIC
/begin CHARACTERISTIC speedgoat_test_SN5659__cal_impl.Setupv2_P9 "" VALUE 0x0020B118 Scalar_FLOAT64_IEEE 0 speedgoat_test_SN5659_R2021b_IO133_CM_double -1.7E+308 1.7E+308 /end CHARACTERISTIC
/begin CHARACTERISTIC speedgoat_test_SN5659__cal_impl.SineWave_Amp "" VALUE 0x0020B538 Scalar_FLOAT64_IEEE 0 speedgoat_test_SN5659_R2021b_IO133_CM_double -1.7E+308 1.7E+308 /end CHARACTERISTIC
/begin CHARACTERISTIC speedgoat_test_SN5659__cal_impl.SineWave_Bias "" VALUE 0x0020B540 Scalar_FLOAT64_IEEE 0 speedgoat_test_SN5659_R2021b_IO133_CM_double -1.7E+308 1.7E+308 /end CHARACTERISTIC
/begin CHARACTERISTIC speedgoat_test_SN5659__cal_impl.SineWave_Freq "" VALUE 0x0020B548 Scalar_FLOAT64_IEEE 0 speedgoat_test_SN5659_R2021b_IO133_CM_double -1.7E+308 1.7E+308 /end CHARACTERISTIC
/begin CHARACTERISTIC speedgoat_test_SN5659__cal_impl.SineWave_Phase "" VALUE 0x0020B550 Scalar_FLOAT64_IEEE 0 speedgoat_test_SN5659_R2021b_IO133_CM_double -1.7E+308 1.7E+308 /end CHARACTERISTIC
/begin MEASUREMENT speedgoat_test_SN5659_R2021b_IO133_B.Gain "" FLOAT64_IEEE speedgoat_test_SN5659_R2021b_IO133_CM_double 0 0 -1.7E+308 1.7E+308 ECU_ADDRESS 0x0020E668 /end MEASUREMENT
/begin MEASUREMENT speedgoat_test_SN5659_R2021b_IO133_B.Gain1 "" FLOAT64_IEEE speedgoat_test_SN5659_R2021b_IO133_CM_double 0 0 -1.7E+308 1.7E+308 ECU_ADDRESS 0x0020E670 /end MEASUREMENT
/begin MEASUREMENT speedgoat_test_SN5659_R2021b_IO133_B.Gain2 "" FLOAT64_IEEE speedgoat_test_SN5659_R2021b_IO133_CM_double 0 0 -1.7E+308 1.7E+308 ECU_ADDRESS 0x0020E678 /end MEASUREMENT
/begin MEASUREMENT speedgoat_test_SN5659_R2021b_IO133_B.Gain3 "" FLOAT64_IEEE speedgoat_test_SN5659_R2021b_IO133_CM_double 0 0 -1.7E+308 1.7E+308 ECU_ADDRESS 0x0020E680 /end MEASUREMENT
/begin MEASUREMENT speedgoat_test_SN5659_R2021b_IO133_B.IO133_AI_CH1 "" FLOAT64_IEEE speedgoat_test_SN5659_R2021b_IO133_CM_double 0 0 -1.7E+308 1.7E+308 ECU_ADDRESS 0x0020E640 /end MEASUREMENT
/begin MEASUREMENT speedgoat_test_SN5659_R2021b_IO133_B.IO133_AI_CH2 "" FLOAT64_IEEE speedgoat_test_SN5659_R2021b_IO133_CM_double 0 0 -1.7E+308 1.7E+308 ECU_ADDRESS 0x0020E648 /end MEASUREMENT
/begin MEASUREMENT speedgoat_test_SN5659_R2021b_IO133_B.IO133_AI_CH3 "" FLOAT64_IEEE speedgoat_test_SN5659_R2021b_IO133_CM_double 0 0 -1.7E+308 1.7E+308 ECU_ADDRESS 0x0020E650 /end MEASUREMENT
/begin MEASUREMENT speedgoat_test_SN5659_R2021b_IO133_B.IO133_AI_CH4 "" FLOAT64_IEEE speedgoat_test_SN5659_R2021b_IO133_CM_double 0 0 -1.7E+308 1.7E+308 ECU_ADDRESS 0x0020E658 /end MEASUREMENT
/begin MEASUREMENT speedgoat_test_SN5659_R2021b_IO133_B.IO133_DI_CH8 "" FLOAT64_IEEE speedgoat_test_SN5659_R2021b_IO133_CM_double 0 0 -1.7E+308 1.7E+308 ECU_ADDRESS 0x0020E688 /end MEASUREMENT
/begin MEASUREMENT speedgoat_test_SN5659_R2021b_IO133_B.IO133_DI_CH9 "" FLOAT64_IEEE speedgoat_test_SN5659_R2021b_IO133_CM_double 0 0 -1.7E+308 1.7E+308 ECU_ADDRESS 0x0020E690 /end MEASUREMENT
/begin MEASUREMENT speedgoat_test_SN5659_R2021b_IO133_B.PulseGenerator "" FLOAT64_IEEE speedgoat_test_SN5659_R2021b_IO133_CM_double 0 0 -1.7E+308 1.7E+308 ECU_ADDRESS 0x0020E698 /end MEASUREMENT
/begin MEASUREMENT speedgoat_test_SN5659_R2021b_IO133_B.PulseGenerator1 "" FLOAT64_IEEE speedgoat_test_SN5659_R2021b_IO133_CM_double 0 0 -1.7E+308 1.7E+308 ECU_ADDRESS 0x0020E6A0 /end MEASUREMENT
/begin MEASUREMENT speedgoat_test_SN5659_R2021b_IO133_B.SineWave "" FLOAT64_IEEE speedgoat_test_SN5659_R2021b_IO133_CM_double 0 0 -1.7E+308 1.7E+308 ECU_ADDRESS 0x0020E660 /end MEASUREMENT
/begin MEASUREMENT speedgoat_test_SN5659_R2021b_IO133_DW.clockTickCounter "" SLONG speedgoat_test_SN5659_R2021b_IO133_CM_int32 0 0 -2147483648 2147483647 ECU_ADDRESS 0x0020E638 /end MEASUREMENT
/begin MEASUREMENT speedgoat_test_SN5659_R2021b_IO133_DW.clockTickCounter_c "" SLONG speedgoat_test_SN5659_R2021b_IO133_CM_int32 0 0 -2147483648 2147483647 ECU_ADDRESS 0x0020E63C /end MEASUREMENT
/begin COMPU_METHOD speedgoat_test_SN5659_R2021b_IO133_CM_double "" IDENTICAL "%15.10" "" /end COMPU_METHOD
/begin COMPU_METHOD speedgoat_test_SN5659_R2021b_IO133_CM_int32 "" IDENTICAL "%10.0" "" /end COMPU_METHOD
/begin RECORD_LAYOUT Scalar_FLOAT64_IEEE FNC_VALUES 1 FLOAT64_IEEE COLUMN_DIR DIRECT /end RECORD_LAYOUT
/begin RECORD_LAYOUT Scalar_SLONG FNC_VALUES 1 SLONG COLUMN_DIR DIRECT /end RECORD_LAYOUT
/begin GROUP speedgoat_test_SN5659_R2021b_IO133 "speedgoat_test_SN5659_R2021b_IO133" ROOT /begin SUB_GROUP speedgoat_test_SN5659_R2021b_IO133_IO133 /end SUB_GROUP /end GROUP
/begin GROUP speedgoat_test_SN5659_R2021b_IO133_IO133 "speedgoat_test_SN5659_R2021b_IO133/IO133"
 /begin REF_CHARACTERISTIC speedgoat_test_SN5659__cal_impl.Analoginputv2_P1 speedgoat_test_SN5659__cal_impl.Analoginputv2_P10 speedgoat_test_SN5659__cal_impl.Analoginputv2_P11 speedgoat_test_SN5659__cal_impl.Analoginputv2_P2 speedgoat_test_SN5659__cal_impl.Analoginputv2_P3 speedgoat_test_SN5659__cal_impl.Analoginputv2_P4 speedgoat_test_SN5659__cal_impl.Analoginputv2_P5 speedgoat_test_SN5659__cal_impl.Analoginputv2_P6 speedgoat_test_SN5659__cal_impl.Analoginputv2_P7 speedgoat_test_SN5659__cal_impl.Analoginputv2_P8 speedgoat_test_SN5659__cal_impl.Analoginputv2_P9 speedgoat_test_SN5659__cal_impl.Analogoutputv2_P1 speedgoat_test_SN5659__cal_impl.Analogoutputv2_P10 speedgoat_test_SN5659__cal_impl.Analogoutputv2_P11 speedgoat_test_SN5659__cal_impl.Analogoutputv2_P12 speedgoat_test_SN5659__cal_impl.Analogoutputv2_P13 speedgoat_test_SN5659__cal_impl.Analogoutputv2_P2 speedgoat_test_SN5659__cal_impl.Analogoutputv2_P3 speedgoat_test_SN5659__cal_impl.Analogoutputv2_P4 speedgoat_test_SN5659__cal_impl.Analogoutputv2_P5 speedgoat_test_SN5659__cal_impl.Analogoutputv2_P6 speedgoat_test_SN5659__cal_impl.Analogoutputv2_P7 speedgoat_test_SN5659__cal_impl.Analogoutputv2_P8 speedgoat_test_SN5659__cal_impl.Analogoutputv2_P9 speedgoat_test_SN5659__cal_impl.Digitalinputv2_P1 speedgoat_test_SN5659__cal_impl.Digitalinputv2_P2 speedgoat_test_SN5659__cal_impl.Digitalinputv2_P3 speedgoat_test_SN5659__cal_impl.Digitalinputv2_P4 speedgoat_test_SN5659__cal_impl.Digitalinputv2_P5 speedgoat_test_SN5659__cal_impl.Digitaloutputv2_P1 speedgoat_test_SN5659__cal_impl.Digitaloutputv2_P2 speedgoat_test_SN5659__cal_impl.Digitaloutputv2_P3 speedgoat_test_SN5659__cal_impl.Digitaloutputv2_P4 speedgoat_test_SN5659__cal_impl.Digitaloutputv2_P5 speedgoat_test_SN5659__cal_impl.Digitaloutputv2_P6 speedgoat_test_SN5659__cal_impl.Digitaloutputv2_P7 speedgoat_test_SN5659__cal_impl.Gain1_Gain speedgoat_test_SN5659__cal_impl.Gain2_Gain speedgoat_test_SN5659__cal_impl.Gain3_Gain speedgoat_test_SN5659__cal_impl.Gain_Gain speedgoat_test_SN5659__cal_impl.PulseGenerator1_Amp speedgoat_test_SN5659__cal_impl.PulseGenerator1_Duty speedgoat_test_SN5659__cal_impl.PulseGenerator1_Period speedgoat_test_SN5659__cal_impl.PulseGenerator1_PhaseDelay speedgoat_test_SN5659__cal_impl.PulseGenerator_Amp speedgoat_test_SN5659__cal_impl.PulseGenerator_Duty speedgoat_test_SN5659__cal_impl.PulseGenerator_Period speedgoat_test_SN5659__cal_impl.PulseGenerator_PhaseDelay speedgoat_test_SN5659__cal_impl.Setupv2_P1 speedgoat_test_SN5659__cal_impl.Setupv2_P10 speedgoat_test_SN5659__cal_impl.Setupv2_P11 speedgoat_test_SN5659__cal_impl.Setupv2_P12 speedgoat_test_SN5659__cal_impl.Setupv2_P13 speedgoat_test_SN5659__cal_impl.Setupv2_P14 speedgoat_test_SN5659__cal_impl.Setupv2_P15 speedgoat_test_SN5659__cal_impl.Setupv2_P16 speedgoat_test_SN5659__cal_impl.Setupv2_P17 speedgoat_test_SN5659__cal_impl.Setupv2_P18 speedgoat_test_SN5659__cal_impl.Setupv2_P19 speedgoat_test_SN5659__cal_impl.Setupv2_P2 speedgoat_test_SN5659__cal_impl.Setupv2_P20 speedgoat_test_SN5659__cal_impl.Setupv2_P21 speedgoat_test_SN5659__cal_impl.Setupv2_P22 speedgoat_test_SN5659__cal_impl.Setupv2_P23 speedgoat_test_SN5659__cal_impl.Setupv2_P24 speedgoat_test_SN5659__cal_impl.Setupv2_P25 speedgoat_test_SN5659__cal_impl.Setupv2_P26 speedgoat_test_SN5659__cal_impl.Setupv2_P27 speedgoat_test_SN5659__cal_impl.Setupv2_P28 speedgoat_test_SN5659__cal_impl.Setupv2_P29 speedgoat_test_SN5659__cal_impl.Setupv2_P3 speedgoat_test_SN5659__cal_impl.Setupv2_P30 speedgoat_test_SN5659__cal_impl.Setupv2_P31 speedgoat_test_SN5659__cal_impl.Setupv2_P32 speedgoat_test_SN5659__cal_impl.Setupv2_P33 speedgoat_test_SN5659__cal_impl.Setupv2_P34 speedgoat_test_SN5659__cal_impl.Setupv2_P35 speedgoat_test_SN5659__cal_impl.Setupv2_P4 speedgoat_test_SN5659__cal_impl.Setupv2_P5 speedgoat_test_SN5659__cal_impl.Setupv2_P6 speedgoat_test_SN5659__cal_impl.Setupv2_P7 speedgoat_test_SN5659__cal_impl.Setupv2_P8 speedgoat_test_SN5659__cal_impl.Setupv2_P9 speedgoat_test_SN5659__cal_impl.SineWave_Amp speedgoat_test_SN5659__cal_impl.SineWave_Bias speedgoat_test_SN5659__cal_impl.SineWave_Freq speedgoat_test_SN5659__cal_impl.SineWave_Phase /end REF_CHARACTERISTIC
 /begin REF_MEASUREMENT speedgoat_test_SN5659_R2021b_IO133_B.Gain speedgoat_test_SN5659_R2021b_IO133_B.Gain1 speedgoat_test_SN5659_R2021b_IO133_B.Gain2 speedgoat_test_SN5659_R2021b_IO133_B.Gain3 speedgoat_test_SN5659_R2021b_IO133_B.IO133_AI_CH1 speedgoat_test_SN5659_R2021b_IO133_B.IO133_AI_CH2 speedgoat_test_SN5659_R2021b_IO133_B.IO133_AI_CH3 speedgoat_test_SN5659_R2021b_IO133_B.IO133_AI_CH4 speedgoat_test_SN5659_R2021b_IO133_B.IO133_DI_CH8 speedgoat_test_SN5659_R2021b_IO133_B.IO133_DI_CH9 speedgoat_test_SN5659_R2021b_IO133_B.PulseGenerator speedgoat_test_SN5659_R2021b_IO133_B.PulseGenerator1 speedgoat_test_SN5659_R2021b_IO133_B.SineWave speedgoat_test_SN5659_R2021b_IO133_DW.Analoginputv2_PWORK speedgoat_test_SN5659_R2021b_IO133_DW.Analogoutputv2_PWORK speedgoat_test_SN5659_R2021b_IO133_DW.Digitalinputv2_PWORK speedgoat_test_SN5659_R2021b_IO133_DW.Digitaloutputv2_PWORK speedgoat_test_SN5659_R2021b_IO133_DW.Scope2_PWORK speedgoat_test_SN5659_R2021b_IO133_DW.Scope4_PWORK speedgoat_test_SN5659_R2021b_IO133_DW.clockTickCounter speedgoat_test_SN5659_R2021b_IO133_DW.clockTickCounter_c /end REF_MEASUREMENT
/end GROUP
/end MODULE
/end PROJECT
