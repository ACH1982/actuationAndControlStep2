/******************************************************************************
* ASAP2 file: speedgoat_test_SN5659_R2021b_IO421.a2l
* Code generation for model "speedgoat_test_SN5659_R2021b_IO421".
* Model version : 3.1
* Simulink Coder version : 10.4 R2021b
* C source code generated on : Fri Apr 08 14:49:26 2022
* Target selection: slrealtime.tlc
* Embedded hardware selection: Intel->x86-64 (Linux 64)
* Code generation objectives: Unspecified
* Validation result: Not run
* (add additional file header information here)
******************************************************************************/ ASAP2_VERSION 1 71
/begin PROJECT ProjectName "Project Comment Goes Here"
/begin HEADER "Header Comments go here" /end HEADER
/begin MODULE ModuleName "Module Comment Goes Here"
/begin IF_DATA XCP
 /begin PROTOCOL_LAYER 0x0100 0x03E8 0x00C8 0x0000 0x0000 0x0000 0x0000 0x0000 0xFC 0x0578 BYTE_ORDER_MSB_LAST ADDRESS_GRANULARITY_BYTE OPTIONAL_CMD ALLOC_ODT_ENTRY OPTIONAL_CMD ALLOC_ODT OPTIONAL_CMD ALLOC_DAQ OPTIONAL_CMD FREE_DAQ OPTIONAL_CMD GET_DAQ_RESOLUTION_INFO OPTIONAL_CMD GET_DAQ_PROCESSOR_INFO OPTIONAL_CMD START_STOP_SYNCH OPTIONAL_CMD START_STOP_DAQ_LIST OPTIONAL_CMD SET_DAQ_LIST_MODE OPTIONAL_CMD WRITE_DAQ OPTIONAL_CMD SET_DAQ_PTR OPTIONAL_CMD GET_CAL_PAGE OPTIONAL_CMD SET_CAL_PAGE OPTIONAL_CMD COPY_CAL_PAGE OPTIONAL_CMD SHORT_DOWNLOAD OPTIONAL_CMD DOWNLOAD_MAX OPTIONAL_CMD DOWNLOAD OPTIONAL_CMD SHORT_UPLOAD OPTIONAL_CMD UPLOAD OPTIONAL_CMD SET_MTA /end PROTOCOL_LAYER
 /begin DAQ DYNAMIC 0x0000 0x0080 0x00 OPTIMISATION_TYPE_DEFAULT ADDRESS_EXTENSION_FREE IDENTIFICATION_FIELD_TYPE_RELATIVE_WORD_ALIGNED GRANULARITY_ODT_ENTRY_SIZE_DAQ_BYTE 0xFF OVERLOAD_INDICATION_PID PRESCALER_SUPPORTED /begin STIM GRANULARITY_ODT_ENTRY_SIZE_STIM_BYTE 0xFF /end STIM /begin TIMESTAMP_SUPPORTED 0x0001 SIZE_DWORD UNIT_1US TIMESTAMP_FIXED /end TIMESTAMP_SUPPORTED /begin EVENT "1 ms" "1 ms" 0x0000 DAQ 0xFF 0x01 0x06 0x00 /end EVENT /end DAQ
 /begin XCP_ON_UDP_IP 0x0100 0x15B3 ADDRESS "192.168.7.2" /end XCP_ON_UDP_IP
/end IF_DATA
/begin MOD_PAR "MOD PAR Comment Goes Here"
 /begin MEMORY_SEGMENT speedgoat_test_SN5659__cal_impl "speedgoat_test_SN5659__cal_impl" DATA FLASH INTERN 0x00206020 0x1F8 -1 -1 -1 -1 -1
  /begin IF_DATA XCP
   /begin SEGMENT 0x00 0x02 0x00 0x00 0x00
    /begin PAGE 0x00 ECU_ACCESS_DONT_CARE XCP_READ_ACCESS_DONT_CARE XCP_WRITE_ACCESS_NOT_ALLOWED /end PAGE
    /begin PAGE 0x01 ECU_ACCESS_DONT_CARE XCP_READ_ACCESS_DONT_CARE XCP_WRITE_ACCESS_DONT_CARE /end PAGE
   /end SEGMENT
  /end IF_DATA
 /end MEMORY_SEGMENT
/end MOD_PAR
/begin MOD_COMMON "Mod Common Comment Here" BYTE_ORDER MSB_LAST ALIGNMENT_BYTE 1 ALIGNMENT_WORD 2 ALIGNMENT_LONG 4 ALIGNMENT_FLOAT32_IEEE 4 ALIGNMENT_FLOAT64_IEEE 8 ALIGNMENT_INT64 8 /end MOD_COMMON
/begin CHARACTERISTIC speedgoat_test_SN5659__cal_impl.LVDTread1_P1 "" VALUE 0x002060F0 Scalar_FLOAT64_IEEE 0 speedgoat_test_SN5659_R2021b_IO421_CM_double -1.7E+308 1.7E+308 /end CHARACTERISTIC
/begin CHARACTERISTIC speedgoat_test_SN5659__cal_impl.LVDTread1_P2 "" VALUE 0x00206108 Scalar_FLOAT64_IEEE 0 speedgoat_test_SN5659_R2021b_IO421_CM_double -1.7E+308 1.7E+308 /end CHARACTERISTIC
/begin CHARACTERISTIC speedgoat_test_SN5659__cal_impl.LVDTread1_P3 "" VALUE 0x00206120 Scalar_FLOAT64_IEEE 0 speedgoat_test_SN5659_R2021b_IO421_CM_double -1.7E+308 1.7E+308 /end CHARACTERISTIC
/begin CHARACTERISTIC speedgoat_test_SN5659__cal_impl.LVDTread1_P4 "" VALUE 0x00206138 Scalar_FLOAT64_IEEE 0 speedgoat_test_SN5659_R2021b_IO421_CM_double -1.7E+308 1.7E+308 /end CHARACTERISTIC
/begin CHARACTERISTIC speedgoat_test_SN5659__cal_impl.LVDTread1_P5 "" VALUE 0x00206150 Scalar_FLOAT64_IEEE 0 speedgoat_test_SN5659_R2021b_IO421_CM_double -1.7E+308 1.7E+308 /end CHARACTERISTIC
/begin CHARACTERISTIC speedgoat_test_SN5659__cal_impl.LVDTread1_P6 "" VALUE 0x00206168 Scalar_FLOAT64_IEEE 0 speedgoat_test_SN5659_R2021b_IO421_CM_double -1.7E+308 1.7E+308 /end CHARACTERISTIC
/begin CHARACTERISTIC speedgoat_test_SN5659__cal_impl.LVDTread1_P7 "" VALUE 0x00206180 Scalar_FLOAT64_IEEE 0 speedgoat_test_SN5659_R2021b_IO421_CM_double -1.7E+308 1.7E+308 /end CHARACTERISTIC
/begin CHARACTERISTIC speedgoat_test_SN5659__cal_impl.LVDTread1_P8 "" VALUE 0x00206198 Scalar_FLOAT64_IEEE 0 speedgoat_test_SN5659_R2021b_IO421_CM_double -1.7E+308 1.7E+308 /end CHARACTERISTIC
/begin CHARACTERISTIC speedgoat_test_SN5659__cal_impl.LVDTread_P1 "" VALUE 0x00206030 Scalar_FLOAT64_IEEE 0 speedgoat_test_SN5659_R2021b_IO421_CM_double -1.7E+308 1.7E+308 /end CHARACTERISTIC
/begin CHARACTERISTIC speedgoat_test_SN5659__cal_impl.LVDTread_P2 "" VALUE 0x00206048 Scalar_FLOAT64_IEEE 0 speedgoat_test_SN5659_R2021b_IO421_CM_double -1.7E+308 1.7E+308 /end CHARACTERISTIC
/begin CHARACTERISTIC speedgoat_test_SN5659__cal_impl.LVDTread_P3 "" VALUE 0x00206060 Scalar_FLOAT64_IEEE 0 speedgoat_test_SN5659_R2021b_IO421_CM_double -1.7E+308 1.7E+308 /end CHARACTERISTIC
/begin CHARACTERISTIC speedgoat_test_SN5659__cal_impl.LVDTread_P4 "" VALUE 0x00206078 Scalar_FLOAT64_IEEE 0 speedgoat_test_SN5659_R2021b_IO421_CM_double -1.7E+308 1.7E+308 /end CHARACTERISTIC
/begin CHARACTERISTIC speedgoat_test_SN5659__cal_impl.LVDTread_P5 "" VALUE 0x00206090 Scalar_FLOAT64_IEEE 0 speedgoat_test_SN5659_R2021b_IO421_CM_double -1.7E+308 1.7E+308 /end CHARACTERISTIC
/begin CHARACTERISTIC speedgoat_test_SN5659__cal_impl.LVDTread_P6 "" VALUE 0x002060A8 Scalar_FLOAT64_IEEE 0 speedgoat_test_SN5659_R2021b_IO421_CM_double -1.7E+308 1.7E+308 /end CHARACTERISTIC
/begin CHARACTERISTIC speedgoat_test_SN5659__cal_impl.LVDTread_P7 "" VALUE 0x002060C0 Scalar_FLOAT64_IEEE 0 speedgoat_test_SN5659_R2021b_IO421_CM_double -1.7E+308 1.7E+308 /end CHARACTERISTIC
/begin CHARACTERISTIC speedgoat_test_SN5659__cal_impl.LVDTread_P8 "" VALUE 0x002060D8 Scalar_FLOAT64_IEEE 0 speedgoat_test_SN5659_R2021b_IO421_CM_double -1.7E+308 1.7E+308 /end CHARACTERISTIC
/begin CHARACTERISTIC speedgoat_test_SN5659__cal_impl.REF_P1 "" VALUE 0x002061B0 Scalar_FLOAT64_IEEE 0 speedgoat_test_SN5659_R2021b_IO421_CM_double -1.7E+308 1.7E+308 /end CHARACTERISTIC
/begin CHARACTERISTIC speedgoat_test_SN5659__cal_impl.REF_P2 "" VALUE 0x002061C8 Scalar_FLOAT64_IEEE 0 speedgoat_test_SN5659_R2021b_IO421_CM_double -1.7E+308 1.7E+308 /end CHARACTERISTIC
/begin CHARACTERISTIC speedgoat_test_SN5659__cal_impl.REF_P3 "" VALUE 0x002061E0 Scalar_FLOAT64_IEEE 0 speedgoat_test_SN5659_R2021b_IO421_CM_double -1.7E+308 1.7E+308 /end CHARACTERISTIC
/begin CHARACTERISTIC speedgoat_test_SN5659__cal_impl.REF_P4 "" VALUE 0x002061F8 Scalar_FLOAT64_IEEE 0 speedgoat_test_SN5659_R2021b_IO421_CM_double -1.7E+308 1.7E+308 /end CHARACTERISTIC
/begin CHARACTERISTIC speedgoat_test_SN5659__cal_impl.REF_P5 "" VALUE 0x00206210 Scalar_FLOAT64_IEEE 0 speedgoat_test_SN5659_R2021b_IO421_CM_double -1.7E+308 1.7E+308 /end CHARACTERISTIC
/begin MEASUREMENT speedgoat_test_SN5659_R2021b_IO421_B.IO421_LVDT_POS1 "" FLOAT64_IEEE speedgoat_test_SN5659_R2021b_IO421_CM_double 0 0 -1.7E+308 1.7E+308 ECU_ADDRESS 0x00207EC0 /end MEASUREMENT
/begin MEASUREMENT speedgoat_test_SN5659_R2021b_IO421_B.IO421_LVDT_POS2 "" FLOAT64_IEEE speedgoat_test_SN5659_R2021b_IO421_CM_double 0 0 -1.7E+308 1.7E+308 ECU_ADDRESS 0x00207EC8 /end MEASUREMENT
/begin COMPU_METHOD speedgoat_test_SN5659_R2021b_IO421_CM_double "" IDENTICAL "%15.10" "" /end COMPU_METHOD
/begin RECORD_LAYOUT Scalar_FLOAT64_IEEE FNC_VALUES 1 FLOAT64_IEEE COLUMN_DIR DIRECT /end RECORD_LAYOUT
/begin GROUP speedgoat_test_SN5659_R2021b_IO421 "speedgoat_test_SN5659_R2021b_IO421" ROOT /begin SUB_GROUP speedgoat_test_SN5659_R2021b_IO421_IO421_1 /end SUB_GROUP /end GROUP
/begin GROUP speedgoat_test_SN5659_R2021b_IO421_IO421_1 "speedgoat_test_SN5659_R2021b_IO421/IO421-1"
 /begin REF_CHARACTERISTIC speedgoat_test_SN5659__cal_impl.LVDTread1_P1 speedgoat_test_SN5659__cal_impl.LVDTread1_P2 speedgoat_test_SN5659__cal_impl.LVDTread1_P3 speedgoat_test_SN5659__cal_impl.LVDTread1_P4 speedgoat_test_SN5659__cal_impl.LVDTread1_P5 speedgoat_test_SN5659__cal_impl.LVDTread1_P6 speedgoat_test_SN5659__cal_impl.LVDTread1_P7 speedgoat_test_SN5659__cal_impl.LVDTread1_P8 speedgoat_test_SN5659__cal_impl.LVDTread_P1 speedgoat_test_SN5659__cal_impl.LVDTread_P2 speedgoat_test_SN5659__cal_impl.LVDTread_P3 speedgoat_test_SN5659__cal_impl.LVDTread_P4 speedgoat_test_SN5659__cal_impl.LVDTread_P5 speedgoat_test_SN5659__cal_impl.LVDTread_P6 speedgoat_test_SN5659__cal_impl.LVDTread_P7 speedgoat_test_SN5659__cal_impl.LVDTread_P8 speedgoat_test_SN5659__cal_impl.REF_P1 speedgoat_test_SN5659__cal_impl.REF_P2 speedgoat_test_SN5659__cal_impl.REF_P3 speedgoat_test_SN5659__cal_impl.REF_P4 speedgoat_test_SN5659__cal_impl.REF_P5 /end REF_CHARACTERISTIC
 /begin REF_MEASUREMENT speedgoat_test_SN5659_R2021b_IO421_B.IO421_LVDT_POS1 speedgoat_test_SN5659_R2021b_IO421_B.IO421_LVDT_POS2 speedgoat_test_SN5659_R2021b_IO421_DW.LVDTread1_PWORK speedgoat_test_SN5659_R2021b_IO421_DW.LVDTread_PWORK speedgoat_test_SN5659_R2021b_IO421_DW.REF_PWORK speedgoat_test_SN5659_R2021b_IO421_DW.Scope1_PWORK speedgoat_test_SN5659_R2021b_IO421_DW.Scope_PWORK /end REF_MEASUREMENT
/end GROUP
/end MODULE
/end PROJECT
