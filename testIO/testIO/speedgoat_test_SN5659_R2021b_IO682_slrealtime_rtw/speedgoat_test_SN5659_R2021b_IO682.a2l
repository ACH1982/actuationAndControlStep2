ASAP2_VERSION 1 71
/begin PROJECT ProjectName "Project Comment Goes Here"
/begin HEADER "Header Comments go here" /end HEADER
/begin MODULE ModuleName "Module Comment Goes Here"
/begin MOD_COMMON "Mod Common Comment Here" BYTE_ORDER MSB_LAST ALIGNMENT_BYTE 1 ALIGNMENT_WORD 2 ALIGNMENT_LONG 4 ALIGNMENT_FLOAT32_IEEE 4 ALIGNMENT_FLOAT64_IEEE 8 ALIGNMENT_INT64 8 /end MOD_COMMON
/begin CHARACTERISTIC speedgoat_test_SN5659__cal_impl.Constant_Value_a "" VALUE 0x00840706 Scalar_UWORD 0 speedgoat_test_SN5659_R2021b_IO682_CM_uint16 0 65535 /end CHARACTERISTIC
/begin CHARACTERISTIC speedgoat_test_SN5659__cal_impl.Constant_Value_aq "" VALUE 0x00840712 Scalar_UWORD 0 speedgoat_test_SN5659_R2021b_IO682_CM_uint16 0 65535 /end CHARACTERISTIC
/begin CHARACTERISTIC speedgoat_test_SN5659__cal_impl.Constant_Value_av "" VALUE 0x00840746 Scalar_UBYTE 0 speedgoat_test_SN5659_R2021b_IO682_CM_uint8 0 255 /end CHARACTERISTIC
/begin CHARACTERISTIC speedgoat_test_SN5659__cal_impl.Constant_Value_b "" VALUE 0x0083D750 Scalar_FLOAT64_IEEE 0 speedgoat_test_SN5659_R2021b_IO682_CM_double -1.7E+308 1.7E+308 /end CHARACTERISTIC
/begin CHARACTERISTIC speedgoat_test_SN5659__cal_impl.Constant_Value_d "" VALUE 0x0083BD90 Scalar_FLOAT64_IEEE 0 speedgoat_test_SN5659_R2021b_IO682_CM_double -1.7E+308 1.7E+308 /end CHARACTERISTIC
/begin CHARACTERISTIC speedgoat_test_SN5659__cal_impl.Constant_Value_dm "" VALUE 0x008406FA Scalar_UWORD 0 speedgoat_test_SN5659_R2021b_IO682_CM_uint16 0 65535 /end CHARACTERISTIC
/begin CHARACTERISTIC speedgoat_test_SN5659__cal_impl.Constant_Value_e "" VALUE 0x0083B720 Scalar_FLOAT64_IEEE 0 speedgoat_test_SN5659_R2021b_IO682_CM_double -1.7E+308 1.7E+308 /end CHARACTERISTIC
/begin CHARACTERISTIC speedgoat_test_SN5659__cal_impl.Constant_Value_ee "" VALUE 0x00840749 Scalar_UBYTE 0 speedgoat_test_SN5659_R2021b_IO682_CM_uint8 0 255 /end CHARACTERISTIC
/begin CHARACTERISTIC speedgoat_test_SN5659__cal_impl.Constant_Value_g "" VALUE 0x0083C400 Scalar_FLOAT64_IEEE 0 speedgoat_test_SN5659_R2021b_IO682_CM_double -1.7E+308 1.7E+308 /end CHARACTERISTIC
/begin CHARACTERISTIC speedgoat_test_SN5659__cal_impl.Constant_Value_i "" VALUE 0x0083B0B0 Scalar_FLOAT64_IEEE 0 speedgoat_test_SN5659_R2021b_IO682_CM_double -1.7E+308 1.7E+308 /end CHARACTERISTIC
/begin CHARACTERISTIC speedgoat_test_SN5659__cal_impl.Constant_Value_k "" VALUE 0x0084070C Scalar_UWORD 0 speedgoat_test_SN5659_R2021b_IO682_CM_uint16 0 65535 /end CHARACTERISTIC
/begin CHARACTERISTIC speedgoat_test_SN5659__cal_impl.Constant_Value_l "" VALUE 0x0083CA70 Scalar_FLOAT64_IEEE 0 speedgoat_test_SN5659_R2021b_IO682_CM_double -1.7E+308 1.7E+308 /end CHARACTERISTIC
/begin CHARACTERISTIC speedgoat_test_SN5659__cal_impl.Constant_Value_n "" VALUE 0x00840700 Scalar_UWORD 0 speedgoat_test_SN5659_R2021b_IO682_CM_uint16 0 65535 /end CHARACTERISTIC
/begin CHARACTERISTIC speedgoat_test_SN5659__cal_impl.Constant_Value_o "" VALUE 0x0083D0E0 Scalar_FLOAT64_IEEE 0 speedgoat_test_SN5659_R2021b_IO682_CM_double -1.7E+308 1.7E+308 /end CHARACTERISTIC
/begin CHARACTERISTIC speedgoat_test_SN5659__cal_impl.Constant_Value_p "" VALUE 0x00840718 Scalar_UWORD 0 speedgoat_test_SN5659_R2021b_IO682_CM_uint16 0 65535 /end CHARACTERISTIC
/begin CHARACTERISTIC speedgoat_test_SN5659__cal_impl.CounterLimited_uplimit_be "" VALUE 0x0083307D Scalar_UBYTE 0 speedgoat_test_SN5659_R2021b_IO682_CM_uint8 0 255 /end CHARACTERISTIC
/begin CHARACTERISTIC speedgoat_test_SN5659__cal_impl.CounterLimited_uplimit_c "" VALUE 0x00833066 Scalar_UWORD 0 speedgoat_test_SN5659_R2021b_IO682_CM_uint16 0 65535 /end CHARACTERISTIC
/begin CHARACTERISTIC speedgoat_test_SN5659__cal_impl.CounterLimited_uplimit_cp "" VALUE 0x0083306A Scalar_UWORD 0 speedgoat_test_SN5659_R2021b_IO682_CM_uint16 0 65535 /end CHARACTERISTIC
/begin CHARACTERISTIC speedgoat_test_SN5659__cal_impl.CounterLimited_uplimit_d "" VALUE 0x00833062 Scalar_UWORD 0 speedgoat_test_SN5659_R2021b_IO682_CM_uint16 0 65535 /end CHARACTERISTIC
/begin CHARACTERISTIC speedgoat_test_SN5659__cal_impl.CounterLimited_uplimit_g "" VALUE 0x0083306C Scalar_UWORD 0 speedgoat_test_SN5659_R2021b_IO682_CM_uint16 0 65535 /end CHARACTERISTIC
/begin CHARACTERISTIC speedgoat_test_SN5659__cal_impl.CounterLimited_uplimit_i "" VALUE 0x0083307C Scalar_UBYTE 0 speedgoat_test_SN5659_R2021b_IO682_CM_uint8 0 255 /end CHARACTERISTIC
/begin CHARACTERISTIC speedgoat_test_SN5659__cal_impl.CounterLimited_uplimit_k "" VALUE 0x00833064 Scalar_UWORD 0 speedgoat_test_SN5659_R2021b_IO682_CM_uint16 0 65535 /end CHARACTERISTIC
/begin CHARACTERISTIC speedgoat_test_SN5659__cal_impl.CounterLimited_uplimit_n "" VALUE 0x00833068 Scalar_UWORD 0 speedgoat_test_SN5659_R2021b_IO682_CM_uint16 0 65535 /end CHARACTERISTIC
/begin CHARACTERISTIC speedgoat_test_SN5659__cal_impl.Encode1_P10_e "" VALUE 0x0083CD40 Scalar_FLOAT64_IEEE 0 speedgoat_test_SN5659_R2021b_IO682_CM_double -1.7E+308 1.7E+308 /end CHARACTERISTIC
/begin CHARACTERISTIC speedgoat_test_SN5659__cal_impl.Encode1_P10_f "" VALUE 0x0083D3B0 Scalar_FLOAT64_IEEE 0 speedgoat_test_SN5659_R2021b_IO682_CM_double -1.7E+308 1.7E+308 /end CHARACTERISTIC
/begin CHARACTERISTIC speedgoat_test_SN5659__cal_impl.Encode1_P10_i "" VALUE 0x0083AD10 Scalar_FLOAT64_IEEE 0 speedgoat_test_SN5659_R2021b_IO682_CM_double -1.7E+308 1.7E+308 /end CHARACTERISTIC
/begin CHARACTERISTIC speedgoat_test_SN5659__cal_impl.Encode1_P10_k "" VALUE 0x0083C6D0 Scalar_FLOAT64_IEEE 0 speedgoat_test_SN5659_R2021b_IO682_CM_double -1.7E+308 1.7E+308 /end CHARACTERISTIC
/begin CHARACTERISTIC speedgoat_test_SN5659__cal_impl.Encode1_P10_l "" VALUE 0x0083B9F0 Scalar_FLOAT64_IEEE 0 speedgoat_test_SN5659_R2021b_IO682_CM_double -1.7E+308 1.7E+308 /end CHARACTERISTIC
/begin CHARACTERISTIC speedgoat_test_SN5659__cal_impl.Encode1_P10_p "" VALUE 0x0083B380 Scalar_FLOAT64_IEEE 0 speedgoat_test_SN5659_R2021b_IO682_CM_double -1.7E+308 1.7E+308 /end CHARACTERISTIC
/begin CHARACTERISTIC speedgoat_test_SN5659__cal_impl.Encode1_P10_pc "" VALUE 0x0083C060 Scalar_FLOAT64_IEEE 0 speedgoat_test_SN5659_R2021b_IO682_CM_double -1.7E+308 1.7E+308 /end CHARACTERISTIC
/begin CHARACTERISTIC speedgoat_test_SN5659__cal_impl.Encode1_P11_a "" VAL_BLK 0x0083C078 Scalar_FLOAT64_IEEE 0 speedgoat_test_SN5659_R2021b_IO682_CM_double -1.7E+308 1.7E+308 MATRIX_DIM 2 1 /end CHARACTERISTIC
/begin CHARACTERISTIC speedgoat_test_SN5659__cal_impl.Encode1_P11_b "" VAL_BLK 0x0083B398 Scalar_FLOAT64_IEEE 0 speedgoat_test_SN5659_R2021b_IO682_CM_double -1.7E+308 1.7E+308 MATRIX_DIM 2 1 /end CHARACTERISTIC
/begin CHARACTERISTIC speedgoat_test_SN5659__cal_impl.Encode1_P11_bk "" VAL_BLK 0x0083BA08 Scalar_FLOAT64_IEEE 0 speedgoat_test_SN5659_R2021b_IO682_CM_double -1.7E+308 1.7E+308 MATRIX_DIM 2 1 /end CHARACTERISTIC
/begin CHARACTERISTIC speedgoat_test_SN5659__cal_impl.Encode1_P11_e "" VAL_BLK 0x0083D3C8 Scalar_FLOAT64_IEEE 0 speedgoat_test_SN5659_R2021b_IO682_CM_double -1.7E+308 1.7E+308 MATRIX_DIM 2 1 /end CHARACTERISTIC
/begin CHARACTERISTIC speedgoat_test_SN5659__cal_impl.Encode1_P11_l "" VAL_BLK 0x0083AD28 Scalar_FLOAT64_IEEE 0 speedgoat_test_SN5659_R2021b_IO682_CM_double -1.7E+308 1.7E+308 MATRIX_DIM 2 1 /end CHARACTERISTIC
/begin CHARACTERISTIC speedgoat_test_SN5659__cal_impl.Encode1_P11_n "" VAL_BLK 0x0083C6E8 Scalar_FLOAT64_IEEE 0 speedgoat_test_SN5659_R2021b_IO682_CM_double -1.7E+308 1.7E+308 MATRIX_DIM 2 1 /end CHARACTERISTIC
/begin CHARACTERISTIC speedgoat_test_SN5659__cal_impl.Encode1_P11_o "" VAL_BLK 0x0083CD58 Scalar_FLOAT64_IEEE 0 speedgoat_test_SN5659_R2021b_IO682_CM_double -1.7E+308 1.7E+308 MATRIX_DIM 2 1 /end CHARACTERISTIC
/begin CHARACTERISTIC speedgoat_test_SN5659__cal_impl.Encode1_P12_g "" VALUE 0x0083D3E8 Scalar_FLOAT64_IEEE 0 speedgoat_test_SN5659_R2021b_IO682_CM_double -1.7E+308 1.7E+308 /end CHARACTERISTIC
/begin CHARACTERISTIC speedgoat_test_SN5659__cal_impl.Encode1_P12_h "" VALUE 0x0083C098 Scalar_FLOAT64_IEEE 0 speedgoat_test_SN5659_R2021b_IO682_CM_double -1.7E+308 1.7E+308 /end CHARACTERISTIC
/begin CHARACTERISTIC speedgoat_test_SN5659__cal_impl.Encode1_P12_j "" VALUE 0x0083C708 Scalar_FLOAT64_IEEE 0 speedgoat_test_SN5659_R2021b_IO682_CM_double -1.7E+308 1.7E+308 /end CHARACTERISTIC
/begin CHARACTERISTIC speedgoat_test_SN5659__cal_impl.Encode1_P12_k "" VALUE 0x0083AD48 Scalar_FLOAT64_IEEE 0 speedgoat_test_SN5659_R2021b_IO682_CM_double -1.7E+308 1.7E+308 /end CHARACTERISTIC
/begin CHARACTERISTIC speedgoat_test_SN5659__cal_impl.Encode1_P12_m "" VALUE 0x0083CD78 Scalar_FLOAT64_IEEE 0 speedgoat_test_SN5659_R2021b_IO682_CM_double -1.7E+308 1.7E+308 /end CHARACTERISTIC
/begin CHARACTERISTIC speedgoat_test_SN5659__cal_impl.Encode1_P12_no "" VALUE 0x0083B3B8 Scalar_FLOAT64_IEEE 0 speedgoat_test_SN5659_R2021b_IO682_CM_double -1.7E+308 1.7E+308 /end CHARACTERISTIC
/begin CHARACTERISTIC speedgoat_test_SN5659__cal_impl.Encode1_P12_o "" VALUE 0x0083BA28 Scalar_FLOAT64_IEEE 0 speedgoat_test_SN5659_R2021b_IO682_CM_double -1.7E+308 1.7E+308 /end CHARACTERISTIC
/begin CHARACTERISTIC speedgoat_test_SN5659__cal_impl.Encode1_P13_f "" VALUE 0x0083C720 Scalar_FLOAT64_IEEE 0 speedgoat_test_SN5659_R2021b_IO682_CM_double -1.7E+308 1.7E+308 /end CHARACTERISTIC
/begin CHARACTERISTIC speedgoat_test_SN5659__cal_impl.Encode1_P13_fj "" VALUE 0x0083CD90 Scalar_FLOAT64_IEEE 0 speedgoat_test_SN5659_R2021b_IO682_CM_double -1.7E+308 1.7E+308 /end CHARACTERISTIC
/begin CHARACTERISTIC speedgoat_test_SN5659__cal_impl.Encode1_P13_i "" VALUE 0x0083AD60 Scalar_FLOAT64_IEEE 0 speedgoat_test_SN5659_R2021b_IO682_CM_double -1.7E+308 1.7E+308 /end CHARACTERISTIC
/begin CHARACTERISTIC speedgoat_test_SN5659__cal_impl.Encode1_P13_it "" VALUE 0x0083B3D0 Scalar_FLOAT64_IEEE 0 speedgoat_test_SN5659_R2021b_IO682_CM_double -1.7E+308 1.7E+308 /end CHARACTERISTIC
/begin CHARACTERISTIC speedgoat_test_SN5659__cal_impl.Encode1_P13_k "" VALUE 0x0083D400 Scalar_FLOAT64_IEEE 0 speedgoat_test_SN5659_R2021b_IO682_CM_double -1.7E+308 1.7E+308 /end CHARACTERISTIC
/begin CHARACTERISTIC speedgoat_test_SN5659__cal_impl.Encode1_P13_l "" VALUE 0x0083C0B0 Scalar_FLOAT64_IEEE 0 speedgoat_test_SN5659_R2021b_IO682_CM_double -1.7E+308 1.7E+308 /end CHARACTERISTIC
/begin CHARACTERISTIC speedgoat_test_SN5659__cal_impl.Encode1_P13_o "" VALUE 0x0083BA40 Scalar_FLOAT64_IEEE 0 speedgoat_test_SN5659_R2021b_IO682_CM_double -1.7E+308 1.7E+308 /end CHARACTERISTIC
/begin CHARACTERISTIC speedgoat_test_SN5659__cal_impl.Encode1_P14_a "" VALUE 0x0083D418 Scalar_FLOAT64_IEEE 0 speedgoat_test_SN5659_R2021b_IO682_CM_double -1.7E+308 1.7E+308 /end CHARACTERISTIC
/begin CHARACTERISTIC speedgoat_test_SN5659__cal_impl.Encode1_P14_c "" VALUE 0x0083C738 Scalar_FLOAT64_IEEE 0 speedgoat_test_SN5659_R2021b_IO682_CM_double -1.7E+308 1.7E+308 /end CHARACTERISTIC
/begin CHARACTERISTIC speedgoat_test_SN5659__cal_impl.Encode1_P14_d "" VALUE 0x0083CDA8 Scalar_FLOAT64_IEEE 0 speedgoat_test_SN5659_R2021b_IO682_CM_double -1.7E+308 1.7E+308 /end CHARACTERISTIC
/begin CHARACTERISTIC speedgoat_test_SN5659__cal_impl.Encode1_P14_e "" VALUE 0x0083C0C8 Scalar_FLOAT64_IEEE 0 speedgoat_test_SN5659_R2021b_IO682_CM_double -1.7E+308 1.7E+308 /end CHARACTERISTIC
/begin CHARACTERISTIC speedgoat_test_SN5659__cal_impl.Encode1_P14_g "" VALUE 0x0083BA58 Scalar_FLOAT64_IEEE 0 speedgoat_test_SN5659_R2021b_IO682_CM_double -1.7E+308 1.7E+308 /end CHARACTERISTIC
/begin CHARACTERISTIC speedgoat_test_SN5659__cal_impl.Encode1_P14_ho "" VALUE 0x0083B3E8 Scalar_FLOAT64_IEEE 0 speedgoat_test_SN5659_R2021b_IO682_CM_double -1.7E+308 1.7E+308 /end CHARACTERISTIC
/begin CHARACTERISTIC speedgoat_test_SN5659__cal_impl.Encode1_P14_o "" VALUE 0x0083AD78 Scalar_FLOAT64_IEEE 0 speedgoat_test_SN5659_R2021b_IO682_CM_double -1.7E+308 1.7E+308 /end CHARACTERISTIC
/begin CHARACTERISTIC speedgoat_test_SN5659__cal_impl.Encode1_P15_a "" VALUE 0x0083C750 Scalar_FLOAT64_IEEE 0 speedgoat_test_SN5659_R2021b_IO682_CM_double -1.7E+308 1.7E+308 /end CHARACTERISTIC
/begin CHARACTERISTIC speedgoat_test_SN5659__cal_impl.Encode1_P15_b "" VALUE 0x0083AD90 Scalar_FLOAT64_IEEE 0 speedgoat_test_SN5659_R2021b_IO682_CM_double -1.7E+308 1.7E+308 /end CHARACTERISTIC
/begin CHARACTERISTIC speedgoat_test_SN5659__cal_impl.Encode1_P15_i "" VALUE 0x0083CDC0 Scalar_FLOAT64_IEEE 0 speedgoat_test_SN5659_R2021b_IO682_CM_double -1.7E+308 1.7E+308 /end CHARACTERISTIC
/begin CHARACTERISTIC speedgoat_test_SN5659__cal_impl.Encode1_P15_j "" VALUE 0x0083BA70 Scalar_FLOAT64_IEEE 0 speedgoat_test_SN5659_R2021b_IO682_CM_double -1.7E+308 1.7E+308 /end CHARACTERISTIC
/begin CHARACTERISTIC speedgoat_test_SN5659__cal_impl.Encode1_P15_k "" VALUE 0x0083B400 Scalar_FLOAT64_IEEE 0 speedgoat_test_SN5659_R2021b_IO682_CM_double -1.7E+308 1.7E+308 /end CHARACTERISTIC
/begin CHARACTERISTIC speedgoat_test_SN5659__cal_impl.Encode1_P15_m "" VALUE 0x0083C0E0 Scalar_FLOAT64_IEEE 0 speedgoat_test_SN5659_R2021b_IO682_CM_double -1.7E+308 1.7E+308 /end CHARACTERISTIC
/begin CHARACTERISTIC speedgoat_test_SN5659__cal_impl.Encode1_P15_p "" VALUE 0x0083D430 Scalar_FLOAT64_IEEE 0 speedgoat_test_SN5659_R2021b_IO682_CM_double -1.7E+308 1.7E+308 /end CHARACTERISTIC
/begin CHARACTERISTIC speedgoat_test_SN5659__cal_impl.Encode1_P1_c "" VALUE 0x0083AC38 Scalar_FLOAT64_IEEE 0 speedgoat_test_SN5659_R2021b_IO682_CM_double -1.7E+308 1.7E+308 /end CHARACTERISTIC
/begin CHARACTERISTIC speedgoat_test_SN5659__cal_impl.Encode1_P1_f "" VALUE 0x0083BF88 Scalar_FLOAT64_IEEE 0 speedgoat_test_SN5659_R2021b_IO682_CM_double -1.7E+308 1.7E+308 /end CHARACTERISTIC
/begin CHARACTERISTIC speedgoat_test_SN5659__cal_impl.Encode1_P1_ft "" VALUE 0x0083D2D8 Scalar_FLOAT64_IEEE 0 speedgoat_test_SN5659_R2021b_IO682_CM_double -1.7E+308 1.7E+308 /end CHARACTERISTIC
/begin CHARACTERISTIC speedgoat_test_SN5659__cal_impl.Encode1_P1_g "" VALUE 0x0083B918 Scalar_FLOAT64_IEEE 0 speedgoat_test_SN5659_R2021b_IO682_CM_double -1.7E+308 1.7E+308 /end CHARACTERISTIC
/begin CHARACTERISTIC speedgoat_test_SN5659__cal_impl.Encode1_P1_h "" VALUE 0x0083C5F8 Scalar_FLOAT64_IEEE 0 speedgoat_test_SN5659_R2021b_IO682_CM_double -1.7E+308 1.7E+308 /end CHARACTERISTIC
/begin CHARACTERISTIC speedgoat_test_SN5659__cal_impl.Encode1_P1_i "" VALUE 0x0083B2A8 Scalar_FLOAT64_IEEE 0 speedgoat_test_SN5659_R2021b_IO682_CM_double -1.7E+308 1.7E+308 /end CHARACTERISTIC
/begin CHARACTERISTIC speedgoat_test_SN5659__cal_impl.Encode1_P1_j "" VALUE 0x0083CC68 Scalar_FLOAT64_IEEE 0 speedgoat_test_SN5659_R2021b_IO682_CM_double -1.7E+308 1.7E+308 /end CHARACTERISTIC
/begin CHARACTERISTIC speedgoat_test_SN5659__cal_impl.Encode1_P2_e "" VALUE 0x0083C610 Scalar_FLOAT64_IEEE 0 speedgoat_test_SN5659_R2021b_IO682_CM_double -1.7E+308 1.7E+308 /end CHARACTERISTIC
/begin CHARACTERISTIC speedgoat_test_SN5659__cal_impl.Encode1_P2_g "" VALUE 0x0083AC50 Scalar_FLOAT64_IEEE 0 speedgoat_test_SN5659_R2021b_IO682_CM_double -1.7E+308 1.7E+308 /end CHARACTERISTIC
/begin CHARACTERISTIC speedgoat_test_SN5659__cal_impl.Encode1_P2_hw "" VALUE 0x0083D2F0 Scalar_FLOAT64_IEEE 0 speedgoat_test_SN5659_R2021b_IO682_CM_double -1.7E+308 1.7E+308 /end CHARACTERISTIC
/begin CHARACTERISTIC speedgoat_test_SN5659__cal_impl.Encode1_P2_l "" VALUE 0x0083B2C0 Scalar_FLOAT64_IEEE 0 speedgoat_test_SN5659_R2021b_IO682_CM_double -1.7E+308 1.7E+308 /end CHARACTERISTIC
/begin CHARACTERISTIC speedgoat_test_SN5659__cal_impl.Encode1_P2_n "" VALUE 0x0083CC80 Scalar_FLOAT64_IEEE 0 speedgoat_test_SN5659_R2021b_IO682_CM_double -1.7E+308 1.7E+308 /end CHARACTERISTIC
/begin CHARACTERISTIC speedgoat_test_SN5659__cal_impl.Encode1_P2_p "" VALUE 0x0083B930 Scalar_FLOAT64_IEEE 0 speedgoat_test_SN5659_R2021b_IO682_CM_double -1.7E+308 1.7E+308 /end CHARACTERISTIC
/begin CHARACTERISTIC speedgoat_test_SN5659__cal_impl.Encode1_P2_pf "" VALUE 0x0083BFA0 Scalar_FLOAT64_IEEE 0 speedgoat_test_SN5659_R2021b_IO682_CM_double -1.7E+308 1.7E+308 /end CHARACTERISTIC
/begin CHARACTERISTIC speedgoat_test_SN5659__cal_impl.Encode1_P3_b "" VALUE 0x0083B2D8 Scalar_FLOAT64_IEEE 0 speedgoat_test_SN5659_R2021b_IO682_CM_double -1.7E+308 1.7E+308 /end CHARACTERISTIC
/begin CHARACTERISTIC speedgoat_test_SN5659__cal_impl.Encode1_P3_h "" VALUE 0x0083BFB8 Scalar_FLOAT64_IEEE 0 speedgoat_test_SN5659_R2021b_IO682_CM_double -1.7E+308 1.7E+308 /end CHARACTERISTIC
/begin CHARACTERISTIC speedgoat_test_SN5659__cal_impl.Encode1_P3_hu "" VALUE 0x0083CC98 Scalar_FLOAT64_IEEE 0 speedgoat_test_SN5659_R2021b_IO682_CM_double -1.7E+308 1.7E+308 /end CHARACTERISTIC
/begin CHARACTERISTIC speedgoat_test_SN5659__cal_impl.Encode1_P3_i "" VALUE 0x0083C628 Scalar_FLOAT64_IEEE 0 speedgoat_test_SN5659_R2021b_IO682_CM_double -1.7E+308 1.7E+308 /end CHARACTERISTIC
/begin CHARACTERISTIC speedgoat_test_SN5659__cal_impl.Encode1_P3_j "" VALUE 0x0083D308 Scalar_FLOAT64_IEEE 0 speedgoat_test_SN5659_R2021b_IO682_CM_double -1.7E+308 1.7E+308 /end CHARACTERISTIC
/begin CHARACTERISTIC speedgoat_test_SN5659__cal_impl.Encode1_P3_l "" VALUE 0x0083AC68 Scalar_FLOAT64_IEEE 0 speedgoat_test_SN5659_R2021b_IO682_CM_double -1.7E+308 1.7E+308 /end CHARACTERISTIC
/begin CHARACTERISTIC speedgoat_test_SN5659__cal_impl.Encode1_P3_o0 "" VALUE 0x0083B948 Scalar_FLOAT64_IEEE 0 speedgoat_test_SN5659_R2021b_IO682_CM_double -1.7E+308 1.7E+308 /end CHARACTERISTIC
/begin CHARACTERISTIC speedgoat_test_SN5659__cal_impl.Encode1_P4_a "" VALUE 0x0083B2F0 Scalar_FLOAT64_IEEE 0 speedgoat_test_SN5659_R2021b_IO682_CM_double -1.7E+308 1.7E+308 /end CHARACTERISTIC
/begin CHARACTERISTIC speedgoat_test_SN5659__cal_impl.Encode1_P4_c "" VALUE 0x0083B960 Scalar_FLOAT64_IEEE 0 speedgoat_test_SN5659_R2021b_IO682_CM_double -1.7E+308 1.7E+308 /end CHARACTERISTIC
/begin CHARACTERISTIC speedgoat_test_SN5659__cal_impl.Encode1_P4_e "" VALUE 0x0083AC80 Scalar_FLOAT64_IEEE 0 speedgoat_test_SN5659_R2021b_IO682_CM_double -1.7E+308 1.7E+308 /end CHARACTERISTIC
/begin CHARACTERISTIC speedgoat_test_SN5659__cal_impl.Encode1_P4_el "" VALUE 0x0083C640 Scalar_FLOAT64_IEEE 0 speedgoat_test_SN5659_R2021b_IO682_CM_double -1.7E+308 1.7E+308 /end CHARACTERISTIC
/begin CHARACTERISTIC speedgoat_test_SN5659__cal_impl.Encode1_P4_g "" VALUE 0x0083D320 Scalar_FLOAT64_IEEE 0 speedgoat_test_SN5659_R2021b_IO682_CM_double -1.7E+308 1.7E+308 /end CHARACTERISTIC
/begin CHARACTERISTIC speedgoat_test_SN5659__cal_impl.Encode1_P4_o "" VALUE 0x0083BFD0 Scalar_FLOAT64_IEEE 0 speedgoat_test_SN5659_R2021b_IO682_CM_double -1.7E+308 1.7E+308 /end CHARACTERISTIC
/begin CHARACTERISTIC speedgoat_test_SN5659__cal_impl.Encode1_P4_p "" VALUE 0x0083CCB0 Scalar_FLOAT64_IEEE 0 speedgoat_test_SN5659_R2021b_IO682_CM_double -1.7E+308 1.7E+308 /end CHARACTERISTIC
/begin CHARACTERISTIC speedgoat_test_SN5659__cal_impl.Encode1_P5_e "" VALUE 0x0083CCC8 Scalar_FLOAT64_IEEE 0 speedgoat_test_SN5659_R2021b_IO682_CM_double -1.7E+308 1.7E+308 /end CHARACTERISTIC
/begin CHARACTERISTIC speedgoat_test_SN5659__cal_impl.Encode1_P5_g "" VALUE 0x0083C658 Scalar_FLOAT64_IEEE 0 speedgoat_test_SN5659_R2021b_IO682_CM_double -1.7E+308 1.7E+308 /end CHARACTERISTIC
/begin CHARACTERISTIC speedgoat_test_SN5659__cal_impl.Encode1_P5_i "" VALUE 0x0083AC98 Scalar_FLOAT64_IEEE 0 speedgoat_test_SN5659_R2021b_IO682_CM_double -1.7E+308 1.7E+308 /end CHARACTERISTIC
/begin CHARACTERISTIC speedgoat_test_SN5659__cal_impl.Encode1_P5_j "" VALUE 0x0083B308 Scalar_FLOAT64_IEEE 0 speedgoat_test_SN5659_R2021b_IO682_CM_double -1.7E+308 1.7E+308 /end CHARACTERISTIC
/begin CHARACTERISTIC speedgoat_test_SN5659__cal_impl.Encode1_P5_l "" VALUE 0x0083BFE8 Scalar_FLOAT64_IEEE 0 speedgoat_test_SN5659_R2021b_IO682_CM_double -1.7E+308 1.7E+308 /end CHARACTERISTIC
/begin CHARACTERISTIC speedgoat_test_SN5659__cal_impl.Encode1_P5_ov "" VALUE 0x0083D338 Scalar_FLOAT64_IEEE 0 speedgoat_test_SN5659_R2021b_IO682_CM_double -1.7E+308 1.7E+308 /end CHARACTERISTIC
/begin CHARACTERISTIC speedgoat_test_SN5659__cal_impl.Encode1_P5_oz "" VALUE 0x0083B978 Scalar_FLOAT64_IEEE 0 speedgoat_test_SN5659_R2021b_IO682_CM_double -1.7E+308 1.7E+308 /end CHARACTERISTIC
/begin CHARACTERISTIC speedgoat_test_SN5659__cal_impl.Encode1_P6_a "" VALUE 0x0083C670 Scalar_FLOAT64_IEEE 0 speedgoat_test_SN5659_R2021b_IO682_CM_double -1.7E+308 1.7E+308 /end CHARACTERISTIC
/begin CHARACTERISTIC speedgoat_test_SN5659__cal_impl.Encode1_P6_d "" VALUE 0x0083C000 Scalar_FLOAT64_IEEE 0 speedgoat_test_SN5659_R2021b_IO682_CM_double -1.7E+308 1.7E+308 /end CHARACTERISTIC
/begin CHARACTERISTIC speedgoat_test_SN5659__cal_impl.Encode1_P6_e "" VALUE 0x0083B320 Scalar_FLOAT64_IEEE 0 speedgoat_test_SN5659_R2021b_IO682_CM_double -1.7E+308 1.7E+308 /end CHARACTERISTIC
/begin CHARACTERISTIC speedgoat_test_SN5659__cal_impl.Encode1_P6_m "" VALUE 0x0083CCE0 Scalar_FLOAT64_IEEE 0 speedgoat_test_SN5659_R2021b_IO682_CM_double -1.7E+308 1.7E+308 /end CHARACTERISTIC
/begin CHARACTERISTIC speedgoat_test_SN5659__cal_impl.Encode1_P6_n5 "" VALUE 0x0083B990 Scalar_FLOAT64_IEEE 0 speedgoat_test_SN5659_R2021b_IO682_CM_double -1.7E+308 1.7E+308 /end CHARACTERISTIC
/begin CHARACTERISTIC speedgoat_test_SN5659__cal_impl.Encode1_P6_p "" VALUE 0x0083ACB0 Scalar_FLOAT64_IEEE 0 speedgoat_test_SN5659_R2021b_IO682_CM_double -1.7E+308 1.7E+308 /end CHARACTERISTIC
/begin CHARACTERISTIC speedgoat_test_SN5659__cal_impl.Encode1_P6_pe "" VALUE 0x0083D350 Scalar_FLOAT64_IEEE 0 speedgoat_test_SN5659_R2021b_IO682_CM_double -1.7E+308 1.7E+308 /end CHARACTERISTIC
/begin CHARACTERISTIC speedgoat_test_SN5659__cal_impl.Encode1_P7_a "" VALUE 0x0083C688 Scalar_FLOAT64_IEEE 0 speedgoat_test_SN5659_R2021b_IO682_CM_double -1.7E+308 1.7E+308 /end CHARACTERISTIC
/begin CHARACTERISTIC speedgoat_test_SN5659__cal_impl.Encode1_P7_b "" VALUE 0x0083C018 Scalar_FLOAT64_IEEE 0 speedgoat_test_SN5659_R2021b_IO682_CM_double -1.7E+308 1.7E+308 /end CHARACTERISTIC
/begin CHARACTERISTIC speedgoat_test_SN5659__cal_impl.Encode1_P7_d "" VALUE 0x0083ACC8 Scalar_FLOAT64_IEEE 0 speedgoat_test_SN5659_R2021b_IO682_CM_double -1.7E+308 1.7E+308 /end CHARACTERISTIC
/begin CHARACTERISTIC speedgoat_test_SN5659__cal_impl.Encode1_P7_db "" VALUE 0x0083B338 Scalar_FLOAT64_IEEE 0 speedgoat_test_SN5659_R2021b_IO682_CM_double -1.7E+308 1.7E+308 /end CHARACTERISTIC
/begin CHARACTERISTIC speedgoat_test_SN5659__cal_impl.Encode1_P7_dz "" VALUE 0x0083B9A8 Scalar_FLOAT64_IEEE 0 speedgoat_test_SN5659_R2021b_IO682_CM_double -1.7E+308 1.7E+308 /end CHARACTERISTIC
/begin CHARACTERISTIC speedgoat_test_SN5659__cal_impl.Encode1_P7_e "" VALUE 0x0083CCF8 Scalar_FLOAT64_IEEE 0 speedgoat_test_SN5659_R2021b_IO682_CM_double -1.7E+308 1.7E+308 /end CHARACTERISTIC
/begin CHARACTERISTIC speedgoat_test_SN5659__cal_impl.Encode1_P7_m "" VALUE 0x0083D368 Scalar_FLOAT64_IEEE 0 speedgoat_test_SN5659_R2021b_IO682_CM_double -1.7E+308 1.7E+308 /end CHARACTERISTIC
/begin CHARACTERISTIC speedgoat_test_SN5659__cal_impl.Encode1_P8_b "" VALUE 0x0083B350 Scalar_FLOAT64_IEEE 0 speedgoat_test_SN5659_R2021b_IO682_CM_double -1.7E+308 1.7E+308 /end CHARACTERISTIC
/begin CHARACTERISTIC speedgoat_test_SN5659__cal_impl.Encode1_P8_c "" VALUE 0x0083ACE0 Scalar_FLOAT64_IEEE 0 speedgoat_test_SN5659_R2021b_IO682_CM_double -1.7E+308 1.7E+308 /end CHARACTERISTIC
/begin CHARACTERISTIC speedgoat_test_SN5659__cal_impl.Encode1_P8_ck "" VALUE 0x0083D380 Scalar_FLOAT64_IEEE 0 speedgoat_test_SN5659_R2021b_IO682_CM_double -1.7E+308 1.7E+308 /end CHARACTERISTIC
/begin CHARACTERISTIC speedgoat_test_SN5659__cal_impl.Encode1_P8_d "" VALUE 0x0083B9C0 Scalar_FLOAT64_IEEE 0 speedgoat_test_SN5659_R2021b_IO682_CM_double -1.7E+308 1.7E+308 /end CHARACTERISTIC
/begin CHARACTERISTIC speedgoat_test_SN5659__cal_impl.Encode1_P8_dh "" VALUE 0x0083C6A0 Scalar_FLOAT64_IEEE 0 speedgoat_test_SN5659_R2021b_IO682_CM_double -1.7E+308 1.7E+308 /end CHARACTERISTIC
/begin CHARACTERISTIC speedgoat_test_SN5659__cal_impl.Encode1_P8_f "" VALUE 0x0083C030 Scalar_FLOAT64_IEEE 0 speedgoat_test_SN5659_R2021b_IO682_CM_double -1.7E+308 1.7E+308 /end CHARACTERISTIC
/begin CHARACTERISTIC speedgoat_test_SN5659__cal_impl.Encode1_P8_fq "" VALUE 0x0083CD10 Scalar_FLOAT64_IEEE 0 speedgoat_test_SN5659_R2021b_IO682_CM_double -1.7E+308 1.7E+308 /end CHARACTERISTIC
/begin CHARACTERISTIC speedgoat_test_SN5659__cal_impl.Encode1_P9_a "" VALUE 0x0083B9D8 Scalar_FLOAT64_IEEE 0 speedgoat_test_SN5659_R2021b_IO682_CM_double -1.7E+308 1.7E+308 /end CHARACTERISTIC
/begin CHARACTERISTIC speedgoat_test_SN5659__cal_impl.Encode1_P9_k "" VALUE 0x0083C6B8 Scalar_FLOAT64_IEEE 0 speedgoat_test_SN5659_R2021b_IO682_CM_double -1.7E+308 1.7E+308 /end CHARACTERISTIC
/begin CHARACTERISTIC speedgoat_test_SN5659__cal_impl.Encode1_P9_md "" VALUE 0x0083B368 Scalar_FLOAT64_IEEE 0 speedgoat_test_SN5659_R2021b_IO682_CM_double -1.7E+308 1.7E+308 /end CHARACTERISTIC
/begin CHARACTERISTIC speedgoat_test_SN5659__cal_impl.Encode1_P9_n "" VALUE 0x0083ACF8 Scalar_FLOAT64_IEEE 0 speedgoat_test_SN5659_R2021b_IO682_CM_double -1.7E+308 1.7E+308 /end CHARACTERISTIC
/begin CHARACTERISTIC speedgoat_test_SN5659__cal_impl.Encode1_P9_ng "" VALUE 0x0083C048 Scalar_FLOAT64_IEEE 0 speedgoat_test_SN5659_R2021b_IO682_CM_double -1.7E+308 1.7E+308 /end CHARACTERISTIC
/begin CHARACTERISTIC speedgoat_test_SN5659__cal_impl.Encode1_P9_o "" VALUE 0x0083CD28 Scalar_FLOAT64_IEEE 0 speedgoat_test_SN5659_R2021b_IO682_CM_double -1.7E+308 1.7E+308 /end CHARACTERISTIC
/begin CHARACTERISTIC speedgoat_test_SN5659__cal_impl.Encode1_P9_ol "" VALUE 0x0083D398 Scalar_FLOAT64_IEEE 0 speedgoat_test_SN5659_R2021b_IO682_CM_double -1.7E+308 1.7E+308 /end CHARACTERISTIC
/begin CHARACTERISTIC speedgoat_test_SN5659__cal_impl.Encode2_P10_a "" VALUE 0x0083C1D0 Scalar_FLOAT64_IEEE 0 speedgoat_test_SN5659_R2021b_IO682_CM_double -1.7E+308 1.7E+308 /end CHARACTERISTIC
/begin CHARACTERISTIC speedgoat_test_SN5659__cal_impl.Encode2_P10_ab "" VALUE 0x0083C840 Scalar_FLOAT64_IEEE 0 speedgoat_test_SN5659_R2021b_IO682_CM_double -1.7E+308 1.7E+308 /end CHARACTERISTIC
/begin CHARACTERISTIC speedgoat_test_SN5659__cal_impl.Encode2_P10_c "" VALUE 0x0083AE80 Scalar_FLOAT64_IEEE 0 speedgoat_test_SN5659_R2021b_IO682_CM_double -1.7E+308 1.7E+308 /end CHARACTERISTIC
/begin CHARACTERISTIC speedgoat_test_SN5659__cal_impl.Encode2_P10_g "" VALUE 0x0083BE90 Scalar_FLOAT64_IEEE 0 speedgoat_test_SN5659_R2021b_IO682_CM_double -1.7E+308 1.7E+308 /end CHARACTERISTIC
/begin CHARACTERISTIC speedgoat_test_SN5659__cal_impl.Encode2_P10_gm "" VALUE 0x0083D520 Scalar_FLOAT64_IEEE 0 speedgoat_test_SN5659_R2021b_IO682_CM_double -1.7E+308 1.7E+308 /end CHARACTERISTIC
/begin CHARACTERISTIC speedgoat_test_SN5659__cal_impl.Encode2_P10_i "" VALUE 0x0083B4F0 Scalar_FLOAT64_IEEE 0 speedgoat_test_SN5659_R2021b_IO682_CM_double -1.7E+308 1.7E+308 /end CHARACTERISTIC
/begin CHARACTERISTIC speedgoat_test_SN5659__cal_impl.Encode2_P10_o "" VALUE 0x0083CEB0 Scalar_FLOAT64_IEEE 0 speedgoat_test_SN5659_R2021b_IO682_CM_double -1.7E+308 1.7E+308 /end CHARACTERISTIC
/begin CHARACTERISTIC speedgoat_test_SN5659__cal_impl.Encode2_P11_d "" VAL_BLK 0x0083D538 Scalar_FLOAT64_IEEE 0 speedgoat_test_SN5659_R2021b_IO682_CM_double -1.7E+308 1.7E+308 MATRIX_DIM 2 1 /end CHARACTERISTIC
/begin CHARACTERISTIC speedgoat_test_SN5659__cal_impl.Encode2_P11_e "" VAL_BLK 0x0083CEC8 Scalar_FLOAT64_IEEE 0 speedgoat_test_SN5659_R2021b_IO682_CM_double -1.7E+308 1.7E+308 MATRIX_DIM 2 1 /end CHARACTERISTIC
/begin CHARACTERISTIC speedgoat_test_SN5659__cal_impl.Encode2_P11_g "" VAL_BLK 0x0083AE98 Scalar_FLOAT64_IEEE 0 speedgoat_test_SN5659_R2021b_IO682_CM_double -1.7E+308 1.7E+308 MATRIX_DIM 2 1 /end CHARACTERISTIC
/begin CHARACTERISTIC speedgoat_test_SN5659__cal_impl.Encode2_P11_ga "" VAL_BLK 0x0083C1E8 Scalar_FLOAT64_IEEE 0 speedgoat_test_SN5659_R2021b_IO682_CM_double -1.7E+308 1.7E+308 MATRIX_DIM 2 1 /end CHARACTERISTIC
/begin CHARACTERISTIC speedgoat_test_SN5659__cal_impl.Encode2_P11_gc "" VAL_BLK 0x0083BEA8 Scalar_FLOAT64_IEEE 0 speedgoat_test_SN5659_R2021b_IO682_CM_double -1.7E+308 1.7E+308 MATRIX_DIM 2 1 /end CHARACTERISTIC
/begin CHARACTERISTIC speedgoat_test_SN5659__cal_impl.Encode2_P11_h "" VAL_BLK 0x0083B508 Scalar_FLOAT64_IEEE 0 speedgoat_test_SN5659_R2021b_IO682_CM_double -1.7E+308 1.7E+308 MATRIX_DIM 2 1 /end CHARACTERISTIC
/begin CHARACTERISTIC speedgoat_test_SN5659__cal_impl.Encode2_P11_k "" VAL_BLK 0x0083C858 Scalar_FLOAT64_IEEE 0 speedgoat_test_SN5659_R2021b_IO682_CM_double -1.7E+308 1.7E+308 MATRIX_DIM 2 1 /end CHARACTERISTIC
/begin CHARACTERISTIC speedgoat_test_SN5659__cal_impl.Encode2_P12_a "" VALUE 0x0083D558 Scalar_FLOAT64_IEEE 0 speedgoat_test_SN5659_R2021b_IO682_CM_double -1.7E+308 1.7E+308 /end CHARACTERISTIC
/begin CHARACTERISTIC speedgoat_test_SN5659__cal_impl.Encode2_P12_d "" VALUE 0x0083C878 Scalar_FLOAT64_IEEE 0 speedgoat_test_SN5659_R2021b_IO682_CM_double -1.7E+308 1.7E+308 /end CHARACTERISTIC
/begin CHARACTERISTIC speedgoat_test_SN5659__cal_impl.Encode2_P12_f "" VALUE 0x0083C208 Scalar_FLOAT64_IEEE 0 speedgoat_test_SN5659_R2021b_IO682_CM_double -1.7E+308 1.7E+308 /end CHARACTERISTIC
/begin CHARACTERISTIC speedgoat_test_SN5659__cal_impl.Encode2_P12_fa "" VALUE 0x0083CEE8 Scalar_FLOAT64_IEEE 0 speedgoat_test_SN5659_R2021b_IO682_CM_double -1.7E+308 1.7E+308 /end CHARACTERISTIC
/begin CHARACTERISTIC speedgoat_test_SN5659__cal_impl.Encode2_P12_k "" VALUE 0x0083B528 Scalar_FLOAT64_IEEE 0 speedgoat_test_SN5659_R2021b_IO682_CM_double -1.7E+308 1.7E+308 /end CHARACTERISTIC
/begin CHARACTERISTIC speedgoat_test_SN5659__cal_impl.Encode2_P12_m "" VALUE 0x0083AEB8 Scalar_FLOAT64_IEEE 0 speedgoat_test_SN5659_R2021b_IO682_CM_double -1.7E+308 1.7E+308 /end CHARACTERISTIC
/begin CHARACTERISTIC speedgoat_test_SN5659__cal_impl.Encode2_P12_me "" VALUE 0x0083BEC8 Scalar_FLOAT64_IEEE 0 speedgoat_test_SN5659_R2021b_IO682_CM_double -1.7E+308 1.7E+308 /end CHARACTERISTIC
/begin CHARACTERISTIC speedgoat_test_SN5659__cal_impl.Encode2_P13_d "" VALUE 0x0083CF00 Scalar_FLOAT64_IEEE 0 speedgoat_test_SN5659_R2021b_IO682_CM_double -1.7E+308 1.7E+308 /end CHARACTERISTIC
/begin CHARACTERISTIC speedgoat_test_SN5659__cal_impl.Encode2_P13_e "" VALUE 0x0083BEE0 Scalar_FLOAT64_IEEE 0 speedgoat_test_SN5659_R2021b_IO682_CM_double -1.7E+308 1.7E+308 /end CHARACTERISTIC
/begin CHARACTERISTIC speedgoat_test_SN5659__cal_impl.Encode2_P13_f "" VALUE 0x0083B540 Scalar_FLOAT64_IEEE 0 speedgoat_test_SN5659_R2021b_IO682_CM_double -1.7E+308 1.7E+308 /end CHARACTERISTIC
/begin CHARACTERISTIC speedgoat_test_SN5659__cal_impl.Encode2_P13_fz "" VALUE 0x0083D570 Scalar_FLOAT64_IEEE 0 speedgoat_test_SN5659_R2021b_IO682_CM_double -1.7E+308 1.7E+308 /end CHARACTERISTIC
/begin CHARACTERISTIC speedgoat_test_SN5659__cal_impl.Encode2_P13_n "" VALUE 0x0083C890 Scalar_FLOAT64_IEEE 0 speedgoat_test_SN5659_R2021b_IO682_CM_double -1.7E+308 1.7E+308 /end CHARACTERISTIC
/begin CHARACTERISTIC speedgoat_test_SN5659__cal_impl.Encode2_P13_o "" VALUE 0x0083C220 Scalar_FLOAT64_IEEE 0 speedgoat_test_SN5659_R2021b_IO682_CM_double -1.7E+308 1.7E+308 /end CHARACTERISTIC
/begin CHARACTERISTIC speedgoat_test_SN5659__cal_impl.Encode2_P13_p "" VALUE 0x0083AED0 Scalar_FLOAT64_IEEE 0 speedgoat_test_SN5659_R2021b_IO682_CM_double -1.7E+308 1.7E+308 /end CHARACTERISTIC
/begin CHARACTERISTIC speedgoat_test_SN5659__cal_impl.Encode2_P14_b "" VALUE 0x0083BEF8 Scalar_FLOAT64_IEEE 0 speedgoat_test_SN5659_R2021b_IO682_CM_double -1.7E+308 1.7E+308 /end CHARACTERISTIC
/begin CHARACTERISTIC speedgoat_test_SN5659__cal_impl.Encode2_P14_ck "" VALUE 0x0083CF18 Scalar_FLOAT64_IEEE 0 speedgoat_test_SN5659_R2021b_IO682_CM_double -1.7E+308 1.7E+308 /end CHARACTERISTIC
/begin CHARACTERISTIC speedgoat_test_SN5659__cal_impl.Encode2_P14_f "" VALUE 0x0083B558 Scalar_FLOAT64_IEEE 0 speedgoat_test_SN5659_R2021b_IO682_CM_double -1.7E+308 1.7E+308 /end CHARACTERISTIC
/begin CHARACTERISTIC speedgoat_test_SN5659__cal_impl.Encode2_P14_i "" VALUE 0x0083D588 Scalar_FLOAT64_IEEE 0 speedgoat_test_SN5659_R2021b_IO682_CM_double -1.7E+308 1.7E+308 /end CHARACTERISTIC
/begin CHARACTERISTIC speedgoat_test_SN5659__cal_impl.Encode2_P14_n "" VALUE 0x0083C8A8 Scalar_FLOAT64_IEEE 0 speedgoat_test_SN5659_R2021b_IO682_CM_double -1.7E+308 1.7E+308 /end CHARACTERISTIC
/begin CHARACTERISTIC speedgoat_test_SN5659__cal_impl.Encode2_P14_p "" VALUE 0x0083AEE8 Scalar_FLOAT64_IEEE 0 speedgoat_test_SN5659_R2021b_IO682_CM_double -1.7E+308 1.7E+308 /end CHARACTERISTIC
/begin CHARACTERISTIC speedgoat_test_SN5659__cal_impl.Encode2_P14_po "" VALUE 0x0083C238 Scalar_FLOAT64_IEEE 0 speedgoat_test_SN5659_R2021b_IO682_CM_double -1.7E+308 1.7E+308 /end CHARACTERISTIC
/begin CHARACTERISTIC speedgoat_test_SN5659__cal_impl.Encode2_P15_c "" VALUE 0x0083AF00 Scalar_FLOAT64_IEEE 0 speedgoat_test_SN5659_R2021b_IO682_CM_double -1.7E+308 1.7E+308 /end CHARACTERISTIC
/begin CHARACTERISTIC speedgoat_test_SN5659__cal_impl.Encode2_P15_e "" VALUE 0x0083CF30 Scalar_FLOAT64_IEEE 0 speedgoat_test_SN5659_R2021b_IO682_CM_double -1.7E+308 1.7E+308 /end CHARACTERISTIC
/begin CHARACTERISTIC speedgoat_test_SN5659__cal_impl.Encode2_P15_h "" VALUE 0x0083C250 Scalar_FLOAT64_IEEE 0 speedgoat_test_SN5659_R2021b_IO682_CM_double -1.7E+308 1.7E+308 /end CHARACTERISTIC
/begin CHARACTERISTIC speedgoat_test_SN5659__cal_impl.Encode2_P15_js "" VALUE 0x0083C8C0 Scalar_FLOAT64_IEEE 0 speedgoat_test_SN5659_R2021b_IO682_CM_double -1.7E+308 1.7E+308 /end CHARACTERISTIC
/begin CHARACTERISTIC speedgoat_test_SN5659__cal_impl.Encode2_P15_k "" VALUE 0x0083BF10 Scalar_FLOAT64_IEEE 0 speedgoat_test_SN5659_R2021b_IO682_CM_double -1.7E+308 1.7E+308 /end CHARACTERISTIC
/begin CHARACTERISTIC speedgoat_test_SN5659__cal_impl.Encode2_P15_m "" VALUE 0x0083D5A0 Scalar_FLOAT64_IEEE 0 speedgoat_test_SN5659_R2021b_IO682_CM_double -1.7E+308 1.7E+308 /end CHARACTERISTIC
/begin CHARACTERISTIC speedgoat_test_SN5659__cal_impl.Encode2_P15_o "" VALUE 0x0083B570 Scalar_FLOAT64_IEEE 0 speedgoat_test_SN5659_R2021b_IO682_CM_double -1.7E+308 1.7E+308 /end CHARACTERISTIC
/begin CHARACTERISTIC speedgoat_test_SN5659__cal_impl.Encode2_P1_a "" VALUE 0x0083ADA8 Scalar_FLOAT64_IEEE 0 speedgoat_test_SN5659_R2021b_IO682_CM_double -1.7E+308 1.7E+308 /end CHARACTERISTIC
/begin CHARACTERISTIC speedgoat_test_SN5659__cal_impl.Encode2_P1_e "" VALUE 0x0083C0F8 Scalar_FLOAT64_IEEE 0 speedgoat_test_SN5659_R2021b_IO682_CM_double -1.7E+308 1.7E+308 /end CHARACTERISTIC
/begin CHARACTERISTIC speedgoat_test_SN5659__cal_impl.Encode2_P1_g "" VALUE 0x0083CDD8 Scalar_FLOAT64_IEEE 0 speedgoat_test_SN5659_R2021b_IO682_CM_double -1.7E+308 1.7E+308 /end CHARACTERISTIC
/begin CHARACTERISTIC speedgoat_test_SN5659__cal_impl.Encode2_P1_hz "" VALUE 0x0083D448 Scalar_FLOAT64_IEEE 0 speedgoat_test_SN5659_R2021b_IO682_CM_double -1.7E+308 1.7E+308 /end CHARACTERISTIC
/begin CHARACTERISTIC speedgoat_test_SN5659__cal_impl.Encode2_P1_m "" VALUE 0x0083BDB8 Scalar_FLOAT64_IEEE 0 speedgoat_test_SN5659_R2021b_IO682_CM_double -1.7E+308 1.7E+308 /end CHARACTERISTIC
/begin CHARACTERISTIC speedgoat_test_SN5659__cal_impl.Encode2_P1_n "" VALUE 0x0083C768 Scalar_FLOAT64_IEEE 0 speedgoat_test_SN5659_R2021b_IO682_CM_double -1.7E+308 1.7E+308 /end CHARACTERISTIC
/begin CHARACTERISTIC speedgoat_test_SN5659__cal_impl.Encode2_P1_p "" VALUE 0x0083B418 Scalar_FLOAT64_IEEE 0 speedgoat_test_SN5659_R2021b_IO682_CM_double -1.7E+308 1.7E+308 /end CHARACTERISTIC
/begin CHARACTERISTIC speedgoat_test_SN5659__cal_impl.Encode2_P2_d "" VALUE 0x0083CDF0 Scalar_FLOAT64_IEEE 0 speedgoat_test_SN5659_R2021b_IO682_CM_double -1.7E+308 1.7E+308 /end CHARACTERISTIC
/begin CHARACTERISTIC speedgoat_test_SN5659__cal_impl.Encode2_P2_f "" VALUE 0x0083BDD0 Scalar_FLOAT64_IEEE 0 speedgoat_test_SN5659_R2021b_IO682_CM_double -1.7E+308 1.7E+308 /end CHARACTERISTIC
/begin CHARACTERISTIC speedgoat_test_SN5659__cal_impl.Encode2_P2_h "" VALUE 0x0083C110 Scalar_FLOAT64_IEEE 0 speedgoat_test_SN5659_R2021b_IO682_CM_double -1.7E+308 1.7E+308 /end CHARACTERISTIC
/begin CHARACTERISTIC speedgoat_test_SN5659__cal_impl.Encode2_P2_i "" VALUE 0x0083ADC0 Scalar_FLOAT64_IEEE 0 speedgoat_test_SN5659_R2021b_IO682_CM_double -1.7E+308 1.7E+308 /end CHARACTERISTIC
/begin CHARACTERISTIC speedgoat_test_SN5659__cal_impl.Encode2_P2_k "" VALUE 0x0083B430 Scalar_FLOAT64_IEEE 0 speedgoat_test_SN5659_R2021b_IO682_CM_double -1.7E+308 1.7E+308 /end CHARACTERISTIC
/begin CHARACTERISTIC speedgoat_test_SN5659__cal_impl.Encode2_P2_kr "" VALUE 0x0083C780 Scalar_FLOAT64_IEEE 0 speedgoat_test_SN5659_R2021b_IO682_CM_double -1.7E+308 1.7E+308 /end CHARACTERISTIC
/begin CHARACTERISTIC speedgoat_test_SN5659__cal_impl.Encode2_P2_mu "" VALUE 0x0083D460 Scalar_FLOAT64_IEEE 0 speedgoat_test_SN5659_R2021b_IO682_CM_double -1.7E+308 1.7E+308 /end CHARACTERISTIC
/begin CHARACTERISTIC speedgoat_test_SN5659__cal_impl.Encode2_P3_f "" VALUE 0x0083C128 Scalar_FLOAT64_IEEE 0 speedgoat_test_SN5659_R2021b_IO682_CM_double -1.7E+308 1.7E+308 /end CHARACTERISTIC
/begin CHARACTERISTIC speedgoat_test_SN5659__cal_impl.Encode2_P3_g "" VALUE 0x0083BDE8 Scalar_FLOAT64_IEEE 0 speedgoat_test_SN5659_R2021b_IO682_CM_double -1.7E+308 1.7E+308 /end CHARACTERISTIC
/begin CHARACTERISTIC speedgoat_test_SN5659__cal_impl.Encode2_P3_i "" VALUE 0x0083CE08 Scalar_FLOAT64_IEEE 0 speedgoat_test_SN5659_R2021b_IO682_CM_double -1.7E+308 1.7E+308 /end CHARACTERISTIC
/begin CHARACTERISTIC speedgoat_test_SN5659__cal_impl.Encode2_P3_j "" VALUE 0x0083C798 Scalar_FLOAT64_IEEE 0 speedgoat_test_SN5659_R2021b_IO682_CM_double -1.7E+308 1.7E+308 /end CHARACTERISTIC
/begin CHARACTERISTIC speedgoat_test_SN5659__cal_impl.Encode2_P3_jd "" VALUE 0x0083D478 Scalar_FLOAT64_IEEE 0 speedgoat_test_SN5659_R2021b_IO682_CM_double -1.7E+308 1.7E+308 /end CHARACTERISTIC
/begin CHARACTERISTIC speedgoat_test_SN5659__cal_impl.Encode2_P3_k "" VALUE 0x0083ADD8 Scalar_FLOAT64_IEEE 0 speedgoat_test_SN5659_R2021b_IO682_CM_double -1.7E+308 1.7E+308 /end CHARACTERISTIC
/begin CHARACTERISTIC speedgoat_test_SN5659__cal_impl.Encode2_P3_l "" VALUE 0x0083B448 Scalar_FLOAT64_IEEE 0 speedgoat_test_SN5659_R2021b_IO682_CM_double -1.7E+308 1.7E+308 /end CHARACTERISTIC
/begin CHARACTERISTIC speedgoat_test_SN5659__cal_impl.Encode2_P4_b "" VALUE 0x0083C140 Scalar_FLOAT64_IEEE 0 speedgoat_test_SN5659_R2021b_IO682_CM_double -1.7E+308 1.7E+308 /end CHARACTERISTIC
/begin CHARACTERISTIC speedgoat_test_SN5659__cal_impl.Encode2_P4_g0 "" VALUE 0x0083D490 Scalar_FLOAT64_IEEE 0 speedgoat_test_SN5659_R2021b_IO682_CM_double -1.7E+308 1.7E+308 /end CHARACTERISTIC
/begin CHARACTERISTIC speedgoat_test_SN5659__cal_impl.Encode2_P4_j "" VALUE 0x0083B460 Scalar_FLOAT64_IEEE 0 speedgoat_test_SN5659_R2021b_IO682_CM_double -1.7E+308 1.7E+308 /end CHARACTERISTIC
/begin CHARACTERISTIC speedgoat_test_SN5659__cal_impl.Encode2_P4_l "" VALUE 0x0083CE20 Scalar_FLOAT64_IEEE 0 speedgoat_test_SN5659_R2021b_IO682_CM_double -1.7E+308 1.7E+308 /end CHARACTERISTIC
/begin CHARACTERISTIC speedgoat_test_SN5659__cal_impl.Encode2_P4_m "" VALUE 0x0083BE00 Scalar_FLOAT64_IEEE 0 speedgoat_test_SN5659_R2021b_IO682_CM_double -1.7E+308 1.7E+308 /end CHARACTERISTIC
/begin CHARACTERISTIC speedgoat_test_SN5659__cal_impl.Encode2_P4_o "" VALUE 0x0083ADF0 Scalar_FLOAT64_IEEE 0 speedgoat_test_SN5659_R2021b_IO682_CM_double -1.7E+308 1.7E+308 /end CHARACTERISTIC
/begin CHARACTERISTIC speedgoat_test_SN5659__cal_impl.Encode2_P4_o0 "" VALUE 0x0083C7B0 Scalar_FLOAT64_IEEE 0 speedgoat_test_SN5659_R2021b_IO682_CM_double -1.7E+308 1.7E+308 /end CHARACTERISTIC
/begin CHARACTERISTIC speedgoat_test_SN5659__cal_impl.Encode2_P5_d "" VALUE 0x0083B478 Scalar_FLOAT64_IEEE 0 speedgoat_test_SN5659_R2021b_IO682_CM_double -1.7E+308 1.7E+308 /end CHARACTERISTIC
/begin CHARACTERISTIC speedgoat_test_SN5659__cal_impl.Encode2_P5_h "" VALUE 0x0083D4A8 Scalar_FLOAT64_IEEE 0 speedgoat_test_SN5659_R2021b_IO682_CM_double -1.7E+308 1.7E+308 /end CHARACTERISTIC
/begin CHARACTERISTIC speedgoat_test_SN5659__cal_impl.Encode2_P5_j "" VALUE 0x0083BE18 Scalar_FLOAT64_IEEE 0 speedgoat_test_SN5659_R2021b_IO682_CM_double -1.7E+308 1.7E+308 /end CHARACTERISTIC
/begin CHARACTERISTIC speedgoat_test_SN5659__cal_impl.Encode2_P5_l "" VALUE 0x0083AE08 Scalar_FLOAT64_IEEE 0 speedgoat_test_SN5659_R2021b_IO682_CM_double -1.7E+308 1.7E+308 /end CHARACTERISTIC
/begin CHARACTERISTIC speedgoat_test_SN5659__cal_impl.Encode2_P5_m "" VALUE 0x0083C7C8 Scalar_FLOAT64_IEEE 0 speedgoat_test_SN5659_R2021b_IO682_CM_double -1.7E+308 1.7E+308 /end CHARACTERISTIC
/begin CHARACTERISTIC speedgoat_test_SN5659__cal_impl.Encode2_P5_p "" VALUE 0x0083C158 Scalar_FLOAT64_IEEE 0 speedgoat_test_SN5659_R2021b_IO682_CM_double -1.7E+308 1.7E+308 /end CHARACTERISTIC
/begin CHARACTERISTIC speedgoat_test_SN5659__cal_impl.Encode2_P5_p4 "" VALUE 0x0083CE38 Scalar_FLOAT64_IEEE 0 speedgoat_test_SN5659_R2021b_IO682_CM_double -1.7E+308 1.7E+308 /end CHARACTERISTIC
/begin CHARACTERISTIC speedgoat_test_SN5659__cal_impl.Encode2_P6_d "" VALUE 0x0083CE50 Scalar_FLOAT64_IEEE 0 speedgoat_test_SN5659_R2021b_IO682_CM_double -1.7E+308 1.7E+308 /end CHARACTERISTIC
/begin CHARACTERISTIC speedgoat_test_SN5659__cal_impl.Encode2_P6_d2 "" VALUE 0x0083D4C0 Scalar_FLOAT64_IEEE 0 speedgoat_test_SN5659_R2021b_IO682_CM_double -1.7E+308 1.7E+308 /end CHARACTERISTIC
/begin CHARACTERISTIC speedgoat_test_SN5659__cal_impl.Encode2_P6_e "" VALUE 0x0083B490 Scalar_FLOAT64_IEEE 0 speedgoat_test_SN5659_R2021b_IO682_CM_double -1.7E+308 1.7E+308 /end CHARACTERISTIC
/begin CHARACTERISTIC speedgoat_test_SN5659__cal_impl.Encode2_P6_i "" VALUE 0x0083C7E0 Scalar_FLOAT64_IEEE 0 speedgoat_test_SN5659_R2021b_IO682_CM_double -1.7E+308 1.7E+308 /end CHARACTERISTIC
/begin CHARACTERISTIC speedgoat_test_SN5659__cal_impl.Encode2_P6_l "" VALUE 0x0083C170 Scalar_FLOAT64_IEEE 0 speedgoat_test_SN5659_R2021b_IO682_CM_double -1.7E+308 1.7E+308 /end CHARACTERISTIC
/begin CHARACTERISTIC speedgoat_test_SN5659__cal_impl.Encode2_P6_m "" VALUE 0x0083BE30 Scalar_FLOAT64_IEEE 0 speedgoat_test_SN5659_R2021b_IO682_CM_double -1.7E+308 1.7E+308 /end CHARACTERISTIC
/begin CHARACTERISTIC speedgoat_test_SN5659__cal_impl.Encode2_P6_n "" VALUE 0x0083AE20 Scalar_FLOAT64_IEEE 0 speedgoat_test_SN5659_R2021b_IO682_CM_double -1.7E+308 1.7E+308 /end CHARACTERISTIC
/begin CHARACTERISTIC speedgoat_test_SN5659__cal_impl.Encode2_P7_b "" VALUE 0x0083AE38 Scalar_FLOAT64_IEEE 0 speedgoat_test_SN5659_R2021b_IO682_CM_double -1.7E+308 1.7E+308 /end CHARACTERISTIC
/begin CHARACTERISTIC speedgoat_test_SN5659__cal_impl.Encode2_P7_bh "" VALUE 0x0083CE68 Scalar_FLOAT64_IEEE 0 speedgoat_test_SN5659_R2021b_IO682_CM_double -1.7E+308 1.7E+308 /end CHARACTERISTIC
/begin CHARACTERISTIC speedgoat_test_SN5659__cal_impl.Encode2_P7_f "" VALUE 0x0083B4A8 Scalar_FLOAT64_IEEE 0 speedgoat_test_SN5659_R2021b_IO682_CM_double -1.7E+308 1.7E+308 /end CHARACTERISTIC
/begin CHARACTERISTIC speedgoat_test_SN5659__cal_impl.Encode2_P7_i "" VALUE 0x0083D4D8 Scalar_FLOAT64_IEEE 0 speedgoat_test_SN5659_R2021b_IO682_CM_double -1.7E+308 1.7E+308 /end CHARACTERISTIC
/begin CHARACTERISTIC speedgoat_test_SN5659__cal_impl.Encode2_P7_j "" VALUE 0x0083BE48 Scalar_FLOAT64_IEEE 0 speedgoat_test_SN5659_R2021b_IO682_CM_double -1.7E+308 1.7E+308 /end CHARACTERISTIC
/begin CHARACTERISTIC speedgoat_test_SN5659__cal_impl.Encode2_P7_jh "" VALUE 0x0083C188 Scalar_FLOAT64_IEEE 0 speedgoat_test_SN5659_R2021b_IO682_CM_double -1.7E+308 1.7E+308 /end CHARACTERISTIC
/begin CHARACTERISTIC speedgoat_test_SN5659__cal_impl.Encode2_P7_k "" VALUE 0x0083C7F8 Scalar_FLOAT64_IEEE 0 speedgoat_test_SN5659_R2021b_IO682_CM_double -1.7E+308 1.7E+308 /end CHARACTERISTIC
/begin CHARACTERISTIC speedgoat_test_SN5659__cal_impl.Encode2_P8_d "" VALUE 0x0083CE80 Scalar_FLOAT64_IEEE 0 speedgoat_test_SN5659_R2021b_IO682_CM_double -1.7E+308 1.7E+308 /end CHARACTERISTIC
/begin CHARACTERISTIC speedgoat_test_SN5659__cal_impl.Encode2_P8_h "" VALUE 0x0083AE50 Scalar_FLOAT64_IEEE 0 speedgoat_test_SN5659_R2021b_IO682_CM_double -1.7E+308 1.7E+308 /end CHARACTERISTIC
/begin CHARACTERISTIC speedgoat_test_SN5659__cal_impl.Encode2_P8_h3 "" VALUE 0x0083C810 Scalar_FLOAT64_IEEE 0 speedgoat_test_SN5659_R2021b_IO682_CM_double -1.7E+308 1.7E+308 /end CHARACTERISTIC
/begin CHARACTERISTIC speedgoat_test_SN5659__cal_impl.Encode2_P8_i "" VALUE 0x0083B4C0 Scalar_FLOAT64_IEEE 0 speedgoat_test_SN5659_R2021b_IO682_CM_double -1.7E+308 1.7E+308 /end CHARACTERISTIC
/begin CHARACTERISTIC speedgoat_test_SN5659__cal_impl.Encode2_P8_iw "" VALUE 0x0083BE60 Scalar_FLOAT64_IEEE 0 speedgoat_test_SN5659_R2021b_IO682_CM_double -1.7E+308 1.7E+308 /end CHARACTERISTIC
/begin CHARACTERISTIC speedgoat_test_SN5659__cal_impl.Encode2_P8_j "" VALUE 0x0083D4F0 Scalar_FLOAT64_IEEE 0 speedgoat_test_SN5659_R2021b_IO682_CM_double -1.7E+308 1.7E+308 /end CHARACTERISTIC
/begin CHARACTERISTIC speedgoat_test_SN5659__cal_impl.Encode2_P8_n "" VALUE 0x0083C1A0 Scalar_FLOAT64_IEEE 0 speedgoat_test_SN5659_R2021b_IO682_CM_double -1.7E+308 1.7E+308 /end CHARACTERISTIC
/begin CHARACTERISTIC speedgoat_test_SN5659__cal_impl.Encode2_P9_a "" VALUE 0x0083C828 Scalar_FLOAT64_IEEE 0 speedgoat_test_SN5659_R2021b_IO682_CM_double -1.7E+308 1.7E+308 /end CHARACTERISTIC
/begin CHARACTERISTIC speedgoat_test_SN5659__cal_impl.Encode2_P9_d "" VALUE 0x0083CE98 Scalar_FLOAT64_IEEE 0 speedgoat_test_SN5659_R2021b_IO682_CM_double -1.7E+308 1.7E+308 /end CHARACTERISTIC
/begin CHARACTERISTIC speedgoat_test_SN5659__cal_impl.Encode2_P9_h "" VALUE 0x0083C1B8 Scalar_FLOAT64_IEEE 0 speedgoat_test_SN5659_R2021b_IO682_CM_double -1.7E+308 1.7E+308 /end CHARACTERISTIC
/begin CHARACTERISTIC speedgoat_test_SN5659__cal_impl.Encode2_P9_m "" VALUE 0x0083AE68 Scalar_FLOAT64_IEEE 0 speedgoat_test_SN5659_R2021b_IO682_CM_double -1.7E+308 1.7E+308 /end CHARACTERISTIC
/begin CHARACTERISTIC speedgoat_test_SN5659__cal_impl.Encode2_P9_n "" VALUE 0x0083D508 Scalar_FLOAT64_IEEE 0 speedgoat_test_SN5659_R2021b_IO682_CM_double -1.7E+308 1.7E+308 /end CHARACTERISTIC
/begin CHARACTERISTIC speedgoat_test_SN5659__cal_impl.Encode2_P9_pd "" VALUE 0x0083BE78 Scalar_FLOAT64_IEEE 0 speedgoat_test_SN5659_R2021b_IO682_CM_double -1.7E+308 1.7E+308 /end CHARACTERISTIC
/begin CHARACTERISTIC speedgoat_test_SN5659__cal_impl.Encode2_P9_pe "" VALUE 0x0083B4D8 Scalar_FLOAT64_IEEE 0 speedgoat_test_SN5659_R2021b_IO682_CM_double -1.7E+308 1.7E+308 /end CHARACTERISTIC
/begin CHARACTERISTIC speedgoat_test_SN5659__cal_impl.Encode3_P10_j "" VALUE 0x0083B028 Scalar_FLOAT64_IEEE 0 speedgoat_test_SN5659_R2021b_IO682_CM_double -1.7E+308 1.7E+308 /end CHARACTERISTIC
/begin CHARACTERISTIC speedgoat_test_SN5659__cal_impl.Encode3_P10_l "" VALUE 0x0083BD08 Scalar_FLOAT64_IEEE 0 speedgoat_test_SN5659_R2021b_IO682_CM_double -1.7E+308 1.7E+308 /end CHARACTERISTIC
/begin CHARACTERISTIC speedgoat_test_SN5659__cal_impl.Encode3_P10_l1 "" VALUE 0x0083C378 Scalar_FLOAT64_IEEE 0 speedgoat_test_SN5659_R2021b_IO682_CM_double -1.7E+308 1.7E+308 /end CHARACTERISTIC
/begin CHARACTERISTIC speedgoat_test_SN5659__cal_impl.Encode3_P10_lx "" VALUE 0x0083C9E8 Scalar_FLOAT64_IEEE 0 speedgoat_test_SN5659_R2021b_IO682_CM_double -1.7E+308 1.7E+308 /end CHARACTERISTIC
/begin CHARACTERISTIC speedgoat_test_SN5659__cal_impl.Encode3_P10_m "" VALUE 0x0083B698 Scalar_FLOAT64_IEEE 0 speedgoat_test_SN5659_R2021b_IO682_CM_double -1.7E+308 1.7E+308 /end CHARACTERISTIC
/begin CHARACTERISTIC speedgoat_test_SN5659__cal_impl.Encode3_P10_o "" VALUE 0x0083D058 Scalar_FLOAT64_IEEE 0 speedgoat_test_SN5659_R2021b_IO682_CM_double -1.7E+308 1.7E+308 /end CHARACTERISTIC
/begin CHARACTERISTIC speedgoat_test_SN5659__cal_impl.Encode3_P10_p "" VALUE 0x0083D6C8 Scalar_FLOAT64_IEEE 0 speedgoat_test_SN5659_R2021b_IO682_CM_double -1.7E+308 1.7E+308 /end CHARACTERISTIC
/begin CHARACTERISTIC speedgoat_test_SN5659__cal_impl.Encode3_P11_c "" VAL_BLK 0x0083C390 Scalar_FLOAT64_IEEE 0 speedgoat_test_SN5659_R2021b_IO682_CM_double -1.7E+308 1.7E+308 MATRIX_DIM 2 1 /end CHARACTERISTIC
/begin CHARACTERISTIC speedgoat_test_SN5659__cal_impl.Encode3_P11_h "" VAL_BLK 0x0083BD20 Scalar_FLOAT64_IEEE 0 speedgoat_test_SN5659_R2021b_IO682_CM_double -1.7E+308 1.7E+308 MATRIX_DIM 2 1 /end CHARACTERISTIC
/begin CHARACTERISTIC speedgoat_test_SN5659__cal_impl.Encode3_P11_h0 "" VAL_BLK 0x0083D070 Scalar_FLOAT64_IEEE 0 speedgoat_test_SN5659_R2021b_IO682_CM_double -1.7E+308 1.7E+308 MATRIX_DIM 2 1 /end CHARACTERISTIC
/begin CHARACTERISTIC speedgoat_test_SN5659__cal_impl.Encode3_P11_i "" VAL_BLK 0x0083B6B0 Scalar_FLOAT64_IEEE 0 speedgoat_test_SN5659_R2021b_IO682_CM_double -1.7E+308 1.7E+308 MATRIX_DIM 2 1 /end CHARACTERISTIC
/begin CHARACTERISTIC speedgoat_test_SN5659__cal_impl.Encode3_P11_j "" VAL_BLK 0x0083B040 Scalar_FLOAT64_IEEE 0 speedgoat_test_SN5659_R2021b_IO682_CM_double -1.7E+308 1.7E+308 MATRIX_DIM 2 1 /end CHARACTERISTIC
/begin CHARACTERISTIC speedgoat_test_SN5659__cal_impl.Encode3_P11_jq "" VAL_BLK 0x0083D6E0 Scalar_FLOAT64_IEEE 0 speedgoat_test_SN5659_R2021b_IO682_CM_double -1.7E+308 1.7E+308 MATRIX_DIM 2 1 /end CHARACTERISTIC
/begin CHARACTERISTIC speedgoat_test_SN5659__cal_impl.Encode3_P11_m "" VAL_BLK 0x0083CA00 Scalar_FLOAT64_IEEE 0 speedgoat_test_SN5659_R2021b_IO682_CM_double -1.7E+308 1.7E+308 MATRIX_DIM 2 1 /end CHARACTERISTIC
/begin CHARACTERISTIC speedgoat_test_SN5659__cal_impl.Encode3_P12_b "" VALUE 0x0083B6D0 Scalar_FLOAT64_IEEE 0 speedgoat_test_SN5659_R2021b_IO682_CM_double -1.7E+308 1.7E+308 /end CHARACTERISTIC
/begin CHARACTERISTIC speedgoat_test_SN5659__cal_impl.Encode3_P12_c "" VALUE 0x0083BD40 Scalar_FLOAT64_IEEE 0 speedgoat_test_SN5659_R2021b_IO682_CM_double -1.7E+308 1.7E+308 /end CHARACTERISTIC
/begin CHARACTERISTIC speedgoat_test_SN5659__cal_impl.Encode3_P12_d "" VALUE 0x0083D700 Scalar_FLOAT64_IEEE 0 speedgoat_test_SN5659_R2021b_IO682_CM_double -1.7E+308 1.7E+308 /end CHARACTERISTIC
/begin CHARACTERISTIC speedgoat_test_SN5659__cal_impl.Encode3_P12_i "" VALUE 0x0083CA20 Scalar_FLOAT64_IEEE 0 speedgoat_test_SN5659_R2021b_IO682_CM_double -1.7E+308 1.7E+308 /end CHARACTERISTIC
/begin CHARACTERISTIC speedgoat_test_SN5659__cal_impl.Encode3_P12_j "" VALUE 0x0083B060 Scalar_FLOAT64_IEEE 0 speedgoat_test_SN5659_R2021b_IO682_CM_double -1.7E+308 1.7E+308 /end CHARACTERISTIC
/begin CHARACTERISTIC speedgoat_test_SN5659__cal_impl.Encode3_P12_k "" VALUE 0x0083D090 Scalar_FLOAT64_IEEE 0 speedgoat_test_SN5659_R2021b_IO682_CM_double -1.7E+308 1.7E+308 /end CHARACTERISTIC
/begin CHARACTERISTIC speedgoat_test_SN5659__cal_impl.Encode3_P12_p "" VALUE 0x0083C3B0 Scalar_FLOAT64_IEEE 0 speedgoat_test_SN5659_R2021b_IO682_CM_double -1.7E+308 1.7E+308 /end CHARACTERISTIC
/begin CHARACTERISTIC speedgoat_test_SN5659__cal_impl.Encode3_P13_e "" VALUE 0x0083BD58 Scalar_FLOAT64_IEEE 0 speedgoat_test_SN5659_R2021b_IO682_CM_double -1.7E+308 1.7E+308 /end CHARACTERISTIC
/begin CHARACTERISTIC speedgoat_test_SN5659__cal_impl.Encode3_P13_g "" VALUE 0x0083B6E8 Scalar_FLOAT64_IEEE 0 speedgoat_test_SN5659_R2021b_IO682_CM_double -1.7E+308 1.7E+308 /end CHARACTERISTIC
/begin CHARACTERISTIC speedgoat_test_SN5659__cal_impl.Encode3_P13_h "" VALUE 0x0083D718 Scalar_FLOAT64_IEEE 0 speedgoat_test_SN5659_R2021b_IO682_CM_double -1.7E+308 1.7E+308 /end CHARACTERISTIC
/begin CHARACTERISTIC speedgoat_test_SN5659__cal_impl.Encode3_P13_i "" VALUE 0x0083B078 Scalar_FLOAT64_IEEE 0 speedgoat_test_SN5659_R2021b_IO682_CM_double -1.7E+308 1.7E+308 /end CHARACTERISTIC
/begin CHARACTERISTIC speedgoat_test_SN5659__cal_impl.Encode3_P13_k "" VALUE 0x0083CA38 Scalar_FLOAT64_IEEE 0 speedgoat_test_SN5659_R2021b_IO682_CM_double -1.7E+308 1.7E+308 /end CHARACTERISTIC
/begin CHARACTERISTIC speedgoat_test_SN5659__cal_impl.Encode3_P13_ka "" VALUE 0x0083D0A8 Scalar_FLOAT64_IEEE 0 speedgoat_test_SN5659_R2021b_IO682_CM_double -1.7E+308 1.7E+308 /end CHARACTERISTIC
/begin CHARACTERISTIC speedgoat_test_SN5659__cal_impl.Encode3_P13_p "" VALUE 0x0083C3C8 Scalar_FLOAT64_IEEE 0 speedgoat_test_SN5659_R2021b_IO682_CM_double -1.7E+308 1.7E+308 /end CHARACTERISTIC
/begin CHARACTERISTIC speedgoat_test_SN5659__cal_impl.Encode3_P14_b "" VALUE 0x0083BD70 Scalar_FLOAT64_IEEE 0 speedgoat_test_SN5659_R2021b_IO682_CM_double -1.7E+308 1.7E+308 /end CHARACTERISTIC
/begin CHARACTERISTIC speedgoat_test_SN5659__cal_impl.Encode3_P14_d "" VALUE 0x0083B090 Scalar_FLOAT64_IEEE 0 speedgoat_test_SN5659_R2021b_IO682_CM_double -1.7E+308 1.7E+308 /end CHARACTERISTIC
/begin CHARACTERISTIC speedgoat_test_SN5659__cal_impl.Encode3_P14_f "" VALUE 0x0083C3E0 Scalar_FLOAT64_IEEE 0 speedgoat_test_SN5659_R2021b_IO682_CM_double -1.7E+308 1.7E+308 /end CHARACTERISTIC
/begin CHARACTERISTIC speedgoat_test_SN5659__cal_impl.Encode3_P14_m "" VALUE 0x0083CA50 Scalar_FLOAT64_IEEE 0 speedgoat_test_SN5659_R2021b_IO682_CM_double -1.7E+308 1.7E+308 /end CHARACTERISTIC
/begin CHARACTERISTIC speedgoat_test_SN5659__cal_impl.Encode3_P14_n "" VALUE 0x0083D0C0 Scalar_FLOAT64_IEEE 0 speedgoat_test_SN5659_R2021b_IO682_CM_double -1.7E+308 1.7E+308 /end CHARACTERISTIC
/begin CHARACTERISTIC speedgoat_test_SN5659__cal_impl.Encode3_P14_ny "" VALUE 0x0083D730 Scalar_FLOAT64_IEEE 0 speedgoat_test_SN5659_R2021b_IO682_CM_double -1.7E+308 1.7E+308 /end CHARACTERISTIC
/begin CHARACTERISTIC speedgoat_test_SN5659__cal_impl.Encode3_P14_o "" VALUE 0x0083B700 Scalar_FLOAT64_IEEE 0 speedgoat_test_SN5659_R2021b_IO682_CM_double -1.7E+308 1.7E+308 /end CHARACTERISTIC
/begin CHARACTERISTIC speedgoat_test_SN5659__cal_impl.Encode3_P15_b "" VALUE 0x0083CA68 Scalar_FLOAT64_IEEE 0 speedgoat_test_SN5659_R2021b_IO682_CM_double -1.7E+308 1.7E+308 /end CHARACTERISTIC
/begin CHARACTERISTIC speedgoat_test_SN5659__cal_impl.Encode3_P15_c "" VALUE 0x0083D0D8 Scalar_FLOAT64_IEEE 0 speedgoat_test_SN5659_R2021b_IO682_CM_double -1.7E+308 1.7E+308 /end CHARACTERISTIC
/begin CHARACTERISTIC speedgoat_test_SN5659__cal_impl.Encode3_P15_g "" VALUE 0x0083D748 Scalar_FLOAT64_IEEE 0 speedgoat_test_SN5659_R2021b_IO682_CM_double -1.7E+308 1.7E+308 /end CHARACTERISTIC
/begin CHARACTERISTIC speedgoat_test_SN5659__cal_impl.Encode3_P15_h "" VALUE 0x0083B0A8 Scalar_FLOAT64_IEEE 0 speedgoat_test_SN5659_R2021b_IO682_CM_double -1.7E+308 1.7E+308 /end CHARACTERISTIC
/begin CHARACTERISTIC speedgoat_test_SN5659__cal_impl.Encode3_P15_hk "" VALUE 0x0083B718 Scalar_FLOAT64_IEEE 0 speedgoat_test_SN5659_R2021b_IO682_CM_double -1.7E+308 1.7E+308 /end CHARACTERISTIC
/begin CHARACTERISTIC speedgoat_test_SN5659__cal_impl.Encode3_P15_hl "" VALUE 0x0083C3F8 Scalar_FLOAT64_IEEE 0 speedgoat_test_SN5659_R2021b_IO682_CM_double -1.7E+308 1.7E+308 /end CHARACTERISTIC
/begin CHARACTERISTIC speedgoat_test_SN5659__cal_impl.Encode3_P15_i "" VALUE 0x0083BD88 Scalar_FLOAT64_IEEE 0 speedgoat_test_SN5659_R2021b_IO682_CM_double -1.7E+308 1.7E+308 /end CHARACTERISTIC
/begin CHARACTERISTIC speedgoat_test_SN5659__cal_impl.Encode3_P1_a "" VALUE 0x0083C2A0 Scalar_FLOAT64_IEEE 0 speedgoat_test_SN5659_R2021b_IO682_CM_double -1.7E+308 1.7E+308 /end CHARACTERISTIC
/begin CHARACTERISTIC speedgoat_test_SN5659__cal_impl.Encode3_P1_e "" VALUE 0x0083AF50 Scalar_FLOAT64_IEEE 0 speedgoat_test_SN5659_R2021b_IO682_CM_double -1.7E+308 1.7E+308 /end CHARACTERISTIC
/begin CHARACTERISTIC speedgoat_test_SN5659__cal_impl.Encode3_P1_i "" VALUE 0x0083BC30 Scalar_FLOAT64_IEEE 0 speedgoat_test_SN5659_R2021b_IO682_CM_double -1.7E+308 1.7E+308 /end CHARACTERISTIC
/begin CHARACTERISTIC speedgoat_test_SN5659__cal_impl.Encode3_P1_m "" VALUE 0x0083D5F0 Scalar_FLOAT64_IEEE 0 speedgoat_test_SN5659_R2021b_IO682_CM_double -1.7E+308 1.7E+308 /end CHARACTERISTIC
/begin CHARACTERISTIC speedgoat_test_SN5659__cal_impl.Encode3_P1_n "" VALUE 0x0083B5C0 Scalar_FLOAT64_IEEE 0 speedgoat_test_SN5659_R2021b_IO682_CM_double -1.7E+308 1.7E+308 /end CHARACTERISTIC
/begin CHARACTERISTIC speedgoat_test_SN5659__cal_impl.Encode3_P1_nj "" VALUE 0x0083C910 Scalar_FLOAT64_IEEE 0 speedgoat_test_SN5659_R2021b_IO682_CM_double -1.7E+308 1.7E+308 /end CHARACTERISTIC
/begin CHARACTERISTIC speedgoat_test_SN5659__cal_impl.Encode3_P1_nj3 "" VALUE 0x0083CF80 Scalar_FLOAT64_IEEE 0 speedgoat_test_SN5659_R2021b_IO682_CM_double -1.7E+308 1.7E+308 /end CHARACTERISTIC
/begin CHARACTERISTIC speedgoat_test_SN5659__cal_impl.Encode3_P2_a "" VALUE 0x0083BC48 Scalar_FLOAT64_IEEE 0 speedgoat_test_SN5659_R2021b_IO682_CM_double -1.7E+308 1.7E+308 /end CHARACTERISTIC
/begin CHARACTERISTIC speedgoat_test_SN5659__cal_impl.Encode3_P2_b "" VALUE 0x0083C2B8 Scalar_FLOAT64_IEEE 0 speedgoat_test_SN5659_R2021b_IO682_CM_double -1.7E+308 1.7E+308 /end CHARACTERISTIC
/begin CHARACTERISTIC speedgoat_test_SN5659__cal_impl.Encode3_P2_f "" VALUE 0x0083AF68 Scalar_FLOAT64_IEEE 0 speedgoat_test_SN5659_R2021b_IO682_CM_double -1.7E+308 1.7E+308 /end CHARACTERISTIC
/begin CHARACTERISTIC speedgoat_test_SN5659__cal_impl.Encode3_P2_h "" VALUE 0x0083CF98 Scalar_FLOAT64_IEEE 0 speedgoat_test_SN5659_R2021b_IO682_CM_double -1.7E+308 1.7E+308 /end CHARACTERISTIC
/begin CHARACTERISTIC speedgoat_test_SN5659__cal_impl.Encode3_P2_i "" VALUE 0x0083B5D8 Scalar_FLOAT64_IEEE 0 speedgoat_test_SN5659_R2021b_IO682_CM_double -1.7E+308 1.7E+308 /end CHARACTERISTIC
/begin CHARACTERISTIC speedgoat_test_SN5659__cal_impl.Encode3_P2_m "" VALUE 0x0083D608 Scalar_FLOAT64_IEEE 0 speedgoat_test_SN5659_R2021b_IO682_CM_double -1.7E+308 1.7E+308 /end CHARACTERISTIC
/begin CHARACTERISTIC speedgoat_test_SN5659__cal_impl.Encode3_P2_n "" VALUE 0x0083C928 Scalar_FLOAT64_IEEE 0 speedgoat_test_SN5659_R2021b_IO682_CM_double -1.7E+308 1.7E+308 /end CHARACTERISTIC
/begin CHARACTERISTIC speedgoat_test_SN5659__cal_impl.Encode3_P3_b "" VALUE 0x0083AF80 Scalar_FLOAT64_IEEE 0 speedgoat_test_SN5659_R2021b_IO682_CM_double -1.7E+308 1.7E+308 /end CHARACTERISTIC
/begin CHARACTERISTIC speedgoat_test_SN5659__cal_impl.Encode3_P3_c "" VALUE 0x0083BC60 Scalar_FLOAT64_IEEE 0 speedgoat_test_SN5659_R2021b_IO682_CM_double -1.7E+308 1.7E+308 /end CHARACTERISTIC
/begin CHARACTERISTIC speedgoat_test_SN5659__cal_impl.Encode3_P3_d "" VALUE 0x0083CFB0 Scalar_FLOAT64_IEEE 0 speedgoat_test_SN5659_R2021b_IO682_CM_double -1.7E+308 1.7E+308 /end CHARACTERISTIC
/begin CHARACTERISTIC speedgoat_test_SN5659__cal_impl.Encode3_P3_g "" VALUE 0x0083C2D0 Scalar_FLOAT64_IEEE 0 speedgoat_test_SN5659_R2021b_IO682_CM_double -1.7E+308 1.7E+308 /end CHARACTERISTIC
/begin CHARACTERISTIC speedgoat_test_SN5659__cal_impl.Encode3_P3_gs "" VALUE 0x0083D620 Scalar_FLOAT64_IEEE 0 speedgoat_test_SN5659_R2021b_IO682_CM_double -1.7E+308 1.7E+308 /end CHARACTERISTIC
/begin CHARACTERISTIC speedgoat_test_SN5659__cal_impl.Encode3_P3_j "" VALUE 0x0083B5F0 Scalar_FLOAT64_IEEE 0 speedgoat_test_SN5659_R2021b_IO682_CM_double -1.7E+308 1.7E+308 /end CHARACTERISTIC
/begin CHARACTERISTIC speedgoat_test_SN5659__cal_impl.Encode3_P3_nc "" VALUE 0x0083C940 Scalar_FLOAT64_IEEE 0 speedgoat_test_SN5659_R2021b_IO682_CM_double -1.7E+308 1.7E+308 /end CHARACTERISTIC
/begin CHARACTERISTIC speedgoat_test_SN5659__cal_impl.Encode3_P4_b "" VALUE 0x0083C2E8 Scalar_FLOAT64_IEEE 0 speedgoat_test_SN5659_R2021b_IO682_CM_double -1.7E+308 1.7E+308 /end CHARACTERISTIC
/begin CHARACTERISTIC speedgoat_test_SN5659__cal_impl.Encode3_P4_d "" VALUE 0x0083AF98 Scalar_FLOAT64_IEEE 0 speedgoat_test_SN5659_R2021b_IO682_CM_double -1.7E+308 1.7E+308 /end CHARACTERISTIC
/begin CHARACTERISTIC speedgoat_test_SN5659__cal_impl.Encode3_P4_dt "" VALUE 0x0083D638 Scalar_FLOAT64_IEEE 0 speedgoat_test_SN5659_R2021b_IO682_CM_double -1.7E+308 1.7E+308 /end CHARACTERISTIC
/begin CHARACTERISTIC speedgoat_test_SN5659__cal_impl.Encode3_P4_h "" VALUE 0x0083CFC8 Scalar_FLOAT64_IEEE 0 speedgoat_test_SN5659_R2021b_IO682_CM_double -1.7E+308 1.7E+308 /end CHARACTERISTIC
/begin CHARACTERISTIC speedgoat_test_SN5659__cal_impl.Encode3_P4_l "" VALUE 0x0083B608 Scalar_FLOAT64_IEEE 0 speedgoat_test_SN5659_R2021b_IO682_CM_double -1.7E+308 1.7E+308 /end CHARACTERISTIC
/begin CHARACTERISTIC speedgoat_test_SN5659__cal_impl.Encode3_P4_ls "" VALUE 0x0083BC78 Scalar_FLOAT64_IEEE 0 speedgoat_test_SN5659_R2021b_IO682_CM_double -1.7E+308 1.7E+308 /end CHARACTERISTIC
/begin CHARACTERISTIC speedgoat_test_SN5659__cal_impl.Encode3_P4_m "" VALUE 0x0083C958 Scalar_FLOAT64_IEEE 0 speedgoat_test_SN5659_R2021b_IO682_CM_double -1.7E+308 1.7E+308 /end CHARACTERISTIC
/begin CHARACTERISTIC speedgoat_test_SN5659__cal_impl.Encode3_P5_b "" VALUE 0x0083B620 Scalar_FLOAT64_IEEE 0 speedgoat_test_SN5659_R2021b_IO682_CM_double -1.7E+308 1.7E+308 /end CHARACTERISTIC
/begin CHARACTERISTIC speedgoat_test_SN5659__cal_impl.Encode3_P5_bo "" VALUE 0x0083BC90 Scalar_FLOAT64_IEEE 0 speedgoat_test_SN5659_R2021b_IO682_CM_double -1.7E+308 1.7E+308 /end CHARACTERISTIC
/begin CHARACTERISTIC speedgoat_test_SN5659__cal_impl.Encode3_P5_d "" VALUE 0x0083D650 Scalar_FLOAT64_IEEE 0 speedgoat_test_SN5659_R2021b_IO682_CM_double -1.7E+308 1.7E+308 /end CHARACTERISTIC
/begin CHARACTERISTIC speedgoat_test_SN5659__cal_impl.Encode3_P5_f "" VALUE 0x0083CFE0 Scalar_FLOAT64_IEEE 0 speedgoat_test_SN5659_R2021b_IO682_CM_double -1.7E+308 1.7E+308 /end CHARACTERISTIC
/begin CHARACTERISTIC speedgoat_test_SN5659__cal_impl.Encode3_P5_h "" VALUE 0x0083C970 Scalar_FLOAT64_IEEE 0 speedgoat_test_SN5659_R2021b_IO682_CM_double -1.7E+308 1.7E+308 /end CHARACTERISTIC
/begin CHARACTERISTIC speedgoat_test_SN5659__cal_impl.Encode3_P5_i "" VALUE 0x0083AFB0 Scalar_FLOAT64_IEEE 0 speedgoat_test_SN5659_R2021b_IO682_CM_double -1.7E+308 1.7E+308 /end CHARACTERISTIC
/begin CHARACTERISTIC speedgoat_test_SN5659__cal_impl.Encode3_P5_ij "" VALUE 0x0083C300 Scalar_FLOAT64_IEEE 0 speedgoat_test_SN5659_R2021b_IO682_CM_double -1.7E+308 1.7E+308 /end CHARACTERISTIC
/begin CHARACTERISTIC speedgoat_test_SN5659__cal_impl.Encode3_P6_a "" VALUE 0x0083BCA8 Scalar_FLOAT64_IEEE 0 speedgoat_test_SN5659_R2021b_IO682_CM_double -1.7E+308 1.7E+308 /end CHARACTERISTIC
/begin CHARACTERISTIC speedgoat_test_SN5659__cal_impl.Encode3_P6_e "" VALUE 0x0083AFC8 Scalar_FLOAT64_IEEE 0 speedgoat_test_SN5659_R2021b_IO682_CM_double -1.7E+308 1.7E+308 /end CHARACTERISTIC
/begin CHARACTERISTIC speedgoat_test_SN5659__cal_impl.Encode3_P6_g "" VALUE 0x0083D668 Scalar_FLOAT64_IEEE 0 speedgoat_test_SN5659_R2021b_IO682_CM_double -1.7E+308 1.7E+308 /end CHARACTERISTIC
/begin CHARACTERISTIC speedgoat_test_SN5659__cal_impl.Encode3_P6_i "" VALUE 0x0083C988 Scalar_FLOAT64_IEEE 0 speedgoat_test_SN5659_R2021b_IO682_CM_double -1.7E+308 1.7E+308 /end CHARACTERISTIC
/begin CHARACTERISTIC speedgoat_test_SN5659__cal_impl.Encode3_P6_j "" VALUE 0x0083B638 Scalar_FLOAT64_IEEE 0 speedgoat_test_SN5659_R2021b_IO682_CM_double -1.7E+308 1.7E+308 /end CHARACTERISTIC
/begin CHARACTERISTIC speedgoat_test_SN5659__cal_impl.Encode3_P6_jb "" VALUE 0x0083C318 Scalar_FLOAT64_IEEE 0 speedgoat_test_SN5659_R2021b_IO682_CM_double -1.7E+308 1.7E+308 /end CHARACTERISTIC
/begin CHARACTERISTIC speedgoat_test_SN5659__cal_impl.Encode3_P6_k "" VALUE 0x0083CFF8 Scalar_FLOAT64_IEEE 0 speedgoat_test_SN5659_R2021b_IO682_CM_double -1.7E+308 1.7E+308 /end CHARACTERISTIC
/begin CHARACTERISTIC speedgoat_test_SN5659__cal_impl.Encode3_P7_d "" VALUE 0x0083BCC0 Scalar_FLOAT64_IEEE 0 speedgoat_test_SN5659_R2021b_IO682_CM_double -1.7E+308 1.7E+308 /end CHARACTERISTIC
/begin CHARACTERISTIC speedgoat_test_SN5659__cal_impl.Encode3_P7_f "" VALUE 0x0083C330 Scalar_FLOAT64_IEEE 0 speedgoat_test_SN5659_R2021b_IO682_CM_double -1.7E+308 1.7E+308 /end CHARACTERISTIC
/begin CHARACTERISTIC speedgoat_test_SN5659__cal_impl.Encode3_P7_fm "" VALUE 0x0083D680 Scalar_FLOAT64_IEEE 0 speedgoat_test_SN5659_R2021b_IO682_CM_double -1.7E+308 1.7E+308 /end CHARACTERISTIC
/begin CHARACTERISTIC speedgoat_test_SN5659__cal_impl.Encode3_P7_fx "" VALUE 0x0083D010 Scalar_FLOAT64_IEEE 0 speedgoat_test_SN5659_R2021b_IO682_CM_double -1.7E+308 1.7E+308 /end CHARACTERISTIC
/begin CHARACTERISTIC speedgoat_test_SN5659__cal_impl.Encode3_P7_h "" VALUE 0x0083AFE0 Scalar_FLOAT64_IEEE 0 speedgoat_test_SN5659_R2021b_IO682_CM_double -1.7E+308 1.7E+308 /end CHARACTERISTIC
/begin CHARACTERISTIC speedgoat_test_SN5659__cal_impl.Encode3_P7_i "" VALUE 0x0083C9A0 Scalar_FLOAT64_IEEE 0 speedgoat_test_SN5659_R2021b_IO682_CM_double -1.7E+308 1.7E+308 /end CHARACTERISTIC
/begin CHARACTERISTIC speedgoat_test_SN5659__cal_impl.Encode3_P7_l "" VALUE 0x0083B650 Scalar_FLOAT64_IEEE 0 speedgoat_test_SN5659_R2021b_IO682_CM_double -1.7E+308 1.7E+308 /end CHARACTERISTIC
/begin CHARACTERISTIC speedgoat_test_SN5659__cal_impl.Encode3_P8_b "" VALUE 0x0083D028 Scalar_FLOAT64_IEEE 0 speedgoat_test_SN5659_R2021b_IO682_CM_double -1.7E+308 1.7E+308 /end CHARACTERISTIC
/begin CHARACTERISTIC speedgoat_test_SN5659__cal_impl.Encode3_P8_f "" VALUE 0x0083AFF8 Scalar_FLOAT64_IEEE 0 speedgoat_test_SN5659_R2021b_IO682_CM_double -1.7E+308 1.7E+308 /end CHARACTERISTIC
/begin CHARACTERISTIC speedgoat_test_SN5659__cal_impl.Encode3_P8_fh "" VALUE 0x0083D698 Scalar_FLOAT64_IEEE 0 speedgoat_test_SN5659_R2021b_IO682_CM_double -1.7E+308 1.7E+308 /end CHARACTERISTIC
/begin CHARACTERISTIC speedgoat_test_SN5659__cal_impl.Encode3_P8_h "" VALUE 0x0083B668 Scalar_FLOAT64_IEEE 0 speedgoat_test_SN5659_R2021b_IO682_CM_double -1.7E+308 1.7E+308 /end CHARACTERISTIC
/begin CHARACTERISTIC speedgoat_test_SN5659__cal_impl.Encode3_P8_k "" VALUE 0x0083BCD8 Scalar_FLOAT64_IEEE 0 speedgoat_test_SN5659_R2021b_IO682_CM_double -1.7E+308 1.7E+308 /end CHARACTERISTIC
/begin CHARACTERISTIC speedgoat_test_SN5659__cal_impl.Encode3_P8_l "" VALUE 0x0083C348 Scalar_FLOAT64_IEEE 0 speedgoat_test_SN5659_R2021b_IO682_CM_double -1.7E+308 1.7E+308 /end CHARACTERISTIC
/begin CHARACTERISTIC speedgoat_test_SN5659__cal_impl.Encode3_P8_p "" VALUE 0x0083C9B8 Scalar_FLOAT64_IEEE 0 speedgoat_test_SN5659_R2021b_IO682_CM_double -1.7E+308 1.7E+308 /end CHARACTERISTIC
/begin CHARACTERISTIC speedgoat_test_SN5659__cal_impl.Encode3_P9_b "" VALUE 0x0083B680 Scalar_FLOAT64_IEEE 0 speedgoat_test_SN5659_R2021b_IO682_CM_double -1.7E+308 1.7E+308 /end CHARACTERISTIC
/begin CHARACTERISTIC speedgoat_test_SN5659__cal_impl.Encode3_P9_b5 "" VALUE 0x0083BCF0 Scalar_FLOAT64_IEEE 0 speedgoat_test_SN5659_R2021b_IO682_CM_double -1.7E+308 1.7E+308 /end CHARACTERISTIC
/begin CHARACTERISTIC speedgoat_test_SN5659__cal_impl.Encode3_P9_bx "" VALUE 0x0083D040 Scalar_FLOAT64_IEEE 0 speedgoat_test_SN5659_R2021b_IO682_CM_double -1.7E+308 1.7E+308 /end CHARACTERISTIC
/begin CHARACTERISTIC speedgoat_test_SN5659__cal_impl.Encode3_P9_c "" VALUE 0x0083C360 Scalar_FLOAT64_IEEE 0 speedgoat_test_SN5659_R2021b_IO682_CM_double -1.7E+308 1.7E+308 /end CHARACTERISTIC
/begin CHARACTERISTIC speedgoat_test_SN5659__cal_impl.Encode3_P9_k "" VALUE 0x0083B010 Scalar_FLOAT64_IEEE 0 speedgoat_test_SN5659_R2021b_IO682_CM_double -1.7E+308 1.7E+308 /end CHARACTERISTIC
/begin CHARACTERISTIC speedgoat_test_SN5659__cal_impl.Encode3_P9_n "" VALUE 0x0083D6B0 Scalar_FLOAT64_IEEE 0 speedgoat_test_SN5659_R2021b_IO682_CM_double -1.7E+308 1.7E+308 /end CHARACTERISTIC
/begin CHARACTERISTIC speedgoat_test_SN5659__cal_impl.Encode3_P9_p "" VALUE 0x0083C9D0 Scalar_FLOAT64_IEEE 0 speedgoat_test_SN5659_R2021b_IO682_CM_double -1.7E+308 1.7E+308 /end CHARACTERISTIC
/begin CHARACTERISTIC speedgoat_test_SN5659__cal_impl.Encode4_P10_h "" VALUE 0x0083B1B0 Scalar_FLOAT64_IEEE 0 speedgoat_test_SN5659_R2021b_IO682_CM_double -1.7E+308 1.7E+308 /end CHARACTERISTIC
/begin CHARACTERISTIC speedgoat_test_SN5659__cal_impl.Encode4_P10_j "" VALUE 0x0083D1E0 Scalar_FLOAT64_IEEE 0 speedgoat_test_SN5659_R2021b_IO682_CM_double -1.7E+308 1.7E+308 /end CHARACTERISTIC
/begin CHARACTERISTIC speedgoat_test_SN5659__cal_impl.Encode4_P10_k "" VALUE 0x0083CB70 Scalar_FLOAT64_IEEE 0 speedgoat_test_SN5659_R2021b_IO682_CM_double -1.7E+308 1.7E+308 /end CHARACTERISTIC
/begin CHARACTERISTIC speedgoat_test_SN5659__cal_impl.Encode4_P10_o "" VALUE 0x0083B820 Scalar_FLOAT64_IEEE 0 speedgoat_test_SN5659_R2021b_IO682_CM_double -1.7E+308 1.7E+308 /end CHARACTERISTIC
/begin CHARACTERISTIC speedgoat_test_SN5659__cal_impl.Encode4_P10_o2 "" VALUE 0x0083C500 Scalar_FLOAT64_IEEE 0 speedgoat_test_SN5659_R2021b_IO682_CM_double -1.7E+308 1.7E+308 /end CHARACTERISTIC
/begin CHARACTERISTIC speedgoat_test_SN5659__cal_impl.Encode4_P10_o4 "" VALUE 0x0083D850 Scalar_FLOAT64_IEEE 0 speedgoat_test_SN5659_R2021b_IO682_CM_double -1.7E+308 1.7E+308 /end CHARACTERISTIC
/begin CHARACTERISTIC speedgoat_test_SN5659__cal_impl.Encode4_P11_c "" VAL_BLK 0x0083D868 Scalar_FLOAT64_IEEE 0 speedgoat_test_SN5659_R2021b_IO682_CM_double -1.7E+308 1.7E+308 MATRIX_DIM 2 1 /end CHARACTERISTIC
/begin CHARACTERISTIC speedgoat_test_SN5659__cal_impl.Encode4_P11_e "" VAL_BLK 0x0083D1F8 Scalar_FLOAT64_IEEE 0 speedgoat_test_SN5659_R2021b_IO682_CM_double -1.7E+308 1.7E+308 MATRIX_DIM 2 1 /end CHARACTERISTIC
/begin CHARACTERISTIC speedgoat_test_SN5659__cal_impl.Encode4_P11_j "" VAL_BLK 0x0083B1C8 Scalar_FLOAT64_IEEE 0 speedgoat_test_SN5659_R2021b_IO682_CM_double -1.7E+308 1.7E+308 MATRIX_DIM 2 1 /end CHARACTERISTIC
/begin CHARACTERISTIC speedgoat_test_SN5659__cal_impl.Encode4_P11_o "" VAL_BLK 0x0083B838 Scalar_FLOAT64_IEEE 0 speedgoat_test_SN5659_R2021b_IO682_CM_double -1.7E+308 1.7E+308 MATRIX_DIM 2 1 /end CHARACTERISTIC
/begin CHARACTERISTIC speedgoat_test_SN5659__cal_impl.Encode4_P11_p "" VAL_BLK 0x0083C518 Scalar_FLOAT64_IEEE 0 speedgoat_test_SN5659_R2021b_IO682_CM_double -1.7E+308 1.7E+308 MATRIX_DIM 2 1 /end CHARACTERISTIC
/begin CHARACTERISTIC speedgoat_test_SN5659__cal_impl.Encode4_P11_pb "" VAL_BLK 0x0083CB88 Scalar_FLOAT64_IEEE 0 speedgoat_test_SN5659_R2021b_IO682_CM_double -1.7E+308 1.7E+308 MATRIX_DIM 2 1 /end CHARACTERISTIC
/begin CHARACTERISTIC speedgoat_test_SN5659__cal_impl.Encode4_P12_d "" VALUE 0x0083B858 Scalar_FLOAT64_IEEE 0 speedgoat_test_SN5659_R2021b_IO682_CM_double -1.7E+308 1.7E+308 /end CHARACTERISTIC
/begin CHARACTERISTIC speedgoat_test_SN5659__cal_impl.Encode4_P12_e "" VALUE 0x0083CBA8 Scalar_FLOAT64_IEEE 0 speedgoat_test_SN5659_R2021b_IO682_CM_double -1.7E+308 1.7E+308 /end CHARACTERISTIC
/begin CHARACTERISTIC speedgoat_test_SN5659__cal_impl.Encode4_P12_h "" VALUE 0x0083C538 Scalar_FLOAT64_IEEE 0 speedgoat_test_SN5659_R2021b_IO682_CM_double -1.7E+308 1.7E+308 /end CHARACTERISTIC
/begin CHARACTERISTIC speedgoat_test_SN5659__cal_impl.Encode4_P12_l "" VALUE 0x0083B1E8 Scalar_FLOAT64_IEEE 0 speedgoat_test_SN5659_R2021b_IO682_CM_double -1.7E+308 1.7E+308 /end CHARACTERISTIC
/begin CHARACTERISTIC speedgoat_test_SN5659__cal_impl.Encode4_P12_lr "" VALUE 0x0083D888 Scalar_FLOAT64_IEEE 0 speedgoat_test_SN5659_R2021b_IO682_CM_double -1.7E+308 1.7E+308 /end CHARACTERISTIC
/begin CHARACTERISTIC speedgoat_test_SN5659__cal_impl.Encode4_P12_o "" VALUE 0x0083D218 Scalar_FLOAT64_IEEE 0 speedgoat_test_SN5659_R2021b_IO682_CM_double -1.7E+308 1.7E+308 /end CHARACTERISTIC
/begin CHARACTERISTIC speedgoat_test_SN5659__cal_impl.Encode4_P13_a "" VALUE 0x0083B200 Scalar_FLOAT64_IEEE 0 speedgoat_test_SN5659_R2021b_IO682_CM_double -1.7E+308 1.7E+308 /end CHARACTERISTIC
/begin CHARACTERISTIC speedgoat_test_SN5659__cal_impl.Encode4_P13_f "" VALUE 0x0083B870 Scalar_FLOAT64_IEEE 0 speedgoat_test_SN5659_R2021b_IO682_CM_double -1.7E+308 1.7E+308 /end CHARACTERISTIC
/begin CHARACTERISTIC speedgoat_test_SN5659__cal_impl.Encode4_P13_h "" VALUE 0x0083D230 Scalar_FLOAT64_IEEE 0 speedgoat_test_SN5659_R2021b_IO682_CM_double -1.7E+308 1.7E+308 /end CHARACTERISTIC
/begin CHARACTERISTIC speedgoat_test_SN5659__cal_impl.Encode4_P13_m "" VALUE 0x0083D8A0 Scalar_FLOAT64_IEEE 0 speedgoat_test_SN5659_R2021b_IO682_CM_double -1.7E+308 1.7E+308 /end CHARACTERISTIC
/begin CHARACTERISTIC speedgoat_test_SN5659__cal_impl.Encode4_P13_o "" VALUE 0x0083C550 Scalar_FLOAT64_IEEE 0 speedgoat_test_SN5659_R2021b_IO682_CM_double -1.7E+308 1.7E+308 /end CHARACTERISTIC
/begin CHARACTERISTIC speedgoat_test_SN5659__cal_impl.Encode4_P13_p "" VALUE 0x0083CBC0 Scalar_FLOAT64_IEEE 0 speedgoat_test_SN5659_R2021b_IO682_CM_double -1.7E+308 1.7E+308 /end CHARACTERISTIC
/begin CHARACTERISTIC speedgoat_test_SN5659__cal_impl.Encode4_P14_b "" VALUE 0x0083CBD8 Scalar_FLOAT64_IEEE 0 speedgoat_test_SN5659_R2021b_IO682_CM_double -1.7E+308 1.7E+308 /end CHARACTERISTIC
/begin CHARACTERISTIC speedgoat_test_SN5659__cal_impl.Encode4_P14_j "" VALUE 0x0083B888 Scalar_FLOAT64_IEEE 0 speedgoat_test_SN5659_R2021b_IO682_CM_double -1.7E+308 1.7E+308 /end CHARACTERISTIC
/begin CHARACTERISTIC speedgoat_test_SN5659__cal_impl.Encode4_P14_l "" VALUE 0x0083B218 Scalar_FLOAT64_IEEE 0 speedgoat_test_SN5659_R2021b_IO682_CM_double -1.7E+308 1.7E+308 /end CHARACTERISTIC
/begin CHARACTERISTIC speedgoat_test_SN5659__cal_impl.Encode4_P14_lr "" VALUE 0x0083C568 Scalar_FLOAT64_IEEE 0 speedgoat_test_SN5659_R2021b_IO682_CM_double -1.7E+308 1.7E+308 /end CHARACTERISTIC
/begin CHARACTERISTIC speedgoat_test_SN5659__cal_impl.Encode4_P14_m "" VALUE 0x0083D248 Scalar_FLOAT64_IEEE 0 speedgoat_test_SN5659_R2021b_IO682_CM_double -1.7E+308 1.7E+308 /end CHARACTERISTIC
/begin CHARACTERISTIC speedgoat_test_SN5659__cal_impl.Encode4_P14_mx "" VALUE 0x0083D8B8 Scalar_FLOAT64_IEEE 0 speedgoat_test_SN5659_R2021b_IO682_CM_double -1.7E+308 1.7E+308 /end CHARACTERISTIC
/begin CHARACTERISTIC speedgoat_test_SN5659__cal_impl.Encode4_P15_a "" VALUE 0x0083C580 Scalar_FLOAT64_IEEE 0 speedgoat_test_SN5659_R2021b_IO682_CM_double -1.7E+308 1.7E+308 /end CHARACTERISTIC
/begin CHARACTERISTIC speedgoat_test_SN5659__cal_impl.Encode4_P15_f "" VALUE 0x0083D260 Scalar_FLOAT64_IEEE 0 speedgoat_test_SN5659_R2021b_IO682_CM_double -1.7E+308 1.7E+308 /end CHARACTERISTIC
/begin CHARACTERISTIC speedgoat_test_SN5659__cal_impl.Encode4_P15_g "" VALUE 0x0083B8A0 Scalar_FLOAT64_IEEE 0 speedgoat_test_SN5659_R2021b_IO682_CM_double -1.7E+308 1.7E+308 /end CHARACTERISTIC
/begin CHARACTERISTIC speedgoat_test_SN5659__cal_impl.Encode4_P15_i "" VALUE 0x0083B230 Scalar_FLOAT64_IEEE 0 speedgoat_test_SN5659_R2021b_IO682_CM_double -1.7E+308 1.7E+308 /end CHARACTERISTIC
/begin CHARACTERISTIC speedgoat_test_SN5659__cal_impl.Encode4_P15_k "" VALUE 0x0083D8D0 Scalar_FLOAT64_IEEE 0 speedgoat_test_SN5659_R2021b_IO682_CM_double -1.7E+308 1.7E+308 /end CHARACTERISTIC
/begin CHARACTERISTIC speedgoat_test_SN5659__cal_impl.Encode4_P15_l "" VALUE 0x0083CBF0 Scalar_FLOAT64_IEEE 0 speedgoat_test_SN5659_R2021b_IO682_CM_double -1.7E+308 1.7E+308 /end CHARACTERISTIC
/begin CHARACTERISTIC speedgoat_test_SN5659__cal_impl.Encode4_P1_a "" VALUE 0x0083D108 Scalar_FLOAT64_IEEE 0 speedgoat_test_SN5659_R2021b_IO682_CM_double -1.7E+308 1.7E+308 /end CHARACTERISTIC
/begin CHARACTERISTIC speedgoat_test_SN5659__cal_impl.Encode4_P1_e "" VALUE 0x0083B0D8 Scalar_FLOAT64_IEEE 0 speedgoat_test_SN5659_R2021b_IO682_CM_double -1.7E+308 1.7E+308 /end CHARACTERISTIC
/begin CHARACTERISTIC speedgoat_test_SN5659__cal_impl.Encode4_P1_f "" VALUE 0x0083B748 Scalar_FLOAT64_IEEE 0 speedgoat_test_SN5659_R2021b_IO682_CM_double -1.7E+308 1.7E+308 /end CHARACTERISTIC
/begin CHARACTERISTIC speedgoat_test_SN5659__cal_impl.Encode4_P1_fl "" VALUE 0x0083C428 Scalar_FLOAT64_IEEE 0 speedgoat_test_SN5659_R2021b_IO682_CM_double -1.7E+308 1.7E+308 /end CHARACTERISTIC
/begin CHARACTERISTIC speedgoat_test_SN5659__cal_impl.Encode4_P1_g "" VALUE 0x0083D778 Scalar_FLOAT64_IEEE 0 speedgoat_test_SN5659_R2021b_IO682_CM_double -1.7E+308 1.7E+308 /end CHARACTERISTIC
/begin CHARACTERISTIC speedgoat_test_SN5659__cal_impl.Encode4_P1_n "" VALUE 0x0083CA98 Scalar_FLOAT64_IEEE 0 speedgoat_test_SN5659_R2021b_IO682_CM_double -1.7E+308 1.7E+308 /end CHARACTERISTIC
/begin CHARACTERISTIC speedgoat_test_SN5659__cal_impl.Encode4_P2_d "" VALUE 0x0083B0F0 Scalar_FLOAT64_IEEE 0 speedgoat_test_SN5659_R2021b_IO682_CM_double -1.7E+308 1.7E+308 /end CHARACTERISTIC
/begin CHARACTERISTIC speedgoat_test_SN5659__cal_impl.Encode4_P2_dd "" VALUE 0x0083CAB0 Scalar_FLOAT64_IEEE 0 speedgoat_test_SN5659_R2021b_IO682_CM_double -1.7E+308 1.7E+308 /end CHARACTERISTIC
/begin CHARACTERISTIC speedgoat_test_SN5659__cal_impl.Encode4_P2_f "" VALUE 0x0083C440 Scalar_FLOAT64_IEEE 0 speedgoat_test_SN5659_R2021b_IO682_CM_double -1.7E+308 1.7E+308 /end CHARACTERISTIC
/begin CHARACTERISTIC speedgoat_test_SN5659__cal_impl.Encode4_P2_h "" VALUE 0x0083D790 Scalar_FLOAT64_IEEE 0 speedgoat_test_SN5659_R2021b_IO682_CM_double -1.7E+308 1.7E+308 /end CHARACTERISTIC
/begin CHARACTERISTIC speedgoat_test_SN5659__cal_impl.Encode4_P2_l "" VALUE 0x0083B760 Scalar_FLOAT64_IEEE 0 speedgoat_test_SN5659_R2021b_IO682_CM_double -1.7E+308 1.7E+308 /end CHARACTERISTIC
/begin CHARACTERISTIC speedgoat_test_SN5659__cal_impl.Encode4_P2_p "" VALUE 0x0083D120 Scalar_FLOAT64_IEEE 0 speedgoat_test_SN5659_R2021b_IO682_CM_double -1.7E+308 1.7E+308 /end CHARACTERISTIC
/begin CHARACTERISTIC speedgoat_test_SN5659__cal_impl.Encode4_P3_a "" VALUE 0x0083D138 Scalar_FLOAT64_IEEE 0 speedgoat_test_SN5659_R2021b_IO682_CM_double -1.7E+308 1.7E+308 /end CHARACTERISTIC
/begin CHARACTERISTIC speedgoat_test_SN5659__cal_impl.Encode4_P3_b "" VALUE 0x0083CAC8 Scalar_FLOAT64_IEEE 0 speedgoat_test_SN5659_R2021b_IO682_CM_double -1.7E+308 1.7E+308 /end CHARACTERISTIC
/begin CHARACTERISTIC speedgoat_test_SN5659__cal_impl.Encode4_P3_h "" VALUE 0x0083C458 Scalar_FLOAT64_IEEE 0 speedgoat_test_SN5659_R2021b_IO682_CM_double -1.7E+308 1.7E+308 /end CHARACTERISTIC
/begin CHARACTERISTIC speedgoat_test_SN5659__cal_impl.Encode4_P3_m "" VALUE 0x0083D7A8 Scalar_FLOAT64_IEEE 0 speedgoat_test_SN5659_R2021b_IO682_CM_double -1.7E+308 1.7E+308 /end CHARACTERISTIC
/begin CHARACTERISTIC speedgoat_test_SN5659__cal_impl.Encode4_P3_o "" VALUE 0x0083B108 Scalar_FLOAT64_IEEE 0 speedgoat_test_SN5659_R2021b_IO682_CM_double -1.7E+308 1.7E+308 /end CHARACTERISTIC
/begin CHARACTERISTIC speedgoat_test_SN5659__cal_impl.Encode4_P3_p "" VALUE 0x0083B778 Scalar_FLOAT64_IEEE 0 speedgoat_test_SN5659_R2021b_IO682_CM_double -1.7E+308 1.7E+308 /end CHARACTERISTIC
/begin CHARACTERISTIC speedgoat_test_SN5659__cal_impl.Encode4_P4_a "" VALUE 0x0083B120 Scalar_FLOAT64_IEEE 0 speedgoat_test_SN5659_R2021b_IO682_CM_double -1.7E+308 1.7E+308 /end CHARACTERISTIC
/begin CHARACTERISTIC speedgoat_test_SN5659__cal_impl.Encode4_P4_b "" VALUE 0x0083C470 Scalar_FLOAT64_IEEE 0 speedgoat_test_SN5659_R2021b_IO682_CM_double -1.7E+308 1.7E+308 /end CHARACTERISTIC
/begin CHARACTERISTIC speedgoat_test_SN5659__cal_impl.Encode4_P4_h "" VALUE 0x0083CAE0 Scalar_FLOAT64_IEEE 0 speedgoat_test_SN5659_R2021b_IO682_CM_double -1.7E+308 1.7E+308 /end CHARACTERISTIC
/begin CHARACTERISTIC speedgoat_test_SN5659__cal_impl.Encode4_P4_i "" VALUE 0x0083D7C0 Scalar_FLOAT64_IEEE 0 speedgoat_test_SN5659_R2021b_IO682_CM_double -1.7E+308 1.7E+308 /end CHARACTERISTIC
/begin CHARACTERISTIC speedgoat_test_SN5659__cal_impl.Encode4_P4_k "" VALUE 0x0083B790 Scalar_FLOAT64_IEEE 0 speedgoat_test_SN5659_R2021b_IO682_CM_double -1.7E+308 1.7E+308 /end CHARACTERISTIC
/begin CHARACTERISTIC speedgoat_test_SN5659__cal_impl.Encode4_P4_l "" VALUE 0x0083D150 Scalar_FLOAT64_IEEE 0 speedgoat_test_SN5659_R2021b_IO682_CM_double -1.7E+308 1.7E+308 /end CHARACTERISTIC
/begin CHARACTERISTIC speedgoat_test_SN5659__cal_impl.Encode4_P5_a "" VALUE 0x0083B138 Scalar_FLOAT64_IEEE 0 speedgoat_test_SN5659_R2021b_IO682_CM_double -1.7E+308 1.7E+308 /end CHARACTERISTIC
/begin CHARACTERISTIC speedgoat_test_SN5659__cal_impl.Encode4_P5_i "" VALUE 0x0083D168 Scalar_FLOAT64_IEEE 0 speedgoat_test_SN5659_R2021b_IO682_CM_double -1.7E+308 1.7E+308 /end CHARACTERISTIC
/begin CHARACTERISTIC speedgoat_test_SN5659__cal_impl.Encode4_P5_j "" VALUE 0x0083D7D8 Scalar_FLOAT64_IEEE 0 speedgoat_test_SN5659_R2021b_IO682_CM_double -1.7E+308 1.7E+308 /end CHARACTERISTIC
/begin CHARACTERISTIC speedgoat_test_SN5659__cal_impl.Encode4_P5_l "" VALUE 0x0083CAF8 Scalar_FLOAT64_IEEE 0 speedgoat_test_SN5659_R2021b_IO682_CM_double -1.7E+308 1.7E+308 /end CHARACTERISTIC
/begin CHARACTERISTIC speedgoat_test_SN5659__cal_impl.Encode4_P5_o "" VALUE 0x0083C488 Scalar_FLOAT64_IEEE 0 speedgoat_test_SN5659_R2021b_IO682_CM_double -1.7E+308 1.7E+308 /end CHARACTERISTIC
/begin CHARACTERISTIC speedgoat_test_SN5659__cal_impl.Encode4_P5_p "" VALUE 0x0083B7A8 Scalar_FLOAT64_IEEE 0 speedgoat_test_SN5659_R2021b_IO682_CM_double -1.7E+308 1.7E+308 /end CHARACTERISTIC
/begin CHARACTERISTIC speedgoat_test_SN5659__cal_impl.Encode4_P6_a "" VALUE 0x0083B150 Scalar_FLOAT64_IEEE 0 speedgoat_test_SN5659_R2021b_IO682_CM_double -1.7E+308 1.7E+308 /end CHARACTERISTIC
/begin CHARACTERISTIC speedgoat_test_SN5659__cal_impl.Encode4_P6_d "" VALUE 0x0083D180 Scalar_FLOAT64_IEEE 0 speedgoat_test_SN5659_R2021b_IO682_CM_double -1.7E+308 1.7E+308 /end CHARACTERISTIC
/begin CHARACTERISTIC speedgoat_test_SN5659__cal_impl.Encode4_P6_k "" VALUE 0x0083B7C0 Scalar_FLOAT64_IEEE 0 speedgoat_test_SN5659_R2021b_IO682_CM_double -1.7E+308 1.7E+308 /end CHARACTERISTIC
/begin CHARACTERISTIC speedgoat_test_SN5659__cal_impl.Encode4_P6_kc "" VALUE 0x0083C4A0 Scalar_FLOAT64_IEEE 0 speedgoat_test_SN5659_R2021b_IO682_CM_double -1.7E+308 1.7E+308 /end CHARACTERISTIC
/begin CHARACTERISTIC speedgoat_test_SN5659__cal_impl.Encode4_P6_l "" VALUE 0x0083CB10 Scalar_FLOAT64_IEEE 0 speedgoat_test_SN5659_R2021b_IO682_CM_double -1.7E+308 1.7E+308 /end CHARACTERISTIC
/begin CHARACTERISTIC speedgoat_test_SN5659__cal_impl.Encode4_P6_n "" VALUE 0x0083D7F0 Scalar_FLOAT64_IEEE 0 speedgoat_test_SN5659_R2021b_IO682_CM_double -1.7E+308 1.7E+308 /end CHARACTERISTIC
/begin CHARACTERISTIC speedgoat_test_SN5659__cal_impl.Encode4_P7_b "" VALUE 0x0083D198 Scalar_FLOAT64_IEEE 0 speedgoat_test_SN5659_R2021b_IO682_CM_double -1.7E+308 1.7E+308 /end CHARACTERISTIC
/begin CHARACTERISTIC speedgoat_test_SN5659__cal_impl.Encode4_P7_c "" VALUE 0x0083B7D8 Scalar_FLOAT64_IEEE 0 speedgoat_test_SN5659_R2021b_IO682_CM_double -1.7E+308 1.7E+308 /end CHARACTERISTIC
/begin CHARACTERISTIC speedgoat_test_SN5659__cal_impl.Encode4_P7_d "" VALUE 0x0083C4B8 Scalar_FLOAT64_IEEE 0 speedgoat_test_SN5659_R2021b_IO682_CM_double -1.7E+308 1.7E+308 /end CHARACTERISTIC
/begin CHARACTERISTIC speedgoat_test_SN5659__cal_impl.Encode4_P7_l "" VALUE 0x0083CB28 Scalar_FLOAT64_IEEE 0 speedgoat_test_SN5659_R2021b_IO682_CM_double -1.7E+308 1.7E+308 /end CHARACTERISTIC
/begin CHARACTERISTIC speedgoat_test_SN5659__cal_impl.Encode4_P7_p "" VALUE 0x0083B168 Scalar_FLOAT64_IEEE 0 speedgoat_test_SN5659_R2021b_IO682_CM_double -1.7E+308 1.7E+308 /end CHARACTERISTIC
/begin CHARACTERISTIC speedgoat_test_SN5659__cal_impl.Encode4_P7_pf "" VALUE 0x0083D808 Scalar_FLOAT64_IEEE 0 speedgoat_test_SN5659_R2021b_IO682_CM_double -1.7E+308 1.7E+308 /end CHARACTERISTIC
/begin CHARACTERISTIC speedgoat_test_SN5659__cal_impl.Encode4_P8_h "" VALUE 0x0083CB40 Scalar_FLOAT64_IEEE 0 speedgoat_test_SN5659_R2021b_IO682_CM_double -1.7E+308 1.7E+308 /end CHARACTERISTIC
/begin CHARACTERISTIC speedgoat_test_SN5659__cal_impl.Encode4_P8_j "" VALUE 0x0083B7F0 Scalar_FLOAT64_IEEE 0 speedgoat_test_SN5659_R2021b_IO682_CM_double -1.7E+308 1.7E+308 /end CHARACTERISTIC
/begin CHARACTERISTIC speedgoat_test_SN5659__cal_impl.Encode4_P8_k "" VALUE 0x0083D1B0 Scalar_FLOAT64_IEEE 0 speedgoat_test_SN5659_R2021b_IO682_CM_double -1.7E+308 1.7E+308 /end CHARACTERISTIC
/begin CHARACTERISTIC speedgoat_test_SN5659__cal_impl.Encode4_P8_l "" VALUE 0x0083D820 Scalar_FLOAT64_IEEE 0 speedgoat_test_SN5659_R2021b_IO682_CM_double -1.7E+308 1.7E+308 /end CHARACTERISTIC
/begin CHARACTERISTIC speedgoat_test_SN5659__cal_impl.Encode4_P8_o "" VALUE 0x0083B180 Scalar_FLOAT64_IEEE 0 speedgoat_test_SN5659_R2021b_IO682_CM_double -1.7E+308 1.7E+308 /end CHARACTERISTIC
/begin CHARACTERISTIC speedgoat_test_SN5659__cal_impl.Encode4_P8_oo "" VALUE 0x0083C4D0 Scalar_FLOAT64_IEEE 0 speedgoat_test_SN5659_R2021b_IO682_CM_double -1.7E+308 1.7E+308 /end CHARACTERISTIC
/begin CHARACTERISTIC speedgoat_test_SN5659__cal_impl.Encode4_P9_c "" VALUE 0x0083B808 Scalar_FLOAT64_IEEE 0 speedgoat_test_SN5659_R2021b_IO682_CM_double -1.7E+308 1.7E+308 /end CHARACTERISTIC
/begin CHARACTERISTIC speedgoat_test_SN5659__cal_impl.Encode4_P9_e "" VALUE 0x0083CB58 Scalar_FLOAT64_IEEE 0 speedgoat_test_SN5659_R2021b_IO682_CM_double -1.7E+308 1.7E+308 /end CHARACTERISTIC
/begin CHARACTERISTIC speedgoat_test_SN5659__cal_impl.Encode4_P9_i "" VALUE 0x0083B198 Scalar_FLOAT64_IEEE 0 speedgoat_test_SN5659_R2021b_IO682_CM_double -1.7E+308 1.7E+308 /end CHARACTERISTIC
/begin CHARACTERISTIC speedgoat_test_SN5659__cal_impl.Encode4_P9_n "" VALUE 0x0083C4E8 Scalar_FLOAT64_IEEE 0 speedgoat_test_SN5659_R2021b_IO682_CM_double -1.7E+308 1.7E+308 /end CHARACTERISTIC
/begin CHARACTERISTIC speedgoat_test_SN5659__cal_impl.Encode4_P9_ns "" VALUE 0x0083D838 Scalar_FLOAT64_IEEE 0 speedgoat_test_SN5659_R2021b_IO682_CM_double -1.7E+308 1.7E+308 /end CHARACTERISTIC
/begin CHARACTERISTIC speedgoat_test_SN5659__cal_impl.Encode4_P9_p "" VALUE 0x0083D1C8 Scalar_FLOAT64_IEEE 0 speedgoat_test_SN5659_R2021b_IO682_CM_double -1.7E+308 1.7E+308 /end CHARACTERISTIC
/begin CHARACTERISTIC speedgoat_test_SN5659__cal_impl.Encode5_P10_a "" VALUE 0x0083BB60 Scalar_FLOAT64_IEEE 0 speedgoat_test_SN5659_R2021b_IO682_CM_double -1.7E+308 1.7E+308 /end CHARACTERISTIC
/begin CHARACTERISTIC speedgoat_test_SN5659__cal_impl.Encode5_P11_n "" VAL_BLK 0x0083BB78 Scalar_FLOAT64_IEEE 0 speedgoat_test_SN5659_R2021b_IO682_CM_double -1.7E+308 1.7E+308 MATRIX_DIM 2 1 /end CHARACTERISTIC
/begin CHARACTERISTIC speedgoat_test_SN5659__cal_impl.Encode5_P12_m "" VALUE 0x0083BB98 Scalar_FLOAT64_IEEE 0 speedgoat_test_SN5659_R2021b_IO682_CM_double -1.7E+308 1.7E+308 /end CHARACTERISTIC
/begin CHARACTERISTIC speedgoat_test_SN5659__cal_impl.Encode5_P13_g "" VALUE 0x0083BBB0 Scalar_FLOAT64_IEEE 0 speedgoat_test_SN5659_R2021b_IO682_CM_double -1.7E+308 1.7E+308 /end CHARACTERISTIC
/begin CHARACTERISTIC speedgoat_test_SN5659__cal_impl.Encode5_P14_l "" VALUE 0x0083BBC8 Scalar_FLOAT64_IEEE 0 speedgoat_test_SN5659_R2021b_IO682_CM_double -1.7E+308 1.7E+308 /end CHARACTERISTIC
/begin CHARACTERISTIC speedgoat_test_SN5659__cal_impl.Encode5_P15_c "" VALUE 0x0083BBE0 Scalar_FLOAT64_IEEE 0 speedgoat_test_SN5659_R2021b_IO682_CM_double -1.7E+308 1.7E+308 /end CHARACTERISTIC
/begin CHARACTERISTIC speedgoat_test_SN5659__cal_impl.Encode5_P1_f "" VALUE 0x0083BA88 Scalar_FLOAT64_IEEE 0 speedgoat_test_SN5659_R2021b_IO682_CM_double -1.7E+308 1.7E+308 /end CHARACTERISTIC
/begin CHARACTERISTIC speedgoat_test_SN5659__cal_impl.Encode5_P2_e "" VALUE 0x0083BAA0 Scalar_FLOAT64_IEEE 0 speedgoat_test_SN5659_R2021b_IO682_CM_double -1.7E+308 1.7E+308 /end CHARACTERISTIC
/begin CHARACTERISTIC speedgoat_test_SN5659__cal_impl.Encode5_P3_m "" VALUE 0x0083BAB8 Scalar_FLOAT64_IEEE 0 speedgoat_test_SN5659_R2021b_IO682_CM_double -1.7E+308 1.7E+308 /end CHARACTERISTIC
/begin CHARACTERISTIC speedgoat_test_SN5659__cal_impl.Encode5_P4_a "" VALUE 0x0083BAD0 Scalar_FLOAT64_IEEE 0 speedgoat_test_SN5659_R2021b_IO682_CM_double -1.7E+308 1.7E+308 /end CHARACTERISTIC
/begin CHARACTERISTIC speedgoat_test_SN5659__cal_impl.Encode5_P5_i "" VALUE 0x0083BAE8 Scalar_FLOAT64_IEEE 0 speedgoat_test_SN5659_R2021b_IO682_CM_double -1.7E+308 1.7E+308 /end CHARACTERISTIC
/begin CHARACTERISTIC speedgoat_test_SN5659__cal_impl.Encode5_P6_d "" VALUE 0x0083BB00 Scalar_FLOAT64_IEEE 0 speedgoat_test_SN5659_R2021b_IO682_CM_double -1.7E+308 1.7E+308 /end CHARACTERISTIC
/begin CHARACTERISTIC speedgoat_test_SN5659__cal_impl.Encode5_P7_f "" VALUE 0x0083BB18 Scalar_FLOAT64_IEEE 0 speedgoat_test_SN5659_R2021b_IO682_CM_double -1.7E+308 1.7E+308 /end CHARACTERISTIC
/begin CHARACTERISTIC speedgoat_test_SN5659__cal_impl.Encode5_P8_k "" VALUE 0x0083BB30 Scalar_FLOAT64_IEEE 0 speedgoat_test_SN5659_R2021b_IO682_CM_double -1.7E+308 1.7E+308 /end CHARACTERISTIC
/begin CHARACTERISTIC speedgoat_test_SN5659__cal_impl.Encode5_P9_l "" VALUE 0x0083BB48 Scalar_FLOAT64_IEEE 0 speedgoat_test_SN5659_R2021b_IO682_CM_double -1.7E+308 1.7E+308 /end CHARACTERISTIC
/begin CHARACTERISTIC speedgoat_test_SN5659__cal_impl.FixPtConstant_Value_a "" VALUE 0x008406F8 Scalar_UWORD 0 speedgoat_test_SN5659_R2021b_IO682_CM_uint16 0 65535 /end CHARACTERISTIC
/begin CHARACTERISTIC speedgoat_test_SN5659__cal_impl.FixPtConstant_Value_h "" VALUE 0x00840745 Scalar_UBYTE 0 speedgoat_test_SN5659_R2021b_IO682_CM_uint8 0 255 /end CHARACTERISTIC
/begin CHARACTERISTIC speedgoat_test_SN5659__cal_impl.FixPtConstant_Value_i "" VALUE 0x00840716 Scalar_UWORD 0 speedgoat_test_SN5659_R2021b_IO682_CM_uint16 0 65535 /end CHARACTERISTIC
/begin CHARACTERISTIC speedgoat_test_SN5659__cal_impl.FixPtConstant_Value_j "" VALUE 0x0084070A Scalar_UWORD 0 speedgoat_test_SN5659_R2021b_IO682_CM_uint16 0 65535 /end CHARACTERISTIC
/begin CHARACTERISTIC speedgoat_test_SN5659__cal_impl.FixPtConstant_Value_k0 "" VALUE 0x00840748 Scalar_UBYTE 0 speedgoat_test_SN5659_R2021b_IO682_CM_uint8 0 255 /end CHARACTERISTIC
/begin CHARACTERISTIC speedgoat_test_SN5659__cal_impl.FixPtConstant_Value_l "" VALUE 0x00840710 Scalar_UWORD 0 speedgoat_test_SN5659_R2021b_IO682_CM_uint16 0 65535 /end CHARACTERISTIC
/begin CHARACTERISTIC speedgoat_test_SN5659__cal_impl.FixPtConstant_Value_o "" VALUE 0x008406FE Scalar_UWORD 0 speedgoat_test_SN5659_R2021b_IO682_CM_uint16 0 65535 /end CHARACTERISTIC
/begin CHARACTERISTIC speedgoat_test_SN5659__cal_impl.FixPtConstant_Value_oz "" VALUE 0x00840704 Scalar_UWORD 0 speedgoat_test_SN5659_R2021b_IO682_CM_uint16 0 65535 /end CHARACTERISTIC
/begin CHARACTERISTIC speedgoat_test_SN5659__cal_impl.Label_Value "" VALUE 0x00840638 Scalar_ULONG 0 speedgoat_test_SN5659_R2021b_IO682_CM_uint32 0 2147483646 /end CHARACTERISTIC
/begin CHARACTERISTIC speedgoat_test_SN5659__cal_impl.Label_Value_b "" VALUE 0x00840680 Scalar_ULONG 0 speedgoat_test_SN5659_R2021b_IO682_CM_uint32 0 2147483646 /end CHARACTERISTIC
/begin CHARACTERISTIC speedgoat_test_SN5659__cal_impl.Label_Value_e "" VALUE 0x00840650 Scalar_ULONG 0 speedgoat_test_SN5659_R2021b_IO682_CM_uint32 0 2147483646 /end CHARACTERISTIC
/begin CHARACTERISTIC speedgoat_test_SN5659__cal_impl.Label_Value_ex "" VALUE 0x00840668 Scalar_ULONG 0 speedgoat_test_SN5659_R2021b_IO682_CM_uint32 0 2147483646 /end CHARACTERISTIC
/begin CHARACTERISTIC speedgoat_test_SN5659__cal_impl.Label_Value_f "" VALUE 0x00840674 Scalar_ULONG 0 speedgoat_test_SN5659_R2021b_IO682_CM_uint32 0 2147483646 /end CHARACTERISTIC
/begin CHARACTERISTIC speedgoat_test_SN5659__cal_impl.Label_Value_j "" VALUE 0x0084065C Scalar_ULONG 0 speedgoat_test_SN5659_R2021b_IO682_CM_uint32 0 2147483646 /end CHARACTERISTIC
/begin CHARACTERISTIC speedgoat_test_SN5659__cal_impl.Label_Value_k "" VALUE 0x0084068C Scalar_ULONG 0 speedgoat_test_SN5659_R2021b_IO682_CM_uint32 0 2147483646 /end CHARACTERISTIC
/begin CHARACTERISTIC speedgoat_test_SN5659__cal_impl.Mask_BitMask "" VALUE 0x00833020 Scalar_ULONG 0 speedgoat_test_SN5659_R2021b_IO682_CM_uint32 0 2147483646 /end CHARACTERISTIC
/begin CHARACTERISTIC speedgoat_test_SN5659__cal_impl.Mask_BitMask_a "" VALUE 0x0083303C Scalar_ULONG 0 speedgoat_test_SN5659_R2021b_IO682_CM_uint32 0 2147483646 /end CHARACTERISTIC
/begin CHARACTERISTIC speedgoat_test_SN5659__cal_impl.Mask_BitMask_d "" VALUE 0x0083302C Scalar_ULONG 0 speedgoat_test_SN5659_R2021b_IO682_CM_uint32 0 2147483646 /end CHARACTERISTIC
/begin CHARACTERISTIC speedgoat_test_SN5659__cal_impl.Mask_BitMask_e "" VALUE 0x00833030 Scalar_ULONG 0 speedgoat_test_SN5659_R2021b_IO682_CM_uint32 0 2147483646 /end CHARACTERISTIC
/begin CHARACTERISTIC speedgoat_test_SN5659__cal_impl.Mask_BitMask_k "" VALUE 0x00833028 Scalar_ULONG 0 speedgoat_test_SN5659_R2021b_IO682_CM_uint32 0 2147483646 /end CHARACTERISTIC
/begin CHARACTERISTIC speedgoat_test_SN5659__cal_impl.Mask_BitMask_p "" VALUE 0x00833034 Scalar_ULONG 0 speedgoat_test_SN5659_R2021b_IO682_CM_uint32 0 2147483646 /end CHARACTERISTIC
/begin CHARACTERISTIC speedgoat_test_SN5659__cal_impl.Mask_BitMask_pd "" VALUE 0x00833038 Scalar_ULONG 0 speedgoat_test_SN5659_R2021b_IO682_CM_uint32 0 2147483646 /end CHARACTERISTIC
/begin CHARACTERISTIC speedgoat_test_SN5659__cal_impl.Output_InitialCondition_b "" VALUE 0x00840744 Scalar_UBYTE 0 speedgoat_test_SN5659_R2021b_IO682_CM_uint8 0 255 /end CHARACTERISTIC
/begin CHARACTERISTIC speedgoat_test_SN5659__cal_impl.Output_InitialCondition_c "" VALUE 0x008406FC Scalar_UWORD 0 speedgoat_test_SN5659_R2021b_IO682_CM_uint16 0 65535 /end CHARACTERISTIC
/begin CHARACTERISTIC speedgoat_test_SN5659__cal_impl.Output_InitialCondition_e "" VALUE 0x00840708 Scalar_UWORD 0 speedgoat_test_SN5659_R2021b_IO682_CM_uint16 0 65535 /end CHARACTERISTIC
/begin CHARACTERISTIC speedgoat_test_SN5659__cal_impl.Output_InitialCondition_j "" VALUE 0x00840747 Scalar_UBYTE 0 speedgoat_test_SN5659_R2021b_IO682_CM_uint8 0 255 /end CHARACTERISTIC
/begin CHARACTERISTIC speedgoat_test_SN5659__cal_impl.Output_InitialCondition_k "" VALUE 0x00840702 Scalar_UWORD 0 speedgoat_test_SN5659_R2021b_IO682_CM_uint16 0 65535 /end CHARACTERISTIC
/begin CHARACTERISTIC speedgoat_test_SN5659__cal_impl.Output_InitialCondition_l "" VALUE 0x0084070E Scalar_UWORD 0 speedgoat_test_SN5659_R2021b_IO682_CM_uint16 0 65535 /end CHARACTERISTIC
/begin CHARACTERISTIC speedgoat_test_SN5659__cal_impl.Output_InitialCondition_n "" VALUE 0x008406F6 Scalar_UWORD 0 speedgoat_test_SN5659_R2021b_IO682_CM_uint16 0 65535 /end CHARACTERISTIC
/begin CHARACTERISTIC speedgoat_test_SN5659__cal_impl.Output_InitialCondition_nl "" VALUE 0x00840714 Scalar_UWORD 0 speedgoat_test_SN5659_R2021b_IO682_CM_uint16 0 65535 /end CHARACTERISTIC
/begin CHARACTERISTIC speedgoat_test_SN5659__cal_impl.Randomnumber_Mean_a "" VALUE 0x0083B8F0 Scalar_FLOAT64_IEEE 0 speedgoat_test_SN5659_R2021b_IO682_CM_double -1.7E+308 1.7E+308 /end CHARACTERISTIC
/begin CHARACTERISTIC speedgoat_test_SN5659__cal_impl.Randomnumber_Mean_b "" VALUE 0x0083C5D0 Scalar_FLOAT64_IEEE 0 speedgoat_test_SN5659_R2021b_IO682_CM_double -1.7E+308 1.7E+308 /end CHARACTERISTIC
/begin CHARACTERISTIC speedgoat_test_SN5659__cal_impl.Randomnumber_Mean_f3 "" VALUE 0x0083D2B0 Scalar_FLOAT64_IEEE 0 speedgoat_test_SN5659_R2021b_IO682_CM_double -1.7E+308 1.7E+308 /end CHARACTERISTIC
/begin CHARACTERISTIC speedgoat_test_SN5659__cal_impl.Randomnumber_Mean_fh "" VALUE 0x0083CC40 Scalar_FLOAT64_IEEE 0 speedgoat_test_SN5659_R2021b_IO682_CM_double -1.7E+308 1.7E+308 /end CHARACTERISTIC
/begin CHARACTERISTIC speedgoat_test_SN5659__cal_impl.Randomnumber_Mean_fn "" VALUE 0x0083B280 Scalar_FLOAT64_IEEE 0 speedgoat_test_SN5659_R2021b_IO682_CM_double -1.7E+308 1.7E+308 /end CHARACTERISTIC
/begin CHARACTERISTIC speedgoat_test_SN5659__cal_impl.Randomnumber_Mean_h "" VALUE 0x0083BF60 Scalar_FLOAT64_IEEE 0 speedgoat_test_SN5659_R2021b_IO682_CM_double -1.7E+308 1.7E+308 /end CHARACTERISTIC
/begin CHARACTERISTIC speedgoat_test_SN5659__cal_impl.Randomnumber_Mean_k "" VALUE 0x0083AC10 Scalar_FLOAT64_IEEE 0 speedgoat_test_SN5659_R2021b_IO682_CM_double -1.7E+308 1.7E+308 /end CHARACTERISTIC
/begin CHARACTERISTIC speedgoat_test_SN5659__cal_impl.Randomnumber_Seed_c "" VALUE 0x0083B900 Scalar_FLOAT64_IEEE 0 speedgoat_test_SN5659_R2021b_IO682_CM_double -1.7E+308 1.7E+308 /end CHARACTERISTIC
/begin CHARACTERISTIC speedgoat_test_SN5659__cal_impl.Randomnumber_Seed_cd "" VALUE 0x0083CC50 Scalar_FLOAT64_IEEE 0 speedgoat_test_SN5659_R2021b_IO682_CM_double -1.7E+308 1.7E+308 /end CHARACTERISTIC
/begin CHARACTERISTIC speedgoat_test_SN5659__cal_impl.Randomnumber_Seed_f "" VALUE 0x0083B290 Scalar_FLOAT64_IEEE 0 speedgoat_test_SN5659_R2021b_IO682_CM_double -1.7E+308 1.7E+308 /end CHARACTERISTIC
/begin CHARACTERISTIC speedgoat_test_SN5659__cal_impl.Randomnumber_Seed_fj "" VALUE 0x0083C5E0 Scalar_FLOAT64_IEEE 0 speedgoat_test_SN5659_R2021b_IO682_CM_double -1.7E+308 1.7E+308 /end CHARACTERISTIC
/begin CHARACTERISTIC speedgoat_test_SN5659__cal_impl.Randomnumber_Seed_h "" VALUE 0x0083AC20 Scalar_FLOAT64_IEEE 0 speedgoat_test_SN5659_R2021b_IO682_CM_double -1.7E+308 1.7E+308 /end CHARACTERISTIC
/begin CHARACTERISTIC speedgoat_test_SN5659__cal_impl.Randomnumber_Seed_nh "" VALUE 0x0083D2C0 Scalar_FLOAT64_IEEE 0 speedgoat_test_SN5659_R2021b_IO682_CM_double -1.7E+308 1.7E+308 /end CHARACTERISTIC
/begin CHARACTERISTIC speedgoat_test_SN5659__cal_impl.Randomnumber_Seed_p "" VALUE 0x0083BF70 Scalar_FLOAT64_IEEE 0 speedgoat_test_SN5659_R2021b_IO682_CM_double -1.7E+308 1.7E+308 /end CHARACTERISTIC
/begin CHARACTERISTIC speedgoat_test_SN5659__cal_impl.Randomnumber_StdDev_g "" VALUE 0x0083BF68 Scalar_FLOAT64_IEEE 0 speedgoat_test_SN5659_R2021b_IO682_CM_double -1.7E+308 1.7E+308 /end CHARACTERISTIC
/begin CHARACTERISTIC speedgoat_test_SN5659__cal_impl.Randomnumber_StdDev_j "" VALUE 0x0083B288 Scalar_FLOAT64_IEEE 0 speedgoat_test_SN5659_R2021b_IO682_CM_double -1.7E+308 1.7E+308 /end CHARACTERISTIC
/begin CHARACTERISTIC speedgoat_test_SN5659__cal_impl.Randomnumber_StdDev_k "" VALUE 0x0083B8F8 Scalar_FLOAT64_IEEE 0 speedgoat_test_SN5659_R2021b_IO682_CM_double -1.7E+308 1.7E+308 /end CHARACTERISTIC
/begin CHARACTERISTIC speedgoat_test_SN5659__cal_impl.Randomnumber_StdDev_l "" VALUE 0x0083AC18 Scalar_FLOAT64_IEEE 0 speedgoat_test_SN5659_R2021b_IO682_CM_double -1.7E+308 1.7E+308 /end CHARACTERISTIC
/begin CHARACTERISTIC speedgoat_test_SN5659__cal_impl.Randomnumber_StdDev_l4 "" VALUE 0x0083C5D8 Scalar_FLOAT64_IEEE 0 speedgoat_test_SN5659_R2021b_IO682_CM_double -1.7E+308 1.7E+308 /end CHARACTERISTIC
/begin CHARACTERISTIC speedgoat_test_SN5659__cal_impl.Randomnumber_StdDev_m "" VALUE 0x0083D2B8 Scalar_FLOAT64_IEEE 0 speedgoat_test_SN5659_R2021b_IO682_CM_double -1.7E+308 1.7E+308 /end CHARACTERISTIC
/begin CHARACTERISTIC speedgoat_test_SN5659__cal_impl.Randomnumber_StdDev_n "" VALUE 0x0083CC48 Scalar_FLOAT64_IEEE 0 speedgoat_test_SN5659_R2021b_IO682_CM_double -1.7E+308 1.7E+308 /end CHARACTERISTIC
/begin CHARACTERISTIC speedgoat_test_SN5659__cal_impl.SDI_Value "" VALUE 0x00840634 Scalar_ULONG 0 speedgoat_test_SN5659_R2021b_IO682_CM_uint32 0 2147483646 /end CHARACTERISTIC
/begin CHARACTERISTIC speedgoat_test_SN5659__cal_impl.SDI_Value_a "" VALUE 0x00840664 Scalar_ULONG 0 speedgoat_test_SN5659_R2021b_IO682_CM_uint32 0 2147483646 /end CHARACTERISTIC
/begin CHARACTERISTIC speedgoat_test_SN5659__cal_impl.SDI_Value_h "" VALUE 0x00840670 Scalar_ULONG 0 speedgoat_test_SN5659_R2021b_IO682_CM_uint32 0 2147483646 /end CHARACTERISTIC
/begin CHARACTERISTIC speedgoat_test_SN5659__cal_impl.SDI_Value_i "" VALUE 0x0084067C Scalar_ULONG 0 speedgoat_test_SN5659_R2021b_IO682_CM_uint32 0 2147483646 /end CHARACTERISTIC
/begin CHARACTERISTIC speedgoat_test_SN5659__cal_impl.SDI_Value_l "" VALUE 0x00840658 Scalar_ULONG 0 speedgoat_test_SN5659_R2021b_IO682_CM_uint32 0 2147483646 /end CHARACTERISTIC
/begin CHARACTERISTIC speedgoat_test_SN5659__cal_impl.SDI_Value_m "" VALUE 0x0084064C Scalar_ULONG 0 speedgoat_test_SN5659_R2021b_IO682_CM_uint32 0 2147483646 /end CHARACTERISTIC
/begin CHARACTERISTIC speedgoat_test_SN5659__cal_impl.SDI_Value_m3 "" VALUE 0x00840688 Scalar_ULONG 0 speedgoat_test_SN5659_R2021b_IO682_CM_uint32 0 2147483646 /end CHARACTERISTIC
/begin CHARACTERISTIC speedgoat_test_SN5659__cal_impl.SSM_Value "" VALUE 0x00840630 Scalar_ULONG 0 speedgoat_test_SN5659_R2021b_IO682_CM_uint32 0 2147483646 /end CHARACTERISTIC
/begin CHARACTERISTIC speedgoat_test_SN5659__cal_impl.SSM_Value_i "" VALUE 0x00840684 Scalar_ULONG 0 speedgoat_test_SN5659_R2021b_IO682_CM_uint32 0 2147483646 /end CHARACTERISTIC
/begin CHARACTERISTIC speedgoat_test_SN5659__cal_impl.SSM_Value_j "" VALUE 0x0084066C Scalar_ULONG 0 speedgoat_test_SN5659_R2021b_IO682_CM_uint32 0 2147483646 /end CHARACTERISTIC
/begin CHARACTERISTIC speedgoat_test_SN5659__cal_impl.SSM_Value_ji "" VALUE 0x00840678 Scalar_ULONG 0 speedgoat_test_SN5659_R2021b_IO682_CM_uint32 0 2147483646 /end CHARACTERISTIC
/begin CHARACTERISTIC speedgoat_test_SN5659__cal_impl.SSM_Value_l "" VALUE 0x00840648 Scalar_ULONG 0 speedgoat_test_SN5659_R2021b_IO682_CM_uint32 0 2147483646 /end CHARACTERISTIC
/begin CHARACTERISTIC speedgoat_test_SN5659__cal_impl.SSM_Value_m "" VALUE 0x00840660 Scalar_ULONG 0 speedgoat_test_SN5659_R2021b_IO682_CM_uint32 0 2147483646 /end CHARACTERISTIC
/begin CHARACTERISTIC speedgoat_test_SN5659__cal_impl.SSM_Value_n "" VALUE 0x00840654 Scalar_ULONG 0 speedgoat_test_SN5659_R2021b_IO682_CM_uint32 0 2147483646 /end CHARACTERISTIC
/begin CHARACTERISTIC speedgoat_test_SN5659__cal_impl.Scale_Value "" VALUE 0x0083A3D8 Scalar_FLOAT64_IEEE 0 speedgoat_test_SN5659_R2021b_IO682_CM_double -1.7E+308 1.7E+308 /end CHARACTERISTIC
/begin CHARACTERISTIC speedgoat_test_SN5659__cal_impl.Scale_Value_a "" VALUE 0x0083B0B8 Scalar_FLOAT64_IEEE 0 speedgoat_test_SN5659_R2021b_IO682_CM_double -1.7E+308 1.7E+308 /end CHARACTERISTIC
/begin CHARACTERISTIC speedgoat_test_SN5659__cal_impl.Scale_Value_b "" VALUE 0x0083B728 Scalar_FLOAT64_IEEE 0 speedgoat_test_SN5659_R2021b_IO682_CM_double -1.7E+308 1.7E+308 /end CHARACTERISTIC
/begin CHARACTERISTIC speedgoat_test_SN5659__cal_impl.Scale_Value_c "" VALUE 0x0083CA78 Scalar_FLOAT64_IEEE 0 speedgoat_test_SN5659_R2021b_IO682_CM_double -1.7E+308 1.7E+308 /end CHARACTERISTIC
/begin CHARACTERISTIC speedgoat_test_SN5659__cal_impl.Scale_Value_d "" VALUE 0x0083C408 Scalar_FLOAT64_IEEE 0 speedgoat_test_SN5659_R2021b_IO682_CM_double -1.7E+308 1.7E+308 /end CHARACTERISTIC
/begin CHARACTERISTIC speedgoat_test_SN5659__cal_impl.Scale_Value_f "" VALUE 0x0083BD98 Scalar_FLOAT64_IEEE 0 speedgoat_test_SN5659_R2021b_IO682_CM_double -1.7E+308 1.7E+308 /end CHARACTERISTIC
/begin CHARACTERISTIC speedgoat_test_SN5659__cal_impl.Scale_Value_i "" VALUE 0x0083D0E8 Scalar_FLOAT64_IEEE 0 speedgoat_test_SN5659_R2021b_IO682_CM_double -1.7E+308 1.7E+308 /end CHARACTERISTIC
/begin CHARACTERISTIC speedgoat_test_SN5659__cal_impl.Sinewave_Amp_c "" VALUE 0x0083CF38 Scalar_FLOAT64_IEEE 0 speedgoat_test_SN5659_R2021b_IO682_CM_double -1.7E+308 1.7E+308 /end CHARACTERISTIC
/begin CHARACTERISTIC speedgoat_test_SN5659__cal_impl.Sinewave_Amp_d "" VALUE 0x0083B578 Scalar_FLOAT64_IEEE 0 speedgoat_test_SN5659_R2021b_IO682_CM_double -1.7E+308 1.7E+308 /end CHARACTERISTIC
/begin CHARACTERISTIC speedgoat_test_SN5659__cal_impl.Sinewave_Amp_h "" VALUE 0x0083BBE8 Scalar_FLOAT64_IEEE 0 speedgoat_test_SN5659_R2021b_IO682_CM_double -1.7E+308 1.7E+308 /end CHARACTERISTIC
/begin CHARACTERISTIC speedgoat_test_SN5659__cal_impl.Sinewave_Amp_hh "" VALUE 0x0083C8C8 Scalar_FLOAT64_IEEE 0 speedgoat_test_SN5659_R2021b_IO682_CM_double -1.7E+308 1.7E+308 /end CHARACTERISTIC
/begin CHARACTERISTIC speedgoat_test_SN5659__cal_impl.Sinewave_Amp_i "" VALUE 0x0083AF08 Scalar_FLOAT64_IEEE 0 speedgoat_test_SN5659_R2021b_IO682_CM_double -1.7E+308 1.7E+308 /end CHARACTERISTIC
/begin CHARACTERISTIC speedgoat_test_SN5659__cal_impl.Sinewave_Amp_n "" VALUE 0x0083C258 Scalar_FLOAT64_IEEE 0 speedgoat_test_SN5659_R2021b_IO682_CM_double -1.7E+308 1.7E+308 /end CHARACTERISTIC
/begin CHARACTERISTIC speedgoat_test_SN5659__cal_impl.Sinewave_Amp_nm "" VALUE 0x0083D5A8 Scalar_FLOAT64_IEEE 0 speedgoat_test_SN5659_R2021b_IO682_CM_double -1.7E+308 1.7E+308 /end CHARACTERISTIC
/begin CHARACTERISTIC speedgoat_test_SN5659__cal_impl.Sinewave_Bias_c "" VALUE 0x0083AF10 Scalar_FLOAT64_IEEE 0 speedgoat_test_SN5659_R2021b_IO682_CM_double -1.7E+308 1.7E+308 /end CHARACTERISTIC
/begin CHARACTERISTIC speedgoat_test_SN5659__cal_impl.Sinewave_Bias_e "" VALUE 0x0083B580 Scalar_FLOAT64_IEEE 0 speedgoat_test_SN5659_R2021b_IO682_CM_double -1.7E+308 1.7E+308 /end CHARACTERISTIC
/begin CHARACTERISTIC speedgoat_test_SN5659__cal_impl.Sinewave_Bias_g "" VALUE 0x0083C8D0 Scalar_FLOAT64_IEEE 0 speedgoat_test_SN5659_R2021b_IO682_CM_double -1.7E+308 1.7E+308 /end CHARACTERISTIC
/begin CHARACTERISTIC speedgoat_test_SN5659__cal_impl.Sinewave_Bias_j "" VALUE 0x0083C260 Scalar_FLOAT64_IEEE 0 speedgoat_test_SN5659_R2021b_IO682_CM_double -1.7E+308 1.7E+308 /end CHARACTERISTIC
/begin CHARACTERISTIC speedgoat_test_SN5659__cal_impl.Sinewave_Bias_jq "" VALUE 0x0083D5B0 Scalar_FLOAT64_IEEE 0 speedgoat_test_SN5659_R2021b_IO682_CM_double -1.7E+308 1.7E+308 /end CHARACTERISTIC
/begin CHARACTERISTIC speedgoat_test_SN5659__cal_impl.Sinewave_Bias_kg "" VALUE 0x0083CF40 Scalar_FLOAT64_IEEE 0 speedgoat_test_SN5659_R2021b_IO682_CM_double -1.7E+308 1.7E+308 /end CHARACTERISTIC
/begin CHARACTERISTIC speedgoat_test_SN5659__cal_impl.Sinewave_Bias_m "" VALUE 0x0083BBF0 Scalar_FLOAT64_IEEE 0 speedgoat_test_SN5659_R2021b_IO682_CM_double -1.7E+308 1.7E+308 /end CHARACTERISTIC
/begin CHARACTERISTIC speedgoat_test_SN5659__cal_impl.Sinewave_Freq_a "" VALUE 0x0083B588 Scalar_FLOAT64_IEEE 0 speedgoat_test_SN5659_R2021b_IO682_CM_double -1.7E+308 1.7E+308 /end CHARACTERISTIC
/begin CHARACTERISTIC speedgoat_test_SN5659__cal_impl.Sinewave_Freq_ah "" VALUE 0x0083C268 Scalar_FLOAT64_IEEE 0 speedgoat_test_SN5659_R2021b_IO682_CM_double -1.7E+308 1.7E+308 /end CHARACTERISTIC
/begin CHARACTERISTIC speedgoat_test_SN5659__cal_impl.Sinewave_Freq_c "" VALUE 0x0083C8D8 Scalar_FLOAT64_IEEE 0 speedgoat_test_SN5659_R2021b_IO682_CM_double -1.7E+308 1.7E+308 /end CHARACTERISTIC
/begin CHARACTERISTIC speedgoat_test_SN5659__cal_impl.Sinewave_Freq_g "" VALUE 0x0083AF18 Scalar_FLOAT64_IEEE 0 speedgoat_test_SN5659_R2021b_IO682_CM_double -1.7E+308 1.7E+308 /end CHARACTERISTIC
/begin CHARACTERISTIC speedgoat_test_SN5659__cal_impl.Sinewave_Freq_l "" VALUE 0x0083D5B8 Scalar_FLOAT64_IEEE 0 speedgoat_test_SN5659_R2021b_IO682_CM_double -1.7E+308 1.7E+308 /end CHARACTERISTIC
/begin CHARACTERISTIC speedgoat_test_SN5659__cal_impl.Sinewave_Freq_m "" VALUE 0x0083BBF8 Scalar_FLOAT64_IEEE 0 speedgoat_test_SN5659_R2021b_IO682_CM_double -1.7E+308 1.7E+308 /end CHARACTERISTIC
/begin CHARACTERISTIC speedgoat_test_SN5659__cal_impl.Sinewave_Freq_mo "" VALUE 0x0083CF48 Scalar_FLOAT64_IEEE 0 speedgoat_test_SN5659_R2021b_IO682_CM_double -1.7E+308 1.7E+308 /end CHARACTERISTIC
/begin CHARACTERISTIC speedgoat_test_SN5659__cal_impl.Sinewave_HCos_b "" VALUE 0x0083D5C8 Scalar_FLOAT64_IEEE 0 speedgoat_test_SN5659_R2021b_IO682_CM_double -1.7E+308 1.7E+308 /end CHARACTERISTIC
/begin CHARACTERISTIC speedgoat_test_SN5659__cal_impl.Sinewave_HCos_f "" VALUE 0x0083CF58 Scalar_FLOAT64_IEEE 0 speedgoat_test_SN5659_R2021b_IO682_CM_double -1.7E+308 1.7E+308 /end CHARACTERISTIC
/begin CHARACTERISTIC speedgoat_test_SN5659__cal_impl.Sinewave_HCos_j "" VALUE 0x0083AF28 Scalar_FLOAT64_IEEE 0 speedgoat_test_SN5659_R2021b_IO682_CM_double -1.7E+308 1.7E+308 /end CHARACTERISTIC
/begin CHARACTERISTIC speedgoat_test_SN5659__cal_impl.Sinewave_HCos_j4 "" VALUE 0x0083B598 Scalar_FLOAT64_IEEE 0 speedgoat_test_SN5659_R2021b_IO682_CM_double -1.7E+308 1.7E+308 /end CHARACTERISTIC
/begin CHARACTERISTIC speedgoat_test_SN5659__cal_impl.Sinewave_HCos_jg "" VALUE 0x0083C8E8 Scalar_FLOAT64_IEEE 0 speedgoat_test_SN5659_R2021b_IO682_CM_double -1.7E+308 1.7E+308 /end CHARACTERISTIC
/begin CHARACTERISTIC speedgoat_test_SN5659__cal_impl.Sinewave_HCos_jn "" VALUE 0x0083C278 Scalar_FLOAT64_IEEE 0 speedgoat_test_SN5659_R2021b_IO682_CM_double -1.7E+308 1.7E+308 /end CHARACTERISTIC
/begin CHARACTERISTIC speedgoat_test_SN5659__cal_impl.Sinewave_HCos_o "" VALUE 0x0083BC08 Scalar_FLOAT64_IEEE 0 speedgoat_test_SN5659_R2021b_IO682_CM_double -1.7E+308 1.7E+308 /end CHARACTERISTIC
/begin CHARACTERISTIC speedgoat_test_SN5659__cal_impl.Sinewave_Hsin_d "" VALUE 0x0083B590 Scalar_FLOAT64_IEEE 0 speedgoat_test_SN5659_R2021b_IO682_CM_double -1.7E+308 1.7E+308 /end CHARACTERISTIC
/begin CHARACTERISTIC speedgoat_test_SN5659__cal_impl.Sinewave_Hsin_e "" VALUE 0x0083D5C0 Scalar_FLOAT64_IEEE 0 speedgoat_test_SN5659_R2021b_IO682_CM_double -1.7E+308 1.7E+308 /end CHARACTERISTIC
/begin CHARACTERISTIC speedgoat_test_SN5659__cal_impl.Sinewave_Hsin_h "" VALUE 0x0083CF50 Scalar_FLOAT64_IEEE 0 speedgoat_test_SN5659_R2021b_IO682_CM_double -1.7E+308 1.7E+308 /end CHARACTERISTIC
/begin CHARACTERISTIC speedgoat_test_SN5659__cal_impl.Sinewave_Hsin_i "" VALUE 0x0083C270 Scalar_FLOAT64_IEEE 0 speedgoat_test_SN5659_R2021b_IO682_CM_double -1.7E+308 1.7E+308 /end CHARACTERISTIC
/begin CHARACTERISTIC speedgoat_test_SN5659__cal_impl.Sinewave_Hsin_n "" VALUE 0x0083AF20 Scalar_FLOAT64_IEEE 0 speedgoat_test_SN5659_R2021b_IO682_CM_double -1.7E+308 1.7E+308 /end CHARACTERISTIC
/begin CHARACTERISTIC speedgoat_test_SN5659__cal_impl.Sinewave_Hsin_o "" VALUE 0x0083BC00 Scalar_FLOAT64_IEEE 0 speedgoat_test_SN5659_R2021b_IO682_CM_double -1.7E+308 1.7E+308 /end CHARACTERISTIC
/begin CHARACTERISTIC speedgoat_test_SN5659__cal_impl.Sinewave_Hsin_o1 "" VALUE 0x0083C8E0 Scalar_FLOAT64_IEEE 0 speedgoat_test_SN5659_R2021b_IO682_CM_double -1.7E+308 1.7E+308 /end CHARACTERISTIC
/begin CHARACTERISTIC speedgoat_test_SN5659__cal_impl.Sinewave_PCos_a "" VALUE 0x0083C8F8 Scalar_FLOAT64_IEEE 0 speedgoat_test_SN5659_R2021b_IO682_CM_double -1.7E+308 1.7E+308 /end CHARACTERISTIC
/begin CHARACTERISTIC speedgoat_test_SN5659__cal_impl.Sinewave_PCos_f "" VALUE 0x0083C288 Scalar_FLOAT64_IEEE 0 speedgoat_test_SN5659_R2021b_IO682_CM_double -1.7E+308 1.7E+308 /end CHARACTERISTIC
/begin CHARACTERISTIC speedgoat_test_SN5659__cal_impl.Sinewave_PCos_h "" VALUE 0x0083BC18 Scalar_FLOAT64_IEEE 0 speedgoat_test_SN5659_R2021b_IO682_CM_double -1.7E+308 1.7E+308 /end CHARACTERISTIC
/begin CHARACTERISTIC speedgoat_test_SN5659__cal_impl.Sinewave_PCos_j "" VALUE 0x0083AF38 Scalar_FLOAT64_IEEE 0 speedgoat_test_SN5659_R2021b_IO682_CM_double -1.7E+308 1.7E+308 /end CHARACTERISTIC
/begin CHARACTERISTIC speedgoat_test_SN5659__cal_impl.Sinewave_PCos_k "" VALUE 0x0083D5D8 Scalar_FLOAT64_IEEE 0 speedgoat_test_SN5659_R2021b_IO682_CM_double -1.7E+308 1.7E+308 /end CHARACTERISTIC
/begin CHARACTERISTIC speedgoat_test_SN5659__cal_impl.Sinewave_PCos_m "" VALUE 0x0083CF68 Scalar_FLOAT64_IEEE 0 speedgoat_test_SN5659_R2021b_IO682_CM_double -1.7E+308 1.7E+308 /end CHARACTERISTIC
/begin CHARACTERISTIC speedgoat_test_SN5659__cal_impl.Sinewave_PCos_p "" VALUE 0x0083B5A8 Scalar_FLOAT64_IEEE 0 speedgoat_test_SN5659_R2021b_IO682_CM_double -1.7E+308 1.7E+308 /end CHARACTERISTIC
/begin CHARACTERISTIC speedgoat_test_SN5659__cal_impl.Sinewave_PSin_c "" VALUE 0x0083B5A0 Scalar_FLOAT64_IEEE 0 speedgoat_test_SN5659_R2021b_IO682_CM_double -1.7E+308 1.7E+308 /end CHARACTERISTIC
/begin CHARACTERISTIC speedgoat_test_SN5659__cal_impl.Sinewave_PSin_e "" VALUE 0x0083BC10 Scalar_FLOAT64_IEEE 0 speedgoat_test_SN5659_R2021b_IO682_CM_double -1.7E+308 1.7E+308 /end CHARACTERISTIC
/begin CHARACTERISTIC speedgoat_test_SN5659__cal_impl.Sinewave_PSin_f "" VALUE 0x0083C280 Scalar_FLOAT64_IEEE 0 speedgoat_test_SN5659_R2021b_IO682_CM_double -1.7E+308 1.7E+308 /end CHARACTERISTIC
/begin CHARACTERISTIC speedgoat_test_SN5659__cal_impl.Sinewave_PSin_fk "" VALUE 0x0083C8F0 Scalar_FLOAT64_IEEE 0 speedgoat_test_SN5659_R2021b_IO682_CM_double -1.7E+308 1.7E+308 /end CHARACTERISTIC
/begin CHARACTERISTIC speedgoat_test_SN5659__cal_impl.Sinewave_PSin_g "" VALUE 0x0083D5D0 Scalar_FLOAT64_IEEE 0 speedgoat_test_SN5659_R2021b_IO682_CM_double -1.7E+308 1.7E+308 /end CHARACTERISTIC
/begin CHARACTERISTIC speedgoat_test_SN5659__cal_impl.Sinewave_PSin_h "" VALUE 0x0083AF30 Scalar_FLOAT64_IEEE 0 speedgoat_test_SN5659_R2021b_IO682_CM_double -1.7E+308 1.7E+308 /end CHARACTERISTIC
/begin CHARACTERISTIC speedgoat_test_SN5659__cal_impl.Sinewave_PSin_m "" VALUE 0x0083CF60 Scalar_FLOAT64_IEEE 0 speedgoat_test_SN5659_R2021b_IO682_CM_double -1.7E+308 1.7E+308 /end CHARACTERISTIC
/begin CHARACTERISTIC speedgoat_test_SN5659__cal_impl.shiftthedoublevalue27bitslef_oj "" VALUE 0x0083CA80 Scalar_FLOAT64_IEEE 0 speedgoat_test_SN5659_R2021b_IO682_CM_double -1.7E+308 1.7E+308 /end CHARACTERISTIC
/begin CHARACTERISTIC speedgoat_test_SN5659__cal_impl.shiftthedoublevalue27bitslef_pp "" VALUE 0x0083C410 Scalar_FLOAT64_IEEE 0 speedgoat_test_SN5659_R2021b_IO682_CM_double -1.7E+308 1.7E+308 /end CHARACTERISTIC
/begin CHARACTERISTIC speedgoat_test_SN5659__cal_impl.shiftthedoublevalue27bitsleft_V "" VALUE 0x0083A3E0 Scalar_FLOAT64_IEEE 0 speedgoat_test_SN5659_R2021b_IO682_CM_double -1.7E+308 1.7E+308 /end CHARACTERISTIC
/begin CHARACTERISTIC speedgoat_test_SN5659__cal_impl.shiftthedoublevalue27bitsleft_g "" VALUE 0x0083B730 Scalar_FLOAT64_IEEE 0 speedgoat_test_SN5659_R2021b_IO682_CM_double -1.7E+308 1.7E+308 /end CHARACTERISTIC
/begin CHARACTERISTIC speedgoat_test_SN5659__cal_impl.shiftthedoublevalue27bitsleft_h "" VALUE 0x0083D0F0 Scalar_FLOAT64_IEEE 0 speedgoat_test_SN5659_R2021b_IO682_CM_double -1.7E+308 1.7E+308 /end CHARACTERISTIC
/begin CHARACTERISTIC speedgoat_test_SN5659__cal_impl.shiftthedoublevalue27bitsleft_i "" VALUE 0x0083BDA0 Scalar_FLOAT64_IEEE 0 speedgoat_test_SN5659_R2021b_IO682_CM_double -1.7E+308 1.7E+308 /end CHARACTERISTIC
/begin CHARACTERISTIC speedgoat_test_SN5659__cal_impl.shiftthedoublevalue27bitsleft_p "" VALUE 0x0083B0C0 Scalar_FLOAT64_IEEE 0 speedgoat_test_SN5659_R2021b_IO682_CM_double -1.7E+308 1.7E+308 /end CHARACTERISTIC
/begin MEASUREMENT speedgoat_test_SN5659_R2021b_IO682_B.BitwiseOperator "" ULONG speedgoat_test_SN5659_R2021b_IO682_CM_uint32 0 0 0 2147483646 ECU_ADDRESS 0x008953B0 /end MEASUREMENT
/begin MEASUREMENT speedgoat_test_SN5659_R2021b_IO682_B.BitwiseOperator_a "" ULONG speedgoat_test_SN5659_R2021b_IO682_CM_uint32 0 0 0 2147483646 ECU_ADDRESS 0x008953D8 /end MEASUREMENT
/begin MEASUREMENT speedgoat_test_SN5659_R2021b_IO682_B.BitwiseOperator_c "" ULONG speedgoat_test_SN5659_R2021b_IO682_CM_uint32 0 0 0 2147483646 ECU_ADDRESS 0x00895414 /end MEASUREMENT
/begin MEASUREMENT speedgoat_test_SN5659_R2021b_IO682_B.BitwiseOperator_e "" ULONG speedgoat_test_SN5659_R2021b_IO682_CM_uint32 0 0 0 2147483646 ECU_ADDRESS 0x0089543C /end MEASUREMENT
/begin MEASUREMENT speedgoat_test_SN5659_R2021b_IO682_B.BitwiseOperator_f "" ULONG speedgoat_test_SN5659_R2021b_IO682_CM_uint32 0 0 0 2147483646 ECU_ADDRESS 0x00895428 /end MEASUREMENT
/begin MEASUREMENT speedgoat_test_SN5659_R2021b_IO682_B.BitwiseOperator_k "" ULONG speedgoat_test_SN5659_R2021b_IO682_CM_uint32 0 0 0 2147483646 ECU_ADDRESS 0x00895400 /end MEASUREMENT
/begin MEASUREMENT speedgoat_test_SN5659_R2021b_IO682_B.BitwiseOperator_p "" ULONG speedgoat_test_SN5659_R2021b_IO682_CM_uint32 0 0 0 2147483646 ECU_ADDRESS 0x008953EC /end MEASUREMENT
/begin MEASUREMENT speedgoat_test_SN5659_R2021b_IO682_B.DataTypeConversion1_d "" FLOAT64_IEEE speedgoat_test_SN5659_R2021b_IO682_CM_double 0 0 -1.7E+308 1.7E+308 ECU_ADDRESS 0x00895110 /end MEASUREMENT
/begin MEASUREMENT speedgoat_test_SN5659_R2021b_IO682_B.DataTypeConversion1_ga "" FLOAT64_IEEE speedgoat_test_SN5659_R2021b_IO682_CM_double 0 0 -1.7E+308 1.7E+308 ECU_ADDRESS 0x008950C0 /end MEASUREMENT
/begin MEASUREMENT speedgoat_test_SN5659_R2021b_IO682_B.DataTypeConversion1_gm "" FLOAT64_IEEE speedgoat_test_SN5659_R2021b_IO682_CM_double 0 0 -1.7E+308 1.7E+308 ECU_ADDRESS 0x00895070 /end MEASUREMENT
/begin MEASUREMENT speedgoat_test_SN5659_R2021b_IO682_B.DataTypeConversion1_i "" FLOAT64_IEEE speedgoat_test_SN5659_R2021b_IO682_CM_double 0 0 -1.7E+308 1.7E+308 ECU_ADDRESS 0x00894F80 /end MEASUREMENT
/begin MEASUREMENT speedgoat_test_SN5659_R2021b_IO682_B.DataTypeConversion1_l "" FLOAT64_IEEE speedgoat_test_SN5659_R2021b_IO682_CM_double 0 0 -1.7E+308 1.7E+308 ECU_ADDRESS 0x00895160 /end MEASUREMENT
/begin MEASUREMENT speedgoat_test_SN5659_R2021b_IO682_B.DataTypeConversion1_n "" FLOAT64_IEEE speedgoat_test_SN5659_R2021b_IO682_CM_double 0 0 -1.7E+308 1.7E+308 ECU_ADDRESS 0x00895020 /end MEASUREMENT
/begin MEASUREMENT speedgoat_test_SN5659_R2021b_IO682_B.DataTypeConversion1_p "" FLOAT64_IEEE speedgoat_test_SN5659_R2021b_IO682_CM_double 0 0 -1.7E+308 1.7E+308 ECU_ADDRESS 0x00894FD0 /end MEASUREMENT
/begin MEASUREMENT speedgoat_test_SN5659_R2021b_IO682_B.DataTypeConversion_b "" ULONG speedgoat_test_SN5659_R2021b_IO682_CM_uint32 0 0 0 2147483646 ECU_ADDRESS 0x008953F0 /end MEASUREMENT
/begin MEASUREMENT speedgoat_test_SN5659_R2021b_IO682_B.DataTypeConversion_d "" FLOAT64_IEEE speedgoat_test_SN5659_R2021b_IO682_CM_double 0 0 -1.7E+308 1.7E+308 ECU_ADDRESS 0x00895090 /end MEASUREMENT
/begin MEASUREMENT speedgoat_test_SN5659_R2021b_IO682_B.DataTypeConversion_e "" FLOAT64_IEEE speedgoat_test_SN5659_R2021b_IO682_CM_double 0 0 -1.7E+308 1.7E+308 ECU_ADDRESS 0x00894F50 /end MEASUREMENT
/begin MEASUREMENT speedgoat_test_SN5659_R2021b_IO682_B.DataTypeConversion_ec "" ULONG speedgoat_test_SN5659_R2021b_IO682_CM_uint32 0 0 0 2147483646 ECU_ADDRESS 0x008953C8 /end MEASUREMENT
/begin MEASUREMENT speedgoat_test_SN5659_R2021b_IO682_B.DataTypeConversion_er "" ULONG speedgoat_test_SN5659_R2021b_IO682_CM_uint32 0 0 0 2147483646 ECU_ADDRESS 0x00895404 /end MEASUREMENT
/begin MEASUREMENT speedgoat_test_SN5659_R2021b_IO682_B.DataTypeConversion_f5 "" ULONG speedgoat_test_SN5659_R2021b_IO682_CM_uint32 0 0 0 2147483646 ECU_ADDRESS 0x0089542C /end MEASUREMENT
/begin MEASUREMENT speedgoat_test_SN5659_R2021b_IO682_B.DataTypeConversion_fb "" ULONG speedgoat_test_SN5659_R2021b_IO682_CM_uint32 0 0 0 2147483646 ECU_ADDRESS 0x00895418 /end MEASUREMENT
/begin MEASUREMENT speedgoat_test_SN5659_R2021b_IO682_B.DataTypeConversion_hu "" FLOAT64_IEEE speedgoat_test_SN5659_R2021b_IO682_CM_double 0 0 -1.7E+308 1.7E+308 ECU_ADDRESS 0x00895130 /end MEASUREMENT
/begin MEASUREMENT speedgoat_test_SN5659_R2021b_IO682_B.DataTypeConversion_j "" FLOAT64_IEEE speedgoat_test_SN5659_R2021b_IO682_CM_double 0 0 -1.7E+308 1.7E+308 ECU_ADDRESS 0x00894FA0 /end MEASUREMENT
/begin MEASUREMENT speedgoat_test_SN5659_R2021b_IO682_B.DataTypeConversion_jj "" ULONG speedgoat_test_SN5659_R2021b_IO682_CM_uint32 0 0 0 2147483646 ECU_ADDRESS 0x008953DC /end MEASUREMENT
/begin MEASUREMENT speedgoat_test_SN5659_R2021b_IO682_B.DataTypeConversion_jr "" FLOAT64_IEEE speedgoat_test_SN5659_R2021b_IO682_CM_double 0 0 -1.7E+308 1.7E+308 ECU_ADDRESS 0x008950E0 /end MEASUREMENT
/begin MEASUREMENT speedgoat_test_SN5659_R2021b_IO682_B.DataTypeConversion_k5 "" ULONG speedgoat_test_SN5659_R2021b_IO682_CM_uint32 0 0 0 2147483646 ECU_ADDRESS 0x008953A0 /end MEASUREMENT
/begin MEASUREMENT speedgoat_test_SN5659_R2021b_IO682_B.DataTypeConversion_o "" FLOAT64_IEEE speedgoat_test_SN5659_R2021b_IO682_CM_double 0 0 -1.7E+308 1.7E+308 ECU_ADDRESS 0x00895040 /end MEASUREMENT
/begin MEASUREMENT speedgoat_test_SN5659_R2021b_IO682_B.DataTypeConversion_p "" FLOAT64_IEEE speedgoat_test_SN5659_R2021b_IO682_CM_double 0 0 -1.7E+308 1.7E+308 ECU_ADDRESS 0x00894FF0 /end MEASUREMENT
/begin MEASUREMENT speedgoat_test_SN5659_R2021b_IO682_B.Divide "" FLOAT64_IEEE speedgoat_test_SN5659_R2021b_IO682_CM_double 0 0 -1.7E+308 1.7E+308 ECU_ADDRESS 0x00894ED0 /end MEASUREMENT
/begin MEASUREMENT speedgoat_test_SN5659_R2021b_IO682_B.Divide_g "" FLOAT64_IEEE speedgoat_test_SN5659_R2021b_IO682_CM_double 0 0 -1.7E+308 1.7E+308 ECU_ADDRESS 0x008950B0 /end MEASUREMENT
/begin MEASUREMENT speedgoat_test_SN5659_R2021b_IO682_B.Divide_h "" FLOAT64_IEEE speedgoat_test_SN5659_R2021b_IO682_CM_double 0 0 -1.7E+308 1.7E+308 ECU_ADDRESS 0x00894F70 /end MEASUREMENT
/begin MEASUREMENT speedgoat_test_SN5659_R2021b_IO682_B.Divide_i "" FLOAT64_IEEE speedgoat_test_SN5659_R2021b_IO682_CM_double 0 0 -1.7E+308 1.7E+308 ECU_ADDRESS 0x00895010 /end MEASUREMENT
/begin MEASUREMENT speedgoat_test_SN5659_R2021b_IO682_B.Divide_j "" FLOAT64_IEEE speedgoat_test_SN5659_R2021b_IO682_CM_double 0 0 -1.7E+308 1.7E+308 ECU_ADDRESS 0x00895060 /end MEASUREMENT
/begin MEASUREMENT speedgoat_test_SN5659_R2021b_IO682_B.Divide_k3 "" FLOAT64_IEEE speedgoat_test_SN5659_R2021b_IO682_CM_double 0 0 -1.7E+308 1.7E+308 ECU_ADDRESS 0x00895100 /end MEASUREMENT
/begin MEASUREMENT speedgoat_test_SN5659_R2021b_IO682_B.Divide_p "" FLOAT64_IEEE speedgoat_test_SN5659_R2021b_IO682_CM_double 0 0 -1.7E+308 1.7E+308 ECU_ADDRESS 0x00894FC0 /end MEASUREMENT
/begin MEASUREMENT speedgoat_test_SN5659_R2021b_IO682_B.Encode1_f "" FLOAT64_IEEE speedgoat_test_SN5659_R2021b_IO682_CM_double 0 0 -1.7E+308 1.7E+308 ECU_ADDRESS 0x00894F48 /end MEASUREMENT
/begin MEASUREMENT speedgoat_test_SN5659_R2021b_IO682_B.Encode1_h "" FLOAT64_IEEE speedgoat_test_SN5659_R2021b_IO682_CM_double 0 0 -1.7E+308 1.7E+308 ECU_ADDRESS 0x00895128 /end MEASUREMENT
/begin MEASUREMENT speedgoat_test_SN5659_R2021b_IO682_B.Encode1_k "" FLOAT64_IEEE speedgoat_test_SN5659_R2021b_IO682_CM_double 0 0 -1.7E+308 1.7E+308 ECU_ADDRESS 0x00894F98 /end MEASUREMENT
/begin MEASUREMENT speedgoat_test_SN5659_R2021b_IO682_B.Encode1_l "" FLOAT64_IEEE speedgoat_test_SN5659_R2021b_IO682_CM_double 0 0 -1.7E+308 1.7E+308 ECU_ADDRESS 0x00894FE8 /end MEASUREMENT
/begin MEASUREMENT speedgoat_test_SN5659_R2021b_IO682_B.Encode1_p "" FLOAT64_IEEE speedgoat_test_SN5659_R2021b_IO682_CM_double 0 0 -1.7E+308 1.7E+308 ECU_ADDRESS 0x00895038 /end MEASUREMENT
/begin MEASUREMENT speedgoat_test_SN5659_R2021b_IO682_B.Encode1_pb "" FLOAT64_IEEE speedgoat_test_SN5659_R2021b_IO682_CM_double 0 0 -1.7E+308 1.7E+308 ECU_ADDRESS 0x00895088 /end MEASUREMENT
/begin MEASUREMENT speedgoat_test_SN5659_R2021b_IO682_B.Encode1_pbz "" FLOAT64_IEEE speedgoat_test_SN5659_R2021b_IO682_CM_double 0 0 -1.7E+308 1.7E+308 ECU_ADDRESS 0x008950D8 /end MEASUREMENT
/begin MEASUREMENT speedgoat_test_SN5659_R2021b_IO682_B.Encode2_f "" FLOAT64_IEEE speedgoat_test_SN5659_R2021b_IO682_CM_double 0 0 -1.7E+308 1.7E+308 ECU_ADDRESS 0x00894F58 /end MEASUREMENT
/begin MEASUREMENT speedgoat_test_SN5659_R2021b_IO682_B.Encode2_fb "" FLOAT64_IEEE speedgoat_test_SN5659_R2021b_IO682_CM_double 0 0 -1.7E+308 1.7E+308 ECU_ADDRESS 0x00895138 /end MEASUREMENT
/begin MEASUREMENT speedgoat_test_SN5659_R2021b_IO682_B.Encode2_fi "" FLOAT64_IEEE speedgoat_test_SN5659_R2021b_IO682_CM_double 0 0 -1.7E+308 1.7E+308 ECU_ADDRESS 0x00895048 /end MEASUREMENT
/begin MEASUREMENT speedgoat_test_SN5659_R2021b_IO682_B.Encode2_h "" FLOAT64_IEEE speedgoat_test_SN5659_R2021b_IO682_CM_double 0 0 -1.7E+308 1.7E+308 ECU_ADDRESS 0x00895098 /end MEASUREMENT
/begin MEASUREMENT speedgoat_test_SN5659_R2021b_IO682_B.Encode2_hc "" FLOAT64_IEEE speedgoat_test_SN5659_R2021b_IO682_CM_double 0 0 -1.7E+308 1.7E+308 ECU_ADDRESS 0x008950E8 /end MEASUREMENT
/begin MEASUREMENT speedgoat_test_SN5659_R2021b_IO682_B.Encode2_i "" FLOAT64_IEEE speedgoat_test_SN5659_R2021b_IO682_CM_double 0 0 -1.7E+308 1.7E+308 ECU_ADDRESS 0x00894FA8 /end MEASUREMENT
/begin MEASUREMENT speedgoat_test_SN5659_R2021b_IO682_B.Encode2_j "" FLOAT64_IEEE speedgoat_test_SN5659_R2021b_IO682_CM_double 0 0 -1.7E+308 1.7E+308 ECU_ADDRESS 0x00895028 /end MEASUREMENT
/begin MEASUREMENT speedgoat_test_SN5659_R2021b_IO682_B.Encode3_b "" FLOAT64_IEEE speedgoat_test_SN5659_R2021b_IO682_CM_double 0 0 -1.7E+308 1.7E+308 ECU_ADDRESS 0x00894F68 /end MEASUREMENT
/begin MEASUREMENT speedgoat_test_SN5659_R2021b_IO682_B.Encode3_d "" FLOAT64_IEEE speedgoat_test_SN5659_R2021b_IO682_CM_double 0 0 -1.7E+308 1.7E+308 ECU_ADDRESS 0x00895148 /end MEASUREMENT
/begin MEASUREMENT speedgoat_test_SN5659_R2021b_IO682_B.Encode3_f "" FLOAT64_IEEE speedgoat_test_SN5659_R2021b_IO682_CM_double 0 0 -1.7E+308 1.7E+308 ECU_ADDRESS 0x00895058 /end MEASUREMENT
/begin MEASUREMENT speedgoat_test_SN5659_R2021b_IO682_B.Encode3_l "" FLOAT64_IEEE speedgoat_test_SN5659_R2021b_IO682_CM_double 0 0 -1.7E+308 1.7E+308 ECU_ADDRESS 0x008950A8 /end MEASUREMENT
/begin MEASUREMENT speedgoat_test_SN5659_R2021b_IO682_B.Encode3_o "" FLOAT64_IEEE speedgoat_test_SN5659_R2021b_IO682_CM_double 0 0 -1.7E+308 1.7E+308 ECU_ADDRESS 0x00894FB8 /end MEASUREMENT
/begin MEASUREMENT speedgoat_test_SN5659_R2021b_IO682_B.Encode3_ou "" FLOAT64_IEEE speedgoat_test_SN5659_R2021b_IO682_CM_double 0 0 -1.7E+308 1.7E+308 ECU_ADDRESS 0x008950F8 /end MEASUREMENT
/begin MEASUREMENT speedgoat_test_SN5659_R2021b_IO682_B.Encode3_p "" FLOAT64_IEEE speedgoat_test_SN5659_R2021b_IO682_CM_double 0 0 -1.7E+308 1.7E+308 ECU_ADDRESS 0x00895008 /end MEASUREMENT
/begin MEASUREMENT speedgoat_test_SN5659_R2021b_IO682_B.Encode4_c "" FLOAT64_IEEE speedgoat_test_SN5659_R2021b_IO682_CM_double 0 0 -1.7E+308 1.7E+308 ECU_ADDRESS 0x00894FD8 /end MEASUREMENT
/begin MEASUREMENT speedgoat_test_SN5659_R2021b_IO682_B.Encode4_g "" FLOAT64_IEEE speedgoat_test_SN5659_R2021b_IO682_CM_double 0 0 -1.7E+308 1.7E+308 ECU_ADDRESS 0x00895078 /end MEASUREMENT
/begin MEASUREMENT speedgoat_test_SN5659_R2021b_IO682_B.Encode4_i "" FLOAT64_IEEE speedgoat_test_SN5659_R2021b_IO682_CM_double 0 0 -1.7E+308 1.7E+308 ECU_ADDRESS 0x00894F88 /end MEASUREMENT
/begin MEASUREMENT speedgoat_test_SN5659_R2021b_IO682_B.Encode4_l "" FLOAT64_IEEE speedgoat_test_SN5659_R2021b_IO682_CM_double 0 0 -1.7E+308 1.7E+308 ECU_ADDRESS 0x008950C8 /end MEASUREMENT
/begin MEASUREMENT speedgoat_test_SN5659_R2021b_IO682_B.Encode4_n "" FLOAT64_IEEE speedgoat_test_SN5659_R2021b_IO682_CM_double 0 0 -1.7E+308 1.7E+308 ECU_ADDRESS 0x00895168 /end MEASUREMENT
/begin MEASUREMENT speedgoat_test_SN5659_R2021b_IO682_B.Encode4_p "" FLOAT64_IEEE speedgoat_test_SN5659_R2021b_IO682_CM_double 0 0 -1.7E+308 1.7E+308 ECU_ADDRESS 0x00895118 /end MEASUREMENT
/begin MEASUREMENT speedgoat_test_SN5659_R2021b_IO682_B.Encode5_d "" FLOAT64_IEEE speedgoat_test_SN5659_R2021b_IO682_CM_double 0 0 -1.7E+308 1.7E+308 ECU_ADDRESS 0x00894FF8 /end MEASUREMENT
/begin MEASUREMENT speedgoat_test_SN5659_R2021b_IO682_B.FixPtSum1_a "" UWORD speedgoat_test_SN5659_R2021b_IO682_CM_uint16 0 0 0 65535 ECU_ADDRESS 0x008954EE /end MEASUREMENT
/begin MEASUREMENT speedgoat_test_SN5659_R2021b_IO682_B.FixPtSum1_d "" UWORD speedgoat_test_SN5659_R2021b_IO682_CM_uint16 0 0 0 65535 ECU_ADDRESS 0x00895506 /end MEASUREMENT
/begin MEASUREMENT speedgoat_test_SN5659_R2021b_IO682_B.FixPtSum1_e "" UWORD speedgoat_test_SN5659_R2021b_IO682_CM_uint16 0 0 0 65535 ECU_ADDRESS 0x008954FA /end MEASUREMENT
/begin MEASUREMENT speedgoat_test_SN5659_R2021b_IO682_B.FixPtSum1_fe "" UBYTE speedgoat_test_SN5659_R2021b_IO682_CM_uint8 0 0 0 255 ECU_ADDRESS 0x00895538 /end MEASUREMENT
/begin MEASUREMENT speedgoat_test_SN5659_R2021b_IO682_B.FixPtSum1_g "" UWORD speedgoat_test_SN5659_R2021b_IO682_CM_uint16 0 0 0 65535 ECU_ADDRESS 0x008954F4 /end MEASUREMENT
/begin MEASUREMENT speedgoat_test_SN5659_R2021b_IO682_B.FixPtSum1_i "" UBYTE speedgoat_test_SN5659_R2021b_IO682_CM_uint8 0 0 0 255 ECU_ADDRESS 0x00895535 /end MEASUREMENT
/begin MEASUREMENT speedgoat_test_SN5659_R2021b_IO682_B.FixPtSum1_n "" UWORD speedgoat_test_SN5659_R2021b_IO682_CM_uint16 0 0 0 65535 ECU_ADDRESS 0x008954E8 /end MEASUREMENT
/begin MEASUREMENT speedgoat_test_SN5659_R2021b_IO682_B.FixPtSum1_o "" UWORD speedgoat_test_SN5659_R2021b_IO682_CM_uint16 0 0 0 65535 ECU_ADDRESS 0x00895500 /end MEASUREMENT
/begin MEASUREMENT speedgoat_test_SN5659_R2021b_IO682_B.FixPtSwitch_b "" UWORD speedgoat_test_SN5659_R2021b_IO682_CM_uint16 0 0 0 65535 ECU_ADDRESS 0x008954F0 /end MEASUREMENT
/begin MEASUREMENT speedgoat_test_SN5659_R2021b_IO682_B.FixPtSwitch_bx "" UWORD speedgoat_test_SN5659_R2021b_IO682_CM_uint16 0 0 0 65535 ECU_ADDRESS 0x008954FC /end MEASUREMENT
/begin MEASUREMENT speedgoat_test_SN5659_R2021b_IO682_B.FixPtSwitch_h "" UWORD speedgoat_test_SN5659_R2021b_IO682_CM_uint16 0 0 0 65535 ECU_ADDRESS 0x008954EA /end MEASUREMENT
/begin MEASUREMENT speedgoat_test_SN5659_R2021b_IO682_B.FixPtSwitch_ha "" UBYTE speedgoat_test_SN5659_R2021b_IO682_CM_uint8 0 0 0 255 ECU_ADDRESS 0x00895536 /end MEASUREMENT
/begin MEASUREMENT speedgoat_test_SN5659_R2021b_IO682_B.FixPtSwitch_jo "" UBYTE speedgoat_test_SN5659_R2021b_IO682_CM_uint8 0 0 0 255 ECU_ADDRESS 0x00895539 /end MEASUREMENT
/begin MEASUREMENT speedgoat_test_SN5659_R2021b_IO682_B.FixPtSwitch_l "" UWORD speedgoat_test_SN5659_R2021b_IO682_CM_uint16 0 0 0 65535 ECU_ADDRESS 0x008954F6 /end MEASUREMENT
/begin MEASUREMENT speedgoat_test_SN5659_R2021b_IO682_B.FixPtSwitch_l2 "" UWORD speedgoat_test_SN5659_R2021b_IO682_CM_uint16 0 0 0 65535 ECU_ADDRESS 0x00895508 /end MEASUREMENT
/begin MEASUREMENT speedgoat_test_SN5659_R2021b_IO682_B.FixPtSwitch_lo "" UWORD speedgoat_test_SN5659_R2021b_IO682_CM_uint16 0 0 0 65535 ECU_ADDRESS 0x00895502 /end MEASUREMENT
/begin MEASUREMENT speedgoat_test_SN5659_R2021b_IO682_B.Mask "" ULONG speedgoat_test_SN5659_R2021b_IO682_CM_uint32 0 0 0 2147483646 ECU_ADDRESS 0x008953A4 /end MEASUREMENT
/begin MEASUREMENT speedgoat_test_SN5659_R2021b_IO682_B.Mask_c "" ULONG speedgoat_test_SN5659_R2021b_IO682_CM_uint32 0 0 0 2147483646 ECU_ADDRESS 0x008953F4 /end MEASUREMENT
/begin MEASUREMENT speedgoat_test_SN5659_R2021b_IO682_B.Mask_h "" ULONG speedgoat_test_SN5659_R2021b_IO682_CM_uint32 0 0 0 2147483646 ECU_ADDRESS 0x0089541C /end MEASUREMENT
/begin MEASUREMENT speedgoat_test_SN5659_R2021b_IO682_B.Mask_h0 "" ULONG speedgoat_test_SN5659_R2021b_IO682_CM_uint32 0 0 0 2147483646 ECU_ADDRESS 0x00895430 /end MEASUREMENT
/begin MEASUREMENT speedgoat_test_SN5659_R2021b_IO682_B.Mask_i "" ULONG speedgoat_test_SN5659_R2021b_IO682_CM_uint32 0 0 0 2147483646 ECU_ADDRESS 0x008953E0 /end MEASUREMENT
/begin MEASUREMENT speedgoat_test_SN5659_R2021b_IO682_B.Mask_m "" ULONG speedgoat_test_SN5659_R2021b_IO682_CM_uint32 0 0 0 2147483646 ECU_ADDRESS 0x00895408 /end MEASUREMENT
/begin MEASUREMENT speedgoat_test_SN5659_R2021b_IO682_B.Mask_n "" ULONG speedgoat_test_SN5659_R2021b_IO682_CM_uint32 0 0 0 2147483646 ECU_ADDRESS 0x008953CC /end MEASUREMENT
/begin MEASUREMENT speedgoat_test_SN5659_R2021b_IO682_B.Multiply "" FLOAT64_IEEE speedgoat_test_SN5659_R2021b_IO682_CM_double 0 0 -1.7E+308 1.7E+308 ECU_ADDRESS 0x00894ED8 /end MEASUREMENT
/begin MEASUREMENT speedgoat_test_SN5659_R2021b_IO682_B.Multiply_a "" FLOAT64_IEEE speedgoat_test_SN5659_R2021b_IO682_CM_double 0 0 -1.7E+308 1.7E+308 ECU_ADDRESS 0x00894F78 /end MEASUREMENT
/begin MEASUREMENT speedgoat_test_SN5659_R2021b_IO682_B.Multiply_hd "" FLOAT64_IEEE speedgoat_test_SN5659_R2021b_IO682_CM_double 0 0 -1.7E+308 1.7E+308 ECU_ADDRESS 0x00895108 /end MEASUREMENT
/begin MEASUREMENT speedgoat_test_SN5659_R2021b_IO682_B.Multiply_he "" FLOAT64_IEEE speedgoat_test_SN5659_R2021b_IO682_CM_double 0 0 -1.7E+308 1.7E+308 ECU_ADDRESS 0x00895018 /end MEASUREMENT
/begin MEASUREMENT speedgoat_test_SN5659_R2021b_IO682_B.Multiply_i "" FLOAT64_IEEE speedgoat_test_SN5659_R2021b_IO682_CM_double 0 0 -1.7E+308 1.7E+308 ECU_ADDRESS 0x00895068 /end MEASUREMENT
/begin MEASUREMENT speedgoat_test_SN5659_R2021b_IO682_B.Multiply_j "" FLOAT64_IEEE speedgoat_test_SN5659_R2021b_IO682_CM_double 0 0 -1.7E+308 1.7E+308 ECU_ADDRESS 0x00894FC8 /end MEASUREMENT
/begin MEASUREMENT speedgoat_test_SN5659_R2021b_IO682_B.Multiply_n "" FLOAT64_IEEE speedgoat_test_SN5659_R2021b_IO682_CM_double 0 0 -1.7E+308 1.7E+308 ECU_ADDRESS 0x008950B8 /end MEASUREMENT
/begin MEASUREMENT speedgoat_test_SN5659_R2021b_IO682_B.Output_b "" UWORD speedgoat_test_SN5659_R2021b_IO682_CM_uint16 0 0 0 65535 ECU_ADDRESS 0x008954E6 /end MEASUREMENT
/begin MEASUREMENT speedgoat_test_SN5659_R2021b_IO682_B.Output_e "" UWORD speedgoat_test_SN5659_R2021b_IO682_CM_uint16 0 0 0 65535 ECU_ADDRESS 0x008954FE /end MEASUREMENT
/begin MEASUREMENT speedgoat_test_SN5659_R2021b_IO682_B.Output_g "" UBYTE speedgoat_test_SN5659_R2021b_IO682_CM_uint8 0 0 0 255 ECU_ADDRESS 0x00895537 /end MEASUREMENT
/begin MEASUREMENT speedgoat_test_SN5659_R2021b_IO682_B.Output_j "" UWORD speedgoat_test_SN5659_R2021b_IO682_CM_uint16 0 0 0 65535 ECU_ADDRESS 0x008954F2 /end MEASUREMENT
/begin MEASUREMENT speedgoat_test_SN5659_R2021b_IO682_B.Output_k "" UWORD speedgoat_test_SN5659_R2021b_IO682_CM_uint16 0 0 0 65535 ECU_ADDRESS 0x00895504 /end MEASUREMENT
/begin MEASUREMENT speedgoat_test_SN5659_R2021b_IO682_B.Output_m "" UWORD speedgoat_test_SN5659_R2021b_IO682_CM_uint16 0 0 0 65535 ECU_ADDRESS 0x008954F8 /end MEASUREMENT
/begin MEASUREMENT speedgoat_test_SN5659_R2021b_IO682_B.Output_p "" UWORD speedgoat_test_SN5659_R2021b_IO682_CM_uint16 0 0 0 65535 ECU_ADDRESS 0x008954EC /end MEASUREMENT
/begin MEASUREMENT speedgoat_test_SN5659_R2021b_IO682_B.Randomnumber_b "" FLOAT64_IEEE speedgoat_test_SN5659_R2021b_IO682_CM_double 0 0 -1.7E+308 1.7E+308 ECU_ADDRESS 0x00894F90 /end MEASUREMENT
/begin MEASUREMENT speedgoat_test_SN5659_R2021b_IO682_B.Randomnumber_br "" FLOAT64_IEEE speedgoat_test_SN5659_R2021b_IO682_CM_double 0 0 -1.7E+308 1.7E+308 ECU_ADDRESS 0x008950D0 /end MEASUREMENT
/begin MEASUREMENT speedgoat_test_SN5659_R2021b_IO682_B.Randomnumber_e "" FLOAT64_IEEE speedgoat_test_SN5659_R2021b_IO682_CM_double 0 0 -1.7E+308 1.7E+308 ECU_ADDRESS 0x00895120 /end MEASUREMENT
/begin MEASUREMENT speedgoat_test_SN5659_R2021b_IO682_B.Randomnumber_m "" FLOAT64_IEEE speedgoat_test_SN5659_R2021b_IO682_CM_double 0 0 -1.7E+308 1.7E+308 ECU_ADDRESS 0x00895080 /end MEASUREMENT
/begin MEASUREMENT speedgoat_test_SN5659_R2021b_IO682_B.Randomnumber_n "" FLOAT64_IEEE speedgoat_test_SN5659_R2021b_IO682_CM_double 0 0 -1.7E+308 1.7E+308 ECU_ADDRESS 0x00895030 /end MEASUREMENT
/begin MEASUREMENT speedgoat_test_SN5659_R2021b_IO682_B.Randomnumber_p "" FLOAT64_IEEE speedgoat_test_SN5659_R2021b_IO682_CM_double 0 0 -1.7E+308 1.7E+308 ECU_ADDRESS 0x00894F40 /end MEASUREMENT
/begin MEASUREMENT speedgoat_test_SN5659_R2021b_IO682_B.Randomnumber_pz "" FLOAT64_IEEE speedgoat_test_SN5659_R2021b_IO682_CM_double 0 0 -1.7E+308 1.7E+308 ECU_ADDRESS 0x00894FE0 /end MEASUREMENT
/begin MEASUREMENT speedgoat_test_SN5659_R2021b_IO682_B.ShifttoSDIslot "" ULONG speedgoat_test_SN5659_R2021b_IO682_CM_uint32 0 0 0 2147483646 ECU_ADDRESS 0x008953AC /end MEASUREMENT
/begin MEASUREMENT speedgoat_test_SN5659_R2021b_IO682_B.ShifttoSDIslot_a "" ULONG speedgoat_test_SN5659_R2021b_IO682_CM_uint32 0 0 0 2147483646 ECU_ADDRESS 0x008953D4 /end MEASUREMENT
/begin MEASUREMENT speedgoat_test_SN5659_R2021b_IO682_B.ShifttoSDIslot_b "" ULONG speedgoat_test_SN5659_R2021b_IO682_CM_uint32 0 0 0 2147483646 ECU_ADDRESS 0x008953FC /end MEASUREMENT
/begin MEASUREMENT speedgoat_test_SN5659_R2021b_IO682_B.ShifttoSDIslot_c "" ULONG speedgoat_test_SN5659_R2021b_IO682_CM_uint32 0 0 0 2147483646 ECU_ADDRESS 0x00895424 /end MEASUREMENT
/begin MEASUREMENT speedgoat_test_SN5659_R2021b_IO682_B.ShifttoSDIslot_k "" ULONG speedgoat_test_SN5659_R2021b_IO682_CM_uint32 0 0 0 2147483646 ECU_ADDRESS 0x008953E8 /end MEASUREMENT
/begin MEASUREMENT speedgoat_test_SN5659_R2021b_IO682_B.ShifttoSDIslot_km "" ULONG speedgoat_test_SN5659_R2021b_IO682_CM_uint32 0 0 0 2147483646 ECU_ADDRESS 0x00895410 /end MEASUREMENT
/begin MEASUREMENT speedgoat_test_SN5659_R2021b_IO682_B.ShifttoSDIslot_m "" ULONG speedgoat_test_SN5659_R2021b_IO682_CM_uint32 0 0 0 2147483646 ECU_ADDRESS 0x00895438 /end MEASUREMENT
/begin MEASUREMENT speedgoat_test_SN5659_R2021b_IO682_B.ShifttoSSMslot "" ULONG speedgoat_test_SN5659_R2021b_IO682_CM_uint32 0 0 0 2147483646 ECU_ADDRESS 0x008953A8 /end MEASUREMENT
/begin MEASUREMENT speedgoat_test_SN5659_R2021b_IO682_B.ShifttoSSMslot_b "" ULONG speedgoat_test_SN5659_R2021b_IO682_CM_uint32 0 0 0 2147483646 ECU_ADDRESS 0x008953E4 /end MEASUREMENT
/begin MEASUREMENT speedgoat_test_SN5659_R2021b_IO682_B.ShifttoSSMslot_f "" ULONG speedgoat_test_SN5659_R2021b_IO682_CM_uint32 0 0 0 2147483646 ECU_ADDRESS 0x00895420 /end MEASUREMENT
/begin MEASUREMENT speedgoat_test_SN5659_R2021b_IO682_B.ShifttoSSMslot_k "" ULONG speedgoat_test_SN5659_R2021b_IO682_CM_uint32 0 0 0 2147483646 ECU_ADDRESS 0x008953F8 /end MEASUREMENT
/begin MEASUREMENT speedgoat_test_SN5659_R2021b_IO682_B.ShifttoSSMslot_m "" ULONG speedgoat_test_SN5659_R2021b_IO682_CM_uint32 0 0 0 2147483646 ECU_ADDRESS 0x008953D0 /end MEASUREMENT
/begin MEASUREMENT speedgoat_test_SN5659_R2021b_IO682_B.ShifttoSSMslot_m3 "" ULONG speedgoat_test_SN5659_R2021b_IO682_CM_uint32 0 0 0 2147483646 ECU_ADDRESS 0x00895434 /end MEASUREMENT
/begin MEASUREMENT speedgoat_test_SN5659_R2021b_IO682_B.ShifttoSSMslot_mi "" ULONG speedgoat_test_SN5659_R2021b_IO682_CM_uint32 0 0 0 2147483646 ECU_ADDRESS 0x0089540C /end MEASUREMENT
/begin MEASUREMENT speedgoat_test_SN5659_R2021b_IO682_B.Sinewave_a "" FLOAT64_IEEE speedgoat_test_SN5659_R2021b_IO682_CM_double 0 0 -1.7E+308 1.7E+308 ECU_ADDRESS 0x008950F0 /end MEASUREMENT
/begin MEASUREMENT speedgoat_test_SN5659_R2021b_IO682_B.Sinewave_f "" FLOAT64_IEEE speedgoat_test_SN5659_R2021b_IO682_CM_double 0 0 -1.7E+308 1.7E+308 ECU_ADDRESS 0x00894F60 /end MEASUREMENT
/begin MEASUREMENT speedgoat_test_SN5659_R2021b_IO682_B.Sinewave_g "" FLOAT64_IEEE speedgoat_test_SN5659_R2021b_IO682_CM_double 0 0 -1.7E+308 1.7E+308 ECU_ADDRESS 0x00895050 /end MEASUREMENT
/begin MEASUREMENT speedgoat_test_SN5659_R2021b_IO682_B.Sinewave_k "" FLOAT64_IEEE speedgoat_test_SN5659_R2021b_IO682_CM_double 0 0 -1.7E+308 1.7E+308 ECU_ADDRESS 0x00894FB0 /end MEASUREMENT
/begin MEASUREMENT speedgoat_test_SN5659_R2021b_IO682_B.Sinewave_kh "" FLOAT64_IEEE speedgoat_test_SN5659_R2021b_IO682_CM_double 0 0 -1.7E+308 1.7E+308 ECU_ADDRESS 0x008950A0 /end MEASUREMENT
/begin MEASUREMENT speedgoat_test_SN5659_R2021b_IO682_B.Sinewave_o5 "" FLOAT64_IEEE speedgoat_test_SN5659_R2021b_IO682_CM_double 0 0 -1.7E+308 1.7E+308 ECU_ADDRESS 0x00895140 /end MEASUREMENT
/begin MEASUREMENT speedgoat_test_SN5659_R2021b_IO682_B.Sinewave_p "" FLOAT64_IEEE speedgoat_test_SN5659_R2021b_IO682_CM_double 0 0 -1.7E+308 1.7E+308 ECU_ADDRESS 0x00895000 /end MEASUREMENT
/begin MEASUREMENT speedgoat_test_SN5659_R2021b_IO682_DW.NextOutput_f "" FLOAT64_IEEE speedgoat_test_SN5659_R2021b_IO682_CM_double 0 0 -1.7E+308 1.7E+308 ECU_ADDRESS 0x008927A8 /end MEASUREMENT
/begin MEASUREMENT speedgoat_test_SN5659_R2021b_IO682_DW.NextOutput_ft "" FLOAT64_IEEE speedgoat_test_SN5659_R2021b_IO682_CM_double 0 0 -1.7E+308 1.7E+308 ECU_ADDRESS 0x008927F0 /end MEASUREMENT
/begin MEASUREMENT speedgoat_test_SN5659_R2021b_IO682_DW.NextOutput_i "" FLOAT64_IEEE speedgoat_test_SN5659_R2021b_IO682_CM_double 0 0 -1.7E+308 1.7E+308 ECU_ADDRESS 0x00892808 /end MEASUREMENT
/begin MEASUREMENT speedgoat_test_SN5659_R2021b_IO682_DW.NextOutput_j "" FLOAT64_IEEE speedgoat_test_SN5659_R2021b_IO682_CM_double 0 0 -1.7E+308 1.7E+308 ECU_ADDRESS 0x00892820 /end MEASUREMENT
/begin MEASUREMENT speedgoat_test_SN5659_R2021b_IO682_DW.NextOutput_n "" FLOAT64_IEEE speedgoat_test_SN5659_R2021b_IO682_CM_double 0 0 -1.7E+308 1.7E+308 ECU_ADDRESS 0x00892790 /end MEASUREMENT
/begin MEASUREMENT speedgoat_test_SN5659_R2021b_IO682_DW.NextOutput_ni "" FLOAT64_IEEE speedgoat_test_SN5659_R2021b_IO682_CM_double 0 0 -1.7E+308 1.7E+308 ECU_ADDRESS 0x008927D8 /end MEASUREMENT
/begin MEASUREMENT speedgoat_test_SN5659_R2021b_IO682_DW.NextOutput_nj "" FLOAT64_IEEE speedgoat_test_SN5659_R2021b_IO682_CM_double 0 0 -1.7E+308 1.7E+308 ECU_ADDRESS 0x008927C0 /end MEASUREMENT
/begin MEASUREMENT speedgoat_test_SN5659_R2021b_IO682_DW.Output_DSTATE_c "" UBYTE speedgoat_test_SN5659_R2021b_IO682_CM_uint8 0 0 0 255 ECU_ADDRESS 0x0089310C /end MEASUREMENT
/begin MEASUREMENT speedgoat_test_SN5659_R2021b_IO682_DW.Output_DSTATE_e "" UWORD speedgoat_test_SN5659_R2021b_IO682_CM_uint16 0 0 0 65535 ECU_ADDRESS 0x008930FA /end MEASUREMENT
/begin MEASUREMENT speedgoat_test_SN5659_R2021b_IO682_DW.Output_DSTATE_e0 "" UBYTE speedgoat_test_SN5659_R2021b_IO682_CM_uint8 0 0 0 255 ECU_ADDRESS 0x0089310D /end MEASUREMENT
/begin MEASUREMENT speedgoat_test_SN5659_R2021b_IO682_DW.Output_DSTATE_k "" UWORD speedgoat_test_SN5659_R2021b_IO682_CM_uint16 0 0 0 65535 ECU_ADDRESS 0x008930FC /end MEASUREMENT
/begin MEASUREMENT speedgoat_test_SN5659_R2021b_IO682_DW.Output_DSTATE_m "" UWORD speedgoat_test_SN5659_R2021b_IO682_CM_uint16 0 0 0 65535 ECU_ADDRESS 0x008930F6 /end MEASUREMENT
/begin MEASUREMENT speedgoat_test_SN5659_R2021b_IO682_DW.Output_DSTATE_o "" UWORD speedgoat_test_SN5659_R2021b_IO682_CM_uint16 0 0 0 65535 ECU_ADDRESS 0x008930F2 /end MEASUREMENT
/begin MEASUREMENT speedgoat_test_SN5659_R2021b_IO682_DW.Output_DSTATE_o0 "" UWORD speedgoat_test_SN5659_R2021b_IO682_CM_uint16 0 0 0 65535 ECU_ADDRESS 0x008930F4 /end MEASUREMENT
/begin MEASUREMENT speedgoat_test_SN5659_R2021b_IO682_DW.Output_DSTATE_oy "" UWORD speedgoat_test_SN5659_R2021b_IO682_CM_uint16 0 0 0 65535 ECU_ADDRESS 0x008930F8 /end MEASUREMENT
/begin MEASUREMENT speedgoat_test_SN5659_R2021b_IO682_DW.RandSeed_d "" ULONG speedgoat_test_SN5659_R2021b_IO682_CM_uint32 0 0 0 2147483646 ECU_ADDRESS 0x00892ED0 /end MEASUREMENT
/begin MEASUREMENT speedgoat_test_SN5659_R2021b_IO682_DW.RandSeed_f "" ULONG speedgoat_test_SN5659_R2021b_IO682_CM_uint32 0 0 0 2147483646 ECU_ADDRESS 0x00892EC4 /end MEASUREMENT
/begin MEASUREMENT speedgoat_test_SN5659_R2021b_IO682_DW.RandSeed_f4 "" ULONG speedgoat_test_SN5659_R2021b_IO682_CM_uint32 0 0 0 2147483646 ECU_ADDRESS 0x00892EC8 /end MEASUREMENT
/begin MEASUREMENT speedgoat_test_SN5659_R2021b_IO682_DW.RandSeed_g "" ULONG speedgoat_test_SN5659_R2021b_IO682_CM_uint32 0 0 0 2147483646 ECU_ADDRESS 0x00892EC0 /end MEASUREMENT
/begin MEASUREMENT speedgoat_test_SN5659_R2021b_IO682_DW.RandSeed_h "" ULONG speedgoat_test_SN5659_R2021b_IO682_CM_uint32 0 0 0 2147483646 ECU_ADDRESS 0x00892EB8 /end MEASUREMENT
/begin MEASUREMENT speedgoat_test_SN5659_R2021b_IO682_DW.RandSeed_i "" ULONG speedgoat_test_SN5659_R2021b_IO682_CM_uint32 0 0 0 2147483646 ECU_ADDRESS 0x00892ECC /end MEASUREMENT
/begin MEASUREMENT speedgoat_test_SN5659_R2021b_IO682_DW.RandSeed_k "" ULONG speedgoat_test_SN5659_R2021b_IO682_CM_uint32 0 0 0 2147483646 ECU_ADDRESS 0x00892EBC /end MEASUREMENT
/begin MEASUREMENT speedgoat_test_SN5659_R2021b_IO682_DW.lastCos_a "" FLOAT64_IEEE speedgoat_test_SN5659_R2021b_IO682_CM_double 0 0 -1.7E+308 1.7E+308 ECU_ADDRESS 0x008927B8 /end MEASUREMENT
/begin MEASUREMENT speedgoat_test_SN5659_R2021b_IO682_DW.lastCos_af "" FLOAT64_IEEE speedgoat_test_SN5659_R2021b_IO682_CM_double 0 0 -1.7E+308 1.7E+308 ECU_ADDRESS 0x008927D0 /end MEASUREMENT
/begin MEASUREMENT speedgoat_test_SN5659_R2021b_IO682_DW.lastCos_h "" FLOAT64_IEEE speedgoat_test_SN5659_R2021b_IO682_CM_double 0 0 -1.7E+308 1.7E+308 ECU_ADDRESS 0x008927E8 /end MEASUREMENT
/begin MEASUREMENT speedgoat_test_SN5659_R2021b_IO682_DW.lastCos_l "" FLOAT64_IEEE speedgoat_test_SN5659_R2021b_IO682_CM_double 0 0 -1.7E+308 1.7E+308 ECU_ADDRESS 0x00892800 /end MEASUREMENT
/begin MEASUREMENT speedgoat_test_SN5659_R2021b_IO682_DW.lastCos_ld "" FLOAT64_IEEE speedgoat_test_SN5659_R2021b_IO682_CM_double 0 0 -1.7E+308 1.7E+308 ECU_ADDRESS 0x00892818 /end MEASUREMENT
/begin MEASUREMENT speedgoat_test_SN5659_R2021b_IO682_DW.lastCos_lh "" FLOAT64_IEEE speedgoat_test_SN5659_R2021b_IO682_CM_double 0 0 -1.7E+308 1.7E+308 ECU_ADDRESS 0x00892830 /end MEASUREMENT
/begin MEASUREMENT speedgoat_test_SN5659_R2021b_IO682_DW.lastCos_m "" FLOAT64_IEEE speedgoat_test_SN5659_R2021b_IO682_CM_double 0 0 -1.7E+308 1.7E+308 ECU_ADDRESS 0x008927A0 /end MEASUREMENT
/begin MEASUREMENT speedgoat_test_SN5659_R2021b_IO682_DW.lastSin_ct "" FLOAT64_IEEE speedgoat_test_SN5659_R2021b_IO682_CM_double 0 0 -1.7E+308 1.7E+308 ECU_ADDRESS 0x008927B0 /end MEASUREMENT
/begin MEASUREMENT speedgoat_test_SN5659_R2021b_IO682_DW.lastSin_d "" FLOAT64_IEEE speedgoat_test_SN5659_R2021b_IO682_CM_double 0 0 -1.7E+308 1.7E+308 ECU_ADDRESS 0x008927E0 /end MEASUREMENT
/begin MEASUREMENT speedgoat_test_SN5659_R2021b_IO682_DW.lastSin_du "" FLOAT64_IEEE speedgoat_test_SN5659_R2021b_IO682_CM_double 0 0 -1.7E+308 1.7E+308 ECU_ADDRESS 0x008927F8 /end MEASUREMENT
/begin MEASUREMENT speedgoat_test_SN5659_R2021b_IO682_DW.lastSin_e "" FLOAT64_IEEE speedgoat_test_SN5659_R2021b_IO682_CM_double 0 0 -1.7E+308 1.7E+308 ECU_ADDRESS 0x00892828 /end MEASUREMENT
/begin MEASUREMENT speedgoat_test_SN5659_R2021b_IO682_DW.lastSin_f "" FLOAT64_IEEE speedgoat_test_SN5659_R2021b_IO682_CM_double 0 0 -1.7E+308 1.7E+308 ECU_ADDRESS 0x00892810 /end MEASUREMENT
/begin MEASUREMENT speedgoat_test_SN5659_R2021b_IO682_DW.lastSin_m "" FLOAT64_IEEE speedgoat_test_SN5659_R2021b_IO682_CM_double 0 0 -1.7E+308 1.7E+308 ECU_ADDRESS 0x00892798 /end MEASUREMENT
/begin MEASUREMENT speedgoat_test_SN5659_R2021b_IO682_DW.lastSin_p "" FLOAT64_IEEE speedgoat_test_SN5659_R2021b_IO682_CM_double 0 0 -1.7E+308 1.7E+308 ECU_ADDRESS 0x008927C8 /end MEASUREMENT
/begin MEASUREMENT speedgoat_test_SN5659_R2021b_IO682_DW.systemEnable_a "" SLONG speedgoat_test_SN5659_R2021b_IO682_CM_int32 0 0 -2147483648 2147483647 ECU_ADDRESS 0x00892E88 /end MEASUREMENT
/begin MEASUREMENT speedgoat_test_SN5659_R2021b_IO682_DW.systemEnable_b "" SLONG speedgoat_test_SN5659_R2021b_IO682_CM_int32 0 0 -2147483648 2147483647 ECU_ADDRESS 0x00892E78 /end MEASUREMENT
/begin MEASUREMENT speedgoat_test_SN5659_R2021b_IO682_DW.systemEnable_f "" SLONG speedgoat_test_SN5659_R2021b_IO682_CM_int32 0 0 -2147483648 2147483647 ECU_ADDRESS 0x00892E7C /end MEASUREMENT
/begin MEASUREMENT speedgoat_test_SN5659_R2021b_IO682_DW.systemEnable_j "" SLONG speedgoat_test_SN5659_R2021b_IO682_CM_int32 0 0 -2147483648 2147483647 ECU_ADDRESS 0x00892E84 /end MEASUREMENT
/begin MEASUREMENT speedgoat_test_SN5659_R2021b_IO682_DW.systemEnable_m "" SLONG speedgoat_test_SN5659_R2021b_IO682_CM_int32 0 0 -2147483648 2147483647 ECU_ADDRESS 0x00892E80 /end MEASUREMENT
/begin MEASUREMENT speedgoat_test_SN5659_R2021b_IO682_DW.systemEnable_ml "" SLONG speedgoat_test_SN5659_R2021b_IO682_CM_int32 0 0 -2147483648 2147483647 ECU_ADDRESS 0x00892E90 /end MEASUREMENT
/begin MEASUREMENT speedgoat_test_SN5659_R2021b_IO682_DW.systemEnable_p "" SLONG speedgoat_test_SN5659_R2021b_IO682_CM_int32 0 0 -2147483648 2147483647 ECU_ADDRESS 0x00892E8C /end MEASUREMENT
/begin COMPU_METHOD speedgoat_test_SN5659_R2021b_IO682_CM_double "" IDENTICAL "%15.10" "" /end COMPU_METHOD
/begin COMPU_METHOD speedgoat_test_SN5659_R2021b_IO682_CM_int32 "" IDENTICAL "%10.0" "" /end COMPU_METHOD
/begin COMPU_METHOD speedgoat_test_SN5659_R2021b_IO682_CM_uint16 "" IDENTICAL "%5.0" "" /end COMPU_METHOD
/begin COMPU_METHOD speedgoat_test_SN5659_R2021b_IO682_CM_uint32 "" IDENTICAL "%10.0" "" /end COMPU_METHOD
/begin COMPU_METHOD speedgoat_test_SN5659_R2021b_IO682_CM_uint8 "" IDENTICAL "%3.0" "" /end COMPU_METHOD
/begin RECORD_LAYOUT Scalar_FLOAT64_IEEE FNC_VALUES 1 FLOAT64_IEEE COLUMN_DIR DIRECT /end RECORD_LAYOUT
/begin RECORD_LAYOUT Scalar_UBYTE FNC_VALUES 1 UBYTE COLUMN_DIR DIRECT /end RECORD_LAYOUT
/begin RECORD_LAYOUT Scalar_ULONG FNC_VALUES 1 ULONG COLUMN_DIR DIRECT /end RECORD_LAYOUT
/begin RECORD_LAYOUT Scalar_UWORD FNC_VALUES 1 UWORD COLUMN_DIR DIRECT /end RECORD_LAYOUT
/begin GROUP speedgoat_test_SN5659_R2021b_IO682_IO682_Encode_Channel_11 "speedgoat_test_SN5659_R2021b_IO682/IO682/Encode Channel 11"
 /begin SUB_GROUP speedgoat_test_SN5659_R2021b_IO682_IO682_Encode_Channel_11_Counter_Limited speedgoat_test_SN5659_R2021b_IO682_IO682_Encode_Channel_11_Prepare_RAW_value /end SUB_GROUP
 /begin REF_CHARACTERISTIC speedgoat_test_SN5659__cal_impl.Constant_Value_i speedgoat_test_SN5659__cal_impl.Encode1_P10_i speedgoat_test_SN5659__cal_impl.Encode1_P11_l speedgoat_test_SN5659__cal_impl.Encode1_P12_k speedgoat_test_SN5659__cal_impl.Encode1_P13_i speedgoat_test_SN5659__cal_impl.Encode1_P14_o speedgoat_test_SN5659__cal_impl.Encode1_P15_b speedgoat_test_SN5659__cal_impl.Encode1_P1_c speedgoat_test_SN5659__cal_impl.Encode1_P2_g speedgoat_test_SN5659__cal_impl.Encode1_P3_l speedgoat_test_SN5659__cal_impl.Encode1_P4_e speedgoat_test_SN5659__cal_impl.Encode1_P5_i speedgoat_test_SN5659__cal_impl.Encode1_P6_p speedgoat_test_SN5659__cal_impl.Encode1_P7_d speedgoat_test_SN5659__cal_impl.Encode1_P8_c speedgoat_test_SN5659__cal_impl.Encode1_P9_n speedgoat_test_SN5659__cal_impl.Encode2_P10_c speedgoat_test_SN5659__cal_impl.Encode2_P11_g speedgoat_test_SN5659__cal_impl.Encode2_P12_m speedgoat_test_SN5659__cal_impl.Encode2_P13_p speedgoat_test_SN5659__cal_impl.Encode2_P14_p speedgoat_test_SN5659__cal_impl.Encode2_P15_c speedgoat_test_SN5659__cal_impl.Encode2_P1_a speedgoat_test_SN5659__cal_impl.Encode2_P2_i speedgoat_test_SN5659__cal_impl.Encode2_P3_k speedgoat_test_SN5659__cal_impl.Encode2_P4_o speedgoat_test_SN5659__cal_impl.Encode2_P5_l speedgoat_test_SN5659__cal_impl.Encode2_P6_n speedgoat_test_SN5659__cal_impl.Encode2_P7_b speedgoat_test_SN5659__cal_impl.Encode2_P8_h speedgoat_test_SN5659__cal_impl.Encode2_P9_m speedgoat_test_SN5659__cal_impl.Encode3_P10_j speedgoat_test_SN5659__cal_impl.Encode3_P11_j speedgoat_test_SN5659__cal_impl.Encode3_P12_j speedgoat_test_SN5659__cal_impl.Encode3_P13_i speedgoat_test_SN5659__cal_impl.Encode3_P14_d speedgoat_test_SN5659__cal_impl.Encode3_P15_h speedgoat_test_SN5659__cal_impl.Encode3_P1_e speedgoat_test_SN5659__cal_impl.Encode3_P2_f speedgoat_test_SN5659__cal_impl.Encode3_P3_b speedgoat_test_SN5659__cal_impl.Encode3_P4_d speedgoat_test_SN5659__cal_impl.Encode3_P5_i speedgoat_test_SN5659__cal_impl.Encode3_P6_e speedgoat_test_SN5659__cal_impl.Encode3_P7_h speedgoat_test_SN5659__cal_impl.Encode3_P8_f speedgoat_test_SN5659__cal_impl.Encode3_P9_k speedgoat_test_SN5659__cal_impl.Encode4_P10_h speedgoat_test_SN5659__cal_impl.Encode4_P11_j speedgoat_test_SN5659__cal_impl.Encode4_P12_l speedgoat_test_SN5659__cal_impl.Encode4_P13_a speedgoat_test_SN5659__cal_impl.Encode4_P14_l speedgoat_test_SN5659__cal_impl.Encode4_P15_i speedgoat_test_SN5659__cal_impl.Encode4_P1_e speedgoat_test_SN5659__cal_impl.Encode4_P2_d speedgoat_test_SN5659__cal_impl.Encode4_P3_o speedgoat_test_SN5659__cal_impl.Encode4_P4_a speedgoat_test_SN5659__cal_impl.Encode4_P5_a speedgoat_test_SN5659__cal_impl.Encode4_P6_a speedgoat_test_SN5659__cal_impl.Encode4_P7_p speedgoat_test_SN5659__cal_impl.Encode4_P8_o speedgoat_test_SN5659__cal_impl.Encode4_P9_i speedgoat_test_SN5659__cal_impl.Randomnumber_Mean_k speedgoat_test_SN5659__cal_impl.Randomnumber_Seed_h speedgoat_test_SN5659__cal_impl.Randomnumber_StdDev_l speedgoat_test_SN5659__cal_impl.Sinewave_Amp_i speedgoat_test_SN5659__cal_impl.Sinewave_Bias_c speedgoat_test_SN5659__cal_impl.Sinewave_Freq_g speedgoat_test_SN5659__cal_impl.Sinewave_HCos_j speedgoat_test_SN5659__cal_impl.Sinewave_Hsin_n speedgoat_test_SN5659__cal_impl.Sinewave_PCos_j speedgoat_test_SN5659__cal_impl.Sinewave_PSin_h /end REF_CHARACTERISTIC
 /begin REF_MEASUREMENT speedgoat_test_SN5659_R2021b_IO682_B.DataTypeConversion1_i speedgoat_test_SN5659_R2021b_IO682_B.DataTypeConversion_e speedgoat_test_SN5659_R2021b_IO682_B.Encode1_f speedgoat_test_SN5659_R2021b_IO682_B.Encode2_f speedgoat_test_SN5659_R2021b_IO682_B.Encode3_b speedgoat_test_SN5659_R2021b_IO682_B.Encode4_i speedgoat_test_SN5659_R2021b_IO682_B.Output_b speedgoat_test_SN5659_R2021b_IO682_B.Randomnumber_p speedgoat_test_SN5659_R2021b_IO682_B.Sinewave_f speedgoat_test_SN5659_R2021b_IO682_DW.NextOutput_n speedgoat_test_SN5659_R2021b_IO682_DW.RandSeed_h speedgoat_test_SN5659_R2021b_IO682_DW.lastCos_m speedgoat_test_SN5659_R2021b_IO682_DW.lastSin_m speedgoat_test_SN5659_R2021b_IO682_DW.systemEnable_b /end REF_MEASUREMENT
/end GROUP
/begin GROUP speedgoat_test_SN5659_R2021b_IO682_IO682_Encode_Channel_11_Counter_Limited "speedgoat_test_SN5659_R2021b_IO682/IO682/Encode Channel 11/Counter
Limited"
 /begin SUB_GROUP speedgoat_test_SN5659_R2021b_IO682_IO682_Encode_Channel_11_Counter_Limited_Increment_Real_World speedgoat_test_SN5659_R2021b_IO682_IO682_Encode_Channel_11_Counter_Limited_Wrap_To_Zero /end SUB_GROUP
 /begin REF_CHARACTERISTIC speedgoat_test_SN5659__cal_impl.Output_InitialCondition_n /end REF_CHARACTERISTIC
 /begin REF_MEASUREMENT speedgoat_test_SN5659_R2021b_IO682_B.FixPtSwitch_h speedgoat_test_SN5659_R2021b_IO682_B.Output_b speedgoat_test_SN5659_R2021b_IO682_DW.Output_DSTATE_o /end REF_MEASUREMENT
/end GROUP
/begin GROUP speedgoat_test_SN5659_R2021b_IO682_IO682_Encode_Channel_11_Counter_Limited_Increment_Real_World "speedgoat_test_SN5659_R2021b_IO682/IO682/Encode Channel 11/Counter
Limited/Increment
Real World" /begin REF_CHARACTERISTIC speedgoat_test_SN5659__cal_impl.FixPtConstant_Value_a /end REF_CHARACTERISTIC
 /begin REF_MEASUREMENT speedgoat_test_SN5659_R2021b_IO682_B.FixPtSum1_n speedgoat_test_SN5659_R2021b_IO682_B.Output_b /end REF_MEASUREMENT
/end GROUP
/begin GROUP speedgoat_test_SN5659_R2021b_IO682_IO682_Encode_Channel_11_Counter_Limited_Wrap_To_Zero "speedgoat_test_SN5659_R2021b_IO682/IO682/Encode Channel 11/Counter
Limited/Wrap To Zero"
 /begin REF_CHARACTERISTIC speedgoat_test_SN5659__cal_impl.Constant_Value_dm speedgoat_test_SN5659__cal_impl.CounterLimited_uplimit_d /end REF_CHARACTERISTIC
 /begin REF_MEASUREMENT speedgoat_test_SN5659_R2021b_IO682_B.FixPtSum1_n speedgoat_test_SN5659_R2021b_IO682_B.FixPtSwitch_h /end REF_MEASUREMENT
/end GROUP
/begin GROUP speedgoat_test_SN5659_R2021b_IO682_IO682_Encode_Channel_11_Prepare_RAW_value "speedgoat_test_SN5659_R2021b_IO682/IO682/Encode Channel 11/Prepare RAW value"
 /begin REF_CHARACTERISTIC speedgoat_test_SN5659__cal_impl.Label_Value_e speedgoat_test_SN5659__cal_impl.Mask_BitMask_k speedgoat_test_SN5659__cal_impl.SDI_Value_m speedgoat_test_SN5659__cal_impl.SSM_Value_l speedgoat_test_SN5659__cal_impl.Scale_Value_a speedgoat_test_SN5659__cal_impl.shiftthedoublevalue27bitsleft_p /end REF_CHARACTERISTIC
 /begin REF_MEASUREMENT speedgoat_test_SN5659_R2021b_IO682_B.BitwiseOperator_a speedgoat_test_SN5659_R2021b_IO682_B.DataTypeConversion1_i speedgoat_test_SN5659_R2021b_IO682_B.DataTypeConversion_ec speedgoat_test_SN5659_R2021b_IO682_B.Divide_h speedgoat_test_SN5659_R2021b_IO682_B.Mask_n speedgoat_test_SN5659_R2021b_IO682_B.Multiply_a speedgoat_test_SN5659_R2021b_IO682_B.ShifttoSDIslot_a speedgoat_test_SN5659_R2021b_IO682_B.ShifttoSSMslot_m /end REF_MEASUREMENT
/end GROUP
/begin GROUP speedgoat_test_SN5659_R2021b_IO682_IO682_Encode_Channel_12 "speedgoat_test_SN5659_R2021b_IO682/IO682/Encode Channel 12"
 /begin SUB_GROUP speedgoat_test_SN5659_R2021b_IO682_IO682_Encode_Channel_12_Counter_Limited speedgoat_test_SN5659_R2021b_IO682_IO682_Encode_Channel_12_Prepare_RAW_value /end SUB_GROUP
 /begin REF_CHARACTERISTIC speedgoat_test_SN5659__cal_impl.Constant_Value_e speedgoat_test_SN5659__cal_impl.Encode1_P10_p speedgoat_test_SN5659__cal_impl.Encode1_P11_b speedgoat_test_SN5659__cal_impl.Encode1_P12_no speedgoat_test_SN5659__cal_impl.Encode1_P13_it speedgoat_test_SN5659__cal_impl.Encode1_P14_ho speedgoat_test_SN5659__cal_impl.Encode1_P15_k speedgoat_test_SN5659__cal_impl.Encode1_P1_i speedgoat_test_SN5659__cal_impl.Encode1_P2_l speedgoat_test_SN5659__cal_impl.Encode1_P3_b speedgoat_test_SN5659__cal_impl.Encode1_P4_a speedgoat_test_SN5659__cal_impl.Encode1_P5_j speedgoat_test_SN5659__cal_impl.Encode1_P6_e speedgoat_test_SN5659__cal_impl.Encode1_P7_db speedgoat_test_SN5659__cal_impl.Encode1_P8_b speedgoat_test_SN5659__cal_impl.Encode1_P9_md speedgoat_test_SN5659__cal_impl.Encode2_P10_i speedgoat_test_SN5659__cal_impl.Encode2_P11_h speedgoat_test_SN5659__cal_impl.Encode2_P12_k speedgoat_test_SN5659__cal_impl.Encode2_P13_f speedgoat_test_SN5659__cal_impl.Encode2_P14_f speedgoat_test_SN5659__cal_impl.Encode2_P15_o speedgoat_test_SN5659__cal_impl.Encode2_P1_p speedgoat_test_SN5659__cal_impl.Encode2_P2_k speedgoat_test_SN5659__cal_impl.Encode2_P3_l speedgoat_test_SN5659__cal_impl.Encode2_P4_j speedgoat_test_SN5659__cal_impl.Encode2_P5_d speedgoat_test_SN5659__cal_impl.Encode2_P6_e speedgoat_test_SN5659__cal_impl.Encode2_P7_f speedgoat_test_SN5659__cal_impl.Encode2_P8_i speedgoat_test_SN5659__cal_impl.Encode2_P9_pe speedgoat_test_SN5659__cal_impl.Encode3_P10_m speedgoat_test_SN5659__cal_impl.Encode3_P11_i speedgoat_test_SN5659__cal_impl.Encode3_P12_b speedgoat_test_SN5659__cal_impl.Encode3_P13_g speedgoat_test_SN5659__cal_impl.Encode3_P14_o speedgoat_test_SN5659__cal_impl.Encode3_P15_hk speedgoat_test_SN5659__cal_impl.Encode3_P1_n speedgoat_test_SN5659__cal_impl.Encode3_P2_i speedgoat_test_SN5659__cal_impl.Encode3_P3_j speedgoat_test_SN5659__cal_impl.Encode3_P4_l speedgoat_test_SN5659__cal_impl.Encode3_P5_b speedgoat_test_SN5659__cal_impl.Encode3_P6_j speedgoat_test_SN5659__cal_impl.Encode3_P7_l speedgoat_test_SN5659__cal_impl.Encode3_P8_h speedgoat_test_SN5659__cal_impl.Encode3_P9_b speedgoat_test_SN5659__cal_impl.Encode4_P10_o speedgoat_test_SN5659__cal_impl.Encode4_P11_o speedgoat_test_SN5659__cal_impl.Encode4_P12_d speedgoat_test_SN5659__cal_impl.Encode4_P13_f speedgoat_test_SN5659__cal_impl.Encode4_P14_j speedgoat_test_SN5659__cal_impl.Encode4_P15_g speedgoat_test_SN5659__cal_impl.Encode4_P1_f speedgoat_test_SN5659__cal_impl.Encode4_P2_l speedgoat_test_SN5659__cal_impl.Encode4_P3_p speedgoat_test_SN5659__cal_impl.Encode4_P4_k speedgoat_test_SN5659__cal_impl.Encode4_P5_p speedgoat_test_SN5659__cal_impl.Encode4_P6_k speedgoat_test_SN5659__cal_impl.Encode4_P7_c speedgoat_test_SN5659__cal_impl.Encode4_P8_j speedgoat_test_SN5659__cal_impl.Encode4_P9_c speedgoat_test_SN5659__cal_impl.Randomnumber_Mean_fn speedgoat_test_SN5659__cal_impl.Randomnumber_Seed_f speedgoat_test_SN5659__cal_impl.Randomnumber_StdDev_j speedgoat_test_SN5659__cal_impl.Sinewave_Amp_d speedgoat_test_SN5659__cal_impl.Sinewave_Bias_e speedgoat_test_SN5659__cal_impl.Sinewave_Freq_a speedgoat_test_SN5659__cal_impl.Sinewave_HCos_j4 speedgoat_test_SN5659__cal_impl.Sinewave_Hsin_d speedgoat_test_SN5659__cal_impl.Sinewave_PCos_p speedgoat_test_SN5659__cal_impl.Sinewave_PSin_c /end REF_CHARACTERISTIC
 /begin REF_MEASUREMENT speedgoat_test_SN5659_R2021b_IO682_B.DataTypeConversion1_p speedgoat_test_SN5659_R2021b_IO682_B.DataTypeConversion_j speedgoat_test_SN5659_R2021b_IO682_B.Encode1_k speedgoat_test_SN5659_R2021b_IO682_B.Encode2_i speedgoat_test_SN5659_R2021b_IO682_B.Encode3_o speedgoat_test_SN5659_R2021b_IO682_B.Encode4_c speedgoat_test_SN5659_R2021b_IO682_B.Output_p speedgoat_test_SN5659_R2021b_IO682_B.Randomnumber_b speedgoat_test_SN5659_R2021b_IO682_B.Sinewave_k speedgoat_test_SN5659_R2021b_IO682_DW.NextOutput_f speedgoat_test_SN5659_R2021b_IO682_DW.RandSeed_k speedgoat_test_SN5659_R2021b_IO682_DW.lastCos_a speedgoat_test_SN5659_R2021b_IO682_DW.lastSin_ct speedgoat_test_SN5659_R2021b_IO682_DW.systemEnable_f /end REF_MEASUREMENT
/end GROUP
/begin GROUP speedgoat_test_SN5659_R2021b_IO682_IO682_Encode_Channel_12_Counter_Limited "speedgoat_test_SN5659_R2021b_IO682/IO682/Encode Channel 12/Counter
Limited"
 /begin SUB_GROUP speedgoat_test_SN5659_R2021b_IO682_IO682_Encode_Channel_12_Counter_Limited_Increment_Real_World speedgoat_test_SN5659_R2021b_IO682_IO682_Encode_Channel_12_Counter_Limited_Wrap_To_Zero /end SUB_GROUP
 /begin REF_CHARACTERISTIC speedgoat_test_SN5659__cal_impl.Output_InitialCondition_c /end REF_CHARACTERISTIC
 /begin REF_MEASUREMENT speedgoat_test_SN5659_R2021b_IO682_B.FixPtSwitch_b speedgoat_test_SN5659_R2021b_IO682_B.Output_p speedgoat_test_SN5659_R2021b_IO682_DW.Output_DSTATE_o0 /end REF_MEASUREMENT
/end GROUP
/begin GROUP speedgoat_test_SN5659_R2021b_IO682_IO682_Encode_Channel_12_Counter_Limited_Increment_Real_World "speedgoat_test_SN5659_R2021b_IO682/IO682/Encode Channel 12/Counter
Limited/Increment
Real World" /begin REF_CHARACTERISTIC speedgoat_test_SN5659__cal_impl.FixPtConstant_Value_o /end REF_CHARACTERISTIC
 /begin REF_MEASUREMENT speedgoat_test_SN5659_R2021b_IO682_B.FixPtSum1_a speedgoat_test_SN5659_R2021b_IO682_B.Output_p /end REF_MEASUREMENT
/end GROUP
/begin GROUP speedgoat_test_SN5659_R2021b_IO682_IO682_Encode_Channel_12_Counter_Limited_Wrap_To_Zero "speedgoat_test_SN5659_R2021b_IO682/IO682/Encode Channel 12/Counter
Limited/Wrap To Zero"
 /begin REF_CHARACTERISTIC speedgoat_test_SN5659__cal_impl.Constant_Value_n speedgoat_test_SN5659__cal_impl.CounterLimited_uplimit_k /end REF_CHARACTERISTIC
 /begin REF_MEASUREMENT speedgoat_test_SN5659_R2021b_IO682_B.FixPtSum1_a speedgoat_test_SN5659_R2021b_IO682_B.FixPtSwitch_b /end REF_MEASUREMENT
/end GROUP
/begin GROUP speedgoat_test_SN5659_R2021b_IO682_IO682_Encode_Channel_12_Prepare_RAW_value "speedgoat_test_SN5659_R2021b_IO682/IO682/Encode Channel 12/Prepare RAW value"
 /begin REF_CHARACTERISTIC speedgoat_test_SN5659__cal_impl.Label_Value_j speedgoat_test_SN5659__cal_impl.Mask_BitMask_d speedgoat_test_SN5659__cal_impl.SDI_Value_l speedgoat_test_SN5659__cal_impl.SSM_Value_n speedgoat_test_SN5659__cal_impl.Scale_Value_b speedgoat_test_SN5659__cal_impl.shiftthedoublevalue27bitsleft_g /end REF_CHARACTERISTIC
 /begin REF_MEASUREMENT speedgoat_test_SN5659_R2021b_IO682_B.BitwiseOperator_p speedgoat_test_SN5659_R2021b_IO682_B.DataTypeConversion1_p speedgoat_test_SN5659_R2021b_IO682_B.DataTypeConversion_jj speedgoat_test_SN5659_R2021b_IO682_B.Divide_p speedgoat_test_SN5659_R2021b_IO682_B.Mask_i speedgoat_test_SN5659_R2021b_IO682_B.Multiply_j speedgoat_test_SN5659_R2021b_IO682_B.ShifttoSDIslot_k speedgoat_test_SN5659_R2021b_IO682_B.ShifttoSSMslot_b /end REF_MEASUREMENT
/end GROUP
/begin GROUP speedgoat_test_SN5659_R2021b_IO682_IO682_Encode_Channel_13 "speedgoat_test_SN5659_R2021b_IO682/IO682/Encode Channel 13"
 /begin SUB_GROUP speedgoat_test_SN5659_R2021b_IO682_IO682_Encode_Channel_13_Counter_Limited speedgoat_test_SN5659_R2021b_IO682_IO682_Encode_Channel_13_Prepare_RAW_value /end SUB_GROUP
 /begin REF_CHARACTERISTIC speedgoat_test_SN5659__cal_impl.Constant_Value_d speedgoat_test_SN5659__cal_impl.Encode1_P10_l speedgoat_test_SN5659__cal_impl.Encode1_P11_bk speedgoat_test_SN5659__cal_impl.Encode1_P12_o speedgoat_test_SN5659__cal_impl.Encode1_P13_o speedgoat_test_SN5659__cal_impl.Encode1_P14_g speedgoat_test_SN5659__cal_impl.Encode1_P15_j speedgoat_test_SN5659__cal_impl.Encode1_P1_g speedgoat_test_SN5659__cal_impl.Encode1_P2_p speedgoat_test_SN5659__cal_impl.Encode1_P3_o0 speedgoat_test_SN5659__cal_impl.Encode1_P4_c speedgoat_test_SN5659__cal_impl.Encode1_P5_oz speedgoat_test_SN5659__cal_impl.Encode1_P6_n5 speedgoat_test_SN5659__cal_impl.Encode1_P7_dz speedgoat_test_SN5659__cal_impl.Encode1_P8_d speedgoat_test_SN5659__cal_impl.Encode1_P9_a speedgoat_test_SN5659__cal_impl.Encode2_P10_g speedgoat_test_SN5659__cal_impl.Encode2_P11_gc speedgoat_test_SN5659__cal_impl.Encode2_P12_me speedgoat_test_SN5659__cal_impl.Encode2_P13_e speedgoat_test_SN5659__cal_impl.Encode2_P14_b speedgoat_test_SN5659__cal_impl.Encode2_P15_k speedgoat_test_SN5659__cal_impl.Encode2_P1_m speedgoat_test_SN5659__cal_impl.Encode2_P2_f speedgoat_test_SN5659__cal_impl.Encode2_P3_g speedgoat_test_SN5659__cal_impl.Encode2_P4_m speedgoat_test_SN5659__cal_impl.Encode2_P5_j speedgoat_test_SN5659__cal_impl.Encode2_P6_m speedgoat_test_SN5659__cal_impl.Encode2_P7_j speedgoat_test_SN5659__cal_impl.Encode2_P8_iw speedgoat_test_SN5659__cal_impl.Encode2_P9_pd speedgoat_test_SN5659__cal_impl.Encode3_P10_l speedgoat_test_SN5659__cal_impl.Encode3_P11_h speedgoat_test_SN5659__cal_impl.Encode3_P12_c speedgoat_test_SN5659__cal_impl.Encode3_P13_e speedgoat_test_SN5659__cal_impl.Encode3_P14_b speedgoat_test_SN5659__cal_impl.Encode3_P15_i speedgoat_test_SN5659__cal_impl.Encode3_P1_i speedgoat_test_SN5659__cal_impl.Encode3_P2_a speedgoat_test_SN5659__cal_impl.Encode3_P3_c speedgoat_test_SN5659__cal_impl.Encode3_P4_ls speedgoat_test_SN5659__cal_impl.Encode3_P5_bo speedgoat_test_SN5659__cal_impl.Encode3_P6_a speedgoat_test_SN5659__cal_impl.Encode3_P7_d speedgoat_test_SN5659__cal_impl.Encode3_P8_k speedgoat_test_SN5659__cal_impl.Encode3_P9_b5 speedgoat_test_SN5659__cal_impl.Encode5_P10_a speedgoat_test_SN5659__cal_impl.Encode5_P11_n speedgoat_test_SN5659__cal_impl.Encode5_P12_m speedgoat_test_SN5659__cal_impl.Encode5_P13_g speedgoat_test_SN5659__cal_impl.Encode5_P14_l speedgoat_test_SN5659__cal_impl.Encode5_P15_c speedgoat_test_SN5659__cal_impl.Encode5_P1_f speedgoat_test_SN5659__cal_impl.Encode5_P2_e speedgoat_test_SN5659__cal_impl.Encode5_P3_m speedgoat_test_SN5659__cal_impl.Encode5_P4_a speedgoat_test_SN5659__cal_impl.Encode5_P5_i speedgoat_test_SN5659__cal_impl.Encode5_P6_d speedgoat_test_SN5659__cal_impl.Encode5_P7_f speedgoat_test_SN5659__cal_impl.Encode5_P8_k speedgoat_test_SN5659__cal_impl.Encode5_P9_l speedgoat_test_SN5659__cal_impl.Randomnumber_Mean_a speedgoat_test_SN5659__cal_impl.Randomnumber_Seed_c speedgoat_test_SN5659__cal_impl.Randomnumber_StdDev_k speedgoat_test_SN5659__cal_impl.Sinewave_Amp_h speedgoat_test_SN5659__cal_impl.Sinewave_Bias_m speedgoat_test_SN5659__cal_impl.Sinewave_Freq_m speedgoat_test_SN5659__cal_impl.Sinewave_HCos_o speedgoat_test_SN5659__cal_impl.Sinewave_Hsin_o speedgoat_test_SN5659__cal_impl.Sinewave_PCos_h speedgoat_test_SN5659__cal_impl.Sinewave_PSin_e /end REF_CHARACTERISTIC
 /begin REF_MEASUREMENT speedgoat_test_SN5659_R2021b_IO682_B.DataTypeConversion1_n speedgoat_test_SN5659_R2021b_IO682_B.DataTypeConversion_p speedgoat_test_SN5659_R2021b_IO682_B.Encode1_l speedgoat_test_SN5659_R2021b_IO682_B.Encode2_j speedgoat_test_SN5659_R2021b_IO682_B.Encode3_p speedgoat_test_SN5659_R2021b_IO682_B.Encode5_d speedgoat_test_SN5659_R2021b_IO682_B.Output_j speedgoat_test_SN5659_R2021b_IO682_B.Randomnumber_pz speedgoat_test_SN5659_R2021b_IO682_B.Sinewave_p speedgoat_test_SN5659_R2021b_IO682_DW.NextOutput_nj speedgoat_test_SN5659_R2021b_IO682_DW.RandSeed_g speedgoat_test_SN5659_R2021b_IO682_DW.lastCos_af speedgoat_test_SN5659_R2021b_IO682_DW.lastSin_p speedgoat_test_SN5659_R2021b_IO682_DW.systemEnable_m /end REF_MEASUREMENT
/end GROUP
/begin GROUP speedgoat_test_SN5659_R2021b_IO682_IO682_Encode_Channel_13_Counter_Limited "speedgoat_test_SN5659_R2021b_IO682/IO682/Encode Channel 13/Counter
Limited"
 /begin SUB_GROUP speedgoat_test_SN5659_R2021b_IO682_IO682_Encode_Channel_13_Counter_Limited_Increment_Real_World speedgoat_test_SN5659_R2021b_IO682_IO682_Encode_Channel_13_Counter_Limited_Wrap_To_Zero /end SUB_GROUP
 /begin REF_CHARACTERISTIC speedgoat_test_SN5659__cal_impl.Output_InitialCondition_k /end REF_CHARACTERISTIC
 /begin REF_MEASUREMENT speedgoat_test_SN5659_R2021b_IO682_B.FixPtSwitch_l speedgoat_test_SN5659_R2021b_IO682_B.Output_j speedgoat_test_SN5659_R2021b_IO682_DW.Output_DSTATE_m /end REF_MEASUREMENT
/end GROUP
/begin GROUP speedgoat_test_SN5659_R2021b_IO682_IO682_Encode_Channel_13_Counter_Limited_Increment_Real_World "speedgoat_test_SN5659_R2021b_IO682/IO682/Encode Channel 13/Counter
Limited/Increment
Real World" /begin REF_CHARACTERISTIC speedgoat_test_SN5659__cal_impl.FixPtConstant_Value_oz /end REF_CHARACTERISTIC
 /begin REF_MEASUREMENT speedgoat_test_SN5659_R2021b_IO682_B.FixPtSum1_g speedgoat_test_SN5659_R2021b_IO682_B.Output_j /end REF_MEASUREMENT
/end GROUP
/begin GROUP speedgoat_test_SN5659_R2021b_IO682_IO682_Encode_Channel_13_Counter_Limited_Wrap_To_Zero "speedgoat_test_SN5659_R2021b_IO682/IO682/Encode Channel 13/Counter
Limited/Wrap To Zero"
 /begin REF_CHARACTERISTIC speedgoat_test_SN5659__cal_impl.Constant_Value_a speedgoat_test_SN5659__cal_impl.CounterLimited_uplimit_c /end REF_CHARACTERISTIC
 /begin REF_MEASUREMENT speedgoat_test_SN5659_R2021b_IO682_B.FixPtSum1_g speedgoat_test_SN5659_R2021b_IO682_B.FixPtSwitch_l /end REF_MEASUREMENT
/end GROUP
/begin GROUP speedgoat_test_SN5659_R2021b_IO682_IO682_Encode_Channel_13_Prepare_RAW_value "speedgoat_test_SN5659_R2021b_IO682/IO682/Encode Channel 13/Prepare RAW value"
 /begin REF_CHARACTERISTIC speedgoat_test_SN5659__cal_impl.Label_Value_ex speedgoat_test_SN5659__cal_impl.Mask_BitMask_e speedgoat_test_SN5659__cal_impl.SDI_Value_a speedgoat_test_SN5659__cal_impl.SSM_Value_m speedgoat_test_SN5659__cal_impl.Scale_Value_f speedgoat_test_SN5659__cal_impl.shiftthedoublevalue27bitsleft_i /end REF_CHARACTERISTIC
 /begin REF_MEASUREMENT speedgoat_test_SN5659_R2021b_IO682_B.BitwiseOperator_k speedgoat_test_SN5659_R2021b_IO682_B.DataTypeConversion1_n speedgoat_test_SN5659_R2021b_IO682_B.DataTypeConversion_b speedgoat_test_SN5659_R2021b_IO682_B.Divide_i speedgoat_test_SN5659_R2021b_IO682_B.Mask_c speedgoat_test_SN5659_R2021b_IO682_B.Multiply_he speedgoat_test_SN5659_R2021b_IO682_B.ShifttoSDIslot_b speedgoat_test_SN5659_R2021b_IO682_B.ShifttoSSMslot_k /end REF_MEASUREMENT
/end GROUP
/begin GROUP speedgoat_test_SN5659_R2021b_IO682_IO682_Encode_Channel_14 "speedgoat_test_SN5659_R2021b_IO682/IO682/Encode Channel 14"
 /begin SUB_GROUP speedgoat_test_SN5659_R2021b_IO682_IO682_Encode_Channel_14_Counter_Limited speedgoat_test_SN5659_R2021b_IO682_IO682_Encode_Channel_14_Prepare_RAW_value /end SUB_GROUP
 /begin REF_CHARACTERISTIC speedgoat_test_SN5659__cal_impl.Constant_Value_g speedgoat_test_SN5659__cal_impl.Encode1_P10_pc speedgoat_test_SN5659__cal_impl.Encode1_P11_a speedgoat_test_SN5659__cal_impl.Encode1_P12_h speedgoat_test_SN5659__cal_impl.Encode1_P13_l speedgoat_test_SN5659__cal_impl.Encode1_P14_e speedgoat_test_SN5659__cal_impl.Encode1_P15_m speedgoat_test_SN5659__cal_impl.Encode1_P1_f speedgoat_test_SN5659__cal_impl.Encode1_P2_pf speedgoat_test_SN5659__cal_impl.Encode1_P3_h speedgoat_test_SN5659__cal_impl.Encode1_P4_o speedgoat_test_SN5659__cal_impl.Encode1_P5_l speedgoat_test_SN5659__cal_impl.Encode1_P6_d speedgoat_test_SN5659__cal_impl.Encode1_P7_b speedgoat_test_SN5659__cal_impl.Encode1_P8_f speedgoat_test_SN5659__cal_impl.Encode1_P9_ng speedgoat_test_SN5659__cal_impl.Encode2_P10_a speedgoat_test_SN5659__cal_impl.Encode2_P11_ga speedgoat_test_SN5659__cal_impl.Encode2_P12_f speedgoat_test_SN5659__cal_impl.Encode2_P13_o speedgoat_test_SN5659__cal_impl.Encode2_P14_po speedgoat_test_SN5659__cal_impl.Encode2_P15_h speedgoat_test_SN5659__cal_impl.Encode2_P1_e speedgoat_test_SN5659__cal_impl.Encode2_P2_h speedgoat_test_SN5659__cal_impl.Encode2_P3_f speedgoat_test_SN5659__cal_impl.Encode2_P4_b speedgoat_test_SN5659__cal_impl.Encode2_P5_p speedgoat_test_SN5659__cal_impl.Encode2_P6_l speedgoat_test_SN5659__cal_impl.Encode2_P7_jh speedgoat_test_SN5659__cal_impl.Encode2_P8_n speedgoat_test_SN5659__cal_impl.Encode2_P9_h speedgoat_test_SN5659__cal_impl.Encode3_P10_l1 speedgoat_test_SN5659__cal_impl.Encode3_P11_c speedgoat_test_SN5659__cal_impl.Encode3_P12_p speedgoat_test_SN5659__cal_impl.Encode3_P13_p speedgoat_test_SN5659__cal_impl.Encode3_P14_f speedgoat_test_SN5659__cal_impl.Encode3_P15_hl speedgoat_test_SN5659__cal_impl.Encode3_P1_a speedgoat_test_SN5659__cal_impl.Encode3_P2_b speedgoat_test_SN5659__cal_impl.Encode3_P3_g speedgoat_test_SN5659__cal_impl.Encode3_P4_b speedgoat_test_SN5659__cal_impl.Encode3_P5_ij speedgoat_test_SN5659__cal_impl.Encode3_P6_jb speedgoat_test_SN5659__cal_impl.Encode3_P7_f speedgoat_test_SN5659__cal_impl.Encode3_P8_l speedgoat_test_SN5659__cal_impl.Encode3_P9_c speedgoat_test_SN5659__cal_impl.Encode4_P10_o2 speedgoat_test_SN5659__cal_impl.Encode4_P11_p speedgoat_test_SN5659__cal_impl.Encode4_P12_h speedgoat_test_SN5659__cal_impl.Encode4_P13_o speedgoat_test_SN5659__cal_impl.Encode4_P14_lr speedgoat_test_SN5659__cal_impl.Encode4_P15_a speedgoat_test_SN5659__cal_impl.Encode4_P1_fl speedgoat_test_SN5659__cal_impl.Encode4_P2_f speedgoat_test_SN5659__cal_impl.Encode4_P3_h speedgoat_test_SN5659__cal_impl.Encode4_P4_b speedgoat_test_SN5659__cal_impl.Encode4_P5_o speedgoat_test_SN5659__cal_impl.Encode4_P6_kc speedgoat_test_SN5659__cal_impl.Encode4_P7_d speedgoat_test_SN5659__cal_impl.Encode4_P8_oo speedgoat_test_SN5659__cal_impl.Encode4_P9_n speedgoat_test_SN5659__cal_impl.Randomnumber_Mean_h speedgoat_test_SN5659__cal_impl.Randomnumber_Seed_p speedgoat_test_SN5659__cal_impl.Randomnumber_StdDev_g speedgoat_test_SN5659__cal_impl.Sinewave_Amp_n speedgoat_test_SN5659__cal_impl.Sinewave_Bias_j speedgoat_test_SN5659__cal_impl.Sinewave_Freq_ah speedgoat_test_SN5659__cal_impl.Sinewave_HCos_jn speedgoat_test_SN5659__cal_impl.Sinewave_Hsin_i speedgoat_test_SN5659__cal_impl.Sinewave_PCos_f speedgoat_test_SN5659__cal_impl.Sinewave_PSin_f /end REF_CHARACTERISTIC
 /begin REF_MEASUREMENT speedgoat_test_SN5659_R2021b_IO682_B.DataTypeConversion1_gm speedgoat_test_SN5659_R2021b_IO682_B.DataTypeConversion_o speedgoat_test_SN5659_R2021b_IO682_B.Encode1_p speedgoat_test_SN5659_R2021b_IO682_B.Encode2_fi speedgoat_test_SN5659_R2021b_IO682_B.Encode3_f speedgoat_test_SN5659_R2021b_IO682_B.Encode4_g speedgoat_test_SN5659_R2021b_IO682_B.Output_m speedgoat_test_SN5659_R2021b_IO682_B.Randomnumber_n speedgoat_test_SN5659_R2021b_IO682_B.Sinewave_g speedgoat_test_SN5659_R2021b_IO682_DW.NextOutput_ni speedgoat_test_SN5659_R2021b_IO682_DW.RandSeed_f speedgoat_test_SN5659_R2021b_IO682_DW.lastCos_h speedgoat_test_SN5659_R2021b_IO682_DW.lastSin_d speedgoat_test_SN5659_R2021b_IO682_DW.systemEnable_j /end REF_MEASUREMENT
/end GROUP
/begin GROUP speedgoat_test_SN5659_R2021b_IO682_IO682_Encode_Channel_14_Counter_Limited "speedgoat_test_SN5659_R2021b_IO682/IO682/Encode Channel 14/Counter
Limited"
 /begin SUB_GROUP speedgoat_test_SN5659_R2021b_IO682_IO682_Encode_Channel_14_Counter_Limited_Increment_Real_World speedgoat_test_SN5659_R2021b_IO682_IO682_Encode_Channel_14_Counter_Limited_Wrap_To_Zero /end SUB_GROUP
 /begin REF_CHARACTERISTIC speedgoat_test_SN5659__cal_impl.Output_InitialCondition_e /end REF_CHARACTERISTIC
 /begin REF_MEASUREMENT speedgoat_test_SN5659_R2021b_IO682_B.FixPtSwitch_bx speedgoat_test_SN5659_R2021b_IO682_B.Output_m speedgoat_test_SN5659_R2021b_IO682_DW.Output_DSTATE_oy /end REF_MEASUREMENT
/end GROUP
/begin GROUP speedgoat_test_SN5659_R2021b_IO682_IO682_Encode_Channel_14_Counter_Limited_Increment_Real_World "speedgoat_test_SN5659_R2021b_IO682/IO682/Encode Channel 14/Counter
Limited/Increment
Real World" /begin REF_CHARACTERISTIC speedgoat_test_SN5659__cal_impl.FixPtConstant_Value_j /end REF_CHARACTERISTIC
 /begin REF_MEASUREMENT speedgoat_test_SN5659_R2021b_IO682_B.FixPtSum1_e speedgoat_test_SN5659_R2021b_IO682_B.Output_m /end REF_MEASUREMENT
/end GROUP
/begin GROUP speedgoat_test_SN5659_R2021b_IO682_IO682_Encode_Channel_14_Counter_Limited_Wrap_To_Zero "speedgoat_test_SN5659_R2021b_IO682/IO682/Encode Channel 14/Counter
Limited/Wrap To Zero"
 /begin REF_CHARACTERISTIC speedgoat_test_SN5659__cal_impl.Constant_Value_k speedgoat_test_SN5659__cal_impl.CounterLimited_uplimit_n /end REF_CHARACTERISTIC
 /begin REF_MEASUREMENT speedgoat_test_SN5659_R2021b_IO682_B.FixPtSum1_e speedgoat_test_SN5659_R2021b_IO682_B.FixPtSwitch_bx /end REF_MEASUREMENT
/end GROUP
/begin GROUP speedgoat_test_SN5659_R2021b_IO682_IO682_Encode_Channel_14_Prepare_RAW_value "speedgoat_test_SN5659_R2021b_IO682/IO682/Encode Channel 14/Prepare RAW value"
 /begin REF_CHARACTERISTIC speedgoat_test_SN5659__cal_impl.Label_Value_f speedgoat_test_SN5659__cal_impl.Mask_BitMask_p speedgoat_test_SN5659__cal_impl.SDI_Value_h speedgoat_test_SN5659__cal_impl.SSM_Value_j speedgoat_test_SN5659__cal_impl.Scale_Value_d speedgoat_test_SN5659__cal_impl.shiftthedoublevalue27bitslef_pp /end REF_CHARACTERISTIC
 /begin REF_MEASUREMENT speedgoat_test_SN5659_R2021b_IO682_B.BitwiseOperator_c speedgoat_test_SN5659_R2021b_IO682_B.DataTypeConversion1_gm speedgoat_test_SN5659_R2021b_IO682_B.DataTypeConversion_er speedgoat_test_SN5659_R2021b_IO682_B.Divide_j speedgoat_test_SN5659_R2021b_IO682_B.Mask_m speedgoat_test_SN5659_R2021b_IO682_B.Multiply_i speedgoat_test_SN5659_R2021b_IO682_B.ShifttoSDIslot_km speedgoat_test_SN5659_R2021b_IO682_B.ShifttoSSMslot_mi /end REF_MEASUREMENT
/end GROUP
/begin GROUP speedgoat_test_SN5659_R2021b_IO682_IO682_Encode_Channel_15 "speedgoat_test_SN5659_R2021b_IO682/IO682/Encode Channel 15"
 /begin SUB_GROUP speedgoat_test_SN5659_R2021b_IO682_IO682_Encode_Channel_15_Counter_Limited speedgoat_test_SN5659_R2021b_IO682_IO682_Encode_Channel_15_Prepare_RAW_value /end SUB_GROUP
 /begin REF_CHARACTERISTIC speedgoat_test_SN5659__cal_impl.Constant_Value_l speedgoat_test_SN5659__cal_impl.Encode1_P10_k speedgoat_test_SN5659__cal_impl.Encode1_P11_n speedgoat_test_SN5659__cal_impl.Encode1_P12_j speedgoat_test_SN5659__cal_impl.Encode1_P13_f speedgoat_test_SN5659__cal_impl.Encode1_P14_c speedgoat_test_SN5659__cal_impl.Encode1_P15_a speedgoat_test_SN5659__cal_impl.Encode1_P1_h speedgoat_test_SN5659__cal_impl.Encode1_P2_e speedgoat_test_SN5659__cal_impl.Encode1_P3_i speedgoat_test_SN5659__cal_impl.Encode1_P4_el speedgoat_test_SN5659__cal_impl.Encode1_P5_g speedgoat_test_SN5659__cal_impl.Encode1_P6_a speedgoat_test_SN5659__cal_impl.Encode1_P7_a speedgoat_test_SN5659__cal_impl.Encode1_P8_dh speedgoat_test_SN5659__cal_impl.Encode1_P9_k speedgoat_test_SN5659__cal_impl.Encode2_P10_ab speedgoat_test_SN5659__cal_impl.Encode2_P11_k speedgoat_test_SN5659__cal_impl.Encode2_P12_d speedgoat_test_SN5659__cal_impl.Encode2_P13_n speedgoat_test_SN5659__cal_impl.Encode2_P14_n speedgoat_test_SN5659__cal_impl.Encode2_P15_js speedgoat_test_SN5659__cal_impl.Encode2_P1_n speedgoat_test_SN5659__cal_impl.Encode2_P2_kr speedgoat_test_SN5659__cal_impl.Encode2_P3_j speedgoat_test_SN5659__cal_impl.Encode2_P4_o0 speedgoat_test_SN5659__cal_impl.Encode2_P5_m speedgoat_test_SN5659__cal_impl.Encode2_P6_i speedgoat_test_SN5659__cal_impl.Encode2_P7_k speedgoat_test_SN5659__cal_impl.Encode2_P8_h3 speedgoat_test_SN5659__cal_impl.Encode2_P9_a speedgoat_test_SN5659__cal_impl.Encode3_P10_lx speedgoat_test_SN5659__cal_impl.Encode3_P11_m speedgoat_test_SN5659__cal_impl.Encode3_P12_i speedgoat_test_SN5659__cal_impl.Encode3_P13_k speedgoat_test_SN5659__cal_impl.Encode3_P14_m speedgoat_test_SN5659__cal_impl.Encode3_P15_b speedgoat_test_SN5659__cal_impl.Encode3_P1_nj speedgoat_test_SN5659__cal_impl.Encode3_P2_n speedgoat_test_SN5659__cal_impl.Encode3_P3_nc speedgoat_test_SN5659__cal_impl.Encode3_P4_m speedgoat_test_SN5659__cal_impl.Encode3_P5_h speedgoat_test_SN5659__cal_impl.Encode3_P6_i speedgoat_test_SN5659__cal_impl.Encode3_P7_i speedgoat_test_SN5659__cal_impl.Encode3_P8_p speedgoat_test_SN5659__cal_impl.Encode3_P9_p speedgoat_test_SN5659__cal_impl.Encode4_P10_k speedgoat_test_SN5659__cal_impl.Encode4_P11_pb speedgoat_test_SN5659__cal_impl.Encode4_P12_e speedgoat_test_SN5659__cal_impl.Encode4_P13_p speedgoat_test_SN5659__cal_impl.Encode4_P14_b speedgoat_test_SN5659__cal_impl.Encode4_P15_l speedgoat_test_SN5659__cal_impl.Encode4_P1_n speedgoat_test_SN5659__cal_impl.Encode4_P2_dd speedgoat_test_SN5659__cal_impl.Encode4_P3_b speedgoat_test_SN5659__cal_impl.Encode4_P4_h speedgoat_test_SN5659__cal_impl.Encode4_P5_l speedgoat_test_SN5659__cal_impl.Encode4_P6_l speedgoat_test_SN5659__cal_impl.Encode4_P7_l speedgoat_test_SN5659__cal_impl.Encode4_P8_h speedgoat_test_SN5659__cal_impl.Encode4_P9_e speedgoat_test_SN5659__cal_impl.Randomnumber_Mean_b speedgoat_test_SN5659__cal_impl.Randomnumber_Seed_fj speedgoat_test_SN5659__cal_impl.Randomnumber_StdDev_l4 speedgoat_test_SN5659__cal_impl.Sinewave_Amp_hh speedgoat_test_SN5659__cal_impl.Sinewave_Bias_g speedgoat_test_SN5659__cal_impl.Sinewave_Freq_c speedgoat_test_SN5659__cal_impl.Sinewave_HCos_jg speedgoat_test_SN5659__cal_impl.Sinewave_Hsin_o1 speedgoat_test_SN5659__cal_impl.Sinewave_PCos_a speedgoat_test_SN5659__cal_impl.Sinewave_PSin_fk /end REF_CHARACTERISTIC
 /begin REF_MEASUREMENT speedgoat_test_SN5659_R2021b_IO682_B.DataTypeConversion1_ga speedgoat_test_SN5659_R2021b_IO682_B.DataTypeConversion_d speedgoat_test_SN5659_R2021b_IO682_B.Encode1_pb speedgoat_test_SN5659_R2021b_IO682_B.Encode2_h speedgoat_test_SN5659_R2021b_IO682_B.Encode3_l speedgoat_test_SN5659_R2021b_IO682_B.Encode4_l speedgoat_test_SN5659_R2021b_IO682_B.Output_e speedgoat_test_SN5659_R2021b_IO682_B.Randomnumber_m speedgoat_test_SN5659_R2021b_IO682_B.Sinewave_kh speedgoat_test_SN5659_R2021b_IO682_DW.NextOutput_ft speedgoat_test_SN5659_R2021b_IO682_DW.RandSeed_f4 speedgoat_test_SN5659_R2021b_IO682_DW.lastCos_l speedgoat_test_SN5659_R2021b_IO682_DW.lastSin_du speedgoat_test_SN5659_R2021b_IO682_DW.systemEnable_a /end REF_MEASUREMENT
/end GROUP
/begin GROUP speedgoat_test_SN5659_R2021b_IO682_IO682_Encode_Channel_15_Counter_Limited "speedgoat_test_SN5659_R2021b_IO682/IO682/Encode Channel 15/Counter
Limited"
 /begin SUB_GROUP speedgoat_test_SN5659_R2021b_IO682_IO682_Encode_Channel_15_Counter_Limited_Increment_Real_World speedgoat_test_SN5659_R2021b_IO682_IO682_Encode_Channel_15_Counter_Limited_Wrap_To_Zero /end SUB_GROUP
 /begin REF_CHARACTERISTIC speedgoat_test_SN5659__cal_impl.Output_InitialCondition_l /end REF_CHARACTERISTIC
 /begin REF_MEASUREMENT speedgoat_test_SN5659_R2021b_IO682_B.FixPtSwitch_lo speedgoat_test_SN5659_R2021b_IO682_B.Output_e speedgoat_test_SN5659_R2021b_IO682_DW.Output_DSTATE_e /end REF_MEASUREMENT
/end GROUP
/begin GROUP speedgoat_test_SN5659_R2021b_IO682_IO682_Encode_Channel_15_Counter_Limited_Increment_Real_World "speedgoat_test_SN5659_R2021b_IO682/IO682/Encode Channel 15/Counter
Limited/Increment
Real World" /begin REF_CHARACTERISTIC speedgoat_test_SN5659__cal_impl.FixPtConstant_Value_l /end REF_CHARACTERISTIC
 /begin REF_MEASUREMENT speedgoat_test_SN5659_R2021b_IO682_B.FixPtSum1_o speedgoat_test_SN5659_R2021b_IO682_B.Output_e /end REF_MEASUREMENT
/end GROUP
/begin GROUP speedgoat_test_SN5659_R2021b_IO682_IO682_Encode_Channel_15_Counter_Limited_Wrap_To_Zero "speedgoat_test_SN5659_R2021b_IO682/IO682/Encode Channel 15/Counter
Limited/Wrap To Zero"
 /begin REF_CHARACTERISTIC speedgoat_test_SN5659__cal_impl.Constant_Value_aq speedgoat_test_SN5659__cal_impl.CounterLimited_uplimit_cp /end REF_CHARACTERISTIC
 /begin REF_MEASUREMENT speedgoat_test_SN5659_R2021b_IO682_B.FixPtSum1_o speedgoat_test_SN5659_R2021b_IO682_B.FixPtSwitch_lo /end REF_MEASUREMENT
/end GROUP
/begin GROUP speedgoat_test_SN5659_R2021b_IO682_IO682_Encode_Channel_15_Prepare_RAW_value "speedgoat_test_SN5659_R2021b_IO682/IO682/Encode Channel 15/Prepare RAW value"
 /begin REF_CHARACTERISTIC speedgoat_test_SN5659__cal_impl.Label_Value_b speedgoat_test_SN5659__cal_impl.Mask_BitMask_pd speedgoat_test_SN5659__cal_impl.SDI_Value_i speedgoat_test_SN5659__cal_impl.SSM_Value_ji speedgoat_test_SN5659__cal_impl.Scale_Value_c speedgoat_test_SN5659__cal_impl.shiftthedoublevalue27bitslef_oj /end REF_CHARACTERISTIC
 /begin REF_MEASUREMENT speedgoat_test_SN5659_R2021b_IO682_B.BitwiseOperator_f speedgoat_test_SN5659_R2021b_IO682_B.DataTypeConversion1_ga speedgoat_test_SN5659_R2021b_IO682_B.DataTypeConversion_fb speedgoat_test_SN5659_R2021b_IO682_B.Divide_g speedgoat_test_SN5659_R2021b_IO682_B.Mask_h speedgoat_test_SN5659_R2021b_IO682_B.Multiply_n speedgoat_test_SN5659_R2021b_IO682_B.ShifttoSDIslot_c speedgoat_test_SN5659_R2021b_IO682_B.ShifttoSSMslot_f /end REF_MEASUREMENT
/end GROUP
/begin GROUP speedgoat_test_SN5659_R2021b_IO682_IO682_Encode_Channel_16 "speedgoat_test_SN5659_R2021b_IO682/IO682/Encode Channel 16"
 /begin SUB_GROUP speedgoat_test_SN5659_R2021b_IO682_IO682_Encode_Channel_16_Counter_Limited speedgoat_test_SN5659_R2021b_IO682_IO682_Encode_Channel_16_Prepare_RAW_value /end SUB_GROUP
 /begin REF_CHARACTERISTIC speedgoat_test_SN5659__cal_impl.Constant_Value_o speedgoat_test_SN5659__cal_impl.Encode1_P10_e speedgoat_test_SN5659__cal_impl.Encode1_P11_o speedgoat_test_SN5659__cal_impl.Encode1_P12_m speedgoat_test_SN5659__cal_impl.Encode1_P13_fj speedgoat_test_SN5659__cal_impl.Encode1_P14_d speedgoat_test_SN5659__cal_impl.Encode1_P15_i speedgoat_test_SN5659__cal_impl.Encode1_P1_j speedgoat_test_SN5659__cal_impl.Encode1_P2_n speedgoat_test_SN5659__cal_impl.Encode1_P3_hu speedgoat_test_SN5659__cal_impl.Encode1_P4_p speedgoat_test_SN5659__cal_impl.Encode1_P5_e speedgoat_test_SN5659__cal_impl.Encode1_P6_m speedgoat_test_SN5659__cal_impl.Encode1_P7_e speedgoat_test_SN5659__cal_impl.Encode1_P8_fq speedgoat_test_SN5659__cal_impl.Encode1_P9_o speedgoat_test_SN5659__cal_impl.Encode2_P10_o speedgoat_test_SN5659__cal_impl.Encode2_P11_e speedgoat_test_SN5659__cal_impl.Encode2_P12_fa speedgoat_test_SN5659__cal_impl.Encode2_P13_d speedgoat_test_SN5659__cal_impl.Encode2_P14_ck speedgoat_test_SN5659__cal_impl.Encode2_P15_e speedgoat_test_SN5659__cal_impl.Encode2_P1_g speedgoat_test_SN5659__cal_impl.Encode2_P2_d speedgoat_test_SN5659__cal_impl.Encode2_P3_i speedgoat_test_SN5659__cal_impl.Encode2_P4_l speedgoat_test_SN5659__cal_impl.Encode2_P5_p4 speedgoat_test_SN5659__cal_impl.Encode2_P6_d speedgoat_test_SN5659__cal_impl.Encode2_P7_bh speedgoat_test_SN5659__cal_impl.Encode2_P8_d speedgoat_test_SN5659__cal_impl.Encode2_P9_d speedgoat_test_SN5659__cal_impl.Encode3_P10_o speedgoat_test_SN5659__cal_impl.Encode3_P11_h0 speedgoat_test_SN5659__cal_impl.Encode3_P12_k speedgoat_test_SN5659__cal_impl.Encode3_P13_ka speedgoat_test_SN5659__cal_impl.Encode3_P14_n speedgoat_test_SN5659__cal_impl.Encode3_P15_c speedgoat_test_SN5659__cal_impl.Encode3_P1_nj3 speedgoat_test_SN5659__cal_impl.Encode3_P2_h speedgoat_test_SN5659__cal_impl.Encode3_P3_d speedgoat_test_SN5659__cal_impl.Encode3_P4_h speedgoat_test_SN5659__cal_impl.Encode3_P5_f speedgoat_test_SN5659__cal_impl.Encode3_P6_k speedgoat_test_SN5659__cal_impl.Encode3_P7_fx speedgoat_test_SN5659__cal_impl.Encode3_P8_b speedgoat_test_SN5659__cal_impl.Encode3_P9_bx speedgoat_test_SN5659__cal_impl.Encode4_P10_j speedgoat_test_SN5659__cal_impl.Encode4_P11_e speedgoat_test_SN5659__cal_impl.Encode4_P12_o speedgoat_test_SN5659__cal_impl.Encode4_P13_h speedgoat_test_SN5659__cal_impl.Encode4_P14_m speedgoat_test_SN5659__cal_impl.Encode4_P15_f speedgoat_test_SN5659__cal_impl.Encode4_P1_a speedgoat_test_SN5659__cal_impl.Encode4_P2_p speedgoat_test_SN5659__cal_impl.Encode4_P3_a speedgoat_test_SN5659__cal_impl.Encode4_P4_l speedgoat_test_SN5659__cal_impl.Encode4_P5_i speedgoat_test_SN5659__cal_impl.Encode4_P6_d speedgoat_test_SN5659__cal_impl.Encode4_P7_b speedgoat_test_SN5659__cal_impl.Encode4_P8_k speedgoat_test_SN5659__cal_impl.Encode4_P9_p speedgoat_test_SN5659__cal_impl.Randomnumber_Mean_fh speedgoat_test_SN5659__cal_impl.Randomnumber_Seed_cd speedgoat_test_SN5659__cal_impl.Randomnumber_StdDev_n speedgoat_test_SN5659__cal_impl.Sinewave_Amp_c speedgoat_test_SN5659__cal_impl.Sinewave_Bias_kg speedgoat_test_SN5659__cal_impl.Sinewave_Freq_mo speedgoat_test_SN5659__cal_impl.Sinewave_HCos_f speedgoat_test_SN5659__cal_impl.Sinewave_Hsin_h speedgoat_test_SN5659__cal_impl.Sinewave_PCos_m speedgoat_test_SN5659__cal_impl.Sinewave_PSin_m /end REF_CHARACTERISTIC
 /begin REF_MEASUREMENT speedgoat_test_SN5659_R2021b_IO682_B.DataTypeConversion1_d speedgoat_test_SN5659_R2021b_IO682_B.DataTypeConversion_jr speedgoat_test_SN5659_R2021b_IO682_B.Encode1_pbz speedgoat_test_SN5659_R2021b_IO682_B.Encode2_hc speedgoat_test_SN5659_R2021b_IO682_B.Encode3_ou speedgoat_test_SN5659_R2021b_IO682_B.Encode4_p speedgoat_test_SN5659_R2021b_IO682_B.Output_k speedgoat_test_SN5659_R2021b_IO682_B.Randomnumber_br speedgoat_test_SN5659_R2021b_IO682_B.Sinewave_a speedgoat_test_SN5659_R2021b_IO682_DW.NextOutput_i speedgoat_test_SN5659_R2021b_IO682_DW.RandSeed_i speedgoat_test_SN5659_R2021b_IO682_DW.lastCos_ld speedgoat_test_SN5659_R2021b_IO682_DW.lastSin_f speedgoat_test_SN5659_R2021b_IO682_DW.systemEnable_p /end REF_MEASUREMENT
/end GROUP
/begin GROUP speedgoat_test_SN5659_R2021b_IO682_IO682_Encode_Channel_16_Counter_Limited "speedgoat_test_SN5659_R2021b_IO682/IO682/Encode Channel 16/Counter
Limited"
 /begin SUB_GROUP speedgoat_test_SN5659_R2021b_IO682_IO682_Encode_Channel_16_Counter_Limited_Increment_Real_World speedgoat_test_SN5659_R2021b_IO682_IO682_Encode_Channel_16_Counter_Limited_Wrap_To_Zero /end SUB_GROUP
 /begin REF_CHARACTERISTIC speedgoat_test_SN5659__cal_impl.Output_InitialCondition_nl /end REF_CHARACTERISTIC
 /begin REF_MEASUREMENT speedgoat_test_SN5659_R2021b_IO682_B.FixPtSwitch_l2 speedgoat_test_SN5659_R2021b_IO682_B.Output_k speedgoat_test_SN5659_R2021b_IO682_DW.Output_DSTATE_k /end REF_MEASUREMENT
/end GROUP
/begin GROUP speedgoat_test_SN5659_R2021b_IO682_IO682_Encode_Channel_16_Counter_Limited_Increment_Real_World "speedgoat_test_SN5659_R2021b_IO682/IO682/Encode Channel 16/Counter
Limited/Increment
Real World" /begin REF_CHARACTERISTIC speedgoat_test_SN5659__cal_impl.FixPtConstant_Value_i /end REF_CHARACTERISTIC
 /begin REF_MEASUREMENT speedgoat_test_SN5659_R2021b_IO682_B.FixPtSum1_d speedgoat_test_SN5659_R2021b_IO682_B.Output_k /end REF_MEASUREMENT
/end GROUP
/begin GROUP speedgoat_test_SN5659_R2021b_IO682_IO682_Encode_Channel_16_Counter_Limited_Wrap_To_Zero "speedgoat_test_SN5659_R2021b_IO682/IO682/Encode Channel 16/Counter
Limited/Wrap To Zero"
 /begin REF_CHARACTERISTIC speedgoat_test_SN5659__cal_impl.Constant_Value_p speedgoat_test_SN5659__cal_impl.CounterLimited_uplimit_g /end REF_CHARACTERISTIC
 /begin REF_MEASUREMENT speedgoat_test_SN5659_R2021b_IO682_B.FixPtSum1_d speedgoat_test_SN5659_R2021b_IO682_B.FixPtSwitch_l2 /end REF_MEASUREMENT
/end GROUP
/begin GROUP speedgoat_test_SN5659_R2021b_IO682_IO682_Encode_Channel_16_Prepare_RAW_value "speedgoat_test_SN5659_R2021b_IO682/IO682/Encode Channel 16/Prepare RAW value"
 /begin REF_CHARACTERISTIC speedgoat_test_SN5659__cal_impl.Label_Value_k speedgoat_test_SN5659__cal_impl.Mask_BitMask_a speedgoat_test_SN5659__cal_impl.SDI_Value_m3 speedgoat_test_SN5659__cal_impl.SSM_Value_i speedgoat_test_SN5659__cal_impl.Scale_Value_i speedgoat_test_SN5659__cal_impl.shiftthedoublevalue27bitsleft_h /end REF_CHARACTERISTIC
 /begin REF_MEASUREMENT speedgoat_test_SN5659_R2021b_IO682_B.BitwiseOperator_e speedgoat_test_SN5659_R2021b_IO682_B.DataTypeConversion1_d speedgoat_test_SN5659_R2021b_IO682_B.DataTypeConversion_f5 speedgoat_test_SN5659_R2021b_IO682_B.Divide_k3 speedgoat_test_SN5659_R2021b_IO682_B.Mask_h0 speedgoat_test_SN5659_R2021b_IO682_B.Multiply_hd speedgoat_test_SN5659_R2021b_IO682_B.ShifttoSDIslot_m speedgoat_test_SN5659_R2021b_IO682_B.ShifttoSSMslot_m3 /end REF_MEASUREMENT
/end GROUP
/begin GROUP speedgoat_test_SN5659_R2021b_IO682_IO682_Encode_Channel_1_Counter_Limited "speedgoat_test_SN5659_R2021b_IO682/IO682/Encode Channel 1/Counter
Limited"
 /begin SUB_GROUP speedgoat_test_SN5659_R2021b_IO682_IO682_Encode_Channel_1_Counter_Limited_Increment_Real_World speedgoat_test_SN5659_R2021b_IO682_IO682_Encode_Channel_1_Counter_Limited_Wrap_To_Zero /end SUB_GROUP
 /begin REF_CHARACTERISTIC speedgoat_test_SN5659__cal_impl.Output_InitialCondition_b /end REF_CHARACTERISTIC
 /begin REF_MEASUREMENT speedgoat_test_SN5659_R2021b_IO682_B.FixPtSwitch_ha speedgoat_test_SN5659_R2021b_IO682_DW.Output_DSTATE_c /end REF_MEASUREMENT
/end GROUP
/begin GROUP speedgoat_test_SN5659_R2021b_IO682_IO682_Encode_Channel_1_Counter_Limited_Increment_Real_World "speedgoat_test_SN5659_R2021b_IO682/IO682/Encode Channel 1/Counter
Limited/Increment
Real World" /begin REF_CHARACTERISTIC speedgoat_test_SN5659__cal_impl.FixPtConstant_Value_h /end REF_CHARACTERISTIC /begin REF_MEASUREMENT speedgoat_test_SN5659_R2021b_IO682_B.FixPtSum1_i /end REF_MEASUREMENT /end GROUP
/begin GROUP speedgoat_test_SN5659_R2021b_IO682_IO682_Encode_Channel_1_Counter_Limited_Wrap_To_Zero "speedgoat_test_SN5659_R2021b_IO682/IO682/Encode Channel 1/Counter
Limited/Wrap To Zero"
 /begin REF_CHARACTERISTIC speedgoat_test_SN5659__cal_impl.Constant_Value_av speedgoat_test_SN5659__cal_impl.CounterLimited_uplimit_i /end REF_CHARACTERISTIC
 /begin REF_MEASUREMENT speedgoat_test_SN5659_R2021b_IO682_B.FixPtSum1_i speedgoat_test_SN5659_R2021b_IO682_B.FixPtSwitch_ha /end REF_MEASUREMENT
/end GROUP
/begin GROUP speedgoat_test_SN5659_R2021b_IO682_IO682_Encode_Channel_1_Prepare_RAW_value "speedgoat_test_SN5659_R2021b_IO682/IO682/Encode Channel 1/Prepare RAW value"
 /begin REF_CHARACTERISTIC speedgoat_test_SN5659__cal_impl.Label_Value speedgoat_test_SN5659__cal_impl.Mask_BitMask speedgoat_test_SN5659__cal_impl.SDI_Value speedgoat_test_SN5659__cal_impl.SSM_Value speedgoat_test_SN5659__cal_impl.Scale_Value speedgoat_test_SN5659__cal_impl.shiftthedoublevalue27bitsleft_V /end REF_CHARACTERISTIC
 /begin REF_MEASUREMENT speedgoat_test_SN5659_R2021b_IO682_B.BitwiseOperator speedgoat_test_SN5659_R2021b_IO682_B.DataTypeConversion_k5 speedgoat_test_SN5659_R2021b_IO682_B.Divide speedgoat_test_SN5659_R2021b_IO682_B.Mask speedgoat_test_SN5659_R2021b_IO682_B.Multiply speedgoat_test_SN5659_R2021b_IO682_B.ShifttoSDIslot speedgoat_test_SN5659_R2021b_IO682_B.ShifttoSSMslot /end REF_MEASUREMENT
/end GROUP
/begin GROUP speedgoat_test_SN5659_R2021b_IO682_IO682_Encode_Channel_2 "speedgoat_test_SN5659_R2021b_IO682/IO682/Encode Channel 2"
 /begin SUB_GROUP speedgoat_test_SN5659_R2021b_IO682_IO682_Encode_Channel_2_Counter_Limited speedgoat_test_SN5659_R2021b_IO682_IO682_Encode_Channel_2_Prepare_RAW_value /end SUB_GROUP
 /begin REF_CHARACTERISTIC speedgoat_test_SN5659__cal_impl.Constant_Value_b speedgoat_test_SN5659__cal_impl.Encode1_P10_f speedgoat_test_SN5659__cal_impl.Encode1_P11_e speedgoat_test_SN5659__cal_impl.Encode1_P12_g speedgoat_test_SN5659__cal_impl.Encode1_P13_k speedgoat_test_SN5659__cal_impl.Encode1_P14_a speedgoat_test_SN5659__cal_impl.Encode1_P15_p speedgoat_test_SN5659__cal_impl.Encode1_P1_ft speedgoat_test_SN5659__cal_impl.Encode1_P2_hw speedgoat_test_SN5659__cal_impl.Encode1_P3_j speedgoat_test_SN5659__cal_impl.Encode1_P4_g speedgoat_test_SN5659__cal_impl.Encode1_P5_ov speedgoat_test_SN5659__cal_impl.Encode1_P6_pe speedgoat_test_SN5659__cal_impl.Encode1_P7_m speedgoat_test_SN5659__cal_impl.Encode1_P8_ck speedgoat_test_SN5659__cal_impl.Encode1_P9_ol speedgoat_test_SN5659__cal_impl.Encode2_P10_gm speedgoat_test_SN5659__cal_impl.Encode2_P11_d speedgoat_test_SN5659__cal_impl.Encode2_P12_a speedgoat_test_SN5659__cal_impl.Encode2_P13_fz speedgoat_test_SN5659__cal_impl.Encode2_P14_i speedgoat_test_SN5659__cal_impl.Encode2_P15_m speedgoat_test_SN5659__cal_impl.Encode2_P1_hz speedgoat_test_SN5659__cal_impl.Encode2_P2_mu speedgoat_test_SN5659__cal_impl.Encode2_P3_jd speedgoat_test_SN5659__cal_impl.Encode2_P4_g0 speedgoat_test_SN5659__cal_impl.Encode2_P5_h speedgoat_test_SN5659__cal_impl.Encode2_P6_d2 speedgoat_test_SN5659__cal_impl.Encode2_P7_i speedgoat_test_SN5659__cal_impl.Encode2_P8_j speedgoat_test_SN5659__cal_impl.Encode2_P9_n speedgoat_test_SN5659__cal_impl.Encode3_P10_p speedgoat_test_SN5659__cal_impl.Encode3_P11_jq speedgoat_test_SN5659__cal_impl.Encode3_P12_d speedgoat_test_SN5659__cal_impl.Encode3_P13_h speedgoat_test_SN5659__cal_impl.Encode3_P14_ny speedgoat_test_SN5659__cal_impl.Encode3_P15_g speedgoat_test_SN5659__cal_impl.Encode3_P1_m speedgoat_test_SN5659__cal_impl.Encode3_P2_m speedgoat_test_SN5659__cal_impl.Encode3_P3_gs speedgoat_test_SN5659__cal_impl.Encode3_P4_dt speedgoat_test_SN5659__cal_impl.Encode3_P5_d speedgoat_test_SN5659__cal_impl.Encode3_P6_g speedgoat_test_SN5659__cal_impl.Encode3_P7_fm speedgoat_test_SN5659__cal_impl.Encode3_P8_fh speedgoat_test_SN5659__cal_impl.Encode3_P9_n speedgoat_test_SN5659__cal_impl.Encode4_P10_o4 speedgoat_test_SN5659__cal_impl.Encode4_P11_c speedgoat_test_SN5659__cal_impl.Encode4_P12_lr speedgoat_test_SN5659__cal_impl.Encode4_P13_m speedgoat_test_SN5659__cal_impl.Encode4_P14_mx speedgoat_test_SN5659__cal_impl.Encode4_P15_k speedgoat_test_SN5659__cal_impl.Encode4_P1_g speedgoat_test_SN5659__cal_impl.Encode4_P2_h speedgoat_test_SN5659__cal_impl.Encode4_P3_m speedgoat_test_SN5659__cal_impl.Encode4_P4_i speedgoat_test_SN5659__cal_impl.Encode4_P5_j speedgoat_test_SN5659__cal_impl.Encode4_P6_n speedgoat_test_SN5659__cal_impl.Encode4_P7_pf speedgoat_test_SN5659__cal_impl.Encode4_P8_l speedgoat_test_SN5659__cal_impl.Encode4_P9_ns speedgoat_test_SN5659__cal_impl.Randomnumber_Mean_f3 speedgoat_test_SN5659__cal_impl.Randomnumber_Seed_nh speedgoat_test_SN5659__cal_impl.Randomnumber_StdDev_m speedgoat_test_SN5659__cal_impl.Sinewave_Amp_nm speedgoat_test_SN5659__cal_impl.Sinewave_Bias_jq speedgoat_test_SN5659__cal_impl.Sinewave_Freq_l speedgoat_test_SN5659__cal_impl.Sinewave_HCos_b speedgoat_test_SN5659__cal_impl.Sinewave_Hsin_e speedgoat_test_SN5659__cal_impl.Sinewave_PCos_k speedgoat_test_SN5659__cal_impl.Sinewave_PSin_g /end REF_CHARACTERISTIC
 /begin REF_MEASUREMENT speedgoat_test_SN5659_R2021b_IO682_B.DataTypeConversion1_l speedgoat_test_SN5659_R2021b_IO682_B.DataTypeConversion_hu speedgoat_test_SN5659_R2021b_IO682_B.Encode1_h speedgoat_test_SN5659_R2021b_IO682_B.Encode2_fb speedgoat_test_SN5659_R2021b_IO682_B.Encode3_d speedgoat_test_SN5659_R2021b_IO682_B.Encode4_n speedgoat_test_SN5659_R2021b_IO682_B.Output_g speedgoat_test_SN5659_R2021b_IO682_B.Randomnumber_e speedgoat_test_SN5659_R2021b_IO682_B.Sinewave_o5 speedgoat_test_SN5659_R2021b_IO682_DW.NextOutput_j speedgoat_test_SN5659_R2021b_IO682_DW.RandSeed_d speedgoat_test_SN5659_R2021b_IO682_DW.lastCos_lh speedgoat_test_SN5659_R2021b_IO682_DW.lastSin_e speedgoat_test_SN5659_R2021b_IO682_DW.systemEnable_ml /end REF_MEASUREMENT
/end GROUP
/begin GROUP speedgoat_test_SN5659_R2021b_IO682_IO682_Encode_Channel_2_Counter_Limited "speedgoat_test_SN5659_R2021b_IO682/IO682/Encode Channel 2/Counter
Limited"
 /begin SUB_GROUP speedgoat_test_SN5659_R2021b_IO682_IO682_Encode_Channel_2_Counter_Limited_Increment_Real_World speedgoat_test_SN5659_R2021b_IO682_IO682_Encode_Channel_2_Counter_Limited_Wrap_To_Zero /end SUB_GROUP
 /begin REF_CHARACTERISTIC speedgoat_test_SN5659__cal_impl.Output_InitialCondition_j /end REF_CHARACTERISTIC
 /begin REF_MEASUREMENT speedgoat_test_SN5659_R2021b_IO682_B.FixPtSwitch_jo speedgoat_test_SN5659_R2021b_IO682_B.Output_g speedgoat_test_SN5659_R2021b_IO682_DW.Output_DSTATE_e0 /end REF_MEASUREMENT
/end GROUP
/begin GROUP speedgoat_test_SN5659_R2021b_IO682_IO682_Encode_Channel_2_Counter_Limited_Increment_Real_World "speedgoat_test_SN5659_R2021b_IO682/IO682/Encode Channel 2/Counter
Limited/Increment
Real World" /begin REF_CHARACTERISTIC speedgoat_test_SN5659__cal_impl.FixPtConstant_Value_k0 /end REF_CHARACTERISTIC
 /begin REF_MEASUREMENT speedgoat_test_SN5659_R2021b_IO682_B.FixPtSum1_fe speedgoat_test_SN5659_R2021b_IO682_B.Output_g /end REF_MEASUREMENT
/end GROUP
/begin GROUP speedgoat_test_SN5659_R2021b_IO682_IO682_Encode_Channel_2_Counter_Limited_Wrap_To_Zero "speedgoat_test_SN5659_R2021b_IO682/IO682/Encode Channel 2/Counter
Limited/Wrap To Zero"
 /begin REF_CHARACTERISTIC speedgoat_test_SN5659__cal_impl.Constant_Value_ee speedgoat_test_SN5659__cal_impl.CounterLimited_uplimit_be /end REF_CHARACTERISTIC
 /begin REF_MEASUREMENT speedgoat_test_SN5659_R2021b_IO682_B.FixPtSum1_fe speedgoat_test_SN5659_R2021b_IO682_B.FixPtSwitch_jo /end REF_MEASUREMENT
/end GROUP
/begin GROUP speedgoat_test_SN5659_R2021b_IO682_IO682_Encode_Channel_2_Prepare_RAW_value "speedgoat_test_SN5659_R2021b_IO682/IO682/Encode Channel 2/Prepare RAW value" /begin REF_MEASUREMENT speedgoat_test_SN5659_R2021b_IO682_B.DataTypeConversion1_l /end REF_MEASUREMENT /end GROUP
/end MODULE
/end PROJECT
