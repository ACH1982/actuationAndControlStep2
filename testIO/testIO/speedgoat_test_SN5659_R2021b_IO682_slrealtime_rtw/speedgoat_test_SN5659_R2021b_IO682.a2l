ASAP2_VERSION 1 71
/begin PROJECT ProjectName "Project Comment Goes Here"
/begin HEADER "Header Comments go here" /end HEADER
/begin MODULE ModuleName "Module Comment Goes Here"
/begin MOD_COMMON "Mod Common Comment Here" BYTE_ORDER MSB_LAST ALIGNMENT_BYTE 1 ALIGNMENT_WORD 2 ALIGNMENT_LONG 4 ALIGNMENT_FLOAT32_IEEE 4 ALIGNMENT_FLOAT64_IEEE 8 ALIGNMENT_INT64 8 /end MOD_COMMON
/begin CHARACTERISTIC speedgoat_test_SN5659__cal_impl.Constant_Value "" VALUE 0x0083A3D0 Scalar_FLOAT64_IEEE 0 speedgoat_test_SN5659_R2021b_IO682_CM_double -1.7E+308 1.7E+308 /end CHARACTERISTIC
/begin CHARACTERISTIC speedgoat_test_SN5659__cal_impl.Constant_Value_c "" VALUE 0x008406F4 Scalar_UWORD 0 speedgoat_test_SN5659_R2021b_IO682_CM_uint16 0 65535 /end CHARACTERISTIC
/begin CHARACTERISTIC speedgoat_test_SN5659__cal_impl.Constant_Value_j "" VALUE 0x0083AA40 Scalar_FLOAT64_IEEE 0 speedgoat_test_SN5659_R2021b_IO682_CM_double -1.7E+308 1.7E+308 /end CHARACTERISTIC
/begin CHARACTERISTIC speedgoat_test_SN5659__cal_impl.CounterLimited_uplimit "" VALUE 0x00833060 Scalar_UWORD 0 speedgoat_test_SN5659_R2021b_IO682_CM_uint16 0 65535 /end CHARACTERISTIC
/begin CHARACTERISTIC speedgoat_test_SN5659__cal_impl.Decode1_P10_aa "" VAL_BLK 0x00837900 Scalar_FLOAT64_IEEE 0 speedgoat_test_SN5659_R2021b_IO682_CM_double -1.7E+308 1.7E+308 MATRIX_DIM 2 1 /end CHARACTERISTIC
/begin CHARACTERISTIC speedgoat_test_SN5659__cal_impl.Decode1_P10_d "" VAL_BLK 0x00837F98 Scalar_FLOAT64_IEEE 0 speedgoat_test_SN5659_R2021b_IO682_CM_double -1.7E+308 1.7E+308 MATRIX_DIM 2 1 /end CHARACTERISTIC
/begin CHARACTERISTIC speedgoat_test_SN5659__cal_impl.Decode1_P10_e1 "" VAL_BLK 0x00838CC8 Scalar_FLOAT64_IEEE 0 speedgoat_test_SN5659_R2021b_IO682_CM_double -1.7E+308 1.7E+308 MATRIX_DIM 2 1 /end CHARACTERISTIC
/begin CHARACTERISTIC speedgoat_test_SN5659__cal_impl.Decode1_P10_g "" VAL_BLK 0x00839360 Scalar_FLOAT64_IEEE 0 speedgoat_test_SN5659_R2021b_IO682_CM_double -1.7E+308 1.7E+308 MATRIX_DIM 2 1 /end CHARACTERISTIC
/begin CHARACTERISTIC speedgoat_test_SN5659__cal_impl.Decode1_P10_j "" VAL_BLK 0x00838630 Scalar_FLOAT64_IEEE 0 speedgoat_test_SN5659_R2021b_IO682_CM_double -1.7E+308 1.7E+308 MATRIX_DIM 2 1 /end CHARACTERISTIC
/begin CHARACTERISTIC speedgoat_test_SN5659__cal_impl.Decode1_P10_k "" VAL_BLK 0x00833DA8 Scalar_FLOAT64_IEEE 0 speedgoat_test_SN5659_R2021b_IO682_CM_double -1.7E+308 1.7E+308 MATRIX_DIM 2 1 /end CHARACTERISTIC
/begin CHARACTERISTIC speedgoat_test_SN5659__cal_impl.Decode1_P10_l "" VAL_BLK 0x00834440 Scalar_FLOAT64_IEEE 0 speedgoat_test_SN5659_R2021b_IO682_CM_double -1.7E+308 1.7E+308 MATRIX_DIM 2 1 /end CHARACTERISTIC
/begin CHARACTERISTIC speedgoat_test_SN5659__cal_impl.Decode1_P10_m "" VAL_BLK 0x008399F8 Scalar_FLOAT64_IEEE 0 speedgoat_test_SN5659_R2021b_IO682_CM_double -1.7E+308 1.7E+308 MATRIX_DIM 2 1 /end CHARACTERISTIC
/begin CHARACTERISTIC speedgoat_test_SN5659__cal_impl.Decode1_P11_al "" VALUE 0x00838CE8 Scalar_FLOAT64_IEEE 0 speedgoat_test_SN5659_R2021b_IO682_CM_double -1.7E+308 1.7E+308 /end CHARACTERISTIC
/begin CHARACTERISTIC speedgoat_test_SN5659__cal_impl.Decode1_P11_c "" VALUE 0x00837FB8 Scalar_FLOAT64_IEEE 0 speedgoat_test_SN5659_R2021b_IO682_CM_double -1.7E+308 1.7E+308 /end CHARACTERISTIC
/begin CHARACTERISTIC speedgoat_test_SN5659__cal_impl.Decode1_P11_d "" VALUE 0x00839A18 Scalar_FLOAT64_IEEE 0 speedgoat_test_SN5659_R2021b_IO682_CM_double -1.7E+308 1.7E+308 /end CHARACTERISTIC
/begin CHARACTERISTIC speedgoat_test_SN5659__cal_impl.Decode1_P11_e "" VALUE 0x00833DC8 Scalar_FLOAT64_IEEE 0 speedgoat_test_SN5659_R2021b_IO682_CM_double -1.7E+308 1.7E+308 /end CHARACTERISTIC
/begin CHARACTERISTIC speedgoat_test_SN5659__cal_impl.Decode1_P11_ee "" VALUE 0x00838650 Scalar_FLOAT64_IEEE 0 speedgoat_test_SN5659_R2021b_IO682_CM_double -1.7E+308 1.7E+308 /end CHARACTERISTIC
/begin CHARACTERISTIC speedgoat_test_SN5659__cal_impl.Decode1_P11_ei "" VALUE 0x00837920 Scalar_FLOAT64_IEEE 0 speedgoat_test_SN5659_R2021b_IO682_CM_double -1.7E+308 1.7E+308 /end CHARACTERISTIC
/begin CHARACTERISTIC speedgoat_test_SN5659__cal_impl.Decode1_P11_eo "" VALUE 0x00839380 Scalar_FLOAT64_IEEE 0 speedgoat_test_SN5659_R2021b_IO682_CM_double -1.7E+308 1.7E+308 /end CHARACTERISTIC
/begin CHARACTERISTIC speedgoat_test_SN5659__cal_impl.Decode1_P11_eu "" VALUE 0x00834460 Scalar_FLOAT64_IEEE 0 speedgoat_test_SN5659_R2021b_IO682_CM_double -1.7E+308 1.7E+308 /end CHARACTERISTIC
/begin CHARACTERISTIC speedgoat_test_SN5659__cal_impl.Decode1_P12_d5 "" VALUE 0x00838668 Scalar_FLOAT64_IEEE 0 speedgoat_test_SN5659_R2021b_IO682_CM_double -1.7E+308 1.7E+308 /end CHARACTERISTIC
/begin CHARACTERISTIC speedgoat_test_SN5659__cal_impl.Decode1_P12_jm "" VALUE 0x00837938 Scalar_FLOAT64_IEEE 0 speedgoat_test_SN5659_R2021b_IO682_CM_double -1.7E+308 1.7E+308 /end CHARACTERISTIC
/begin CHARACTERISTIC speedgoat_test_SN5659__cal_impl.Decode1_P12_kj "" VALUE 0x00838D00 Scalar_FLOAT64_IEEE 0 speedgoat_test_SN5659_R2021b_IO682_CM_double -1.7E+308 1.7E+308 /end CHARACTERISTIC
/begin CHARACTERISTIC speedgoat_test_SN5659__cal_impl.Decode1_P12_m "" VALUE 0x00839398 Scalar_FLOAT64_IEEE 0 speedgoat_test_SN5659_R2021b_IO682_CM_double -1.7E+308 1.7E+308 /end CHARACTERISTIC
/begin CHARACTERISTIC speedgoat_test_SN5659__cal_impl.Decode1_P12_n "" VALUE 0x00839A30 Scalar_FLOAT64_IEEE 0 speedgoat_test_SN5659_R2021b_IO682_CM_double -1.7E+308 1.7E+308 /end CHARACTERISTIC
/begin CHARACTERISTIC speedgoat_test_SN5659__cal_impl.Decode1_P12_p "" VALUE 0x00833DE0 Scalar_FLOAT64_IEEE 0 speedgoat_test_SN5659_R2021b_IO682_CM_double -1.7E+308 1.7E+308 /end CHARACTERISTIC
/begin CHARACTERISTIC speedgoat_test_SN5659__cal_impl.Decode1_P12_pl "" VALUE 0x00834478 Scalar_FLOAT64_IEEE 0 speedgoat_test_SN5659_R2021b_IO682_CM_double -1.7E+308 1.7E+308 /end CHARACTERISTIC
/begin CHARACTERISTIC speedgoat_test_SN5659__cal_impl.Decode1_P12_po "" VALUE 0x00837FD0 Scalar_FLOAT64_IEEE 0 speedgoat_test_SN5659_R2021b_IO682_CM_double -1.7E+308 1.7E+308 /end CHARACTERISTIC
/begin CHARACTERISTIC speedgoat_test_SN5659__cal_impl.Decode1_P13_a "" VALUE 0x00833DF8 Scalar_FLOAT64_IEEE 0 speedgoat_test_SN5659_R2021b_IO682_CM_double -1.7E+308 1.7E+308 /end CHARACTERISTIC
/begin CHARACTERISTIC speedgoat_test_SN5659__cal_impl.Decode1_P13_ad "" VALUE 0x00838680 Scalar_FLOAT64_IEEE 0 speedgoat_test_SN5659_R2021b_IO682_CM_double -1.7E+308 1.7E+308 /end CHARACTERISTIC
/begin CHARACTERISTIC speedgoat_test_SN5659__cal_impl.Decode1_P13_cn "" VALUE 0x00839A48 Scalar_FLOAT64_IEEE 0 speedgoat_test_SN5659_R2021b_IO682_CM_double -1.7E+308 1.7E+308 /end CHARACTERISTIC
/begin CHARACTERISTIC speedgoat_test_SN5659__cal_impl.Decode1_P13_e "" VALUE 0x00837950 Scalar_FLOAT64_IEEE 0 speedgoat_test_SN5659_R2021b_IO682_CM_double -1.7E+308 1.7E+308 /end CHARACTERISTIC
/begin CHARACTERISTIC speedgoat_test_SN5659__cal_impl.Decode1_P13_f "" VALUE 0x00834490 Scalar_FLOAT64_IEEE 0 speedgoat_test_SN5659_R2021b_IO682_CM_double -1.7E+308 1.7E+308 /end CHARACTERISTIC
/begin CHARACTERISTIC speedgoat_test_SN5659__cal_impl.Decode1_P13_fl "" VALUE 0x008393B0 Scalar_FLOAT64_IEEE 0 speedgoat_test_SN5659_R2021b_IO682_CM_double -1.7E+308 1.7E+308 /end CHARACTERISTIC
/begin CHARACTERISTIC speedgoat_test_SN5659__cal_impl.Decode1_P13_m "" VALUE 0x00838D18 Scalar_FLOAT64_IEEE 0 speedgoat_test_SN5659_R2021b_IO682_CM_double -1.7E+308 1.7E+308 /end CHARACTERISTIC
/begin CHARACTERISTIC speedgoat_test_SN5659__cal_impl.Decode1_P13_p "" VALUE 0x00837FE8 Scalar_FLOAT64_IEEE 0 speedgoat_test_SN5659_R2021b_IO682_CM_double -1.7E+308 1.7E+308 /end CHARACTERISTIC
/begin CHARACTERISTIC speedgoat_test_SN5659__cal_impl.Decode1_P14_a "" VALUE 0x00838D30 Scalar_FLOAT64_IEEE 0 speedgoat_test_SN5659_R2021b_IO682_CM_double -1.7E+308 1.7E+308 /end CHARACTERISTIC
/begin CHARACTERISTIC speedgoat_test_SN5659__cal_impl.Decode1_P14_da "" VALUE 0x00838000 Scalar_FLOAT64_IEEE 0 speedgoat_test_SN5659_R2021b_IO682_CM_double -1.7E+308 1.7E+308 /end CHARACTERISTIC
/begin CHARACTERISTIC speedgoat_test_SN5659__cal_impl.Decode1_P14_f "" VALUE 0x008393C8 Scalar_FLOAT64_IEEE 0 speedgoat_test_SN5659_R2021b_IO682_CM_double -1.7E+308 1.7E+308 /end CHARACTERISTIC
/begin CHARACTERISTIC speedgoat_test_SN5659__cal_impl.Decode1_P14_fq "" VALUE 0x00839A60 Scalar_FLOAT64_IEEE 0 speedgoat_test_SN5659_R2021b_IO682_CM_double -1.7E+308 1.7E+308 /end CHARACTERISTIC
/begin CHARACTERISTIC speedgoat_test_SN5659__cal_impl.Decode1_P14_id "" VALUE 0x00837968 Scalar_FLOAT64_IEEE 0 speedgoat_test_SN5659_R2021b_IO682_CM_double -1.7E+308 1.7E+308 /end CHARACTERISTIC
/begin CHARACTERISTIC speedgoat_test_SN5659__cal_impl.Decode1_P14_j "" VALUE 0x00838698 Scalar_FLOAT64_IEEE 0 speedgoat_test_SN5659_R2021b_IO682_CM_double -1.7E+308 1.7E+308 /end CHARACTERISTIC
/begin CHARACTERISTIC speedgoat_test_SN5659__cal_impl.Decode1_P14_m "" VALUE 0x008344A8 Scalar_FLOAT64_IEEE 0 speedgoat_test_SN5659_R2021b_IO682_CM_double -1.7E+308 1.7E+308 /end CHARACTERISTIC
/begin CHARACTERISTIC speedgoat_test_SN5659__cal_impl.Decode1_P14_o "" VALUE 0x00833E10 Scalar_FLOAT64_IEEE 0 speedgoat_test_SN5659_R2021b_IO682_CM_double -1.7E+308 1.7E+308 /end CHARACTERISTIC
/begin CHARACTERISTIC speedgoat_test_SN5659__cal_impl.Decode1_P15_au "" VALUE 0x008386B0 Scalar_FLOAT64_IEEE 0 speedgoat_test_SN5659_R2021b_IO682_CM_double -1.7E+308 1.7E+308 /end CHARACTERISTIC
/begin CHARACTERISTIC speedgoat_test_SN5659__cal_impl.Decode1_P15_aw "" VALUE 0x00838D48 Scalar_FLOAT64_IEEE 0 speedgoat_test_SN5659_R2021b_IO682_CM_double -1.7E+308 1.7E+308 /end CHARACTERISTIC
/begin CHARACTERISTIC speedgoat_test_SN5659__cal_impl.Decode1_P15_b "" VALUE 0x008344C0 Scalar_FLOAT64_IEEE 0 speedgoat_test_SN5659_R2021b_IO682_CM_double -1.7E+308 1.7E+308 /end CHARACTERISTIC
/begin CHARACTERISTIC speedgoat_test_SN5659__cal_impl.Decode1_P15_gw "" VALUE 0x00838018 Scalar_FLOAT64_IEEE 0 speedgoat_test_SN5659_R2021b_IO682_CM_double -1.7E+308 1.7E+308 /end CHARACTERISTIC
/begin CHARACTERISTIC speedgoat_test_SN5659__cal_impl.Decode1_P15_l "" VALUE 0x00833E28 Scalar_FLOAT64_IEEE 0 speedgoat_test_SN5659_R2021b_IO682_CM_double -1.7E+308 1.7E+308 /end CHARACTERISTIC
/begin CHARACTERISTIC speedgoat_test_SN5659__cal_impl.Decode1_P15_l0 "" VALUE 0x00837980 Scalar_FLOAT64_IEEE 0 speedgoat_test_SN5659_R2021b_IO682_CM_double -1.7E+308 1.7E+308 /end CHARACTERISTIC
/begin CHARACTERISTIC speedgoat_test_SN5659__cal_impl.Decode1_P15_nq "" VALUE 0x008393E0 Scalar_FLOAT64_IEEE 0 speedgoat_test_SN5659_R2021b_IO682_CM_double -1.7E+308 1.7E+308 /end CHARACTERISTIC
/begin CHARACTERISTIC speedgoat_test_SN5659__cal_impl.Decode1_P15_p "" VALUE 0x00839A78 Scalar_FLOAT64_IEEE 0 speedgoat_test_SN5659_R2021b_IO682_CM_double -1.7E+308 1.7E+308 /end CHARACTERISTIC
/begin CHARACTERISTIC speedgoat_test_SN5659__cal_impl.Decode1_P16_b "" VALUE 0x008344D8 Scalar_FLOAT64_IEEE 0 speedgoat_test_SN5659_R2021b_IO682_CM_double -1.7E+308 1.7E+308 /end CHARACTERISTIC
/begin CHARACTERISTIC speedgoat_test_SN5659__cal_impl.Decode1_P16_be "" VALUE 0x00838030 Scalar_FLOAT64_IEEE 0 speedgoat_test_SN5659_R2021b_IO682_CM_double -1.7E+308 1.7E+308 /end CHARACTERISTIC
/begin CHARACTERISTIC speedgoat_test_SN5659__cal_impl.Decode1_P16_eq "" VALUE 0x00838D60 Scalar_FLOAT64_IEEE 0 speedgoat_test_SN5659_R2021b_IO682_CM_double -1.7E+308 1.7E+308 /end CHARACTERISTIC
/begin CHARACTERISTIC speedgoat_test_SN5659__cal_impl.Decode1_P16_fi "" VALUE 0x00839A90 Scalar_FLOAT64_IEEE 0 speedgoat_test_SN5659_R2021b_IO682_CM_double -1.7E+308 1.7E+308 /end CHARACTERISTIC
/begin CHARACTERISTIC speedgoat_test_SN5659__cal_impl.Decode1_P16_g "" VALUE 0x00837998 Scalar_FLOAT64_IEEE 0 speedgoat_test_SN5659_R2021b_IO682_CM_double -1.7E+308 1.7E+308 /end CHARACTERISTIC
/begin CHARACTERISTIC speedgoat_test_SN5659__cal_impl.Decode1_P16_j "" VALUE 0x00833E40 Scalar_FLOAT64_IEEE 0 speedgoat_test_SN5659_R2021b_IO682_CM_double -1.7E+308 1.7E+308 /end CHARACTERISTIC
/begin CHARACTERISTIC speedgoat_test_SN5659__cal_impl.Decode1_P16_ju "" VALUE 0x008393F8 Scalar_FLOAT64_IEEE 0 speedgoat_test_SN5659_R2021b_IO682_CM_double -1.7E+308 1.7E+308 /end CHARACTERISTIC
/begin CHARACTERISTIC speedgoat_test_SN5659__cal_impl.Decode1_P16_l "" VALUE 0x008386C8 Scalar_FLOAT64_IEEE 0 speedgoat_test_SN5659_R2021b_IO682_CM_double -1.7E+308 1.7E+308 /end CHARACTERISTIC
/begin CHARACTERISTIC speedgoat_test_SN5659__cal_impl.Decode1_P1_c "" VALUE 0x00833CD0 Scalar_FLOAT64_IEEE 0 speedgoat_test_SN5659_R2021b_IO682_CM_double -1.7E+308 1.7E+308 /end CHARACTERISTIC
/begin CHARACTERISTIC speedgoat_test_SN5659__cal_impl.Decode1_P1_c2 "" VALUE 0x00834368 Scalar_FLOAT64_IEEE 0 speedgoat_test_SN5659_R2021b_IO682_CM_double -1.7E+308 1.7E+308 /end CHARACTERISTIC
/begin CHARACTERISTIC speedgoat_test_SN5659__cal_impl.Decode1_P1_cw "" VALUE 0x00838BF0 Scalar_FLOAT64_IEEE 0 speedgoat_test_SN5659_R2021b_IO682_CM_double -1.7E+308 1.7E+308 /end CHARACTERISTIC
/begin CHARACTERISTIC speedgoat_test_SN5659__cal_impl.Decode1_P1_h "" VALUE 0x00838558 Scalar_FLOAT64_IEEE 0 speedgoat_test_SN5659_R2021b_IO682_CM_double -1.7E+308 1.7E+308 /end CHARACTERISTIC
/begin CHARACTERISTIC speedgoat_test_SN5659__cal_impl.Decode1_P1_hw "" VALUE 0x00839288 Scalar_FLOAT64_IEEE 0 speedgoat_test_SN5659_R2021b_IO682_CM_double -1.7E+308 1.7E+308 /end CHARACTERISTIC
/begin CHARACTERISTIC speedgoat_test_SN5659__cal_impl.Decode1_P1_k "" VALUE 0x00837EC0 Scalar_FLOAT64_IEEE 0 speedgoat_test_SN5659_R2021b_IO682_CM_double -1.7E+308 1.7E+308 /end CHARACTERISTIC
/begin CHARACTERISTIC speedgoat_test_SN5659__cal_impl.Decode1_P1_p "" VALUE 0x00837828 Scalar_FLOAT64_IEEE 0 speedgoat_test_SN5659_R2021b_IO682_CM_double -1.7E+308 1.7E+308 /end CHARACTERISTIC
/begin CHARACTERISTIC speedgoat_test_SN5659__cal_impl.Decode1_P1_pi "" VALUE 0x00839920 Scalar_FLOAT64_IEEE 0 speedgoat_test_SN5659_R2021b_IO682_CM_double -1.7E+308 1.7E+308 /end CHARACTERISTIC
/begin CHARACTERISTIC speedgoat_test_SN5659__cal_impl.Decode1_P2_b "" VALUE 0x00834380 Scalar_FLOAT64_IEEE 0 speedgoat_test_SN5659_R2021b_IO682_CM_double -1.7E+308 1.7E+308 /end CHARACTERISTIC
/begin CHARACTERISTIC speedgoat_test_SN5659__cal_impl.Decode1_P2_bu "" VALUE 0x00838C08 Scalar_FLOAT64_IEEE 0 speedgoat_test_SN5659_R2021b_IO682_CM_double -1.7E+308 1.7E+308 /end CHARACTERISTIC
/begin CHARACTERISTIC speedgoat_test_SN5659__cal_impl.Decode1_P2_c "" VALUE 0x00838570 Scalar_FLOAT64_IEEE 0 speedgoat_test_SN5659_R2021b_IO682_CM_double -1.7E+308 1.7E+308 /end CHARACTERISTIC
/begin CHARACTERISTIC speedgoat_test_SN5659__cal_impl.Decode1_P2_d "" VALUE 0x00837840 Scalar_FLOAT64_IEEE 0 speedgoat_test_SN5659_R2021b_IO682_CM_double -1.7E+308 1.7E+308 /end CHARACTERISTIC
/begin CHARACTERISTIC speedgoat_test_SN5659__cal_impl.Decode1_P2_e1 "" VALUE 0x00837ED8 Scalar_FLOAT64_IEEE 0 speedgoat_test_SN5659_R2021b_IO682_CM_double -1.7E+308 1.7E+308 /end CHARACTERISTIC
/begin CHARACTERISTIC speedgoat_test_SN5659__cal_impl.Decode1_P2_g "" VALUE 0x00833CE8 Scalar_FLOAT64_IEEE 0 speedgoat_test_SN5659_R2021b_IO682_CM_double -1.7E+308 1.7E+308 /end CHARACTERISTIC
/begin CHARACTERISTIC speedgoat_test_SN5659__cal_impl.Decode1_P2_m "" VALUE 0x008392A0 Scalar_FLOAT64_IEEE 0 speedgoat_test_SN5659_R2021b_IO682_CM_double -1.7E+308 1.7E+308 /end CHARACTERISTIC
/begin CHARACTERISTIC speedgoat_test_SN5659__cal_impl.Decode1_P2_mk "" VALUE 0x00839938 Scalar_FLOAT64_IEEE 0 speedgoat_test_SN5659_R2021b_IO682_CM_double -1.7E+308 1.7E+308 /end CHARACTERISTIC
/begin CHARACTERISTIC speedgoat_test_SN5659__cal_impl.Decode1_P3_a "" VALUE 0x00838C20 Scalar_FLOAT64_IEEE 0 speedgoat_test_SN5659_R2021b_IO682_CM_double -1.7E+308 1.7E+308 /end CHARACTERISTIC
/begin CHARACTERISTIC speedgoat_test_SN5659__cal_impl.Decode1_P3_b "" VALUE 0x00833D00 Scalar_FLOAT64_IEEE 0 speedgoat_test_SN5659_R2021b_IO682_CM_double -1.7E+308 1.7E+308 /end CHARACTERISTIC
/begin CHARACTERISTIC speedgoat_test_SN5659__cal_impl.Decode1_P3_ci "" VALUE 0x008392B8 Scalar_FLOAT64_IEEE 0 speedgoat_test_SN5659_R2021b_IO682_CM_double -1.7E+308 1.7E+308 /end CHARACTERISTIC
/begin CHARACTERISTIC speedgoat_test_SN5659__cal_impl.Decode1_P3_d "" VALUE 0x00838588 Scalar_FLOAT64_IEEE 0 speedgoat_test_SN5659_R2021b_IO682_CM_double -1.7E+308 1.7E+308 /end CHARACTERISTIC
/begin CHARACTERISTIC speedgoat_test_SN5659__cal_impl.Decode1_P3_g "" VALUE 0x00834398 Scalar_FLOAT64_IEEE 0 speedgoat_test_SN5659_R2021b_IO682_CM_double -1.7E+308 1.7E+308 /end CHARACTERISTIC
/begin CHARACTERISTIC speedgoat_test_SN5659__cal_impl.Decode1_P3_gr "" VALUE 0x00839950 Scalar_FLOAT64_IEEE 0 speedgoat_test_SN5659_R2021b_IO682_CM_double -1.7E+308 1.7E+308 /end CHARACTERISTIC
/begin CHARACTERISTIC speedgoat_test_SN5659__cal_impl.Decode1_P3_n "" VALUE 0x00837858 Scalar_FLOAT64_IEEE 0 speedgoat_test_SN5659_R2021b_IO682_CM_double -1.7E+308 1.7E+308 /end CHARACTERISTIC
/begin CHARACTERISTIC speedgoat_test_SN5659__cal_impl.Decode1_P3_ng "" VALUE 0x00837EF0 Scalar_FLOAT64_IEEE 0 speedgoat_test_SN5659_R2021b_IO682_CM_double -1.7E+308 1.7E+308 /end CHARACTERISTIC
/begin CHARACTERISTIC speedgoat_test_SN5659__cal_impl.Decode1_P4_b "" VALUE 0x00833D18 Scalar_FLOAT64_IEEE 0 speedgoat_test_SN5659_R2021b_IO682_CM_double -1.7E+308 1.7E+308 /end CHARACTERISTIC
/begin CHARACTERISTIC speedgoat_test_SN5659__cal_impl.Decode1_P4_bf "" VALUE 0x008392D0 Scalar_FLOAT64_IEEE 0 speedgoat_test_SN5659_R2021b_IO682_CM_double -1.7E+308 1.7E+308 /end CHARACTERISTIC
/begin CHARACTERISTIC speedgoat_test_SN5659__cal_impl.Decode1_P4_e "" VALUE 0x008343B0 Scalar_FLOAT64_IEEE 0 speedgoat_test_SN5659_R2021b_IO682_CM_double -1.7E+308 1.7E+308 /end CHARACTERISTIC
/begin CHARACTERISTIC speedgoat_test_SN5659__cal_impl.Decode1_P4_h "" VALUE 0x00837F08 Scalar_FLOAT64_IEEE 0 speedgoat_test_SN5659_R2021b_IO682_CM_double -1.7E+308 1.7E+308 /end CHARACTERISTIC
/begin CHARACTERISTIC speedgoat_test_SN5659__cal_impl.Decode1_P4_j "" VALUE 0x00838C38 Scalar_FLOAT64_IEEE 0 speedgoat_test_SN5659_R2021b_IO682_CM_double -1.7E+308 1.7E+308 /end CHARACTERISTIC
/begin CHARACTERISTIC speedgoat_test_SN5659__cal_impl.Decode1_P4_me "" VALUE 0x008385A0 Scalar_FLOAT64_IEEE 0 speedgoat_test_SN5659_R2021b_IO682_CM_double -1.7E+308 1.7E+308 /end CHARACTERISTIC
/begin CHARACTERISTIC speedgoat_test_SN5659__cal_impl.Decode1_P4_n "" VALUE 0x00839968 Scalar_FLOAT64_IEEE 0 speedgoat_test_SN5659_R2021b_IO682_CM_double -1.7E+308 1.7E+308 /end CHARACTERISTIC
/begin CHARACTERISTIC speedgoat_test_SN5659__cal_impl.Decode1_P4_pr "" VALUE 0x00837870 Scalar_FLOAT64_IEEE 0 speedgoat_test_SN5659_R2021b_IO682_CM_double -1.7E+308 1.7E+308 /end CHARACTERISTIC
/begin CHARACTERISTIC speedgoat_test_SN5659__cal_impl.Decode1_P5_d "" VALUE 0x00837F20 Scalar_FLOAT64_IEEE 0 speedgoat_test_SN5659_R2021b_IO682_CM_double -1.7E+308 1.7E+308 /end CHARACTERISTIC
/begin CHARACTERISTIC speedgoat_test_SN5659__cal_impl.Decode1_P5_d5 "" VALUE 0x008385B8 Scalar_FLOAT64_IEEE 0 speedgoat_test_SN5659_R2021b_IO682_CM_double -1.7E+308 1.7E+308 /end CHARACTERISTIC
/begin CHARACTERISTIC speedgoat_test_SN5659__cal_impl.Decode1_P5_f "" VALUE 0x00833D30 Scalar_FLOAT64_IEEE 0 speedgoat_test_SN5659_R2021b_IO682_CM_double -1.7E+308 1.7E+308 /end CHARACTERISTIC
/begin CHARACTERISTIC speedgoat_test_SN5659__cal_impl.Decode1_P5_h "" VALUE 0x00839980 Scalar_FLOAT64_IEEE 0 speedgoat_test_SN5659_R2021b_IO682_CM_double -1.7E+308 1.7E+308 /end CHARACTERISTIC
/begin CHARACTERISTIC speedgoat_test_SN5659__cal_impl.Decode1_P5_kb "" VALUE 0x008392E8 Scalar_FLOAT64_IEEE 0 speedgoat_test_SN5659_R2021b_IO682_CM_double -1.7E+308 1.7E+308 /end CHARACTERISTIC
/begin CHARACTERISTIC speedgoat_test_SN5659__cal_impl.Decode1_P5_m3 "" VALUE 0x00838C50 Scalar_FLOAT64_IEEE 0 speedgoat_test_SN5659_R2021b_IO682_CM_double -1.7E+308 1.7E+308 /end CHARACTERISTIC
/begin CHARACTERISTIC speedgoat_test_SN5659__cal_impl.Decode1_P5_n "" VALUE 0x008343C8 Scalar_FLOAT64_IEEE 0 speedgoat_test_SN5659_R2021b_IO682_CM_double -1.7E+308 1.7E+308 /end CHARACTERISTIC
/begin CHARACTERISTIC speedgoat_test_SN5659__cal_impl.Decode1_P5_p "" VALUE 0x00837888 Scalar_FLOAT64_IEEE 0 speedgoat_test_SN5659_R2021b_IO682_CM_double -1.7E+308 1.7E+308 /end CHARACTERISTIC
/begin CHARACTERISTIC speedgoat_test_SN5659__cal_impl.Decode1_P6_bi "" VALUE 0x00838C68 Scalar_FLOAT64_IEEE 0 speedgoat_test_SN5659_R2021b_IO682_CM_double -1.7E+308 1.7E+308 /end CHARACTERISTIC
/begin CHARACTERISTIC speedgoat_test_SN5659__cal_impl.Decode1_P6_e "" VALUE 0x00839998 Scalar_FLOAT64_IEEE 0 speedgoat_test_SN5659_R2021b_IO682_CM_double -1.7E+308 1.7E+308 /end CHARACTERISTIC
/begin CHARACTERISTIC speedgoat_test_SN5659__cal_impl.Decode1_P6_f "" VALUE 0x00833D48 Scalar_FLOAT64_IEEE 0 speedgoat_test_SN5659_R2021b_IO682_CM_double -1.7E+308 1.7E+308 /end CHARACTERISTIC
/begin CHARACTERISTIC speedgoat_test_SN5659__cal_impl.Decode1_P6_i3 "" VALUE 0x008385D0 Scalar_FLOAT64_IEEE 0 speedgoat_test_SN5659_R2021b_IO682_CM_double -1.7E+308 1.7E+308 /end CHARACTERISTIC
/begin CHARACTERISTIC speedgoat_test_SN5659__cal_impl.Decode1_P6_j "" VALUE 0x008343E0 Scalar_FLOAT64_IEEE 0 speedgoat_test_SN5659_R2021b_IO682_CM_double -1.7E+308 1.7E+308 /end CHARACTERISTIC
/begin CHARACTERISTIC speedgoat_test_SN5659__cal_impl.Decode1_P6_jf "" VALUE 0x00839300 Scalar_FLOAT64_IEEE 0 speedgoat_test_SN5659_R2021b_IO682_CM_double -1.7E+308 1.7E+308 /end CHARACTERISTIC
/begin CHARACTERISTIC speedgoat_test_SN5659__cal_impl.Decode1_P6_o "" VALUE 0x008378A0 Scalar_FLOAT64_IEEE 0 speedgoat_test_SN5659_R2021b_IO682_CM_double -1.7E+308 1.7E+308 /end CHARACTERISTIC
/begin CHARACTERISTIC speedgoat_test_SN5659__cal_impl.Decode1_P6_pa "" VALUE 0x00837F38 Scalar_FLOAT64_IEEE 0 speedgoat_test_SN5659_R2021b_IO682_CM_double -1.7E+308 1.7E+308 /end CHARACTERISTIC
/begin CHARACTERISTIC speedgoat_test_SN5659__cal_impl.Decode1_P7_bo "" VALUE 0x008378B8 Scalar_FLOAT64_IEEE 0 speedgoat_test_SN5659_R2021b_IO682_CM_double -1.7E+308 1.7E+308 /end CHARACTERISTIC
/begin CHARACTERISTIC speedgoat_test_SN5659__cal_impl.Decode1_P7_d3 "" VALUE 0x008385E8 Scalar_FLOAT64_IEEE 0 speedgoat_test_SN5659_R2021b_IO682_CM_double -1.7E+308 1.7E+308 /end CHARACTERISTIC
/begin CHARACTERISTIC speedgoat_test_SN5659__cal_impl.Decode1_P7_h "" VALUE 0x00833D60 Scalar_FLOAT64_IEEE 0 speedgoat_test_SN5659_R2021b_IO682_CM_double -1.7E+308 1.7E+308 /end CHARACTERISTIC
/begin CHARACTERISTIC speedgoat_test_SN5659__cal_impl.Decode1_P7_j "" VALUE 0x008399B0 Scalar_FLOAT64_IEEE 0 speedgoat_test_SN5659_R2021b_IO682_CM_double -1.7E+308 1.7E+308 /end CHARACTERISTIC
/begin CHARACTERISTIC speedgoat_test_SN5659__cal_impl.Decode1_P7_k "" VALUE 0x008343F8 Scalar_FLOAT64_IEEE 0 speedgoat_test_SN5659_R2021b_IO682_CM_double -1.7E+308 1.7E+308 /end CHARACTERISTIC
/begin CHARACTERISTIC speedgoat_test_SN5659__cal_impl.Decode1_P7_l "" VALUE 0x00837F50 Scalar_FLOAT64_IEEE 0 speedgoat_test_SN5659_R2021b_IO682_CM_double -1.7E+308 1.7E+308 /end CHARACTERISTIC
/begin CHARACTERISTIC speedgoat_test_SN5659__cal_impl.Decode1_P7_m1 "" VALUE 0x00838C80 Scalar_FLOAT64_IEEE 0 speedgoat_test_SN5659_R2021b_IO682_CM_double -1.7E+308 1.7E+308 /end CHARACTERISTIC
/begin CHARACTERISTIC speedgoat_test_SN5659__cal_impl.Decode1_P7_ob "" VALUE 0x00839318 Scalar_FLOAT64_IEEE 0 speedgoat_test_SN5659_R2021b_IO682_CM_double -1.7E+308 1.7E+308 /end CHARACTERISTIC
/begin CHARACTERISTIC speedgoat_test_SN5659__cal_impl.Decode1_P8_a "" VALUE 0x00839330 Scalar_FLOAT64_IEEE 0 speedgoat_test_SN5659_R2021b_IO682_CM_double -1.7E+308 1.7E+308 /end CHARACTERISTIC
/begin CHARACTERISTIC speedgoat_test_SN5659__cal_impl.Decode1_P8_a1 "" VALUE 0x008399C8 Scalar_FLOAT64_IEEE 0 speedgoat_test_SN5659_R2021b_IO682_CM_double -1.7E+308 1.7E+308 /end CHARACTERISTIC
/begin CHARACTERISTIC speedgoat_test_SN5659__cal_impl.Decode1_P8_c "" VALUE 0x00833D78 Scalar_FLOAT64_IEEE 0 speedgoat_test_SN5659_R2021b_IO682_CM_double -1.7E+308 1.7E+308 /end CHARACTERISTIC
/begin CHARACTERISTIC speedgoat_test_SN5659__cal_impl.Decode1_P8_c5 "" VALUE 0x00838600 Scalar_FLOAT64_IEEE 0 speedgoat_test_SN5659_R2021b_IO682_CM_double -1.7E+308 1.7E+308 /end CHARACTERISTIC
/begin CHARACTERISTIC speedgoat_test_SN5659__cal_impl.Decode1_P8_f "" VALUE 0x00838C98 Scalar_FLOAT64_IEEE 0 speedgoat_test_SN5659_R2021b_IO682_CM_double -1.7E+308 1.7E+308 /end CHARACTERISTIC
/begin CHARACTERISTIC speedgoat_test_SN5659__cal_impl.Decode1_P8_ga "" VALUE 0x008378D0 Scalar_FLOAT64_IEEE 0 speedgoat_test_SN5659_R2021b_IO682_CM_double -1.7E+308 1.7E+308 /end CHARACTERISTIC
/begin CHARACTERISTIC speedgoat_test_SN5659__cal_impl.Decode1_P8_l "" VALUE 0x00834410 Scalar_FLOAT64_IEEE 0 speedgoat_test_SN5659_R2021b_IO682_CM_double -1.7E+308 1.7E+308 /end CHARACTERISTIC
/begin CHARACTERISTIC speedgoat_test_SN5659__cal_impl.Decode1_P8_o "" VALUE 0x00837F68 Scalar_FLOAT64_IEEE 0 speedgoat_test_SN5659_R2021b_IO682_CM_double -1.7E+308 1.7E+308 /end CHARACTERISTIC
/begin CHARACTERISTIC speedgoat_test_SN5659__cal_impl.Decode1_P9_a "" VALUE 0x00837F80 Scalar_FLOAT64_IEEE 0 speedgoat_test_SN5659_R2021b_IO682_CM_double -1.7E+308 1.7E+308 /end CHARACTERISTIC
/begin CHARACTERISTIC speedgoat_test_SN5659__cal_impl.Decode1_P9_c "" VALUE 0x008378E8 Scalar_FLOAT64_IEEE 0 speedgoat_test_SN5659_R2021b_IO682_CM_double -1.7E+308 1.7E+308 /end CHARACTERISTIC
/begin CHARACTERISTIC speedgoat_test_SN5659__cal_impl.Decode1_P9_dz "" VALUE 0x008399E0 Scalar_FLOAT64_IEEE 0 speedgoat_test_SN5659_R2021b_IO682_CM_double -1.7E+308 1.7E+308 /end CHARACTERISTIC
/begin CHARACTERISTIC speedgoat_test_SN5659__cal_impl.Decode1_P9_ie "" VALUE 0x00838CB0 Scalar_FLOAT64_IEEE 0 speedgoat_test_SN5659_R2021b_IO682_CM_double -1.7E+308 1.7E+308 /end CHARACTERISTIC
/begin CHARACTERISTIC speedgoat_test_SN5659__cal_impl.Decode1_P9_k "" VALUE 0x00834428 Scalar_FLOAT64_IEEE 0 speedgoat_test_SN5659_R2021b_IO682_CM_double -1.7E+308 1.7E+308 /end CHARACTERISTIC
/begin CHARACTERISTIC speedgoat_test_SN5659__cal_impl.Decode1_P9_op "" VALUE 0x00839348 Scalar_FLOAT64_IEEE 0 speedgoat_test_SN5659_R2021b_IO682_CM_double -1.7E+308 1.7E+308 /end CHARACTERISTIC
/begin CHARACTERISTIC speedgoat_test_SN5659__cal_impl.Decode1_P9_p "" VALUE 0x00833D90 Scalar_FLOAT64_IEEE 0 speedgoat_test_SN5659_R2021b_IO682_CM_double -1.7E+308 1.7E+308 /end CHARACTERISTIC
/begin CHARACTERISTIC speedgoat_test_SN5659__cal_impl.Decode1_P9_pu "" VALUE 0x00838618 Scalar_FLOAT64_IEEE 0 speedgoat_test_SN5659_R2021b_IO682_CM_double -1.7E+308 1.7E+308 /end CHARACTERISTIC
/begin CHARACTERISTIC speedgoat_test_SN5659__cal_impl.Decode2_P1 "" VALUE 0x00833E58 Scalar_FLOAT64_IEEE 0 speedgoat_test_SN5659_R2021b_IO682_CM_double -1.7E+308 1.7E+308 /end CHARACTERISTIC
/begin CHARACTERISTIC speedgoat_test_SN5659__cal_impl.Decode2_P10 "" VAL_BLK 0x00833F30 Scalar_FLOAT64_IEEE 0 speedgoat_test_SN5659_R2021b_IO682_CM_double -1.7E+308 1.7E+308 MATRIX_DIM 2 1 /end CHARACTERISTIC
/begin CHARACTERISTIC speedgoat_test_SN5659__cal_impl.Decode2_P10_bf "" VAL_BLK 0x00837A88 Scalar_FLOAT64_IEEE 0 speedgoat_test_SN5659_R2021b_IO682_CM_double -1.7E+308 1.7E+308 MATRIX_DIM 2 1 /end CHARACTERISTIC
/begin CHARACTERISTIC speedgoat_test_SN5659__cal_impl.Decode2_P10_cg "" VAL_BLK 0x00839B80 Scalar_FLOAT64_IEEE 0 speedgoat_test_SN5659_R2021b_IO682_CM_double -1.7E+308 1.7E+308 MATRIX_DIM 2 1 /end CHARACTERISTIC
/begin CHARACTERISTIC speedgoat_test_SN5659__cal_impl.Decode2_P10_e "" VAL_BLK 0x00838E50 Scalar_FLOAT64_IEEE 0 speedgoat_test_SN5659_R2021b_IO682_CM_double -1.7E+308 1.7E+308 MATRIX_DIM 2 1 /end CHARACTERISTIC
/begin CHARACTERISTIC speedgoat_test_SN5659__cal_impl.Decode2_P10_f "" VAL_BLK 0x00838120 Scalar_FLOAT64_IEEE 0 speedgoat_test_SN5659_R2021b_IO682_CM_double -1.7E+308 1.7E+308 MATRIX_DIM 2 1 /end CHARACTERISTIC
/begin CHARACTERISTIC speedgoat_test_SN5659__cal_impl.Decode2_P10_l "" VAL_BLK 0x008394E8 Scalar_FLOAT64_IEEE 0 speedgoat_test_SN5659_R2021b_IO682_CM_double -1.7E+308 1.7E+308 MATRIX_DIM 2 1 /end CHARACTERISTIC
/begin CHARACTERISTIC speedgoat_test_SN5659__cal_impl.Decode2_P11 "" VALUE 0x00833F50 Scalar_FLOAT64_IEEE 0 speedgoat_test_SN5659_R2021b_IO682_CM_double -1.7E+308 1.7E+308 /end CHARACTERISTIC
/begin CHARACTERISTIC speedgoat_test_SN5659__cal_impl.Decode2_P11_ff "" VALUE 0x00837AA8 Scalar_FLOAT64_IEEE 0 speedgoat_test_SN5659_R2021b_IO682_CM_double -1.7E+308 1.7E+308 /end CHARACTERISTIC
/begin CHARACTERISTIC speedgoat_test_SN5659__cal_impl.Decode2_P11_fz "" VALUE 0x00838140 Scalar_FLOAT64_IEEE 0 speedgoat_test_SN5659_R2021b_IO682_CM_double -1.7E+308 1.7E+308 /end CHARACTERISTIC
/begin CHARACTERISTIC speedgoat_test_SN5659__cal_impl.Decode2_P11_h "" VALUE 0x00839508 Scalar_FLOAT64_IEEE 0 speedgoat_test_SN5659_R2021b_IO682_CM_double -1.7E+308 1.7E+308 /end CHARACTERISTIC
/begin CHARACTERISTIC speedgoat_test_SN5659__cal_impl.Decode2_P11_kl "" VALUE 0x00839BA0 Scalar_FLOAT64_IEEE 0 speedgoat_test_SN5659_R2021b_IO682_CM_double -1.7E+308 1.7E+308 /end CHARACTERISTIC
/begin CHARACTERISTIC speedgoat_test_SN5659__cal_impl.Decode2_P11_p "" VALUE 0x00838E70 Scalar_FLOAT64_IEEE 0 speedgoat_test_SN5659_R2021b_IO682_CM_double -1.7E+308 1.7E+308 /end CHARACTERISTIC
/begin CHARACTERISTIC speedgoat_test_SN5659__cal_impl.Decode2_P12 "" VALUE 0x00833F68 Scalar_FLOAT64_IEEE 0 speedgoat_test_SN5659_R2021b_IO682_CM_double -1.7E+308 1.7E+308 /end CHARACTERISTIC
/begin CHARACTERISTIC speedgoat_test_SN5659__cal_impl.Decode2_P12_b "" VALUE 0x00837AC0 Scalar_FLOAT64_IEEE 0 speedgoat_test_SN5659_R2021b_IO682_CM_double -1.7E+308 1.7E+308 /end CHARACTERISTIC
/begin CHARACTERISTIC speedgoat_test_SN5659__cal_impl.Decode2_P12_bf "" VALUE 0x00838158 Scalar_FLOAT64_IEEE 0 speedgoat_test_SN5659_R2021b_IO682_CM_double -1.7E+308 1.7E+308 /end CHARACTERISTIC
/begin CHARACTERISTIC speedgoat_test_SN5659__cal_impl.Decode2_P12_d "" VALUE 0x00839520 Scalar_FLOAT64_IEEE 0 speedgoat_test_SN5659_R2021b_IO682_CM_double -1.7E+308 1.7E+308 /end CHARACTERISTIC
/begin CHARACTERISTIC speedgoat_test_SN5659__cal_impl.Decode2_P12_id "" VALUE 0x00838E88 Scalar_FLOAT64_IEEE 0 speedgoat_test_SN5659_R2021b_IO682_CM_double -1.7E+308 1.7E+308 /end CHARACTERISTIC
/begin CHARACTERISTIC speedgoat_test_SN5659__cal_impl.Decode2_P12_m "" VALUE 0x00839BB8 Scalar_FLOAT64_IEEE 0 speedgoat_test_SN5659_R2021b_IO682_CM_double -1.7E+308 1.7E+308 /end CHARACTERISTIC
/begin CHARACTERISTIC speedgoat_test_SN5659__cal_impl.Decode2_P13 "" VALUE 0x00833F80 Scalar_FLOAT64_IEEE 0 speedgoat_test_SN5659_R2021b_IO682_CM_double -1.7E+308 1.7E+308 /end CHARACTERISTIC
/begin CHARACTERISTIC speedgoat_test_SN5659__cal_impl.Decode2_P13_b "" VALUE 0x00838EA0 Scalar_FLOAT64_IEEE 0 speedgoat_test_SN5659_R2021b_IO682_CM_double -1.7E+308 1.7E+308 /end CHARACTERISTIC
/begin CHARACTERISTIC speedgoat_test_SN5659__cal_impl.Decode2_P13_bk "" VALUE 0x00839BD0 Scalar_FLOAT64_IEEE 0 speedgoat_test_SN5659_R2021b_IO682_CM_double -1.7E+308 1.7E+308 /end CHARACTERISTIC
/begin CHARACTERISTIC speedgoat_test_SN5659__cal_impl.Decode2_P13_c "" VALUE 0x00837AD8 Scalar_FLOAT64_IEEE 0 speedgoat_test_SN5659_R2021b_IO682_CM_double -1.7E+308 1.7E+308 /end CHARACTERISTIC
/begin CHARACTERISTIC speedgoat_test_SN5659__cal_impl.Decode2_P13_d "" VALUE 0x00839538 Scalar_FLOAT64_IEEE 0 speedgoat_test_SN5659_R2021b_IO682_CM_double -1.7E+308 1.7E+308 /end CHARACTERISTIC
/begin CHARACTERISTIC speedgoat_test_SN5659__cal_impl.Decode2_P13_m "" VALUE 0x00838170 Scalar_FLOAT64_IEEE 0 speedgoat_test_SN5659_R2021b_IO682_CM_double -1.7E+308 1.7E+308 /end CHARACTERISTIC
/begin CHARACTERISTIC speedgoat_test_SN5659__cal_impl.Decode2_P14 "" VALUE 0x00833F98 Scalar_FLOAT64_IEEE 0 speedgoat_test_SN5659_R2021b_IO682_CM_double -1.7E+308 1.7E+308 /end CHARACTERISTIC
/begin CHARACTERISTIC speedgoat_test_SN5659__cal_impl.Decode2_P14_d "" VALUE 0x00838EB8 Scalar_FLOAT64_IEEE 0 speedgoat_test_SN5659_R2021b_IO682_CM_double -1.7E+308 1.7E+308 /end CHARACTERISTIC
/begin CHARACTERISTIC speedgoat_test_SN5659__cal_impl.Decode2_P14_f2 "" VALUE 0x00837AF0 Scalar_FLOAT64_IEEE 0 speedgoat_test_SN5659_R2021b_IO682_CM_double -1.7E+308 1.7E+308 /end CHARACTERISTIC
/begin CHARACTERISTIC speedgoat_test_SN5659__cal_impl.Decode2_P14_j "" VALUE 0x00838188 Scalar_FLOAT64_IEEE 0 speedgoat_test_SN5659_R2021b_IO682_CM_double -1.7E+308 1.7E+308 /end CHARACTERISTIC
/begin CHARACTERISTIC speedgoat_test_SN5659__cal_impl.Decode2_P14_k "" VALUE 0x00839550 Scalar_FLOAT64_IEEE 0 speedgoat_test_SN5659_R2021b_IO682_CM_double -1.7E+308 1.7E+308 /end CHARACTERISTIC
/begin CHARACTERISTIC speedgoat_test_SN5659__cal_impl.Decode2_P14_kg "" VALUE 0x00839BE8 Scalar_FLOAT64_IEEE 0 speedgoat_test_SN5659_R2021b_IO682_CM_double -1.7E+308 1.7E+308 /end CHARACTERISTIC
/begin CHARACTERISTIC speedgoat_test_SN5659__cal_impl.Decode2_P15 "" VALUE 0x00833FB0 Scalar_FLOAT64_IEEE 0 speedgoat_test_SN5659_R2021b_IO682_CM_double -1.7E+308 1.7E+308 /end CHARACTERISTIC
/begin CHARACTERISTIC speedgoat_test_SN5659__cal_impl.Decode2_P15_b "" VALUE 0x00838ED0 Scalar_FLOAT64_IEEE 0 speedgoat_test_SN5659_R2021b_IO682_CM_double -1.7E+308 1.7E+308 /end CHARACTERISTIC
/begin CHARACTERISTIC speedgoat_test_SN5659__cal_impl.Decode2_P15_gh "" VALUE 0x00839C00 Scalar_FLOAT64_IEEE 0 speedgoat_test_SN5659_R2021b_IO682_CM_double -1.7E+308 1.7E+308 /end CHARACTERISTIC
/begin CHARACTERISTIC speedgoat_test_SN5659__cal_impl.Decode2_P15_go "" VALUE 0x00837B08 Scalar_FLOAT64_IEEE 0 speedgoat_test_SN5659_R2021b_IO682_CM_double -1.7E+308 1.7E+308 /end CHARACTERISTIC
/begin CHARACTERISTIC speedgoat_test_SN5659__cal_impl.Decode2_P15_jl "" VALUE 0x008381A0 Scalar_FLOAT64_IEEE 0 speedgoat_test_SN5659_R2021b_IO682_CM_double -1.7E+308 1.7E+308 /end CHARACTERISTIC
/begin CHARACTERISTIC speedgoat_test_SN5659__cal_impl.Decode2_P15_l "" VALUE 0x00839568 Scalar_FLOAT64_IEEE 0 speedgoat_test_SN5659_R2021b_IO682_CM_double -1.7E+308 1.7E+308 /end CHARACTERISTIC
/begin CHARACTERISTIC speedgoat_test_SN5659__cal_impl.Decode2_P16 "" VALUE 0x00833FC8 Scalar_FLOAT64_IEEE 0 speedgoat_test_SN5659_R2021b_IO682_CM_double -1.7E+308 1.7E+308 /end CHARACTERISTIC
/begin CHARACTERISTIC speedgoat_test_SN5659__cal_impl.Decode2_P16_a "" VALUE 0x00839C18 Scalar_FLOAT64_IEEE 0 speedgoat_test_SN5659_R2021b_IO682_CM_double -1.7E+308 1.7E+308 /end CHARACTERISTIC
/begin CHARACTERISTIC speedgoat_test_SN5659__cal_impl.Decode2_P16_cw "" VALUE 0x00837B20 Scalar_FLOAT64_IEEE 0 speedgoat_test_SN5659_R2021b_IO682_CM_double -1.7E+308 1.7E+308 /end CHARACTERISTIC
/begin CHARACTERISTIC speedgoat_test_SN5659__cal_impl.Decode2_P16_d "" VALUE 0x00838EE8 Scalar_FLOAT64_IEEE 0 speedgoat_test_SN5659_R2021b_IO682_CM_double -1.7E+308 1.7E+308 /end CHARACTERISTIC
/begin CHARACTERISTIC speedgoat_test_SN5659__cal_impl.Decode2_P16_f "" VALUE 0x008381B8 Scalar_FLOAT64_IEEE 0 speedgoat_test_SN5659_R2021b_IO682_CM_double -1.7E+308 1.7E+308 /end CHARACTERISTIC
/begin CHARACTERISTIC speedgoat_test_SN5659__cal_impl.Decode2_P16_h "" VALUE 0x00839580 Scalar_FLOAT64_IEEE 0 speedgoat_test_SN5659_R2021b_IO682_CM_double -1.7E+308 1.7E+308 /end CHARACTERISTIC
/begin CHARACTERISTIC speedgoat_test_SN5659__cal_impl.Decode2_P1_b "" VALUE 0x00839410 Scalar_FLOAT64_IEEE 0 speedgoat_test_SN5659_R2021b_IO682_CM_double -1.7E+308 1.7E+308 /end CHARACTERISTIC
/begin CHARACTERISTIC speedgoat_test_SN5659__cal_impl.Decode2_P1_i "" VALUE 0x008379B0 Scalar_FLOAT64_IEEE 0 speedgoat_test_SN5659_R2021b_IO682_CM_double -1.7E+308 1.7E+308 /end CHARACTERISTIC
/begin CHARACTERISTIC speedgoat_test_SN5659__cal_impl.Decode2_P1_i0 "" VALUE 0x00839AA8 Scalar_FLOAT64_IEEE 0 speedgoat_test_SN5659_R2021b_IO682_CM_double -1.7E+308 1.7E+308 /end CHARACTERISTIC
/begin CHARACTERISTIC speedgoat_test_SN5659__cal_impl.Decode2_P1_k "" VALUE 0x00838D78 Scalar_FLOAT64_IEEE 0 speedgoat_test_SN5659_R2021b_IO682_CM_double -1.7E+308 1.7E+308 /end CHARACTERISTIC
/begin CHARACTERISTIC speedgoat_test_SN5659__cal_impl.Decode2_P1_p "" VALUE 0x00838048 Scalar_FLOAT64_IEEE 0 speedgoat_test_SN5659_R2021b_IO682_CM_double -1.7E+308 1.7E+308 /end CHARACTERISTIC
/begin CHARACTERISTIC speedgoat_test_SN5659__cal_impl.Decode2_P2 "" VALUE 0x00833E70 Scalar_FLOAT64_IEEE 0 speedgoat_test_SN5659_R2021b_IO682_CM_double -1.7E+308 1.7E+308 /end CHARACTERISTIC
/begin CHARACTERISTIC speedgoat_test_SN5659__cal_impl.Decode2_P2_ef "" VALUE 0x008379C8 Scalar_FLOAT64_IEEE 0 speedgoat_test_SN5659_R2021b_IO682_CM_double -1.7E+308 1.7E+308 /end CHARACTERISTIC
/begin CHARACTERISTIC speedgoat_test_SN5659__cal_impl.Decode2_P2_jg "" VALUE 0x00839428 Scalar_FLOAT64_IEEE 0 speedgoat_test_SN5659_R2021b_IO682_CM_double -1.7E+308 1.7E+308 /end CHARACTERISTIC
/begin CHARACTERISTIC speedgoat_test_SN5659__cal_impl.Decode2_P2_kc "" VALUE 0x00838060 Scalar_FLOAT64_IEEE 0 speedgoat_test_SN5659_R2021b_IO682_CM_double -1.7E+308 1.7E+308 /end CHARACTERISTIC
/begin CHARACTERISTIC speedgoat_test_SN5659__cal_impl.Decode2_P2_kx "" VALUE 0x00838D90 Scalar_FLOAT64_IEEE 0 speedgoat_test_SN5659_R2021b_IO682_CM_double -1.7E+308 1.7E+308 /end CHARACTERISTIC
/begin CHARACTERISTIC speedgoat_test_SN5659__cal_impl.Decode2_P2_mg "" VALUE 0x00839AC0 Scalar_FLOAT64_IEEE 0 speedgoat_test_SN5659_R2021b_IO682_CM_double -1.7E+308 1.7E+308 /end CHARACTERISTIC
/begin CHARACTERISTIC speedgoat_test_SN5659__cal_impl.Decode2_P3 "" VALUE 0x00833E88 Scalar_FLOAT64_IEEE 0 speedgoat_test_SN5659_R2021b_IO682_CM_double -1.7E+308 1.7E+308 /end CHARACTERISTIC
/begin CHARACTERISTIC speedgoat_test_SN5659__cal_impl.Decode2_P3_b5 "" VALUE 0x00838DA8 Scalar_FLOAT64_IEEE 0 speedgoat_test_SN5659_R2021b_IO682_CM_double -1.7E+308 1.7E+308 /end CHARACTERISTIC
/begin CHARACTERISTIC speedgoat_test_SN5659__cal_impl.Decode2_P3_c "" VALUE 0x008379E0 Scalar_FLOAT64_IEEE 0 speedgoat_test_SN5659_R2021b_IO682_CM_double -1.7E+308 1.7E+308 /end CHARACTERISTIC
/begin CHARACTERISTIC speedgoat_test_SN5659__cal_impl.Decode2_P3_i "" VALUE 0x00838078 Scalar_FLOAT64_IEEE 0 speedgoat_test_SN5659_R2021b_IO682_CM_double -1.7E+308 1.7E+308 /end CHARACTERISTIC
/begin CHARACTERISTIC speedgoat_test_SN5659__cal_impl.Decode2_P3_m "" VALUE 0x00839440 Scalar_FLOAT64_IEEE 0 speedgoat_test_SN5659_R2021b_IO682_CM_double -1.7E+308 1.7E+308 /end CHARACTERISTIC
/begin CHARACTERISTIC speedgoat_test_SN5659__cal_impl.Decode2_P3_p "" VALUE 0x00839AD8 Scalar_FLOAT64_IEEE 0 speedgoat_test_SN5659_R2021b_IO682_CM_double -1.7E+308 1.7E+308 /end CHARACTERISTIC
/begin CHARACTERISTIC speedgoat_test_SN5659__cal_impl.Decode2_P4 "" VALUE 0x00833EA0 Scalar_FLOAT64_IEEE 0 speedgoat_test_SN5659_R2021b_IO682_CM_double -1.7E+308 1.7E+308 /end CHARACTERISTIC
/begin CHARACTERISTIC speedgoat_test_SN5659__cal_impl.Decode2_P4_a "" VALUE 0x00838DC0 Scalar_FLOAT64_IEEE 0 speedgoat_test_SN5659_R2021b_IO682_CM_double -1.7E+308 1.7E+308 /end CHARACTERISTIC
/begin CHARACTERISTIC speedgoat_test_SN5659__cal_impl.Decode2_P4_b "" VALUE 0x00838090 Scalar_FLOAT64_IEEE 0 speedgoat_test_SN5659_R2021b_IO682_CM_double -1.7E+308 1.7E+308 /end CHARACTERISTIC
/begin CHARACTERISTIC speedgoat_test_SN5659__cal_impl.Decode2_P4_bb "" VALUE 0x00839AF0 Scalar_FLOAT64_IEEE 0 speedgoat_test_SN5659_R2021b_IO682_CM_double -1.7E+308 1.7E+308 /end CHARACTERISTIC
/begin CHARACTERISTIC speedgoat_test_SN5659__cal_impl.Decode2_P4_e "" VALUE 0x008379F8 Scalar_FLOAT64_IEEE 0 speedgoat_test_SN5659_R2021b_IO682_CM_double -1.7E+308 1.7E+308 /end CHARACTERISTIC
/begin CHARACTERISTIC speedgoat_test_SN5659__cal_impl.Decode2_P4_ff "" VALUE 0x00839458 Scalar_FLOAT64_IEEE 0 speedgoat_test_SN5659_R2021b_IO682_CM_double -1.7E+308 1.7E+308 /end CHARACTERISTIC
/begin CHARACTERISTIC speedgoat_test_SN5659__cal_impl.Decode2_P5 "" VALUE 0x00833EB8 Scalar_FLOAT64_IEEE 0 speedgoat_test_SN5659_R2021b_IO682_CM_double -1.7E+308 1.7E+308 /end CHARACTERISTIC
/begin CHARACTERISTIC speedgoat_test_SN5659__cal_impl.Decode2_P5_d "" VALUE 0x008380A8 Scalar_FLOAT64_IEEE 0 speedgoat_test_SN5659_R2021b_IO682_CM_double -1.7E+308 1.7E+308 /end CHARACTERISTIC
/begin CHARACTERISTIC speedgoat_test_SN5659__cal_impl.Decode2_P5_h "" VALUE 0x00839470 Scalar_FLOAT64_IEEE 0 speedgoat_test_SN5659_R2021b_IO682_CM_double -1.7E+308 1.7E+308 /end CHARACTERISTIC
/begin CHARACTERISTIC speedgoat_test_SN5659__cal_impl.Decode2_P5_jm "" VALUE 0x00838DD8 Scalar_FLOAT64_IEEE 0 speedgoat_test_SN5659_R2021b_IO682_CM_double -1.7E+308 1.7E+308 /end CHARACTERISTIC
/begin CHARACTERISTIC speedgoat_test_SN5659__cal_impl.Decode2_P5_ju "" VALUE 0x00839B08 Scalar_FLOAT64_IEEE 0 speedgoat_test_SN5659_R2021b_IO682_CM_double -1.7E+308 1.7E+308 /end CHARACTERISTIC
/begin CHARACTERISTIC speedgoat_test_SN5659__cal_impl.Decode2_P5_l "" VALUE 0x00837A10 Scalar_FLOAT64_IEEE 0 speedgoat_test_SN5659_R2021b_IO682_CM_double -1.7E+308 1.7E+308 /end CHARACTERISTIC
/begin CHARACTERISTIC speedgoat_test_SN5659__cal_impl.Decode2_P6 "" VALUE 0x00833ED0 Scalar_FLOAT64_IEEE 0 speedgoat_test_SN5659_R2021b_IO682_CM_double -1.7E+308 1.7E+308 /end CHARACTERISTIC
/begin CHARACTERISTIC speedgoat_test_SN5659__cal_impl.Decode2_P6_b "" VALUE 0x00839488 Scalar_FLOAT64_IEEE 0 speedgoat_test_SN5659_R2021b_IO682_CM_double -1.7E+308 1.7E+308 /end CHARACTERISTIC
/begin CHARACTERISTIC speedgoat_test_SN5659__cal_impl.Decode2_P6_hg "" VALUE 0x00839B20 Scalar_FLOAT64_IEEE 0 speedgoat_test_SN5659_R2021b_IO682_CM_double -1.7E+308 1.7E+308 /end CHARACTERISTIC
/begin CHARACTERISTIC speedgoat_test_SN5659__cal_impl.Decode2_P6_lx "" VALUE 0x00838DF0 Scalar_FLOAT64_IEEE 0 speedgoat_test_SN5659_R2021b_IO682_CM_double -1.7E+308 1.7E+308 /end CHARACTERISTIC
/begin CHARACTERISTIC speedgoat_test_SN5659__cal_impl.Decode2_P6_m "" VALUE 0x008380C0 Scalar_FLOAT64_IEEE 0 speedgoat_test_SN5659_R2021b_IO682_CM_double -1.7E+308 1.7E+308 /end CHARACTERISTIC
/begin CHARACTERISTIC speedgoat_test_SN5659__cal_impl.Decode2_P6_n "" VALUE 0x00837A28 Scalar_FLOAT64_IEEE 0 speedgoat_test_SN5659_R2021b_IO682_CM_double -1.7E+308 1.7E+308 /end CHARACTERISTIC
/begin CHARACTERISTIC speedgoat_test_SN5659__cal_impl.Decode2_P7 "" VALUE 0x00833EE8 Scalar_FLOAT64_IEEE 0 speedgoat_test_SN5659_R2021b_IO682_CM_double -1.7E+308 1.7E+308 /end CHARACTERISTIC
/begin CHARACTERISTIC speedgoat_test_SN5659__cal_impl.Decode2_P7_c "" VALUE 0x008394A0 Scalar_FLOAT64_IEEE 0 speedgoat_test_SN5659_R2021b_IO682_CM_double -1.7E+308 1.7E+308 /end CHARACTERISTIC
/begin CHARACTERISTIC speedgoat_test_SN5659__cal_impl.Decode2_P7_h "" VALUE 0x008380D8 Scalar_FLOAT64_IEEE 0 speedgoat_test_SN5659_R2021b_IO682_CM_double -1.7E+308 1.7E+308 /end CHARACTERISTIC
/begin CHARACTERISTIC speedgoat_test_SN5659__cal_impl.Decode2_P7_ht "" VALUE 0x00839B38 Scalar_FLOAT64_IEEE 0 speedgoat_test_SN5659_R2021b_IO682_CM_double -1.7E+308 1.7E+308 /end CHARACTERISTIC
/begin CHARACTERISTIC speedgoat_test_SN5659__cal_impl.Decode2_P7_ja "" VALUE 0x00837A40 Scalar_FLOAT64_IEEE 0 speedgoat_test_SN5659_R2021b_IO682_CM_double -1.7E+308 1.7E+308 /end CHARACTERISTIC
/begin CHARACTERISTIC speedgoat_test_SN5659__cal_impl.Decode2_P7_k "" VALUE 0x00838E08 Scalar_FLOAT64_IEEE 0 speedgoat_test_SN5659_R2021b_IO682_CM_double -1.7E+308 1.7E+308 /end CHARACTERISTIC
/begin CHARACTERISTIC speedgoat_test_SN5659__cal_impl.Decode2_P8 "" VALUE 0x00833F00 Scalar_FLOAT64_IEEE 0 speedgoat_test_SN5659_R2021b_IO682_CM_double -1.7E+308 1.7E+308 /end CHARACTERISTIC
/begin CHARACTERISTIC speedgoat_test_SN5659__cal_impl.Decode2_P8_bd "" VALUE 0x008380F0 Scalar_FLOAT64_IEEE 0 speedgoat_test_SN5659_R2021b_IO682_CM_double -1.7E+308 1.7E+308 /end CHARACTERISTIC
/begin CHARACTERISTIC speedgoat_test_SN5659__cal_impl.Decode2_P8_fr "" VALUE 0x00839B50 Scalar_FLOAT64_IEEE 0 speedgoat_test_SN5659_R2021b_IO682_CM_double -1.7E+308 1.7E+308 /end CHARACTERISTIC
/begin CHARACTERISTIC speedgoat_test_SN5659__cal_impl.Decode2_P8_g "" VALUE 0x00837A58 Scalar_FLOAT64_IEEE 0 speedgoat_test_SN5659_R2021b_IO682_CM_double -1.7E+308 1.7E+308 /end CHARACTERISTIC
/begin CHARACTERISTIC speedgoat_test_SN5659__cal_impl.Decode2_P8_h4 "" VALUE 0x00838E20 Scalar_FLOAT64_IEEE 0 speedgoat_test_SN5659_R2021b_IO682_CM_double -1.7E+308 1.7E+308 /end CHARACTERISTIC
/begin CHARACTERISTIC speedgoat_test_SN5659__cal_impl.Decode2_P8_k "" VALUE 0x008394B8 Scalar_FLOAT64_IEEE 0 speedgoat_test_SN5659_R2021b_IO682_CM_double -1.7E+308 1.7E+308 /end CHARACTERISTIC
/begin CHARACTERISTIC speedgoat_test_SN5659__cal_impl.Decode2_P9 "" VALUE 0x00833F18 Scalar_FLOAT64_IEEE 0 speedgoat_test_SN5659_R2021b_IO682_CM_double -1.7E+308 1.7E+308 /end CHARACTERISTIC
/begin CHARACTERISTIC speedgoat_test_SN5659__cal_impl.Decode2_P9_e "" VALUE 0x00837A70 Scalar_FLOAT64_IEEE 0 speedgoat_test_SN5659_R2021b_IO682_CM_double -1.7E+308 1.7E+308 /end CHARACTERISTIC
/begin CHARACTERISTIC speedgoat_test_SN5659__cal_impl.Decode2_P9_gj "" VALUE 0x008394D0 Scalar_FLOAT64_IEEE 0 speedgoat_test_SN5659_R2021b_IO682_CM_double -1.7E+308 1.7E+308 /end CHARACTERISTIC
/begin CHARACTERISTIC speedgoat_test_SN5659__cal_impl.Decode2_P9_gq "" VALUE 0x00838E38 Scalar_FLOAT64_IEEE 0 speedgoat_test_SN5659_R2021b_IO682_CM_double -1.7E+308 1.7E+308 /end CHARACTERISTIC
/begin CHARACTERISTIC speedgoat_test_SN5659__cal_impl.Decode2_P9_lp "" VALUE 0x00838108 Scalar_FLOAT64_IEEE 0 speedgoat_test_SN5659_R2021b_IO682_CM_double -1.7E+308 1.7E+308 /end CHARACTERISTIC
/begin CHARACTERISTIC speedgoat_test_SN5659__cal_impl.Decode2_P9_m "" VALUE 0x00839B68 Scalar_FLOAT64_IEEE 0 speedgoat_test_SN5659_R2021b_IO682_CM_double -1.7E+308 1.7E+308 /end CHARACTERISTIC
/begin CHARACTERISTIC speedgoat_test_SN5659__cal_impl.Decode3_P10_a "" VAL_BLK 0x008340B8 Scalar_FLOAT64_IEEE 0 speedgoat_test_SN5659_R2021b_IO682_CM_double -1.7E+308 1.7E+308 MATRIX_DIM 2 1 /end CHARACTERISTIC
/begin CHARACTERISTIC speedgoat_test_SN5659__cal_impl.Decode3_P10_av "" VAL_BLK 0x00838FD8 Scalar_FLOAT64_IEEE 0 speedgoat_test_SN5659_R2021b_IO682_CM_double -1.7E+308 1.7E+308 MATRIX_DIM 2 1 /end CHARACTERISTIC
/begin CHARACTERISTIC speedgoat_test_SN5659__cal_impl.Decode3_P10_g "" VAL_BLK 0x00839D08 Scalar_FLOAT64_IEEE 0 speedgoat_test_SN5659_R2021b_IO682_CM_double -1.7E+308 1.7E+308 MATRIX_DIM 2 1 /end CHARACTERISTIC
/begin CHARACTERISTIC speedgoat_test_SN5659__cal_impl.Decode3_P10_i "" VAL_BLK 0x00837C10 Scalar_FLOAT64_IEEE 0 speedgoat_test_SN5659_R2021b_IO682_CM_double -1.7E+308 1.7E+308 MATRIX_DIM 2 1 /end CHARACTERISTIC
/begin CHARACTERISTIC speedgoat_test_SN5659__cal_impl.Decode3_P10_k "" VAL_BLK 0x00834750 Scalar_FLOAT64_IEEE 0 speedgoat_test_SN5659_R2021b_IO682_CM_double -1.7E+308 1.7E+308 MATRIX_DIM 2 1 /end CHARACTERISTIC
/begin CHARACTERISTIC speedgoat_test_SN5659__cal_impl.Decode3_P10_k5 "" VAL_BLK 0x00838940 Scalar_FLOAT64_IEEE 0 speedgoat_test_SN5659_R2021b_IO682_CM_double -1.7E+308 1.7E+308 MATRIX_DIM 2 1 /end CHARACTERISTIC
/begin CHARACTERISTIC speedgoat_test_SN5659__cal_impl.Decode3_P10_lv "" VAL_BLK 0x00839670 Scalar_FLOAT64_IEEE 0 speedgoat_test_SN5659_R2021b_IO682_CM_double -1.7E+308 1.7E+308 MATRIX_DIM 2 1 /end CHARACTERISTIC
/begin CHARACTERISTIC speedgoat_test_SN5659__cal_impl.Decode3_P10_oo "" VAL_BLK 0x008382A8 Scalar_FLOAT64_IEEE 0 speedgoat_test_SN5659_R2021b_IO682_CM_double -1.7E+308 1.7E+308 MATRIX_DIM 2 1 /end CHARACTERISTIC
/begin CHARACTERISTIC speedgoat_test_SN5659__cal_impl.Decode3_P11_b "" VALUE 0x008340D8 Scalar_FLOAT64_IEEE 0 speedgoat_test_SN5659_R2021b_IO682_CM_double -1.7E+308 1.7E+308 /end CHARACTERISTIC
/begin CHARACTERISTIC speedgoat_test_SN5659__cal_impl.Decode3_P11_bg "" VALUE 0x00838960 Scalar_FLOAT64_IEEE 0 speedgoat_test_SN5659_R2021b_IO682_CM_double -1.7E+308 1.7E+308 /end CHARACTERISTIC
/begin CHARACTERISTIC speedgoat_test_SN5659__cal_impl.Decode3_P11_e "" VALUE 0x00834770 Scalar_FLOAT64_IEEE 0 speedgoat_test_SN5659_R2021b_IO682_CM_double -1.7E+308 1.7E+308 /end CHARACTERISTIC
/begin CHARACTERISTIC speedgoat_test_SN5659__cal_impl.Decode3_P11_ku "" VALUE 0x00838FF8 Scalar_FLOAT64_IEEE 0 speedgoat_test_SN5659_R2021b_IO682_CM_double -1.7E+308 1.7E+308 /end CHARACTERISTIC
/begin CHARACTERISTIC speedgoat_test_SN5659__cal_impl.Decode3_P11_m "" VALUE 0x00837C30 Scalar_FLOAT64_IEEE 0 speedgoat_test_SN5659_R2021b_IO682_CM_double -1.7E+308 1.7E+308 /end CHARACTERISTIC
/begin CHARACTERISTIC speedgoat_test_SN5659__cal_impl.Decode3_P11_mj "" VALUE 0x008382C8 Scalar_FLOAT64_IEEE 0 speedgoat_test_SN5659_R2021b_IO682_CM_double -1.7E+308 1.7E+308 /end CHARACTERISTIC
/begin CHARACTERISTIC speedgoat_test_SN5659__cal_impl.Decode3_P11_n "" VALUE 0x00839690 Scalar_FLOAT64_IEEE 0 speedgoat_test_SN5659_R2021b_IO682_CM_double -1.7E+308 1.7E+308 /end CHARACTERISTIC
/begin CHARACTERISTIC speedgoat_test_SN5659__cal_impl.Decode3_P11_o "" VALUE 0x00839D28 Scalar_FLOAT64_IEEE 0 speedgoat_test_SN5659_R2021b_IO682_CM_double -1.7E+308 1.7E+308 /end CHARACTERISTIC
/begin CHARACTERISTIC speedgoat_test_SN5659__cal_impl.Decode3_P12_ak "" VALUE 0x00839D40 Scalar_FLOAT64_IEEE 0 speedgoat_test_SN5659_R2021b_IO682_CM_double -1.7E+308 1.7E+308 /end CHARACTERISTIC
/begin CHARACTERISTIC speedgoat_test_SN5659__cal_impl.Decode3_P12_e "" VALUE 0x00839010 Scalar_FLOAT64_IEEE 0 speedgoat_test_SN5659_R2021b_IO682_CM_double -1.7E+308 1.7E+308 /end CHARACTERISTIC
/begin CHARACTERISTIC speedgoat_test_SN5659__cal_impl.Decode3_P12_i "" VALUE 0x00834788 Scalar_FLOAT64_IEEE 0 speedgoat_test_SN5659_R2021b_IO682_CM_double -1.7E+308 1.7E+308 /end CHARACTERISTIC
/begin CHARACTERISTIC speedgoat_test_SN5659__cal_impl.Decode3_P12_kuc "" VALUE 0x008382E0 Scalar_FLOAT64_IEEE 0 speedgoat_test_SN5659_R2021b_IO682_CM_double -1.7E+308 1.7E+308 /end CHARACTERISTIC
/begin CHARACTERISTIC speedgoat_test_SN5659__cal_impl.Decode3_P12_ls "" VALUE 0x00837C48 Scalar_FLOAT64_IEEE 0 speedgoat_test_SN5659_R2021b_IO682_CM_double -1.7E+308 1.7E+308 /end CHARACTERISTIC
/begin CHARACTERISTIC speedgoat_test_SN5659__cal_impl.Decode3_P12_p "" VALUE 0x008340F0 Scalar_FLOAT64_IEEE 0 speedgoat_test_SN5659_R2021b_IO682_CM_double -1.7E+308 1.7E+308 /end CHARACTERISTIC
/begin CHARACTERISTIC speedgoat_test_SN5659__cal_impl.Decode3_P12_pa "" VALUE 0x00838978 Scalar_FLOAT64_IEEE 0 speedgoat_test_SN5659_R2021b_IO682_CM_double -1.7E+308 1.7E+308 /end CHARACTERISTIC
/begin CHARACTERISTIC speedgoat_test_SN5659__cal_impl.Decode3_P12_pg "" VALUE 0x008396A8 Scalar_FLOAT64_IEEE 0 speedgoat_test_SN5659_R2021b_IO682_CM_double -1.7E+308 1.7E+308 /end CHARACTERISTIC
/begin CHARACTERISTIC speedgoat_test_SN5659__cal_impl.Decode3_P13_bw "" VALUE 0x008396C0 Scalar_FLOAT64_IEEE 0 speedgoat_test_SN5659_R2021b_IO682_CM_double -1.7E+308 1.7E+308 /end CHARACTERISTIC
/begin CHARACTERISTIC speedgoat_test_SN5659__cal_impl.Decode3_P13_d "" VALUE 0x00834108 Scalar_FLOAT64_IEEE 0 speedgoat_test_SN5659_R2021b_IO682_CM_double -1.7E+308 1.7E+308 /end CHARACTERISTIC
/begin CHARACTERISTIC speedgoat_test_SN5659__cal_impl.Decode3_P13_e1 "" VALUE 0x00839D58 Scalar_FLOAT64_IEEE 0 speedgoat_test_SN5659_R2021b_IO682_CM_double -1.7E+308 1.7E+308 /end CHARACTERISTIC
/begin CHARACTERISTIC speedgoat_test_SN5659__cal_impl.Decode3_P13_ez "" VALUE 0x00837C60 Scalar_FLOAT64_IEEE 0 speedgoat_test_SN5659_R2021b_IO682_CM_double -1.7E+308 1.7E+308 /end CHARACTERISTIC
/begin CHARACTERISTIC speedgoat_test_SN5659__cal_impl.Decode3_P13_fu "" VALUE 0x00839028 Scalar_FLOAT64_IEEE 0 speedgoat_test_SN5659_R2021b_IO682_CM_double -1.7E+308 1.7E+308 /end CHARACTERISTIC
/begin CHARACTERISTIC speedgoat_test_SN5659__cal_impl.Decode3_P13_j "" VALUE 0x008347A0 Scalar_FLOAT64_IEEE 0 speedgoat_test_SN5659_R2021b_IO682_CM_double -1.7E+308 1.7E+308 /end CHARACTERISTIC
/begin CHARACTERISTIC speedgoat_test_SN5659__cal_impl.Decode3_P13_k "" VALUE 0x00838990 Scalar_FLOAT64_IEEE 0 speedgoat_test_SN5659_R2021b_IO682_CM_double -1.7E+308 1.7E+308 /end CHARACTERISTIC
/begin CHARACTERISTIC speedgoat_test_SN5659__cal_impl.Decode3_P13_my "" VALUE 0x008382F8 Scalar_FLOAT64_IEEE 0 speedgoat_test_SN5659_R2021b_IO682_CM_double -1.7E+308 1.7E+308 /end CHARACTERISTIC
/begin CHARACTERISTIC speedgoat_test_SN5659__cal_impl.Decode3_P14_c "" VALUE 0x00838310 Scalar_FLOAT64_IEEE 0 speedgoat_test_SN5659_R2021b_IO682_CM_double -1.7E+308 1.7E+308 /end CHARACTERISTIC
/begin CHARACTERISTIC speedgoat_test_SN5659__cal_impl.Decode3_P14_j "" VALUE 0x00834120 Scalar_FLOAT64_IEEE 0 speedgoat_test_SN5659_R2021b_IO682_CM_double -1.7E+308 1.7E+308 /end CHARACTERISTIC
/begin CHARACTERISTIC speedgoat_test_SN5659__cal_impl.Decode3_P14_m "" VALUE 0x00837C78 Scalar_FLOAT64_IEEE 0 speedgoat_test_SN5659_R2021b_IO682_CM_double -1.7E+308 1.7E+308 /end CHARACTERISTIC
/begin CHARACTERISTIC speedgoat_test_SN5659__cal_impl.Decode3_P14_nc "" VALUE 0x008389A8 Scalar_FLOAT64_IEEE 0 speedgoat_test_SN5659_R2021b_IO682_CM_double -1.7E+308 1.7E+308 /end CHARACTERISTIC
/begin CHARACTERISTIC speedgoat_test_SN5659__cal_impl.Decode3_P14_o "" VALUE 0x008396D8 Scalar_FLOAT64_IEEE 0 speedgoat_test_SN5659_R2021b_IO682_CM_double -1.7E+308 1.7E+308 /end CHARACTERISTIC
/begin CHARACTERISTIC speedgoat_test_SN5659__cal_impl.Decode3_P14_od "" VALUE 0x00839D70 Scalar_FLOAT64_IEEE 0 speedgoat_test_SN5659_R2021b_IO682_CM_double -1.7E+308 1.7E+308 /end CHARACTERISTIC
/begin CHARACTERISTIC speedgoat_test_SN5659__cal_impl.Decode3_P14_p "" VALUE 0x008347B8 Scalar_FLOAT64_IEEE 0 speedgoat_test_SN5659_R2021b_IO682_CM_double -1.7E+308 1.7E+308 /end CHARACTERISTIC
/begin CHARACTERISTIC speedgoat_test_SN5659__cal_impl.Decode3_P14_ph "" VALUE 0x00839040 Scalar_FLOAT64_IEEE 0 speedgoat_test_SN5659_R2021b_IO682_CM_double -1.7E+308 1.7E+308 /end CHARACTERISTIC
/begin CHARACTERISTIC speedgoat_test_SN5659__cal_impl.Decode3_P15_d "" VALUE 0x00834138 Scalar_FLOAT64_IEEE 0 speedgoat_test_SN5659_R2021b_IO682_CM_double -1.7E+308 1.7E+308 /end CHARACTERISTIC
/begin CHARACTERISTIC speedgoat_test_SN5659__cal_impl.Decode3_P15_h "" VALUE 0x00837C90 Scalar_FLOAT64_IEEE 0 speedgoat_test_SN5659_R2021b_IO682_CM_double -1.7E+308 1.7E+308 /end CHARACTERISTIC
/begin CHARACTERISTIC speedgoat_test_SN5659__cal_impl.Decode3_P15_hq "" VALUE 0x00839058 Scalar_FLOAT64_IEEE 0 speedgoat_test_SN5659_R2021b_IO682_CM_double -1.7E+308 1.7E+308 /end CHARACTERISTIC
/begin CHARACTERISTIC speedgoat_test_SN5659__cal_impl.Decode3_P15_i "" VALUE 0x00839D88 Scalar_FLOAT64_IEEE 0 speedgoat_test_SN5659_R2021b_IO682_CM_double -1.7E+308 1.7E+308 /end CHARACTERISTIC
/begin CHARACTERISTIC speedgoat_test_SN5659__cal_impl.Decode3_P15_k "" VALUE 0x00838328 Scalar_FLOAT64_IEEE 0 speedgoat_test_SN5659_R2021b_IO682_CM_double -1.7E+308 1.7E+308 /end CHARACTERISTIC
/begin CHARACTERISTIC speedgoat_test_SN5659__cal_impl.Decode3_P15_m "" VALUE 0x008347D0 Scalar_FLOAT64_IEEE 0 speedgoat_test_SN5659_R2021b_IO682_CM_double -1.7E+308 1.7E+308 /end CHARACTERISTIC
/begin CHARACTERISTIC speedgoat_test_SN5659__cal_impl.Decode3_P15_n "" VALUE 0x008389C0 Scalar_FLOAT64_IEEE 0 speedgoat_test_SN5659_R2021b_IO682_CM_double -1.7E+308 1.7E+308 /end CHARACTERISTIC
/begin CHARACTERISTIC speedgoat_test_SN5659__cal_impl.Decode3_P15_o "" VALUE 0x008396F0 Scalar_FLOAT64_IEEE 0 speedgoat_test_SN5659_R2021b_IO682_CM_double -1.7E+308 1.7E+308 /end CHARACTERISTIC
/begin CHARACTERISTIC speedgoat_test_SN5659__cal_impl.Decode3_P16_b "" VALUE 0x00834150 Scalar_FLOAT64_IEEE 0 speedgoat_test_SN5659_R2021b_IO682_CM_double -1.7E+308 1.7E+308 /end CHARACTERISTIC
/begin CHARACTERISTIC speedgoat_test_SN5659__cal_impl.Decode3_P16_c "" VALUE 0x00839708 Scalar_FLOAT64_IEEE 0 speedgoat_test_SN5659_R2021b_IO682_CM_double -1.7E+308 1.7E+308 /end CHARACTERISTIC
/begin CHARACTERISTIC speedgoat_test_SN5659__cal_impl.Decode3_P16_g "" VALUE 0x00837CA8 Scalar_FLOAT64_IEEE 0 speedgoat_test_SN5659_R2021b_IO682_CM_double -1.7E+308 1.7E+308 /end CHARACTERISTIC
/begin CHARACTERISTIC speedgoat_test_SN5659__cal_impl.Decode3_P16_i "" VALUE 0x008389D8 Scalar_FLOAT64_IEEE 0 speedgoat_test_SN5659_R2021b_IO682_CM_double -1.7E+308 1.7E+308 /end CHARACTERISTIC
/begin CHARACTERISTIC speedgoat_test_SN5659__cal_impl.Decode3_P16_iz "" VALUE 0x00839070 Scalar_FLOAT64_IEEE 0 speedgoat_test_SN5659_R2021b_IO682_CM_double -1.7E+308 1.7E+308 /end CHARACTERISTIC
/begin CHARACTERISTIC speedgoat_test_SN5659__cal_impl.Decode3_P16_m "" VALUE 0x00839DA0 Scalar_FLOAT64_IEEE 0 speedgoat_test_SN5659_R2021b_IO682_CM_double -1.7E+308 1.7E+308 /end CHARACTERISTIC
/begin CHARACTERISTIC speedgoat_test_SN5659__cal_impl.Decode3_P16_n "" VALUE 0x008347E8 Scalar_FLOAT64_IEEE 0 speedgoat_test_SN5659_R2021b_IO682_CM_double -1.7E+308 1.7E+308 /end CHARACTERISTIC
/begin CHARACTERISTIC speedgoat_test_SN5659__cal_impl.Decode3_P16_p "" VALUE 0x00838340 Scalar_FLOAT64_IEEE 0 speedgoat_test_SN5659_R2021b_IO682_CM_double -1.7E+308 1.7E+308 /end CHARACTERISTIC
/begin CHARACTERISTIC speedgoat_test_SN5659__cal_impl.Decode3_P1_a "" VALUE 0x00833FE0 Scalar_FLOAT64_IEEE 0 speedgoat_test_SN5659_R2021b_IO682_CM_double -1.7E+308 1.7E+308 /end CHARACTERISTIC
/begin CHARACTERISTIC speedgoat_test_SN5659__cal_impl.Decode3_P1_c "" VALUE 0x00834678 Scalar_FLOAT64_IEEE 0 speedgoat_test_SN5659_R2021b_IO682_CM_double -1.7E+308 1.7E+308 /end CHARACTERISTIC
/begin CHARACTERISTIC speedgoat_test_SN5659__cal_impl.Decode3_P1_ew "" VALUE 0x00839598 Scalar_FLOAT64_IEEE 0 speedgoat_test_SN5659_R2021b_IO682_CM_double -1.7E+308 1.7E+308 /end CHARACTERISTIC
/begin CHARACTERISTIC speedgoat_test_SN5659__cal_impl.Decode3_P1_m "" VALUE 0x00837B38 Scalar_FLOAT64_IEEE 0 speedgoat_test_SN5659_R2021b_IO682_CM_double -1.7E+308 1.7E+308 /end CHARACTERISTIC
/begin CHARACTERISTIC speedgoat_test_SN5659__cal_impl.Decode3_P1_mu "" VALUE 0x008381D0 Scalar_FLOAT64_IEEE 0 speedgoat_test_SN5659_R2021b_IO682_CM_double -1.7E+308 1.7E+308 /end CHARACTERISTIC
/begin CHARACTERISTIC speedgoat_test_SN5659__cal_impl.Decode3_P1_n "" VALUE 0x00838868 Scalar_FLOAT64_IEEE 0 speedgoat_test_SN5659_R2021b_IO682_CM_double -1.7E+308 1.7E+308 /end CHARACTERISTIC
/begin CHARACTERISTIC speedgoat_test_SN5659__cal_impl.Decode3_P1_nz "" VALUE 0x00839C30 Scalar_FLOAT64_IEEE 0 speedgoat_test_SN5659_R2021b_IO682_CM_double -1.7E+308 1.7E+308 /end CHARACTERISTIC
/begin CHARACTERISTIC speedgoat_test_SN5659__cal_impl.Decode3_P1_p "" VALUE 0x00838F00 Scalar_FLOAT64_IEEE 0 speedgoat_test_SN5659_R2021b_IO682_CM_double -1.7E+308 1.7E+308 /end CHARACTERISTIC
/begin CHARACTERISTIC speedgoat_test_SN5659__cal_impl.Decode3_P2_c "" VALUE 0x00837B50 Scalar_FLOAT64_IEEE 0 speedgoat_test_SN5659_R2021b_IO682_CM_double -1.7E+308 1.7E+308 /end CHARACTERISTIC
/begin CHARACTERISTIC speedgoat_test_SN5659__cal_impl.Decode3_P2_f "" VALUE 0x00838F18 Scalar_FLOAT64_IEEE 0 speedgoat_test_SN5659_R2021b_IO682_CM_double -1.7E+308 1.7E+308 /end CHARACTERISTIC
/begin CHARACTERISTIC speedgoat_test_SN5659__cal_impl.Decode3_P2_j "" VALUE 0x00834690 Scalar_FLOAT64_IEEE 0 speedgoat_test_SN5659_R2021b_IO682_CM_double -1.7E+308 1.7E+308 /end CHARACTERISTIC
/begin CHARACTERISTIC speedgoat_test_SN5659__cal_impl.Decode3_P2_l "" VALUE 0x00833FF8 Scalar_FLOAT64_IEEE 0 speedgoat_test_SN5659_R2021b_IO682_CM_double -1.7E+308 1.7E+308 /end CHARACTERISTIC
/begin CHARACTERISTIC speedgoat_test_SN5659__cal_impl.Decode3_P2_ll "" VALUE 0x008395B0 Scalar_FLOAT64_IEEE 0 speedgoat_test_SN5659_R2021b_IO682_CM_double -1.7E+308 1.7E+308 /end CHARACTERISTIC
/begin CHARACTERISTIC speedgoat_test_SN5659__cal_impl.Decode3_P2_n "" VALUE 0x00839C48 Scalar_FLOAT64_IEEE 0 speedgoat_test_SN5659_R2021b_IO682_CM_double -1.7E+308 1.7E+308 /end CHARACTERISTIC
/begin CHARACTERISTIC speedgoat_test_SN5659__cal_impl.Decode3_P2_ow "" VALUE 0x008381E8 Scalar_FLOAT64_IEEE 0 speedgoat_test_SN5659_R2021b_IO682_CM_double -1.7E+308 1.7E+308 /end CHARACTERISTIC
/begin CHARACTERISTIC speedgoat_test_SN5659__cal_impl.Decode3_P2_pu "" VALUE 0x00838880 Scalar_FLOAT64_IEEE 0 speedgoat_test_SN5659_R2021b_IO682_CM_double -1.7E+308 1.7E+308 /end CHARACTERISTIC
/begin CHARACTERISTIC speedgoat_test_SN5659__cal_impl.Decode3_P3_a "" VALUE 0x00839C60 Scalar_FLOAT64_IEEE 0 speedgoat_test_SN5659_R2021b_IO682_CM_double -1.7E+308 1.7E+308 /end CHARACTERISTIC
/begin CHARACTERISTIC speedgoat_test_SN5659__cal_impl.Decode3_P3_d "" VALUE 0x00838F30 Scalar_FLOAT64_IEEE 0 speedgoat_test_SN5659_R2021b_IO682_CM_double -1.7E+308 1.7E+308 /end CHARACTERISTIC
/begin CHARACTERISTIC speedgoat_test_SN5659__cal_impl.Decode3_P3_e "" VALUE 0x00838898 Scalar_FLOAT64_IEEE 0 speedgoat_test_SN5659_R2021b_IO682_CM_double -1.7E+308 1.7E+308 /end CHARACTERISTIC
/begin CHARACTERISTIC speedgoat_test_SN5659__cal_impl.Decode3_P3_ht "" VALUE 0x00838200 Scalar_FLOAT64_IEEE 0 speedgoat_test_SN5659_R2021b_IO682_CM_double -1.7E+308 1.7E+308 /end CHARACTERISTIC
/begin CHARACTERISTIC speedgoat_test_SN5659__cal_impl.Decode3_P3_i "" VALUE 0x00837B68 Scalar_FLOAT64_IEEE 0 speedgoat_test_SN5659_R2021b_IO682_CM_double -1.7E+308 1.7E+308 /end CHARACTERISTIC
/begin CHARACTERISTIC speedgoat_test_SN5659__cal_impl.Decode3_P3_j "" VALUE 0x008346A8 Scalar_FLOAT64_IEEE 0 speedgoat_test_SN5659_R2021b_IO682_CM_double -1.7E+308 1.7E+308 /end CHARACTERISTIC
/begin CHARACTERISTIC speedgoat_test_SN5659__cal_impl.Decode3_P3_o "" VALUE 0x008395C8 Scalar_FLOAT64_IEEE 0 speedgoat_test_SN5659_R2021b_IO682_CM_double -1.7E+308 1.7E+308 /end CHARACTERISTIC
/begin CHARACTERISTIC speedgoat_test_SN5659__cal_impl.Decode3_P3_p "" VALUE 0x00834010 Scalar_FLOAT64_IEEE 0 speedgoat_test_SN5659_R2021b_IO682_CM_double -1.7E+308 1.7E+308 /end CHARACTERISTIC
/begin CHARACTERISTIC speedgoat_test_SN5659__cal_impl.Decode3_P4_av "" VALUE 0x008395E0 Scalar_FLOAT64_IEEE 0 speedgoat_test_SN5659_R2021b_IO682_CM_double -1.7E+308 1.7E+308 /end CHARACTERISTIC
/begin CHARACTERISTIC speedgoat_test_SN5659__cal_impl.Decode3_P4_c "" VALUE 0x00839C78 Scalar_FLOAT64_IEEE 0 speedgoat_test_SN5659_R2021b_IO682_CM_double -1.7E+308 1.7E+308 /end CHARACTERISTIC
/begin CHARACTERISTIC speedgoat_test_SN5659__cal_impl.Decode3_P4_dj "" VALUE 0x00838F48 Scalar_FLOAT64_IEEE 0 speedgoat_test_SN5659_R2021b_IO682_CM_double -1.7E+308 1.7E+308 /end CHARACTERISTIC
/begin CHARACTERISTIC speedgoat_test_SN5659__cal_impl.Decode3_P4_g "" VALUE 0x00838218 Scalar_FLOAT64_IEEE 0 speedgoat_test_SN5659_R2021b_IO682_CM_double -1.7E+308 1.7E+308 /end CHARACTERISTIC
/begin CHARACTERISTIC speedgoat_test_SN5659__cal_impl.Decode3_P4_jl "" VALUE 0x008388B0 Scalar_FLOAT64_IEEE 0 speedgoat_test_SN5659_R2021b_IO682_CM_double -1.7E+308 1.7E+308 /end CHARACTERISTIC
/begin CHARACTERISTIC speedgoat_test_SN5659__cal_impl.Decode3_P4_m "" VALUE 0x00834028 Scalar_FLOAT64_IEEE 0 speedgoat_test_SN5659_R2021b_IO682_CM_double -1.7E+308 1.7E+308 /end CHARACTERISTIC
/begin CHARACTERISTIC speedgoat_test_SN5659__cal_impl.Decode3_P4_m4 "" VALUE 0x00837B80 Scalar_FLOAT64_IEEE 0 speedgoat_test_SN5659_R2021b_IO682_CM_double -1.7E+308 1.7E+308 /end CHARACTERISTIC
/begin CHARACTERISTIC speedgoat_test_SN5659__cal_impl.Decode3_P4_p "" VALUE 0x008346C0 Scalar_FLOAT64_IEEE 0 speedgoat_test_SN5659_R2021b_IO682_CM_double -1.7E+308 1.7E+308 /end CHARACTERISTIC
/begin CHARACTERISTIC speedgoat_test_SN5659__cal_impl.Decode3_P5_as "" VALUE 0x008395F8 Scalar_FLOAT64_IEEE 0 speedgoat_test_SN5659_R2021b_IO682_CM_double -1.7E+308 1.7E+308 /end CHARACTERISTIC
/begin CHARACTERISTIC speedgoat_test_SN5659__cal_impl.Decode3_P5_b "" VALUE 0x008346D8 Scalar_FLOAT64_IEEE 0 speedgoat_test_SN5659_R2021b_IO682_CM_double -1.7E+308 1.7E+308 /end CHARACTERISTIC
/begin CHARACTERISTIC speedgoat_test_SN5659__cal_impl.Decode3_P5_c "" VALUE 0x00834040 Scalar_FLOAT64_IEEE 0 speedgoat_test_SN5659_R2021b_IO682_CM_double -1.7E+308 1.7E+308 /end CHARACTERISTIC
/begin CHARACTERISTIC speedgoat_test_SN5659__cal_impl.Decode3_P5_e "" VALUE 0x00838230 Scalar_FLOAT64_IEEE 0 speedgoat_test_SN5659_R2021b_IO682_CM_double -1.7E+308 1.7E+308 /end CHARACTERISTIC
/begin CHARACTERISTIC speedgoat_test_SN5659__cal_impl.Decode3_P5_gt "" VALUE 0x00839C90 Scalar_FLOAT64_IEEE 0 speedgoat_test_SN5659_R2021b_IO682_CM_double -1.7E+308 1.7E+308 /end CHARACTERISTIC
/begin CHARACTERISTIC speedgoat_test_SN5659__cal_impl.Decode3_P5_j "" VALUE 0x00838F60 Scalar_FLOAT64_IEEE 0 speedgoat_test_SN5659_R2021b_IO682_CM_double -1.7E+308 1.7E+308 /end CHARACTERISTIC
/begin CHARACTERISTIC speedgoat_test_SN5659__cal_impl.Decode3_P5_nh "" VALUE 0x00837B98 Scalar_FLOAT64_IEEE 0 speedgoat_test_SN5659_R2021b_IO682_CM_double -1.7E+308 1.7E+308 /end CHARACTERISTIC
/begin CHARACTERISTIC speedgoat_test_SN5659__cal_impl.Decode3_P5_o "" VALUE 0x008388C8 Scalar_FLOAT64_IEEE 0 speedgoat_test_SN5659_R2021b_IO682_CM_double -1.7E+308 1.7E+308 /end CHARACTERISTIC
/begin CHARACTERISTIC speedgoat_test_SN5659__cal_impl.Decode3_P6_f "" VALUE 0x00838F78 Scalar_FLOAT64_IEEE 0 speedgoat_test_SN5659_R2021b_IO682_CM_double -1.7E+308 1.7E+308 /end CHARACTERISTIC
/begin CHARACTERISTIC speedgoat_test_SN5659__cal_impl.Decode3_P6_g "" VALUE 0x00838248 Scalar_FLOAT64_IEEE 0 speedgoat_test_SN5659_R2021b_IO682_CM_double -1.7E+308 1.7E+308 /end CHARACTERISTIC
/begin CHARACTERISTIC speedgoat_test_SN5659__cal_impl.Decode3_P6_h "" VALUE 0x008346F0 Scalar_FLOAT64_IEEE 0 speedgoat_test_SN5659_R2021b_IO682_CM_double -1.7E+308 1.7E+308 /end CHARACTERISTIC
/begin CHARACTERISTIC speedgoat_test_SN5659__cal_impl.Decode3_P6_ib "" VALUE 0x008388E0 Scalar_FLOAT64_IEEE 0 speedgoat_test_SN5659_R2021b_IO682_CM_double -1.7E+308 1.7E+308 /end CHARACTERISTIC
/begin CHARACTERISTIC speedgoat_test_SN5659__cal_impl.Decode3_P6_j "" VALUE 0x00839610 Scalar_FLOAT64_IEEE 0 speedgoat_test_SN5659_R2021b_IO682_CM_double -1.7E+308 1.7E+308 /end CHARACTERISTIC
/begin CHARACTERISTIC speedgoat_test_SN5659__cal_impl.Decode3_P6_k "" VALUE 0x00834058 Scalar_FLOAT64_IEEE 0 speedgoat_test_SN5659_R2021b_IO682_CM_double -1.7E+308 1.7E+308 /end CHARACTERISTIC
/begin CHARACTERISTIC speedgoat_test_SN5659__cal_impl.Decode3_P6_l "" VALUE 0x00837BB0 Scalar_FLOAT64_IEEE 0 speedgoat_test_SN5659_R2021b_IO682_CM_double -1.7E+308 1.7E+308 /end CHARACTERISTIC
/begin CHARACTERISTIC speedgoat_test_SN5659__cal_impl.Decode3_P6_ov "" VALUE 0x00839CA8 Scalar_FLOAT64_IEEE 0 speedgoat_test_SN5659_R2021b_IO682_CM_double -1.7E+308 1.7E+308 /end CHARACTERISTIC
/begin CHARACTERISTIC speedgoat_test_SN5659__cal_impl.Decode3_P7_bv "" VALUE 0x00837BC8 Scalar_FLOAT64_IEEE 0 speedgoat_test_SN5659_R2021b_IO682_CM_double -1.7E+308 1.7E+308 /end CHARACTERISTIC
/begin CHARACTERISTIC speedgoat_test_SN5659__cal_impl.Decode3_P7_d "" VALUE 0x00834708 Scalar_FLOAT64_IEEE 0 speedgoat_test_SN5659_R2021b_IO682_CM_double -1.7E+308 1.7E+308 /end CHARACTERISTIC
/begin CHARACTERISTIC speedgoat_test_SN5659__cal_impl.Decode3_P7_fb "" VALUE 0x00839628 Scalar_FLOAT64_IEEE 0 speedgoat_test_SN5659_R2021b_IO682_CM_double -1.7E+308 1.7E+308 /end CHARACTERISTIC
/begin CHARACTERISTIC speedgoat_test_SN5659__cal_impl.Decode3_P7_fx "" VALUE 0x008388F8 Scalar_FLOAT64_IEEE 0 speedgoat_test_SN5659_R2021b_IO682_CM_double -1.7E+308 1.7E+308 /end CHARACTERISTIC
/begin CHARACTERISTIC speedgoat_test_SN5659__cal_impl.Decode3_P7_ix "" VALUE 0x00839CC0 Scalar_FLOAT64_IEEE 0 speedgoat_test_SN5659_R2021b_IO682_CM_double -1.7E+308 1.7E+308 /end CHARACTERISTIC
/begin CHARACTERISTIC speedgoat_test_SN5659__cal_impl.Decode3_P7_k "" VALUE 0x00834070 Scalar_FLOAT64_IEEE 0 speedgoat_test_SN5659_R2021b_IO682_CM_double -1.7E+308 1.7E+308 /end CHARACTERISTIC
/begin CHARACTERISTIC speedgoat_test_SN5659__cal_impl.Decode3_P7_m "" VALUE 0x00838260 Scalar_FLOAT64_IEEE 0 speedgoat_test_SN5659_R2021b_IO682_CM_double -1.7E+308 1.7E+308 /end CHARACTERISTIC
/begin CHARACTERISTIC speedgoat_test_SN5659__cal_impl.Decode3_P7_p "" VALUE 0x00838F90 Scalar_FLOAT64_IEEE 0 speedgoat_test_SN5659_R2021b_IO682_CM_double -1.7E+308 1.7E+308 /end CHARACTERISTIC
/begin CHARACTERISTIC speedgoat_test_SN5659__cal_impl.Decode3_P8_a "" VALUE 0x00838278 Scalar_FLOAT64_IEEE 0 speedgoat_test_SN5659_R2021b_IO682_CM_double -1.7E+308 1.7E+308 /end CHARACTERISTIC
/begin CHARACTERISTIC speedgoat_test_SN5659__cal_impl.Decode3_P8_b "" VALUE 0x00838910 Scalar_FLOAT64_IEEE 0 speedgoat_test_SN5659_R2021b_IO682_CM_double -1.7E+308 1.7E+308 /end CHARACTERISTIC
/begin CHARACTERISTIC speedgoat_test_SN5659__cal_impl.Decode3_P8_d "" VALUE 0x00839640 Scalar_FLOAT64_IEEE 0 speedgoat_test_SN5659_R2021b_IO682_CM_double -1.7E+308 1.7E+308 /end CHARACTERISTIC
/begin CHARACTERISTIC speedgoat_test_SN5659__cal_impl.Decode3_P8_f "" VALUE 0x00838FA8 Scalar_FLOAT64_IEEE 0 speedgoat_test_SN5659_R2021b_IO682_CM_double -1.7E+308 1.7E+308 /end CHARACTERISTIC
/begin CHARACTERISTIC speedgoat_test_SN5659__cal_impl.Decode3_P8_g "" VALUE 0x00834088 Scalar_FLOAT64_IEEE 0 speedgoat_test_SN5659_R2021b_IO682_CM_double -1.7E+308 1.7E+308 /end CHARACTERISTIC
/begin CHARACTERISTIC speedgoat_test_SN5659__cal_impl.Decode3_P8_h "" VALUE 0x00834720 Scalar_FLOAT64_IEEE 0 speedgoat_test_SN5659_R2021b_IO682_CM_double -1.7E+308 1.7E+308 /end CHARACTERISTIC
/begin CHARACTERISTIC speedgoat_test_SN5659__cal_impl.Decode3_P8_ig "" VALUE 0x00837BE0 Scalar_FLOAT64_IEEE 0 speedgoat_test_SN5659_R2021b_IO682_CM_double -1.7E+308 1.7E+308 /end CHARACTERISTIC
/begin CHARACTERISTIC speedgoat_test_SN5659__cal_impl.Decode3_P8_n "" VALUE 0x00839CD8 Scalar_FLOAT64_IEEE 0 speedgoat_test_SN5659_R2021b_IO682_CM_double -1.7E+308 1.7E+308 /end CHARACTERISTIC
/begin CHARACTERISTIC speedgoat_test_SN5659__cal_impl.Decode3_P9_dw "" VALUE 0x00838290 Scalar_FLOAT64_IEEE 0 speedgoat_test_SN5659_R2021b_IO682_CM_double -1.7E+308 1.7E+308 /end CHARACTERISTIC
/begin CHARACTERISTIC speedgoat_test_SN5659__cal_impl.Decode3_P9_dy "" VALUE 0x00838928 Scalar_FLOAT64_IEEE 0 speedgoat_test_SN5659_R2021b_IO682_CM_double -1.7E+308 1.7E+308 /end CHARACTERISTIC
/begin CHARACTERISTIC speedgoat_test_SN5659__cal_impl.Decode3_P9_f "" VALUE 0x00839658 Scalar_FLOAT64_IEEE 0 speedgoat_test_SN5659_R2021b_IO682_CM_double -1.7E+308 1.7E+308 /end CHARACTERISTIC
/begin CHARACTERISTIC speedgoat_test_SN5659__cal_impl.Decode3_P9_h "" VALUE 0x008340A0 Scalar_FLOAT64_IEEE 0 speedgoat_test_SN5659_R2021b_IO682_CM_double -1.7E+308 1.7E+308 /end CHARACTERISTIC
/begin CHARACTERISTIC speedgoat_test_SN5659__cal_impl.Decode3_P9_i "" VALUE 0x00834738 Scalar_FLOAT64_IEEE 0 speedgoat_test_SN5659_R2021b_IO682_CM_double -1.7E+308 1.7E+308 /end CHARACTERISTIC
/begin CHARACTERISTIC speedgoat_test_SN5659__cal_impl.Decode3_P9_ig "" VALUE 0x00838FC0 Scalar_FLOAT64_IEEE 0 speedgoat_test_SN5659_R2021b_IO682_CM_double -1.7E+308 1.7E+308 /end CHARACTERISTIC
/begin CHARACTERISTIC speedgoat_test_SN5659__cal_impl.Decode3_P9_m5 "" VALUE 0x00837BF8 Scalar_FLOAT64_IEEE 0 speedgoat_test_SN5659_R2021b_IO682_CM_double -1.7E+308 1.7E+308 /end CHARACTERISTIC
/begin CHARACTERISTIC speedgoat_test_SN5659__cal_impl.Decode3_P9_p "" VALUE 0x00839CF0 Scalar_FLOAT64_IEEE 0 speedgoat_test_SN5659_R2021b_IO682_CM_double -1.7E+308 1.7E+308 /end CHARACTERISTIC
/begin CHARACTERISTIC speedgoat_test_SN5659__cal_impl.Decode4_P10_ax "" VAL_BLK 0x008397F8 Scalar_FLOAT64_IEEE 0 speedgoat_test_SN5659_R2021b_IO682_CM_double -1.7E+308 1.7E+308 MATRIX_DIM 2 1 /end CHARACTERISTIC
/begin CHARACTERISTIC speedgoat_test_SN5659__cal_impl.Decode4_P10_b "" VAL_BLK 0x00834240 Scalar_FLOAT64_IEEE 0 speedgoat_test_SN5659_R2021b_IO682_CM_double -1.7E+308 1.7E+308 MATRIX_DIM 2 1 /end CHARACTERISTIC
/begin CHARACTERISTIC speedgoat_test_SN5659__cal_impl.Decode4_P10_bv "" VAL_BLK 0x00838430 Scalar_FLOAT64_IEEE 0 speedgoat_test_SN5659_R2021b_IO682_CM_double -1.7E+308 1.7E+308 MATRIX_DIM 2 1 /end CHARACTERISTIC
/begin CHARACTERISTIC speedgoat_test_SN5659__cal_impl.Decode4_P10_d "" VAL_BLK 0x008348D8 Scalar_FLOAT64_IEEE 0 speedgoat_test_SN5659_R2021b_IO682_CM_double -1.7E+308 1.7E+308 MATRIX_DIM 2 1 /end CHARACTERISTIC
/begin CHARACTERISTIC speedgoat_test_SN5659__cal_impl.Decode4_P10_k "" VAL_BLK 0x00839E90 Scalar_FLOAT64_IEEE 0 speedgoat_test_SN5659_R2021b_IO682_CM_double -1.7E+308 1.7E+308 MATRIX_DIM 2 1 /end CHARACTERISTIC
/begin CHARACTERISTIC speedgoat_test_SN5659__cal_impl.Decode4_P10_l "" VAL_BLK 0x00839160 Scalar_FLOAT64_IEEE 0 speedgoat_test_SN5659_R2021b_IO682_CM_double -1.7E+308 1.7E+308 MATRIX_DIM 2 1 /end CHARACTERISTIC
/begin CHARACTERISTIC speedgoat_test_SN5659__cal_impl.Decode4_P10_mz "" VAL_BLK 0x00838AC8 Scalar_FLOAT64_IEEE 0 speedgoat_test_SN5659_R2021b_IO682_CM_double -1.7E+308 1.7E+308 MATRIX_DIM 2 1 /end CHARACTERISTIC
/begin CHARACTERISTIC speedgoat_test_SN5659__cal_impl.Decode4_P10_o "" VAL_BLK 0x00837D98 Scalar_FLOAT64_IEEE 0 speedgoat_test_SN5659_R2021b_IO682_CM_double -1.7E+308 1.7E+308 MATRIX_DIM 2 1 /end CHARACTERISTIC
/begin CHARACTERISTIC speedgoat_test_SN5659__cal_impl.Decode4_P11_a "" VALUE 0x00838450 Scalar_FLOAT64_IEEE 0 speedgoat_test_SN5659_R2021b_IO682_CM_double -1.7E+308 1.7E+308 /end CHARACTERISTIC
/begin CHARACTERISTIC speedgoat_test_SN5659__cal_impl.Decode4_P11_c "" VALUE 0x00838AE8 Scalar_FLOAT64_IEEE 0 speedgoat_test_SN5659_R2021b_IO682_CM_double -1.7E+308 1.7E+308 /end CHARACTERISTIC
/begin CHARACTERISTIC speedgoat_test_SN5659__cal_impl.Decode4_P11_dk "" VALUE 0x00839180 Scalar_FLOAT64_IEEE 0 speedgoat_test_SN5659_R2021b_IO682_CM_double -1.7E+308 1.7E+308 /end CHARACTERISTIC
/begin CHARACTERISTIC speedgoat_test_SN5659__cal_impl.Decode4_P11_g "" VALUE 0x008348F8 Scalar_FLOAT64_IEEE 0 speedgoat_test_SN5659_R2021b_IO682_CM_double -1.7E+308 1.7E+308 /end CHARACTERISTIC
/begin CHARACTERISTIC speedgoat_test_SN5659__cal_impl.Decode4_P11_j "" VALUE 0x00837DB8 Scalar_FLOAT64_IEEE 0 speedgoat_test_SN5659_R2021b_IO682_CM_double -1.7E+308 1.7E+308 /end CHARACTERISTIC
/begin CHARACTERISTIC speedgoat_test_SN5659__cal_impl.Decode4_P11_m "" VALUE 0x00834260 Scalar_FLOAT64_IEEE 0 speedgoat_test_SN5659_R2021b_IO682_CM_double -1.7E+308 1.7E+308 /end CHARACTERISTIC
/begin CHARACTERISTIC speedgoat_test_SN5659__cal_impl.Decode4_P11_mg "" VALUE 0x00839EB0 Scalar_FLOAT64_IEEE 0 speedgoat_test_SN5659_R2021b_IO682_CM_double -1.7E+308 1.7E+308 /end CHARACTERISTIC
/begin CHARACTERISTIC speedgoat_test_SN5659__cal_impl.Decode4_P11_mt "" VALUE 0x00839818 Scalar_FLOAT64_IEEE 0 speedgoat_test_SN5659_R2021b_IO682_CM_double -1.7E+308 1.7E+308 /end CHARACTERISTIC
/begin CHARACTERISTIC speedgoat_test_SN5659__cal_impl.Decode4_P12_ci "" VALUE 0x00839EC8 Scalar_FLOAT64_IEEE 0 speedgoat_test_SN5659_R2021b_IO682_CM_double -1.7E+308 1.7E+308 /end CHARACTERISTIC
/begin CHARACTERISTIC speedgoat_test_SN5659__cal_impl.Decode4_P12_d "" VALUE 0x00834278 Scalar_FLOAT64_IEEE 0 speedgoat_test_SN5659_R2021b_IO682_CM_double -1.7E+308 1.7E+308 /end CHARACTERISTIC
/begin CHARACTERISTIC speedgoat_test_SN5659__cal_impl.Decode4_P12_e "" VALUE 0x00834910 Scalar_FLOAT64_IEEE 0 speedgoat_test_SN5659_R2021b_IO682_CM_double -1.7E+308 1.7E+308 /end CHARACTERISTIC
/begin CHARACTERISTIC speedgoat_test_SN5659__cal_impl.Decode4_P12_ff "" VALUE 0x00838B00 Scalar_FLOAT64_IEEE 0 speedgoat_test_SN5659_R2021b_IO682_CM_double -1.7E+308 1.7E+308 /end CHARACTERISTIC
/begin CHARACTERISTIC speedgoat_test_SN5659__cal_impl.Decode4_P12_i "" VALUE 0x00839198 Scalar_FLOAT64_IEEE 0 speedgoat_test_SN5659_R2021b_IO682_CM_double -1.7E+308 1.7E+308 /end CHARACTERISTIC
/begin CHARACTERISTIC speedgoat_test_SN5659__cal_impl.Decode4_P12_ik "" VALUE 0x00839830 Scalar_FLOAT64_IEEE 0 speedgoat_test_SN5659_R2021b_IO682_CM_double -1.7E+308 1.7E+308 /end CHARACTERISTIC
/begin CHARACTERISTIC speedgoat_test_SN5659__cal_impl.Decode4_P12_j "" VALUE 0x00837DD0 Scalar_FLOAT64_IEEE 0 speedgoat_test_SN5659_R2021b_IO682_CM_double -1.7E+308 1.7E+308 /end CHARACTERISTIC
/begin CHARACTERISTIC speedgoat_test_SN5659__cal_impl.Decode4_P12_nu "" VALUE 0x00838468 Scalar_FLOAT64_IEEE 0 speedgoat_test_SN5659_R2021b_IO682_CM_double -1.7E+308 1.7E+308 /end CHARACTERISTIC
/begin CHARACTERISTIC speedgoat_test_SN5659__cal_impl.Decode4_P13_aq "" VALUE 0x00838480 Scalar_FLOAT64_IEEE 0 speedgoat_test_SN5659_R2021b_IO682_CM_double -1.7E+308 1.7E+308 /end CHARACTERISTIC
/begin CHARACTERISTIC speedgoat_test_SN5659__cal_impl.Decode4_P13_cn "" VALUE 0x00839848 Scalar_FLOAT64_IEEE 0 speedgoat_test_SN5659_R2021b_IO682_CM_double -1.7E+308 1.7E+308 /end CHARACTERISTIC
/begin CHARACTERISTIC speedgoat_test_SN5659__cal_impl.Decode4_P13_gv "" VALUE 0x008391B0 Scalar_FLOAT64_IEEE 0 speedgoat_test_SN5659_R2021b_IO682_CM_double -1.7E+308 1.7E+308 /end CHARACTERISTIC
/begin CHARACTERISTIC speedgoat_test_SN5659__cal_impl.Decode4_P13_io "" VALUE 0x00837DE8 Scalar_FLOAT64_IEEE 0 speedgoat_test_SN5659_R2021b_IO682_CM_double -1.7E+308 1.7E+308 /end CHARACTERISTIC
/begin CHARACTERISTIC speedgoat_test_SN5659__cal_impl.Decode4_P13_l "" VALUE 0x00839EE0 Scalar_FLOAT64_IEEE 0 speedgoat_test_SN5659_R2021b_IO682_CM_double -1.7E+308 1.7E+308 /end CHARACTERISTIC
/begin CHARACTERISTIC speedgoat_test_SN5659__cal_impl.Decode4_P13_n "" VALUE 0x00838B18 Scalar_FLOAT64_IEEE 0 speedgoat_test_SN5659_R2021b_IO682_CM_double -1.7E+308 1.7E+308 /end CHARACTERISTIC
/begin CHARACTERISTIC speedgoat_test_SN5659__cal_impl.Decode4_P13_o "" VALUE 0x00834928 Scalar_FLOAT64_IEEE 0 speedgoat_test_SN5659_R2021b_IO682_CM_double -1.7E+308 1.7E+308 /end CHARACTERISTIC
/begin CHARACTERISTIC speedgoat_test_SN5659__cal_impl.Decode4_P13_p "" VALUE 0x00834290 Scalar_FLOAT64_IEEE 0 speedgoat_test_SN5659_R2021b_IO682_CM_double -1.7E+308 1.7E+308 /end CHARACTERISTIC
/begin CHARACTERISTIC speedgoat_test_SN5659__cal_impl.Decode4_P14_b "" VALUE 0x00839EF8 Scalar_FLOAT64_IEEE 0 speedgoat_test_SN5659_R2021b_IO682_CM_double -1.7E+308 1.7E+308 /end CHARACTERISTIC
/begin CHARACTERISTIC speedgoat_test_SN5659__cal_impl.Decode4_P14_dy "" VALUE 0x00838498 Scalar_FLOAT64_IEEE 0 speedgoat_test_SN5659_R2021b_IO682_CM_double -1.7E+308 1.7E+308 /end CHARACTERISTIC
/begin CHARACTERISTIC speedgoat_test_SN5659__cal_impl.Decode4_P14_fz "" VALUE 0x00839860 Scalar_FLOAT64_IEEE 0 speedgoat_test_SN5659_R2021b_IO682_CM_double -1.7E+308 1.7E+308 /end CHARACTERISTIC
/begin CHARACTERISTIC speedgoat_test_SN5659__cal_impl.Decode4_P14_h "" VALUE 0x008342A8 Scalar_FLOAT64_IEEE 0 speedgoat_test_SN5659_R2021b_IO682_CM_double -1.7E+308 1.7E+308 /end CHARACTERISTIC
/begin CHARACTERISTIC speedgoat_test_SN5659__cal_impl.Decode4_P14_k "" VALUE 0x00834940 Scalar_FLOAT64_IEEE 0 speedgoat_test_SN5659_R2021b_IO682_CM_double -1.7E+308 1.7E+308 /end CHARACTERISTIC
/begin CHARACTERISTIC speedgoat_test_SN5659__cal_impl.Decode4_P14_l4 "" VALUE 0x00837E00 Scalar_FLOAT64_IEEE 0 speedgoat_test_SN5659_R2021b_IO682_CM_double -1.7E+308 1.7E+308 /end CHARACTERISTIC
/begin CHARACTERISTIC speedgoat_test_SN5659__cal_impl.Decode4_P14_lo "" VALUE 0x00838B30 Scalar_FLOAT64_IEEE 0 speedgoat_test_SN5659_R2021b_IO682_CM_double -1.7E+308 1.7E+308 /end CHARACTERISTIC
/begin CHARACTERISTIC speedgoat_test_SN5659__cal_impl.Decode4_P14_m "" VALUE 0x008391C8 Scalar_FLOAT64_IEEE 0 speedgoat_test_SN5659_R2021b_IO682_CM_double -1.7E+308 1.7E+308 /end CHARACTERISTIC
/begin CHARACTERISTIC speedgoat_test_SN5659__cal_impl.Decode4_P15_c "" VALUE 0x008342C0 Scalar_FLOAT64_IEEE 0 speedgoat_test_SN5659_R2021b_IO682_CM_double -1.7E+308 1.7E+308 /end CHARACTERISTIC
/begin CHARACTERISTIC speedgoat_test_SN5659__cal_impl.Decode4_P15_dv "" VALUE 0x00837E18 Scalar_FLOAT64_IEEE 0 speedgoat_test_SN5659_R2021b_IO682_CM_double -1.7E+308 1.7E+308 /end CHARACTERISTIC
/begin CHARACTERISTIC speedgoat_test_SN5659__cal_impl.Decode4_P15_h "" VALUE 0x00839F10 Scalar_FLOAT64_IEEE 0 speedgoat_test_SN5659_R2021b_IO682_CM_double -1.7E+308 1.7E+308 /end CHARACTERISTIC
/begin CHARACTERISTIC speedgoat_test_SN5659__cal_impl.Decode4_P15_j "" VALUE 0x00834958 Scalar_FLOAT64_IEEE 0 speedgoat_test_SN5659_R2021b_IO682_CM_double -1.7E+308 1.7E+308 /end CHARACTERISTIC
/begin CHARACTERISTIC speedgoat_test_SN5659__cal_impl.Decode4_P15_l "" VALUE 0x00839878 Scalar_FLOAT64_IEEE 0 speedgoat_test_SN5659_R2021b_IO682_CM_double -1.7E+308 1.7E+308 /end CHARACTERISTIC
/begin CHARACTERISTIC speedgoat_test_SN5659__cal_impl.Decode4_P15_n "" VALUE 0x008384B0 Scalar_FLOAT64_IEEE 0 speedgoat_test_SN5659_R2021b_IO682_CM_double -1.7E+308 1.7E+308 /end CHARACTERISTIC
/begin CHARACTERISTIC speedgoat_test_SN5659__cal_impl.Decode4_P15_p "" VALUE 0x00838B48 Scalar_FLOAT64_IEEE 0 speedgoat_test_SN5659_R2021b_IO682_CM_double -1.7E+308 1.7E+308 /end CHARACTERISTIC
/begin CHARACTERISTIC speedgoat_test_SN5659__cal_impl.Decode4_P15_pv "" VALUE 0x008391E0 Scalar_FLOAT64_IEEE 0 speedgoat_test_SN5659_R2021b_IO682_CM_double -1.7E+308 1.7E+308 /end CHARACTERISTIC
/begin CHARACTERISTIC speedgoat_test_SN5659__cal_impl.Decode4_P16_ad "" VALUE 0x008391F8 Scalar_FLOAT64_IEEE 0 speedgoat_test_SN5659_R2021b_IO682_CM_double -1.7E+308 1.7E+308 /end CHARACTERISTIC
/begin CHARACTERISTIC speedgoat_test_SN5659__cal_impl.Decode4_P16_b "" VALUE 0x00834970 Scalar_FLOAT64_IEEE 0 speedgoat_test_SN5659_R2021b_IO682_CM_double -1.7E+308 1.7E+308 /end CHARACTERISTIC
/begin CHARACTERISTIC speedgoat_test_SN5659__cal_impl.Decode4_P16_du "" VALUE 0x00839890 Scalar_FLOAT64_IEEE 0 speedgoat_test_SN5659_R2021b_IO682_CM_double -1.7E+308 1.7E+308 /end CHARACTERISTIC
/begin CHARACTERISTIC speedgoat_test_SN5659__cal_impl.Decode4_P16_ec "" VALUE 0x00838B60 Scalar_FLOAT64_IEEE 0 speedgoat_test_SN5659_R2021b_IO682_CM_double -1.7E+308 1.7E+308 /end CHARACTERISTIC
/begin CHARACTERISTIC speedgoat_test_SN5659__cal_impl.Decode4_P16_g "" VALUE 0x008342D8 Scalar_FLOAT64_IEEE 0 speedgoat_test_SN5659_R2021b_IO682_CM_double -1.7E+308 1.7E+308 /end CHARACTERISTIC
/begin CHARACTERISTIC speedgoat_test_SN5659__cal_impl.Decode4_P16_gq "" VALUE 0x008384C8 Scalar_FLOAT64_IEEE 0 speedgoat_test_SN5659_R2021b_IO682_CM_double -1.7E+308 1.7E+308 /end CHARACTERISTIC
/begin CHARACTERISTIC speedgoat_test_SN5659__cal_impl.Decode4_P16_j "" VALUE 0x00837E30 Scalar_FLOAT64_IEEE 0 speedgoat_test_SN5659_R2021b_IO682_CM_double -1.7E+308 1.7E+308 /end CHARACTERISTIC
/begin CHARACTERISTIC speedgoat_test_SN5659__cal_impl.Decode4_P16_n "" VALUE 0x00839F28 Scalar_FLOAT64_IEEE 0 speedgoat_test_SN5659_R2021b_IO682_CM_double -1.7E+308 1.7E+308 /end CHARACTERISTIC
/begin CHARACTERISTIC speedgoat_test_SN5659__cal_impl.Decode4_P1_d "" VALUE 0x00839720 Scalar_FLOAT64_IEEE 0 speedgoat_test_SN5659_R2021b_IO682_CM_double -1.7E+308 1.7E+308 /end CHARACTERISTIC
/begin CHARACTERISTIC speedgoat_test_SN5659__cal_impl.Decode4_P1_f "" VALUE 0x00837CC0 Scalar_FLOAT64_IEEE 0 speedgoat_test_SN5659_R2021b_IO682_CM_double -1.7E+308 1.7E+308 /end CHARACTERISTIC
/begin CHARACTERISTIC speedgoat_test_SN5659__cal_impl.Decode4_P1_fa "" VALUE 0x00839088 Scalar_FLOAT64_IEEE 0 speedgoat_test_SN5659_R2021b_IO682_CM_double -1.7E+308 1.7E+308 /end CHARACTERISTIC
/begin CHARACTERISTIC speedgoat_test_SN5659__cal_impl.Decode4_P1_g "" VALUE 0x00834168 Scalar_FLOAT64_IEEE 0 speedgoat_test_SN5659_R2021b_IO682_CM_double -1.7E+308 1.7E+308 /end CHARACTERISTIC
/begin CHARACTERISTIC speedgoat_test_SN5659__cal_impl.Decode4_P1_i "" VALUE 0x00834800 Scalar_FLOAT64_IEEE 0 speedgoat_test_SN5659_R2021b_IO682_CM_double -1.7E+308 1.7E+308 /end CHARACTERISTIC
/begin CHARACTERISTIC speedgoat_test_SN5659__cal_impl.Decode4_P1_m "" VALUE 0x008389F0 Scalar_FLOAT64_IEEE 0 speedgoat_test_SN5659_R2021b_IO682_CM_double -1.7E+308 1.7E+308 /end CHARACTERISTIC
/begin CHARACTERISTIC speedgoat_test_SN5659__cal_impl.Decode4_P1_ml "" VALUE 0x00839DB8 Scalar_FLOAT64_IEEE 0 speedgoat_test_SN5659_R2021b_IO682_CM_double -1.7E+308 1.7E+308 /end CHARACTERISTIC
/begin CHARACTERISTIC speedgoat_test_SN5659__cal_impl.Decode4_P1_px "" VALUE 0x00838358 Scalar_FLOAT64_IEEE 0 speedgoat_test_SN5659_R2021b_IO682_CM_double -1.7E+308 1.7E+308 /end CHARACTERISTIC
/begin CHARACTERISTIC speedgoat_test_SN5659__cal_impl.Decode4_P2_b "" VALUE 0x00839738 Scalar_FLOAT64_IEEE 0 speedgoat_test_SN5659_R2021b_IO682_CM_double -1.7E+308 1.7E+308 /end CHARACTERISTIC
/begin CHARACTERISTIC speedgoat_test_SN5659__cal_impl.Decode4_P2_e "" VALUE 0x00838370 Scalar_FLOAT64_IEEE 0 speedgoat_test_SN5659_R2021b_IO682_CM_double -1.7E+308 1.7E+308 /end CHARACTERISTIC
/begin CHARACTERISTIC speedgoat_test_SN5659__cal_impl.Decode4_P2_e5 "" VALUE 0x008390A0 Scalar_FLOAT64_IEEE 0 speedgoat_test_SN5659_R2021b_IO682_CM_double -1.7E+308 1.7E+308 /end CHARACTERISTIC
/begin CHARACTERISTIC speedgoat_test_SN5659__cal_impl.Decode4_P2_h "" VALUE 0x00838A08 Scalar_FLOAT64_IEEE 0 speedgoat_test_SN5659_R2021b_IO682_CM_double -1.7E+308 1.7E+308 /end CHARACTERISTIC
/begin CHARACTERISTIC speedgoat_test_SN5659__cal_impl.Decode4_P2_k "" VALUE 0x00834818 Scalar_FLOAT64_IEEE 0 speedgoat_test_SN5659_R2021b_IO682_CM_double -1.7E+308 1.7E+308 /end CHARACTERISTIC
/begin CHARACTERISTIC speedgoat_test_SN5659__cal_impl.Decode4_P2_l1 "" VALUE 0x00839DD0 Scalar_FLOAT64_IEEE 0 speedgoat_test_SN5659_R2021b_IO682_CM_double -1.7E+308 1.7E+308 /end CHARACTERISTIC
/begin CHARACTERISTIC speedgoat_test_SN5659__cal_impl.Decode4_P2_p "" VALUE 0x00834180 Scalar_FLOAT64_IEEE 0 speedgoat_test_SN5659_R2021b_IO682_CM_double -1.7E+308 1.7E+308 /end CHARACTERISTIC
/begin CHARACTERISTIC speedgoat_test_SN5659__cal_impl.Decode4_P2_pq "" VALUE 0x00837CD8 Scalar_FLOAT64_IEEE 0 speedgoat_test_SN5659_R2021b_IO682_CM_double -1.7E+308 1.7E+308 /end CHARACTERISTIC
/begin CHARACTERISTIC speedgoat_test_SN5659__cal_impl.Decode4_P3_c "" VALUE 0x00834198 Scalar_FLOAT64_IEEE 0 speedgoat_test_SN5659_R2021b_IO682_CM_double -1.7E+308 1.7E+308 /end CHARACTERISTIC
/begin CHARACTERISTIC speedgoat_test_SN5659__cal_impl.Decode4_P3_g "" VALUE 0x00838388 Scalar_FLOAT64_IEEE 0 speedgoat_test_SN5659_R2021b_IO682_CM_double -1.7E+308 1.7E+308 /end CHARACTERISTIC
/begin CHARACTERISTIC speedgoat_test_SN5659__cal_impl.Decode4_P3_i "" VALUE 0x00839DE8 Scalar_FLOAT64_IEEE 0 speedgoat_test_SN5659_R2021b_IO682_CM_double -1.7E+308 1.7E+308 /end CHARACTERISTIC
/begin CHARACTERISTIC speedgoat_test_SN5659__cal_impl.Decode4_P3_k "" VALUE 0x00837CF0 Scalar_FLOAT64_IEEE 0 speedgoat_test_SN5659_R2021b_IO682_CM_double -1.7E+308 1.7E+308 /end CHARACTERISTIC
/begin CHARACTERISTIC speedgoat_test_SN5659__cal_impl.Decode4_P3_l "" VALUE 0x00834830 Scalar_FLOAT64_IEEE 0 speedgoat_test_SN5659_R2021b_IO682_CM_double -1.7E+308 1.7E+308 /end CHARACTERISTIC
/begin CHARACTERISTIC speedgoat_test_SN5659__cal_impl.Decode4_P3_mv "" VALUE 0x00839750 Scalar_FLOAT64_IEEE 0 speedgoat_test_SN5659_R2021b_IO682_CM_double -1.7E+308 1.7E+308 /end CHARACTERISTIC
/begin CHARACTERISTIC speedgoat_test_SN5659__cal_impl.Decode4_P3_n "" VALUE 0x00838A20 Scalar_FLOAT64_IEEE 0 speedgoat_test_SN5659_R2021b_IO682_CM_double -1.7E+308 1.7E+308 /end CHARACTERISTIC
/begin CHARACTERISTIC speedgoat_test_SN5659__cal_impl.Decode4_P3_p4 "" VALUE 0x008390B8 Scalar_FLOAT64_IEEE 0 speedgoat_test_SN5659_R2021b_IO682_CM_double -1.7E+308 1.7E+308 /end CHARACTERISTIC
/begin CHARACTERISTIC speedgoat_test_SN5659__cal_impl.Decode4_P4_b "" VALUE 0x00838A38 Scalar_FLOAT64_IEEE 0 speedgoat_test_SN5659_R2021b_IO682_CM_double -1.7E+308 1.7E+308 /end CHARACTERISTIC
/begin CHARACTERISTIC speedgoat_test_SN5659__cal_impl.Decode4_P4_e "" VALUE 0x008341B0 Scalar_FLOAT64_IEEE 0 speedgoat_test_SN5659_R2021b_IO682_CM_double -1.7E+308 1.7E+308 /end CHARACTERISTIC
/begin CHARACTERISTIC speedgoat_test_SN5659__cal_impl.Decode4_P4_f1 "" VALUE 0x00839E00 Scalar_FLOAT64_IEEE 0 speedgoat_test_SN5659_R2021b_IO682_CM_double -1.7E+308 1.7E+308 /end CHARACTERISTIC
/begin CHARACTERISTIC speedgoat_test_SN5659__cal_impl.Decode4_P4_ft "" VALUE 0x00837D08 Scalar_FLOAT64_IEEE 0 speedgoat_test_SN5659_R2021b_IO682_CM_double -1.7E+308 1.7E+308 /end CHARACTERISTIC
/begin CHARACTERISTIC speedgoat_test_SN5659__cal_impl.Decode4_P4_g "" VALUE 0x008383A0 Scalar_FLOAT64_IEEE 0 speedgoat_test_SN5659_R2021b_IO682_CM_double -1.7E+308 1.7E+308 /end CHARACTERISTIC
/begin CHARACTERISTIC speedgoat_test_SN5659__cal_impl.Decode4_P4_k "" VALUE 0x00834848 Scalar_FLOAT64_IEEE 0 speedgoat_test_SN5659_R2021b_IO682_CM_double -1.7E+308 1.7E+308 /end CHARACTERISTIC
/begin CHARACTERISTIC speedgoat_test_SN5659__cal_impl.Decode4_P4_kx "" VALUE 0x00839768 Scalar_FLOAT64_IEEE 0 speedgoat_test_SN5659_R2021b_IO682_CM_double -1.7E+308 1.7E+308 /end CHARACTERISTIC
/begin CHARACTERISTIC speedgoat_test_SN5659__cal_impl.Decode4_P4_p2 "" VALUE 0x008390D0 Scalar_FLOAT64_IEEE 0 speedgoat_test_SN5659_R2021b_IO682_CM_double -1.7E+308 1.7E+308 /end CHARACTERISTIC
/begin CHARACTERISTIC speedgoat_test_SN5659__cal_impl.Decode4_P5_cd "" VALUE 0x008390E8 Scalar_FLOAT64_IEEE 0 speedgoat_test_SN5659_R2021b_IO682_CM_double -1.7E+308 1.7E+308 /end CHARACTERISTIC
/begin CHARACTERISTIC speedgoat_test_SN5659__cal_impl.Decode4_P5_cm "" VALUE 0x008383B8 Scalar_FLOAT64_IEEE 0 speedgoat_test_SN5659_R2021b_IO682_CM_double -1.7E+308 1.7E+308 /end CHARACTERISTIC
/begin CHARACTERISTIC speedgoat_test_SN5659__cal_impl.Decode4_P5_d "" VALUE 0x00837D20 Scalar_FLOAT64_IEEE 0 speedgoat_test_SN5659_R2021b_IO682_CM_double -1.7E+308 1.7E+308 /end CHARACTERISTIC
/begin CHARACTERISTIC speedgoat_test_SN5659__cal_impl.Decode4_P5_h "" VALUE 0x00839E18 Scalar_FLOAT64_IEEE 0 speedgoat_test_SN5659_R2021b_IO682_CM_double -1.7E+308 1.7E+308 /end CHARACTERISTIC
/begin CHARACTERISTIC speedgoat_test_SN5659__cal_impl.Decode4_P5_i "" VALUE 0x00834860 Scalar_FLOAT64_IEEE 0 speedgoat_test_SN5659_R2021b_IO682_CM_double -1.7E+308 1.7E+308 /end CHARACTERISTIC
/begin CHARACTERISTIC speedgoat_test_SN5659__cal_impl.Decode4_P5_ia "" VALUE 0x00839780 Scalar_FLOAT64_IEEE 0 speedgoat_test_SN5659_R2021b_IO682_CM_double -1.7E+308 1.7E+308 /end CHARACTERISTIC
/begin CHARACTERISTIC speedgoat_test_SN5659__cal_impl.Decode4_P5_m "" VALUE 0x00838A50 Scalar_FLOAT64_IEEE 0 speedgoat_test_SN5659_R2021b_IO682_CM_double -1.7E+308 1.7E+308 /end CHARACTERISTIC
/begin CHARACTERISTIC speedgoat_test_SN5659__cal_impl.Decode4_P5_p "" VALUE 0x008341C8 Scalar_FLOAT64_IEEE 0 speedgoat_test_SN5659_R2021b_IO682_CM_double -1.7E+308 1.7E+308 /end CHARACTERISTIC
/begin CHARACTERISTIC speedgoat_test_SN5659__cal_impl.Decode4_P6_an "" VALUE 0x00839798 Scalar_FLOAT64_IEEE 0 speedgoat_test_SN5659_R2021b_IO682_CM_double -1.7E+308 1.7E+308 /end CHARACTERISTIC
/begin CHARACTERISTIC speedgoat_test_SN5659__cal_impl.Decode4_P6_awi "" VALUE 0x008383D0 Scalar_FLOAT64_IEEE 0 speedgoat_test_SN5659_R2021b_IO682_CM_double -1.7E+308 1.7E+308 /end CHARACTERISTIC
/begin CHARACTERISTIC speedgoat_test_SN5659__cal_impl.Decode4_P6_d "" VALUE 0x00838A68 Scalar_FLOAT64_IEEE 0 speedgoat_test_SN5659_R2021b_IO682_CM_double -1.7E+308 1.7E+308 /end CHARACTERISTIC
/begin CHARACTERISTIC speedgoat_test_SN5659__cal_impl.Decode4_P6_fd "" VALUE 0x00839100 Scalar_FLOAT64_IEEE 0 speedgoat_test_SN5659_R2021b_IO682_CM_double -1.7E+308 1.7E+308 /end CHARACTERISTIC
/begin CHARACTERISTIC speedgoat_test_SN5659__cal_impl.Decode4_P6_g "" VALUE 0x00839E30 Scalar_FLOAT64_IEEE 0 speedgoat_test_SN5659_R2021b_IO682_CM_double -1.7E+308 1.7E+308 /end CHARACTERISTIC
/begin CHARACTERISTIC speedgoat_test_SN5659__cal_impl.Decode4_P6_h "" VALUE 0x008341E0 Scalar_FLOAT64_IEEE 0 speedgoat_test_SN5659_R2021b_IO682_CM_double -1.7E+308 1.7E+308 /end CHARACTERISTIC
/begin CHARACTERISTIC speedgoat_test_SN5659__cal_impl.Decode4_P6_m "" VALUE 0x00837D38 Scalar_FLOAT64_IEEE 0 speedgoat_test_SN5659_R2021b_IO682_CM_double -1.7E+308 1.7E+308 /end CHARACTERISTIC
/begin CHARACTERISTIC speedgoat_test_SN5659__cal_impl.Decode4_P6_n "" VALUE 0x00834878 Scalar_FLOAT64_IEEE 0 speedgoat_test_SN5659_R2021b_IO682_CM_double -1.7E+308 1.7E+308 /end CHARACTERISTIC
/begin CHARACTERISTIC speedgoat_test_SN5659__cal_impl.Decode4_P7_a "" VALUE 0x00838A80 Scalar_FLOAT64_IEEE 0 speedgoat_test_SN5659_R2021b_IO682_CM_double -1.7E+308 1.7E+308 /end CHARACTERISTIC
/begin CHARACTERISTIC speedgoat_test_SN5659__cal_impl.Decode4_P7_c "" VALUE 0x008397B0 Scalar_FLOAT64_IEEE 0 speedgoat_test_SN5659_R2021b_IO682_CM_double -1.7E+308 1.7E+308 /end CHARACTERISTIC
/begin CHARACTERISTIC speedgoat_test_SN5659__cal_impl.Decode4_P7_f "" VALUE 0x008341F8 Scalar_FLOAT64_IEEE 0 speedgoat_test_SN5659_R2021b_IO682_CM_double -1.7E+308 1.7E+308 /end CHARACTERISTIC
/begin CHARACTERISTIC speedgoat_test_SN5659__cal_impl.Decode4_P7_g2 "" VALUE 0x00839118 Scalar_FLOAT64_IEEE 0 speedgoat_test_SN5659_R2021b_IO682_CM_double -1.7E+308 1.7E+308 /end CHARACTERISTIC
/begin CHARACTERISTIC speedgoat_test_SN5659__cal_impl.Decode4_P7_h0 "" VALUE 0x008383E8 Scalar_FLOAT64_IEEE 0 speedgoat_test_SN5659_R2021b_IO682_CM_double -1.7E+308 1.7E+308 /end CHARACTERISTIC
/begin CHARACTERISTIC speedgoat_test_SN5659__cal_impl.Decode4_P7_j "" VALUE 0x00839E48 Scalar_FLOAT64_IEEE 0 speedgoat_test_SN5659_R2021b_IO682_CM_double -1.7E+308 1.7E+308 /end CHARACTERISTIC
/begin CHARACTERISTIC speedgoat_test_SN5659__cal_impl.Decode4_P7_n "" VALUE 0x00834890 Scalar_FLOAT64_IEEE 0 speedgoat_test_SN5659_R2021b_IO682_CM_double -1.7E+308 1.7E+308 /end CHARACTERISTIC
/begin CHARACTERISTIC speedgoat_test_SN5659__cal_impl.Decode4_P7_nw "" VALUE 0x00837D50 Scalar_FLOAT64_IEEE 0 speedgoat_test_SN5659_R2021b_IO682_CM_double -1.7E+308 1.7E+308 /end CHARACTERISTIC
/begin CHARACTERISTIC speedgoat_test_SN5659__cal_impl.Decode4_P8_b "" VALUE 0x00834210 Scalar_FLOAT64_IEEE 0 speedgoat_test_SN5659_R2021b_IO682_CM_double -1.7E+308 1.7E+308 /end CHARACTERISTIC
/begin CHARACTERISTIC speedgoat_test_SN5659__cal_impl.Decode4_P8_g "" VALUE 0x008348A8 Scalar_FLOAT64_IEEE 0 speedgoat_test_SN5659_R2021b_IO682_CM_double -1.7E+308 1.7E+308 /end CHARACTERISTIC
/begin CHARACTERISTIC speedgoat_test_SN5659__cal_impl.Decode4_P8_l "" VALUE 0x00838A98 Scalar_FLOAT64_IEEE 0 speedgoat_test_SN5659_R2021b_IO682_CM_double -1.7E+308 1.7E+308 /end CHARACTERISTIC
/begin CHARACTERISTIC speedgoat_test_SN5659__cal_impl.Decode4_P8_lu "" VALUE 0x00839130 Scalar_FLOAT64_IEEE 0 speedgoat_test_SN5659_R2021b_IO682_CM_double -1.7E+308 1.7E+308 /end CHARACTERISTIC
/begin CHARACTERISTIC speedgoat_test_SN5659__cal_impl.Decode4_P8_mv "" VALUE 0x00839E60 Scalar_FLOAT64_IEEE 0 speedgoat_test_SN5659_R2021b_IO682_CM_double -1.7E+308 1.7E+308 /end CHARACTERISTIC
/begin CHARACTERISTIC speedgoat_test_SN5659__cal_impl.Decode4_P8_n "" VALUE 0x00837D68 Scalar_FLOAT64_IEEE 0 speedgoat_test_SN5659_R2021b_IO682_CM_double -1.7E+308 1.7E+308 /end CHARACTERISTIC
/begin CHARACTERISTIC speedgoat_test_SN5659__cal_impl.Decode4_P8_o "" VALUE 0x008397C8 Scalar_FLOAT64_IEEE 0 speedgoat_test_SN5659_R2021b_IO682_CM_double -1.7E+308 1.7E+308 /end CHARACTERISTIC
/begin CHARACTERISTIC speedgoat_test_SN5659__cal_impl.Decode4_P8_p "" VALUE 0x00838400 Scalar_FLOAT64_IEEE 0 speedgoat_test_SN5659_R2021b_IO682_CM_double -1.7E+308 1.7E+308 /end CHARACTERISTIC
/begin CHARACTERISTIC speedgoat_test_SN5659__cal_impl.Decode4_P9_a "" VALUE 0x00834228 Scalar_FLOAT64_IEEE 0 speedgoat_test_SN5659_R2021b_IO682_CM_double -1.7E+308 1.7E+308 /end CHARACTERISTIC
/begin CHARACTERISTIC speedgoat_test_SN5659__cal_impl.Decode4_P9_c "" VALUE 0x008397E0 Scalar_FLOAT64_IEEE 0 speedgoat_test_SN5659_R2021b_IO682_CM_double -1.7E+308 1.7E+308 /end CHARACTERISTIC
/begin CHARACTERISTIC speedgoat_test_SN5659__cal_impl.Decode4_P9_dp "" VALUE 0x00837D80 Scalar_FLOAT64_IEEE 0 speedgoat_test_SN5659_R2021b_IO682_CM_double -1.7E+308 1.7E+308 /end CHARACTERISTIC
/begin CHARACTERISTIC speedgoat_test_SN5659__cal_impl.Decode4_P9_e "" VALUE 0x008348C0 Scalar_FLOAT64_IEEE 0 speedgoat_test_SN5659_R2021b_IO682_CM_double -1.7E+308 1.7E+308 /end CHARACTERISTIC
/begin CHARACTERISTIC speedgoat_test_SN5659__cal_impl.Decode4_P9_g "" VALUE 0x00839E78 Scalar_FLOAT64_IEEE 0 speedgoat_test_SN5659_R2021b_IO682_CM_double -1.7E+308 1.7E+308 /end CHARACTERISTIC
/begin CHARACTERISTIC speedgoat_test_SN5659__cal_impl.Decode4_P9_j "" VALUE 0x00839148 Scalar_FLOAT64_IEEE 0 speedgoat_test_SN5659_R2021b_IO682_CM_double -1.7E+308 1.7E+308 /end CHARACTERISTIC
/begin CHARACTERISTIC speedgoat_test_SN5659__cal_impl.Decode4_P9_p "" VALUE 0x00838418 Scalar_FLOAT64_IEEE 0 speedgoat_test_SN5659_R2021b_IO682_CM_double -1.7E+308 1.7E+308 /end CHARACTERISTIC
/begin CHARACTERISTIC speedgoat_test_SN5659__cal_impl.Decode4_P9_p0 "" VALUE 0x00838AB0 Scalar_FLOAT64_IEEE 0 speedgoat_test_SN5659_R2021b_IO682_CM_double -1.7E+308 1.7E+308 /end CHARACTERISTIC
/begin CHARACTERISTIC speedgoat_test_SN5659__cal_impl.Decode5_P10_k2 "" VAL_BLK 0x008387B8 Scalar_FLOAT64_IEEE 0 speedgoat_test_SN5659_R2021b_IO682_CM_double -1.7E+308 1.7E+308 MATRIX_DIM 2 1 /end CHARACTERISTIC
/begin CHARACTERISTIC speedgoat_test_SN5659__cal_impl.Decode5_P10_m "" VAL_BLK 0x008345C8 Scalar_FLOAT64_IEEE 0 speedgoat_test_SN5659_R2021b_IO682_CM_double -1.7E+308 1.7E+308 MATRIX_DIM 2 1 /end CHARACTERISTIC
/begin CHARACTERISTIC speedgoat_test_SN5659__cal_impl.Decode5_P11_g "" VALUE 0x008345E8 Scalar_FLOAT64_IEEE 0 speedgoat_test_SN5659_R2021b_IO682_CM_double -1.7E+308 1.7E+308 /end CHARACTERISTIC
/begin CHARACTERISTIC speedgoat_test_SN5659__cal_impl.Decode5_P11_i "" VALUE 0x008387D8 Scalar_FLOAT64_IEEE 0 speedgoat_test_SN5659_R2021b_IO682_CM_double -1.7E+308 1.7E+308 /end CHARACTERISTIC
/begin CHARACTERISTIC speedgoat_test_SN5659__cal_impl.Decode5_P12_h "" VALUE 0x008387F0 Scalar_FLOAT64_IEEE 0 speedgoat_test_SN5659_R2021b_IO682_CM_double -1.7E+308 1.7E+308 /end CHARACTERISTIC
/begin CHARACTERISTIC speedgoat_test_SN5659__cal_impl.Decode5_P12_m "" VALUE 0x00834600 Scalar_FLOAT64_IEEE 0 speedgoat_test_SN5659_R2021b_IO682_CM_double -1.7E+308 1.7E+308 /end CHARACTERISTIC
/begin CHARACTERISTIC speedgoat_test_SN5659__cal_impl.Decode5_P13_c "" VALUE 0x00834618 Scalar_FLOAT64_IEEE 0 speedgoat_test_SN5659_R2021b_IO682_CM_double -1.7E+308 1.7E+308 /end CHARACTERISTIC
/begin CHARACTERISTIC speedgoat_test_SN5659__cal_impl.Decode5_P13_p "" VALUE 0x00838808 Scalar_FLOAT64_IEEE 0 speedgoat_test_SN5659_R2021b_IO682_CM_double -1.7E+308 1.7E+308 /end CHARACTERISTIC
/begin CHARACTERISTIC speedgoat_test_SN5659__cal_impl.Decode5_P14_c "" VALUE 0x00834630 Scalar_FLOAT64_IEEE 0 speedgoat_test_SN5659_R2021b_IO682_CM_double -1.7E+308 1.7E+308 /end CHARACTERISTIC
/begin CHARACTERISTIC speedgoat_test_SN5659__cal_impl.Decode5_P14_cm "" VALUE 0x00838820 Scalar_FLOAT64_IEEE 0 speedgoat_test_SN5659_R2021b_IO682_CM_double -1.7E+308 1.7E+308 /end CHARACTERISTIC
/begin CHARACTERISTIC speedgoat_test_SN5659__cal_impl.Decode5_P15_b "" VALUE 0x00838838 Scalar_FLOAT64_IEEE 0 speedgoat_test_SN5659_R2021b_IO682_CM_double -1.7E+308 1.7E+308 /end CHARACTERISTIC
/begin CHARACTERISTIC speedgoat_test_SN5659__cal_impl.Decode5_P15_j "" VALUE 0x00834648 Scalar_FLOAT64_IEEE 0 speedgoat_test_SN5659_R2021b_IO682_CM_double -1.7E+308 1.7E+308 /end CHARACTERISTIC
/begin CHARACTERISTIC speedgoat_test_SN5659__cal_impl.Decode5_P16_a "" VALUE 0x00834660 Scalar_FLOAT64_IEEE 0 speedgoat_test_SN5659_R2021b_IO682_CM_double -1.7E+308 1.7E+308 /end CHARACTERISTIC
/begin CHARACTERISTIC speedgoat_test_SN5659__cal_impl.Decode5_P16_o "" VALUE 0x00838850 Scalar_FLOAT64_IEEE 0 speedgoat_test_SN5659_R2021b_IO682_CM_double -1.7E+308 1.7E+308 /end CHARACTERISTIC
/begin CHARACTERISTIC speedgoat_test_SN5659__cal_impl.Decode5_P1_n "" VALUE 0x008344F0 Scalar_FLOAT64_IEEE 0 speedgoat_test_SN5659_R2021b_IO682_CM_double -1.7E+308 1.7E+308 /end CHARACTERISTIC
/begin CHARACTERISTIC speedgoat_test_SN5659__cal_impl.Decode5_P1_p "" VALUE 0x008386E0 Scalar_FLOAT64_IEEE 0 speedgoat_test_SN5659_R2021b_IO682_CM_double -1.7E+308 1.7E+308 /end CHARACTERISTIC
/begin CHARACTERISTIC speedgoat_test_SN5659__cal_impl.Decode5_P2_f0 "" VALUE 0x008386F8 Scalar_FLOAT64_IEEE 0 speedgoat_test_SN5659_R2021b_IO682_CM_double -1.7E+308 1.7E+308 /end CHARACTERISTIC
/begin CHARACTERISTIC speedgoat_test_SN5659__cal_impl.Decode5_P2_m "" VALUE 0x00834508 Scalar_FLOAT64_IEEE 0 speedgoat_test_SN5659_R2021b_IO682_CM_double -1.7E+308 1.7E+308 /end CHARACTERISTIC
/begin CHARACTERISTIC speedgoat_test_SN5659__cal_impl.Decode5_P3_i "" VALUE 0x00834520 Scalar_FLOAT64_IEEE 0 speedgoat_test_SN5659_R2021b_IO682_CM_double -1.7E+308 1.7E+308 /end CHARACTERISTIC
/begin CHARACTERISTIC speedgoat_test_SN5659__cal_impl.Decode5_P3_o "" VALUE 0x00838710 Scalar_FLOAT64_IEEE 0 speedgoat_test_SN5659_R2021b_IO682_CM_double -1.7E+308 1.7E+308 /end CHARACTERISTIC
/begin CHARACTERISTIC speedgoat_test_SN5659__cal_impl.Decode5_P4_f "" VALUE 0x00834538 Scalar_FLOAT64_IEEE 0 speedgoat_test_SN5659_R2021b_IO682_CM_double -1.7E+308 1.7E+308 /end CHARACTERISTIC
/begin CHARACTERISTIC speedgoat_test_SN5659__cal_impl.Decode5_P4_f5 "" VALUE 0x00838728 Scalar_FLOAT64_IEEE 0 speedgoat_test_SN5659_R2021b_IO682_CM_double -1.7E+308 1.7E+308 /end CHARACTERISTIC
/begin CHARACTERISTIC speedgoat_test_SN5659__cal_impl.Decode5_P5_d "" VALUE 0x00838740 Scalar_FLOAT64_IEEE 0 speedgoat_test_SN5659_R2021b_IO682_CM_double -1.7E+308 1.7E+308 /end CHARACTERISTIC
/begin CHARACTERISTIC speedgoat_test_SN5659__cal_impl.Decode5_P5_m "" VALUE 0x00834550 Scalar_FLOAT64_IEEE 0 speedgoat_test_SN5659_R2021b_IO682_CM_double -1.7E+308 1.7E+308 /end CHARACTERISTIC
/begin CHARACTERISTIC speedgoat_test_SN5659__cal_impl.Decode5_P6_c "" VALUE 0x00838758 Scalar_FLOAT64_IEEE 0 speedgoat_test_SN5659_R2021b_IO682_CM_double -1.7E+308 1.7E+308 /end CHARACTERISTIC
/begin CHARACTERISTIC speedgoat_test_SN5659__cal_impl.Decode5_P6_m "" VALUE 0x00834568 Scalar_FLOAT64_IEEE 0 speedgoat_test_SN5659_R2021b_IO682_CM_double -1.7E+308 1.7E+308 /end CHARACTERISTIC
/begin CHARACTERISTIC speedgoat_test_SN5659__cal_impl.Decode5_P7_m "" VALUE 0x00838770 Scalar_FLOAT64_IEEE 0 speedgoat_test_SN5659_R2021b_IO682_CM_double -1.7E+308 1.7E+308 /end CHARACTERISTIC
/begin CHARACTERISTIC speedgoat_test_SN5659__cal_impl.Decode5_P7_n "" VALUE 0x00834580 Scalar_FLOAT64_IEEE 0 speedgoat_test_SN5659_R2021b_IO682_CM_double -1.7E+308 1.7E+308 /end CHARACTERISTIC
/begin CHARACTERISTIC speedgoat_test_SN5659__cal_impl.Decode5_P8_b "" VALUE 0x00834598 Scalar_FLOAT64_IEEE 0 speedgoat_test_SN5659_R2021b_IO682_CM_double -1.7E+308 1.7E+308 /end CHARACTERISTIC
/begin CHARACTERISTIC speedgoat_test_SN5659__cal_impl.Decode5_P8_c "" VALUE 0x00838788 Scalar_FLOAT64_IEEE 0 speedgoat_test_SN5659_R2021b_IO682_CM_double -1.7E+308 1.7E+308 /end CHARACTERISTIC
/begin CHARACTERISTIC speedgoat_test_SN5659__cal_impl.Decode5_P9_h "" VALUE 0x008387A0 Scalar_FLOAT64_IEEE 0 speedgoat_test_SN5659_R2021b_IO682_CM_double -1.7E+308 1.7E+308 /end CHARACTERISTIC
/begin CHARACTERISTIC speedgoat_test_SN5659__cal_impl.Decode5_P9_n "" VALUE 0x008345B0 Scalar_FLOAT64_IEEE 0 speedgoat_test_SN5659_R2021b_IO682_CM_double -1.7E+308 1.7E+308 /end CHARACTERISTIC
/begin CHARACTERISTIC speedgoat_test_SN5659__cal_impl.Encode1_P1 "" VALUE 0x00839F58 Scalar_FLOAT64_IEEE 0 speedgoat_test_SN5659_R2021b_IO682_CM_double -1.7E+308 1.7E+308 /end CHARACTERISTIC
/begin CHARACTERISTIC speedgoat_test_SN5659__cal_impl.Encode1_P10 "" VALUE 0x0083A030 Scalar_FLOAT64_IEEE 0 speedgoat_test_SN5659_R2021b_IO682_CM_double -1.7E+308 1.7E+308 /end CHARACTERISTIC
/begin CHARACTERISTIC speedgoat_test_SN5659__cal_impl.Encode1_P10_a "" VALUE 0x0083A6A0 Scalar_FLOAT64_IEEE 0 speedgoat_test_SN5659_R2021b_IO682_CM_double -1.7E+308 1.7E+308 /end CHARACTERISTIC
/begin CHARACTERISTIC speedgoat_test_SN5659__cal_impl.Encode1_P11 "" VAL_BLK 0x0083A048 Scalar_FLOAT64_IEEE 0 speedgoat_test_SN5659_R2021b_IO682_CM_double -1.7E+308 1.7E+308 MATRIX_DIM 2 1 /end CHARACTERISTIC
/begin CHARACTERISTIC speedgoat_test_SN5659__cal_impl.Encode1_P11_g "" VAL_BLK 0x0083A6B8 Scalar_FLOAT64_IEEE 0 speedgoat_test_SN5659_R2021b_IO682_CM_double -1.7E+308 1.7E+308 MATRIX_DIM 2 1 /end CHARACTERISTIC
/begin CHARACTERISTIC speedgoat_test_SN5659__cal_impl.Encode1_P12 "" VALUE 0x0083A068 Scalar_FLOAT64_IEEE 0 speedgoat_test_SN5659_R2021b_IO682_CM_double -1.7E+308 1.7E+308 /end CHARACTERISTIC
/begin CHARACTERISTIC speedgoat_test_SN5659__cal_impl.Encode1_P12_n "" VALUE 0x0083A6D8 Scalar_FLOAT64_IEEE 0 speedgoat_test_SN5659_R2021b_IO682_CM_double -1.7E+308 1.7E+308 /end CHARACTERISTIC
/begin CHARACTERISTIC speedgoat_test_SN5659__cal_impl.Encode1_P13 "" VALUE 0x0083A080 Scalar_FLOAT64_IEEE 0 speedgoat_test_SN5659_R2021b_IO682_CM_double -1.7E+308 1.7E+308 /end CHARACTERISTIC
/begin CHARACTERISTIC speedgoat_test_SN5659__cal_impl.Encode1_P13_j "" VALUE 0x0083A6F0 Scalar_FLOAT64_IEEE 0 speedgoat_test_SN5659_R2021b_IO682_CM_double -1.7E+308 1.7E+308 /end CHARACTERISTIC
/begin CHARACTERISTIC speedgoat_test_SN5659__cal_impl.Encode1_P14 "" VALUE 0x0083A098 Scalar_FLOAT64_IEEE 0 speedgoat_test_SN5659_R2021b_IO682_CM_double -1.7E+308 1.7E+308 /end CHARACTERISTIC
/begin CHARACTERISTIC speedgoat_test_SN5659__cal_impl.Encode1_P14_h "" VALUE 0x0083A708 Scalar_FLOAT64_IEEE 0 speedgoat_test_SN5659_R2021b_IO682_CM_double -1.7E+308 1.7E+308 /end CHARACTERISTIC
/begin CHARACTERISTIC speedgoat_test_SN5659__cal_impl.Encode1_P15 "" VALUE 0x0083A0B0 Scalar_FLOAT64_IEEE 0 speedgoat_test_SN5659_R2021b_IO682_CM_double -1.7E+308 1.7E+308 /end CHARACTERISTIC
/begin CHARACTERISTIC speedgoat_test_SN5659__cal_impl.Encode1_P15_h "" VALUE 0x0083A720 Scalar_FLOAT64_IEEE 0 speedgoat_test_SN5659_R2021b_IO682_CM_double -1.7E+308 1.7E+308 /end CHARACTERISTIC
/begin CHARACTERISTIC speedgoat_test_SN5659__cal_impl.Encode1_P1_a "" VALUE 0x0083A5C8 Scalar_FLOAT64_IEEE 0 speedgoat_test_SN5659_R2021b_IO682_CM_double -1.7E+308 1.7E+308 /end CHARACTERISTIC
/begin CHARACTERISTIC speedgoat_test_SN5659__cal_impl.Encode1_P2 "" VALUE 0x00839F70 Scalar_FLOAT64_IEEE 0 speedgoat_test_SN5659_R2021b_IO682_CM_double -1.7E+308 1.7E+308 /end CHARACTERISTIC
/begin CHARACTERISTIC speedgoat_test_SN5659__cal_impl.Encode1_P2_h "" VALUE 0x0083A5E0 Scalar_FLOAT64_IEEE 0 speedgoat_test_SN5659_R2021b_IO682_CM_double -1.7E+308 1.7E+308 /end CHARACTERISTIC
/begin CHARACTERISTIC speedgoat_test_SN5659__cal_impl.Encode1_P3 "" VALUE 0x00839F88 Scalar_FLOAT64_IEEE 0 speedgoat_test_SN5659_R2021b_IO682_CM_double -1.7E+308 1.7E+308 /end CHARACTERISTIC
/begin CHARACTERISTIC speedgoat_test_SN5659__cal_impl.Encode1_P3_o "" VALUE 0x0083A5F8 Scalar_FLOAT64_IEEE 0 speedgoat_test_SN5659_R2021b_IO682_CM_double -1.7E+308 1.7E+308 /end CHARACTERISTIC
/begin CHARACTERISTIC speedgoat_test_SN5659__cal_impl.Encode1_P4 "" VALUE 0x00839FA0 Scalar_FLOAT64_IEEE 0 speedgoat_test_SN5659_R2021b_IO682_CM_double -1.7E+308 1.7E+308 /end CHARACTERISTIC
/begin CHARACTERISTIC speedgoat_test_SN5659__cal_impl.Encode1_P4_d "" VALUE 0x0083A610 Scalar_FLOAT64_IEEE 0 speedgoat_test_SN5659_R2021b_IO682_CM_double -1.7E+308 1.7E+308 /end CHARACTERISTIC
/begin CHARACTERISTIC speedgoat_test_SN5659__cal_impl.Encode1_P5 "" VALUE 0x00839FB8 Scalar_FLOAT64_IEEE 0 speedgoat_test_SN5659_R2021b_IO682_CM_double -1.7E+308 1.7E+308 /end CHARACTERISTIC
/begin CHARACTERISTIC speedgoat_test_SN5659__cal_impl.Encode1_P5_o "" VALUE 0x0083A628 Scalar_FLOAT64_IEEE 0 speedgoat_test_SN5659_R2021b_IO682_CM_double -1.7E+308 1.7E+308 /end CHARACTERISTIC
/begin CHARACTERISTIC speedgoat_test_SN5659__cal_impl.Encode1_P6 "" VALUE 0x00839FD0 Scalar_FLOAT64_IEEE 0 speedgoat_test_SN5659_R2021b_IO682_CM_double -1.7E+308 1.7E+308 /end CHARACTERISTIC
/begin CHARACTERISTIC speedgoat_test_SN5659__cal_impl.Encode1_P6_n "" VALUE 0x0083A640 Scalar_FLOAT64_IEEE 0 speedgoat_test_SN5659_R2021b_IO682_CM_double -1.7E+308 1.7E+308 /end CHARACTERISTIC
/begin CHARACTERISTIC speedgoat_test_SN5659__cal_impl.Encode1_P7 "" VALUE 0x00839FE8 Scalar_FLOAT64_IEEE 0 speedgoat_test_SN5659_R2021b_IO682_CM_double -1.7E+308 1.7E+308 /end CHARACTERISTIC
/begin CHARACTERISTIC speedgoat_test_SN5659__cal_impl.Encode1_P7_g "" VALUE 0x0083A658 Scalar_FLOAT64_IEEE 0 speedgoat_test_SN5659_R2021b_IO682_CM_double -1.7E+308 1.7E+308 /end CHARACTERISTIC
/begin CHARACTERISTIC speedgoat_test_SN5659__cal_impl.Encode1_P8 "" VALUE 0x0083A000 Scalar_FLOAT64_IEEE 0 speedgoat_test_SN5659_R2021b_IO682_CM_double -1.7E+308 1.7E+308 /end CHARACTERISTIC
/begin CHARACTERISTIC speedgoat_test_SN5659__cal_impl.Encode1_P8_p "" VALUE 0x0083A670 Scalar_FLOAT64_IEEE 0 speedgoat_test_SN5659_R2021b_IO682_CM_double -1.7E+308 1.7E+308 /end CHARACTERISTIC
/begin CHARACTERISTIC speedgoat_test_SN5659__cal_impl.Encode1_P9 "" VALUE 0x0083A018 Scalar_FLOAT64_IEEE 0 speedgoat_test_SN5659_R2021b_IO682_CM_double -1.7E+308 1.7E+308 /end CHARACTERISTIC
/begin CHARACTERISTIC speedgoat_test_SN5659__cal_impl.Encode1_P9_m "" VALUE 0x0083A688 Scalar_FLOAT64_IEEE 0 speedgoat_test_SN5659_R2021b_IO682_CM_double -1.7E+308 1.7E+308 /end CHARACTERISTIC
/begin CHARACTERISTIC speedgoat_test_SN5659__cal_impl.Encode2_P1 "" VALUE 0x0083A3F8 Scalar_FLOAT64_IEEE 0 speedgoat_test_SN5659_R2021b_IO682_CM_double -1.7E+308 1.7E+308 /end CHARACTERISTIC
/begin CHARACTERISTIC speedgoat_test_SN5659__cal_impl.Encode2_P10 "" VALUE 0x0083A4D0 Scalar_FLOAT64_IEEE 0 speedgoat_test_SN5659_R2021b_IO682_CM_double -1.7E+308 1.7E+308 /end CHARACTERISTIC
/begin CHARACTERISTIC speedgoat_test_SN5659__cal_impl.Encode2_P10_n "" VALUE 0x0083A810 Scalar_FLOAT64_IEEE 0 speedgoat_test_SN5659_R2021b_IO682_CM_double -1.7E+308 1.7E+308 /end CHARACTERISTIC
/begin CHARACTERISTIC speedgoat_test_SN5659__cal_impl.Encode2_P11 "" VAL_BLK 0x0083A4E8 Scalar_FLOAT64_IEEE 0 speedgoat_test_SN5659_R2021b_IO682_CM_double -1.7E+308 1.7E+308 MATRIX_DIM 2 1 /end CHARACTERISTIC
/begin CHARACTERISTIC speedgoat_test_SN5659__cal_impl.Encode2_P11_j "" VAL_BLK 0x0083A828 Scalar_FLOAT64_IEEE 0 speedgoat_test_SN5659_R2021b_IO682_CM_double -1.7E+308 1.7E+308 MATRIX_DIM 2 1 /end CHARACTERISTIC
/begin CHARACTERISTIC speedgoat_test_SN5659__cal_impl.Encode2_P12 "" VALUE 0x0083A508 Scalar_FLOAT64_IEEE 0 speedgoat_test_SN5659_R2021b_IO682_CM_double -1.7E+308 1.7E+308 /end CHARACTERISTIC
/begin CHARACTERISTIC speedgoat_test_SN5659__cal_impl.Encode2_P12_b "" VALUE 0x0083A848 Scalar_FLOAT64_IEEE 0 speedgoat_test_SN5659_R2021b_IO682_CM_double -1.7E+308 1.7E+308 /end CHARACTERISTIC
/begin CHARACTERISTIC speedgoat_test_SN5659__cal_impl.Encode2_P13 "" VALUE 0x0083A520 Scalar_FLOAT64_IEEE 0 speedgoat_test_SN5659_R2021b_IO682_CM_double -1.7E+308 1.7E+308 /end CHARACTERISTIC
/begin CHARACTERISTIC speedgoat_test_SN5659__cal_impl.Encode2_P13_j "" VALUE 0x0083A860 Scalar_FLOAT64_IEEE 0 speedgoat_test_SN5659_R2021b_IO682_CM_double -1.7E+308 1.7E+308 /end CHARACTERISTIC
/begin CHARACTERISTIC speedgoat_test_SN5659__cal_impl.Encode2_P14 "" VALUE 0x0083A538 Scalar_FLOAT64_IEEE 0 speedgoat_test_SN5659_R2021b_IO682_CM_double -1.7E+308 1.7E+308 /end CHARACTERISTIC
/begin CHARACTERISTIC speedgoat_test_SN5659__cal_impl.Encode2_P14_c "" VALUE 0x0083A878 Scalar_FLOAT64_IEEE 0 speedgoat_test_SN5659_R2021b_IO682_CM_double -1.7E+308 1.7E+308 /end CHARACTERISTIC
/begin CHARACTERISTIC speedgoat_test_SN5659__cal_impl.Encode2_P15 "" VALUE 0x0083A550 Scalar_FLOAT64_IEEE 0 speedgoat_test_SN5659_R2021b_IO682_CM_double -1.7E+308 1.7E+308 /end CHARACTERISTIC
/begin CHARACTERISTIC speedgoat_test_SN5659__cal_impl.Encode2_P15_j "" VALUE 0x0083A890 Scalar_FLOAT64_IEEE 0 speedgoat_test_SN5659_R2021b_IO682_CM_double -1.7E+308 1.7E+308 /end CHARACTERISTIC
/begin CHARACTERISTIC speedgoat_test_SN5659__cal_impl.Encode2_P1_h "" VALUE 0x0083A738 Scalar_FLOAT64_IEEE 0 speedgoat_test_SN5659_R2021b_IO682_CM_double -1.7E+308 1.7E+308 /end CHARACTERISTIC
/begin CHARACTERISTIC speedgoat_test_SN5659__cal_impl.Encode2_P2 "" VALUE 0x0083A410 Scalar_FLOAT64_IEEE 0 speedgoat_test_SN5659_R2021b_IO682_CM_double -1.7E+308 1.7E+308 /end CHARACTERISTIC
/begin CHARACTERISTIC speedgoat_test_SN5659__cal_impl.Encode2_P2_m "" VALUE 0x0083A750 Scalar_FLOAT64_IEEE 0 speedgoat_test_SN5659_R2021b_IO682_CM_double -1.7E+308 1.7E+308 /end CHARACTERISTIC
/begin CHARACTERISTIC speedgoat_test_SN5659__cal_impl.Encode2_P3 "" VALUE 0x0083A428 Scalar_FLOAT64_IEEE 0 speedgoat_test_SN5659_R2021b_IO682_CM_double -1.7E+308 1.7E+308 /end CHARACTERISTIC
/begin CHARACTERISTIC speedgoat_test_SN5659__cal_impl.Encode2_P3_o "" VALUE 0x0083A768 Scalar_FLOAT64_IEEE 0 speedgoat_test_SN5659_R2021b_IO682_CM_double -1.7E+308 1.7E+308 /end CHARACTERISTIC
/begin CHARACTERISTIC speedgoat_test_SN5659__cal_impl.Encode2_P4 "" VALUE 0x0083A440 Scalar_FLOAT64_IEEE 0 speedgoat_test_SN5659_R2021b_IO682_CM_double -1.7E+308 1.7E+308 /end CHARACTERISTIC
/begin CHARACTERISTIC speedgoat_test_SN5659__cal_impl.Encode2_P4_g "" VALUE 0x0083A780 Scalar_FLOAT64_IEEE 0 speedgoat_test_SN5659_R2021b_IO682_CM_double -1.7E+308 1.7E+308 /end CHARACTERISTIC
/begin CHARACTERISTIC speedgoat_test_SN5659__cal_impl.Encode2_P5 "" VALUE 0x0083A458 Scalar_FLOAT64_IEEE 0 speedgoat_test_SN5659_R2021b_IO682_CM_double -1.7E+308 1.7E+308 /end CHARACTERISTIC
/begin CHARACTERISTIC speedgoat_test_SN5659__cal_impl.Encode2_P5_g "" VALUE 0x0083A798 Scalar_FLOAT64_IEEE 0 speedgoat_test_SN5659_R2021b_IO682_CM_double -1.7E+308 1.7E+308 /end CHARACTERISTIC
/begin CHARACTERISTIC speedgoat_test_SN5659__cal_impl.Encode2_P6 "" VALUE 0x0083A470 Scalar_FLOAT64_IEEE 0 speedgoat_test_SN5659_R2021b_IO682_CM_double -1.7E+308 1.7E+308 /end CHARACTERISTIC
/begin CHARACTERISTIC speedgoat_test_SN5659__cal_impl.Encode2_P6_j "" VALUE 0x0083A7B0 Scalar_FLOAT64_IEEE 0 speedgoat_test_SN5659_R2021b_IO682_CM_double -1.7E+308 1.7E+308 /end CHARACTERISTIC
/begin CHARACTERISTIC speedgoat_test_SN5659__cal_impl.Encode2_P7 "" VALUE 0x0083A488 Scalar_FLOAT64_IEEE 0 speedgoat_test_SN5659_R2021b_IO682_CM_double -1.7E+308 1.7E+308 /end CHARACTERISTIC
/begin CHARACTERISTIC speedgoat_test_SN5659__cal_impl.Encode2_P7_d "" VALUE 0x0083A7C8 Scalar_FLOAT64_IEEE 0 speedgoat_test_SN5659_R2021b_IO682_CM_double -1.7E+308 1.7E+308 /end CHARACTERISTIC
/begin CHARACTERISTIC speedgoat_test_SN5659__cal_impl.Encode2_P8 "" VALUE 0x0083A4A0 Scalar_FLOAT64_IEEE 0 speedgoat_test_SN5659_R2021b_IO682_CM_double -1.7E+308 1.7E+308 /end CHARACTERISTIC
/begin CHARACTERISTIC speedgoat_test_SN5659__cal_impl.Encode2_P8_f "" VALUE 0x0083A7E0 Scalar_FLOAT64_IEEE 0 speedgoat_test_SN5659_R2021b_IO682_CM_double -1.7E+308 1.7E+308 /end CHARACTERISTIC
/begin CHARACTERISTIC speedgoat_test_SN5659__cal_impl.Encode2_P9 "" VALUE 0x0083A4B8 Scalar_FLOAT64_IEEE 0 speedgoat_test_SN5659_R2021b_IO682_CM_double -1.7E+308 1.7E+308 /end CHARACTERISTIC
/begin CHARACTERISTIC speedgoat_test_SN5659__cal_impl.Encode2_P9_p "" VALUE 0x0083A7F8 Scalar_FLOAT64_IEEE 0 speedgoat_test_SN5659_R2021b_IO682_CM_double -1.7E+308 1.7E+308 /end CHARACTERISTIC
/begin CHARACTERISTIC speedgoat_test_SN5659__cal_impl.Encode3_P1 "" VALUE 0x0083A270 Scalar_FLOAT64_IEEE 0 speedgoat_test_SN5659_R2021b_IO682_CM_double -1.7E+308 1.7E+308 /end CHARACTERISTIC
/begin CHARACTERISTIC speedgoat_test_SN5659__cal_impl.Encode3_P10 "" VALUE 0x0083A348 Scalar_FLOAT64_IEEE 0 speedgoat_test_SN5659_R2021b_IO682_CM_double -1.7E+308 1.7E+308 /end CHARACTERISTIC
/begin CHARACTERISTIC speedgoat_test_SN5659__cal_impl.Encode3_P10_n "" VALUE 0x0083A9B8 Scalar_FLOAT64_IEEE 0 speedgoat_test_SN5659_R2021b_IO682_CM_double -1.7E+308 1.7E+308 /end CHARACTERISTIC
/begin CHARACTERISTIC speedgoat_test_SN5659__cal_impl.Encode3_P11 "" VAL_BLK 0x0083A360 Scalar_FLOAT64_IEEE 0 speedgoat_test_SN5659_R2021b_IO682_CM_double -1.7E+308 1.7E+308 MATRIX_DIM 2 1 /end CHARACTERISTIC
/begin CHARACTERISTIC speedgoat_test_SN5659__cal_impl.Encode3_P11_l "" VAL_BLK 0x0083A9D0 Scalar_FLOAT64_IEEE 0 speedgoat_test_SN5659_R2021b_IO682_CM_double -1.7E+308 1.7E+308 MATRIX_DIM 2 1 /end CHARACTERISTIC
/begin CHARACTERISTIC speedgoat_test_SN5659__cal_impl.Encode3_P12 "" VALUE 0x0083A380 Scalar_FLOAT64_IEEE 0 speedgoat_test_SN5659_R2021b_IO682_CM_double -1.7E+308 1.7E+308 /end CHARACTERISTIC
/begin CHARACTERISTIC speedgoat_test_SN5659__cal_impl.Encode3_P12_e "" VALUE 0x0083A9F0 Scalar_FLOAT64_IEEE 0 speedgoat_test_SN5659_R2021b_IO682_CM_double -1.7E+308 1.7E+308 /end CHARACTERISTIC
/begin CHARACTERISTIC speedgoat_test_SN5659__cal_impl.Encode3_P13 "" VALUE 0x0083A398 Scalar_FLOAT64_IEEE 0 speedgoat_test_SN5659_R2021b_IO682_CM_double -1.7E+308 1.7E+308 /end CHARACTERISTIC
/begin CHARACTERISTIC speedgoat_test_SN5659__cal_impl.Encode3_P13_o "" VALUE 0x0083AA08 Scalar_FLOAT64_IEEE 0 speedgoat_test_SN5659_R2021b_IO682_CM_double -1.7E+308 1.7E+308 /end CHARACTERISTIC
/begin CHARACTERISTIC speedgoat_test_SN5659__cal_impl.Encode3_P14 "" VALUE 0x0083A3B0 Scalar_FLOAT64_IEEE 0 speedgoat_test_SN5659_R2021b_IO682_CM_double -1.7E+308 1.7E+308 /end CHARACTERISTIC
/begin CHARACTERISTIC speedgoat_test_SN5659__cal_impl.Encode3_P14_e "" VALUE 0x0083AA20 Scalar_FLOAT64_IEEE 0 speedgoat_test_SN5659_R2021b_IO682_CM_double -1.7E+308 1.7E+308 /end CHARACTERISTIC
/begin CHARACTERISTIC speedgoat_test_SN5659__cal_impl.Encode3_P15 "" VALUE 0x0083A3C8 Scalar_FLOAT64_IEEE 0 speedgoat_test_SN5659_R2021b_IO682_CM_double -1.7E+308 1.7E+308 /end CHARACTERISTIC
/begin CHARACTERISTIC speedgoat_test_SN5659__cal_impl.Encode3_P15_p "" VALUE 0x0083AA38 Scalar_FLOAT64_IEEE 0 speedgoat_test_SN5659_R2021b_IO682_CM_double -1.7E+308 1.7E+308 /end CHARACTERISTIC
/begin CHARACTERISTIC speedgoat_test_SN5659__cal_impl.Encode3_P1_l "" VALUE 0x0083A8E0 Scalar_FLOAT64_IEEE 0 speedgoat_test_SN5659_R2021b_IO682_CM_double -1.7E+308 1.7E+308 /end CHARACTERISTIC
/begin CHARACTERISTIC speedgoat_test_SN5659__cal_impl.Encode3_P2 "" VALUE 0x0083A288 Scalar_FLOAT64_IEEE 0 speedgoat_test_SN5659_R2021b_IO682_CM_double -1.7E+308 1.7E+308 /end CHARACTERISTIC
/begin CHARACTERISTIC speedgoat_test_SN5659__cal_impl.Encode3_P2_j "" VALUE 0x0083A8F8 Scalar_FLOAT64_IEEE 0 speedgoat_test_SN5659_R2021b_IO682_CM_double -1.7E+308 1.7E+308 /end CHARACTERISTIC
/begin CHARACTERISTIC speedgoat_test_SN5659__cal_impl.Encode3_P3 "" VALUE 0x0083A2A0 Scalar_FLOAT64_IEEE 0 speedgoat_test_SN5659_R2021b_IO682_CM_double -1.7E+308 1.7E+308 /end CHARACTERISTIC
/begin CHARACTERISTIC speedgoat_test_SN5659__cal_impl.Encode3_P3_n "" VALUE 0x0083A910 Scalar_FLOAT64_IEEE 0 speedgoat_test_SN5659_R2021b_IO682_CM_double -1.7E+308 1.7E+308 /end CHARACTERISTIC
/begin CHARACTERISTIC speedgoat_test_SN5659__cal_impl.Encode3_P4 "" VALUE 0x0083A2B8 Scalar_FLOAT64_IEEE 0 speedgoat_test_SN5659_R2021b_IO682_CM_double -1.7E+308 1.7E+308 /end CHARACTERISTIC
/begin CHARACTERISTIC speedgoat_test_SN5659__cal_impl.Encode3_P4_g "" VALUE 0x0083A928 Scalar_FLOAT64_IEEE 0 speedgoat_test_SN5659_R2021b_IO682_CM_double -1.7E+308 1.7E+308 /end CHARACTERISTIC
/begin CHARACTERISTIC speedgoat_test_SN5659__cal_impl.Encode3_P5 "" VALUE 0x0083A2D0 Scalar_FLOAT64_IEEE 0 speedgoat_test_SN5659_R2021b_IO682_CM_double -1.7E+308 1.7E+308 /end CHARACTERISTIC
/begin CHARACTERISTIC speedgoat_test_SN5659__cal_impl.Encode3_P5_k "" VALUE 0x0083A940 Scalar_FLOAT64_IEEE 0 speedgoat_test_SN5659_R2021b_IO682_CM_double -1.7E+308 1.7E+308 /end CHARACTERISTIC
/begin CHARACTERISTIC speedgoat_test_SN5659__cal_impl.Encode3_P6 "" VALUE 0x0083A2E8 Scalar_FLOAT64_IEEE 0 speedgoat_test_SN5659_R2021b_IO682_CM_double -1.7E+308 1.7E+308 /end CHARACTERISTIC
/begin CHARACTERISTIC speedgoat_test_SN5659__cal_impl.Encode3_P6_h "" VALUE 0x0083A958 Scalar_FLOAT64_IEEE 0 speedgoat_test_SN5659_R2021b_IO682_CM_double -1.7E+308 1.7E+308 /end CHARACTERISTIC
/begin CHARACTERISTIC speedgoat_test_SN5659__cal_impl.Encode3_P7 "" VALUE 0x0083A300 Scalar_FLOAT64_IEEE 0 speedgoat_test_SN5659_R2021b_IO682_CM_double -1.7E+308 1.7E+308 /end CHARACTERISTIC
/begin CHARACTERISTIC speedgoat_test_SN5659__cal_impl.Encode3_P7_b "" VALUE 0x0083A970 Scalar_FLOAT64_IEEE 0 speedgoat_test_SN5659_R2021b_IO682_CM_double -1.7E+308 1.7E+308 /end CHARACTERISTIC
/begin CHARACTERISTIC speedgoat_test_SN5659__cal_impl.Encode3_P8 "" VALUE 0x0083A318 Scalar_FLOAT64_IEEE 0 speedgoat_test_SN5659_R2021b_IO682_CM_double -1.7E+308 1.7E+308 /end CHARACTERISTIC
/begin CHARACTERISTIC speedgoat_test_SN5659__cal_impl.Encode3_P8_e "" VALUE 0x0083A988 Scalar_FLOAT64_IEEE 0 speedgoat_test_SN5659_R2021b_IO682_CM_double -1.7E+308 1.7E+308 /end CHARACTERISTIC
/begin CHARACTERISTIC speedgoat_test_SN5659__cal_impl.Encode3_P9 "" VALUE 0x0083A330 Scalar_FLOAT64_IEEE 0 speedgoat_test_SN5659_R2021b_IO682_CM_double -1.7E+308 1.7E+308 /end CHARACTERISTIC
/begin CHARACTERISTIC speedgoat_test_SN5659__cal_impl.Encode3_P9_g "" VALUE 0x0083A9A0 Scalar_FLOAT64_IEEE 0 speedgoat_test_SN5659_R2021b_IO682_CM_double -1.7E+308 1.7E+308 /end CHARACTERISTIC
/begin CHARACTERISTIC speedgoat_test_SN5659__cal_impl.Encode4_P1 "" VALUE 0x0083AA68 Scalar_FLOAT64_IEEE 0 speedgoat_test_SN5659_R2021b_IO682_CM_double -1.7E+308 1.7E+308 /end CHARACTERISTIC
/begin CHARACTERISTIC speedgoat_test_SN5659__cal_impl.Encode4_P10 "" VALUE 0x0083AB40 Scalar_FLOAT64_IEEE 0 speedgoat_test_SN5659_R2021b_IO682_CM_double -1.7E+308 1.7E+308 /end CHARACTERISTIC
/begin CHARACTERISTIC speedgoat_test_SN5659__cal_impl.Encode4_P11 "" VAL_BLK 0x0083AB58 Scalar_FLOAT64_IEEE 0 speedgoat_test_SN5659_R2021b_IO682_CM_double -1.7E+308 1.7E+308 MATRIX_DIM 2 1 /end CHARACTERISTIC
/begin CHARACTERISTIC speedgoat_test_SN5659__cal_impl.Encode4_P12 "" VALUE 0x0083AB78 Scalar_FLOAT64_IEEE 0 speedgoat_test_SN5659_R2021b_IO682_CM_double -1.7E+308 1.7E+308 /end CHARACTERISTIC
/begin CHARACTERISTIC speedgoat_test_SN5659__cal_impl.Encode4_P13 "" VALUE 0x0083AB90 Scalar_FLOAT64_IEEE 0 speedgoat_test_SN5659_R2021b_IO682_CM_double -1.7E+308 1.7E+308 /end CHARACTERISTIC
/begin CHARACTERISTIC speedgoat_test_SN5659__cal_impl.Encode4_P14 "" VALUE 0x0083ABA8 Scalar_FLOAT64_IEEE 0 speedgoat_test_SN5659_R2021b_IO682_CM_double -1.7E+308 1.7E+308 /end CHARACTERISTIC
/begin CHARACTERISTIC speedgoat_test_SN5659__cal_impl.Encode4_P15 "" VALUE 0x0083ABC0 Scalar_FLOAT64_IEEE 0 speedgoat_test_SN5659_R2021b_IO682_CM_double -1.7E+308 1.7E+308 /end CHARACTERISTIC
/begin CHARACTERISTIC speedgoat_test_SN5659__cal_impl.Encode4_P2 "" VALUE 0x0083AA80 Scalar_FLOAT64_IEEE 0 speedgoat_test_SN5659_R2021b_IO682_CM_double -1.7E+308 1.7E+308 /end CHARACTERISTIC
/begin CHARACTERISTIC speedgoat_test_SN5659__cal_impl.Encode4_P3 "" VALUE 0x0083AA98 Scalar_FLOAT64_IEEE 0 speedgoat_test_SN5659_R2021b_IO682_CM_double -1.7E+308 1.7E+308 /end CHARACTERISTIC
/begin CHARACTERISTIC speedgoat_test_SN5659__cal_impl.Encode4_P4 "" VALUE 0x0083AAB0 Scalar_FLOAT64_IEEE 0 speedgoat_test_SN5659_R2021b_IO682_CM_double -1.7E+308 1.7E+308 /end CHARACTERISTIC
/begin CHARACTERISTIC speedgoat_test_SN5659__cal_impl.Encode4_P5 "" VALUE 0x0083AAC8 Scalar_FLOAT64_IEEE 0 speedgoat_test_SN5659_R2021b_IO682_CM_double -1.7E+308 1.7E+308 /end CHARACTERISTIC
/begin CHARACTERISTIC speedgoat_test_SN5659__cal_impl.Encode4_P6 "" VALUE 0x0083AAE0 Scalar_FLOAT64_IEEE 0 speedgoat_test_SN5659_R2021b_IO682_CM_double -1.7E+308 1.7E+308 /end CHARACTERISTIC
/begin CHARACTERISTIC speedgoat_test_SN5659__cal_impl.Encode4_P7 "" VALUE 0x0083AAF8 Scalar_FLOAT64_IEEE 0 speedgoat_test_SN5659_R2021b_IO682_CM_double -1.7E+308 1.7E+308 /end CHARACTERISTIC
/begin CHARACTERISTIC speedgoat_test_SN5659__cal_impl.Encode4_P8 "" VALUE 0x0083AB10 Scalar_FLOAT64_IEEE 0 speedgoat_test_SN5659_R2021b_IO682_CM_double -1.7E+308 1.7E+308 /end CHARACTERISTIC
/begin CHARACTERISTIC speedgoat_test_SN5659__cal_impl.Encode4_P9 "" VALUE 0x0083AB28 Scalar_FLOAT64_IEEE 0 speedgoat_test_SN5659_R2021b_IO682_CM_double -1.7E+308 1.7E+308 /end CHARACTERISTIC
/begin CHARACTERISTIC speedgoat_test_SN5659__cal_impl.Encode5_P1 "" VALUE 0x0083A0C8 Scalar_FLOAT64_IEEE 0 speedgoat_test_SN5659_R2021b_IO682_CM_double -1.7E+308 1.7E+308 /end CHARACTERISTIC
/begin CHARACTERISTIC speedgoat_test_SN5659__cal_impl.Encode5_P10 "" VALUE 0x0083A1A0 Scalar_FLOAT64_IEEE 0 speedgoat_test_SN5659_R2021b_IO682_CM_double -1.7E+308 1.7E+308 /end CHARACTERISTIC
/begin CHARACTERISTIC speedgoat_test_SN5659__cal_impl.Encode5_P11 "" VAL_BLK 0x0083A1B8 Scalar_FLOAT64_IEEE 0 speedgoat_test_SN5659_R2021b_IO682_CM_double -1.7E+308 1.7E+308 MATRIX_DIM 2 1 /end CHARACTERISTIC
/begin CHARACTERISTIC speedgoat_test_SN5659__cal_impl.Encode5_P12 "" VALUE 0x0083A1D8 Scalar_FLOAT64_IEEE 0 speedgoat_test_SN5659_R2021b_IO682_CM_double -1.7E+308 1.7E+308 /end CHARACTERISTIC
/begin CHARACTERISTIC speedgoat_test_SN5659__cal_impl.Encode5_P13 "" VALUE 0x0083A1F0 Scalar_FLOAT64_IEEE 0 speedgoat_test_SN5659_R2021b_IO682_CM_double -1.7E+308 1.7E+308 /end CHARACTERISTIC
/begin CHARACTERISTIC speedgoat_test_SN5659__cal_impl.Encode5_P14 "" VALUE 0x0083A208 Scalar_FLOAT64_IEEE 0 speedgoat_test_SN5659_R2021b_IO682_CM_double -1.7E+308 1.7E+308 /end CHARACTERISTIC
/begin CHARACTERISTIC speedgoat_test_SN5659__cal_impl.Encode5_P15 "" VALUE 0x0083A220 Scalar_FLOAT64_IEEE 0 speedgoat_test_SN5659_R2021b_IO682_CM_double -1.7E+308 1.7E+308 /end CHARACTERISTIC
/begin CHARACTERISTIC speedgoat_test_SN5659__cal_impl.Encode5_P2 "" VALUE 0x0083A0E0 Scalar_FLOAT64_IEEE 0 speedgoat_test_SN5659_R2021b_IO682_CM_double -1.7E+308 1.7E+308 /end CHARACTERISTIC
/begin CHARACTERISTIC speedgoat_test_SN5659__cal_impl.Encode5_P3 "" VALUE 0x0083A0F8 Scalar_FLOAT64_IEEE 0 speedgoat_test_SN5659_R2021b_IO682_CM_double -1.7E+308 1.7E+308 /end CHARACTERISTIC
/begin CHARACTERISTIC speedgoat_test_SN5659__cal_impl.Encode5_P4 "" VALUE 0x0083A110 Scalar_FLOAT64_IEEE 0 speedgoat_test_SN5659_R2021b_IO682_CM_double -1.7E+308 1.7E+308 /end CHARACTERISTIC
/begin CHARACTERISTIC speedgoat_test_SN5659__cal_impl.Encode5_P5 "" VALUE 0x0083A128 Scalar_FLOAT64_IEEE 0 speedgoat_test_SN5659_R2021b_IO682_CM_double -1.7E+308 1.7E+308 /end CHARACTERISTIC
/begin CHARACTERISTIC speedgoat_test_SN5659__cal_impl.Encode5_P6 "" VALUE 0x0083A140 Scalar_FLOAT64_IEEE 0 speedgoat_test_SN5659_R2021b_IO682_CM_double -1.7E+308 1.7E+308 /end CHARACTERISTIC
/begin CHARACTERISTIC speedgoat_test_SN5659__cal_impl.Encode5_P7 "" VALUE 0x0083A158 Scalar_FLOAT64_IEEE 0 speedgoat_test_SN5659_R2021b_IO682_CM_double -1.7E+308 1.7E+308 /end CHARACTERISTIC
/begin CHARACTERISTIC speedgoat_test_SN5659__cal_impl.Encode5_P8 "" VALUE 0x0083A170 Scalar_FLOAT64_IEEE 0 speedgoat_test_SN5659_R2021b_IO682_CM_double -1.7E+308 1.7E+308 /end CHARACTERISTIC
/begin CHARACTERISTIC speedgoat_test_SN5659__cal_impl.Encode5_P9 "" VALUE 0x0083A188 Scalar_FLOAT64_IEEE 0 speedgoat_test_SN5659_R2021b_IO682_CM_double -1.7E+308 1.7E+308 /end CHARACTERISTIC
/begin CHARACTERISTIC speedgoat_test_SN5659__cal_impl.FixPtConstant_Value "" VALUE 0x008406F2 Scalar_UWORD 0 speedgoat_test_SN5659_R2021b_IO682_CM_uint16 0 65535 /end CHARACTERISTIC
/begin CHARACTERISTIC speedgoat_test_SN5659__cal_impl.Label_Value_d "" VALUE 0x00840644 Scalar_ULONG 0 speedgoat_test_SN5659_R2021b_IO682_CM_uint32 0 2147483646 /end CHARACTERISTIC
/begin CHARACTERISTIC speedgoat_test_SN5659__cal_impl.Mask_BitMask_h "" VALUE 0x00833024 Scalar_ULONG 0 speedgoat_test_SN5659_R2021b_IO682_CM_uint32 0 2147483646 /end CHARACTERISTIC
/begin CHARACTERISTIC speedgoat_test_SN5659__cal_impl.Output_InitialCondition "" VALUE 0x008406F0 Scalar_UWORD 0 speedgoat_test_SN5659_R2021b_IO682_CM_uint16 0 65535 /end CHARACTERISTIC
/begin CHARACTERISTIC speedgoat_test_SN5659__cal_impl.Randomnumber_Mean "" VALUE 0x00839F30 Scalar_FLOAT64_IEEE 0 speedgoat_test_SN5659_R2021b_IO682_CM_double -1.7E+308 1.7E+308 /end CHARACTERISTIC
/begin CHARACTERISTIC speedgoat_test_SN5659__cal_impl.Randomnumber_Mean_f "" VALUE 0x0083A5A0 Scalar_FLOAT64_IEEE 0 speedgoat_test_SN5659_R2021b_IO682_CM_double -1.7E+308 1.7E+308 /end CHARACTERISTIC
/begin CHARACTERISTIC speedgoat_test_SN5659__cal_impl.Randomnumber_Seed "" VALUE 0x00839F40 Scalar_FLOAT64_IEEE 0 speedgoat_test_SN5659_R2021b_IO682_CM_double -1.7E+308 1.7E+308 /end CHARACTERISTIC
/begin CHARACTERISTIC speedgoat_test_SN5659__cal_impl.Randomnumber_Seed_n "" VALUE 0x0083A5B0 Scalar_FLOAT64_IEEE 0 speedgoat_test_SN5659_R2021b_IO682_CM_double -1.7E+308 1.7E+308 /end CHARACTERISTIC
/begin CHARACTERISTIC speedgoat_test_SN5659__cal_impl.Randomnumber_StdDev "" VALUE 0x00839F38 Scalar_FLOAT64_IEEE 0 speedgoat_test_SN5659_R2021b_IO682_CM_double -1.7E+308 1.7E+308 /end CHARACTERISTIC
/begin CHARACTERISTIC speedgoat_test_SN5659__cal_impl.Randomnumber_StdDev_a "" VALUE 0x0083A5A8 Scalar_FLOAT64_IEEE 0 speedgoat_test_SN5659_R2021b_IO682_CM_double -1.7E+308 1.7E+308 /end CHARACTERISTIC
/begin CHARACTERISTIC speedgoat_test_SN5659__cal_impl.SDI_Value_d "" VALUE 0x00840640 Scalar_ULONG 0 speedgoat_test_SN5659_R2021b_IO682_CM_uint32 0 2147483646 /end CHARACTERISTIC
/begin CHARACTERISTIC speedgoat_test_SN5659__cal_impl.SSM_Value_o "" VALUE 0x0084063C Scalar_ULONG 0 speedgoat_test_SN5659_R2021b_IO682_CM_uint32 0 2147483646 /end CHARACTERISTIC
/begin CHARACTERISTIC speedgoat_test_SN5659__cal_impl.Scale_Value_l "" VALUE 0x0083AA48 Scalar_FLOAT64_IEEE 0 speedgoat_test_SN5659_R2021b_IO682_CM_double -1.7E+308 1.7E+308 /end CHARACTERISTIC
/begin CHARACTERISTIC speedgoat_test_SN5659__cal_impl.Sinewave_Amp "" VALUE 0x0083A228 Scalar_FLOAT64_IEEE 0 speedgoat_test_SN5659_R2021b_IO682_CM_double -1.7E+308 1.7E+308 /end CHARACTERISTIC
/begin CHARACTERISTIC speedgoat_test_SN5659__cal_impl.Sinewave_Amp_o "" VALUE 0x0083A898 Scalar_FLOAT64_IEEE 0 speedgoat_test_SN5659_R2021b_IO682_CM_double -1.7E+308 1.7E+308 /end CHARACTERISTIC
/begin CHARACTERISTIC speedgoat_test_SN5659__cal_impl.Sinewave_Bias "" VALUE 0x0083A230 Scalar_FLOAT64_IEEE 0 speedgoat_test_SN5659_R2021b_IO682_CM_double -1.7E+308 1.7E+308 /end CHARACTERISTIC
/begin CHARACTERISTIC speedgoat_test_SN5659__cal_impl.Sinewave_Bias_k "" VALUE 0x0083A8A0 Scalar_FLOAT64_IEEE 0 speedgoat_test_SN5659_R2021b_IO682_CM_double -1.7E+308 1.7E+308 /end CHARACTERISTIC
/begin CHARACTERISTIC speedgoat_test_SN5659__cal_impl.Sinewave_Freq "" VALUE 0x0083A238 Scalar_FLOAT64_IEEE 0 speedgoat_test_SN5659_R2021b_IO682_CM_double -1.7E+308 1.7E+308 /end CHARACTERISTIC
/begin CHARACTERISTIC speedgoat_test_SN5659__cal_impl.Sinewave_Freq_p "" VALUE 0x0083A8A8 Scalar_FLOAT64_IEEE 0 speedgoat_test_SN5659_R2021b_IO682_CM_double -1.7E+308 1.7E+308 /end CHARACTERISTIC
/begin CHARACTERISTIC speedgoat_test_SN5659__cal_impl.Sinewave_HCos "" VALUE 0x0083A248 Scalar_FLOAT64_IEEE 0 speedgoat_test_SN5659_R2021b_IO682_CM_double -1.7E+308 1.7E+308 /end CHARACTERISTIC
/begin CHARACTERISTIC speedgoat_test_SN5659__cal_impl.Sinewave_HCos_l "" VALUE 0x0083A8B8 Scalar_FLOAT64_IEEE 0 speedgoat_test_SN5659_R2021b_IO682_CM_double -1.7E+308 1.7E+308 /end CHARACTERISTIC
/begin CHARACTERISTIC speedgoat_test_SN5659__cal_impl.Sinewave_Hsin "" VALUE 0x0083A240 Scalar_FLOAT64_IEEE 0 speedgoat_test_SN5659_R2021b_IO682_CM_double -1.7E+308 1.7E+308 /end CHARACTERISTIC
/begin CHARACTERISTIC speedgoat_test_SN5659__cal_impl.Sinewave_Hsin_j "" VALUE 0x0083A8B0 Scalar_FLOAT64_IEEE 0 speedgoat_test_SN5659_R2021b_IO682_CM_double -1.7E+308 1.7E+308 /end CHARACTERISTIC
/begin CHARACTERISTIC speedgoat_test_SN5659__cal_impl.Sinewave_PCos "" VALUE 0x0083A258 Scalar_FLOAT64_IEEE 0 speedgoat_test_SN5659_R2021b_IO682_CM_double -1.7E+308 1.7E+308 /end CHARACTERISTIC
/begin CHARACTERISTIC speedgoat_test_SN5659__cal_impl.Sinewave_PCos_c "" VALUE 0x0083A8C8 Scalar_FLOAT64_IEEE 0 speedgoat_test_SN5659_R2021b_IO682_CM_double -1.7E+308 1.7E+308 /end CHARACTERISTIC
/begin CHARACTERISTIC speedgoat_test_SN5659__cal_impl.Sinewave_PSin "" VALUE 0x0083A250 Scalar_FLOAT64_IEEE 0 speedgoat_test_SN5659_R2021b_IO682_CM_double -1.7E+308 1.7E+308 /end CHARACTERISTIC
/begin CHARACTERISTIC speedgoat_test_SN5659__cal_impl.Sinewave_PSin_p "" VALUE 0x0083A8C0 Scalar_FLOAT64_IEEE 0 speedgoat_test_SN5659_R2021b_IO682_CM_double -1.7E+308 1.7E+308 /end CHARACTERISTIC
/begin CHARACTERISTIC speedgoat_test_SN5659__cal_impl.shiftthedoublevalue27bitsleft_o "" VALUE 0x0083AA50 Scalar_FLOAT64_IEEE 0 speedgoat_test_SN5659_R2021b_IO682_CM_double -1.7E+308 1.7E+308 /end CHARACTERISTIC
/begin MEASUREMENT speedgoat_test_SN5659_R2021b_IO682_B.BitwiseOperator_m "" ULONG speedgoat_test_SN5659_R2021b_IO682_CM_uint32 0 0 0 2147483646 ECU_ADDRESS 0x008953C4 /end MEASUREMENT
/begin MEASUREMENT speedgoat_test_SN5659_R2021b_IO682_B.DataTypeConversion "" FLOAT64_IEEE speedgoat_test_SN5659_R2021b_IO682_CM_double 0 0 -1.7E+308 1.7E+308 ECU_ADDRESS 0x00894EB0 /end MEASUREMENT
/begin MEASUREMENT speedgoat_test_SN5659_R2021b_IO682_B.DataTypeConversion1 "" FLOAT64_IEEE speedgoat_test_SN5659_R2021b_IO682_CM_double 0 0 -1.7E+308 1.7E+308 ECU_ADDRESS 0x00894EE0 /end MEASUREMENT
/begin MEASUREMENT speedgoat_test_SN5659_R2021b_IO682_B.DataTypeConversion1_g "" FLOAT64_IEEE speedgoat_test_SN5659_R2021b_IO682_CM_double 0 0 -1.7E+308 1.7E+308 ECU_ADDRESS 0x00894F30 /end MEASUREMENT
/begin MEASUREMENT speedgoat_test_SN5659_R2021b_IO682_B.DataTypeConversion_c "" ULONG speedgoat_test_SN5659_R2021b_IO682_CM_uint32 0 0 0 2147483646 ECU_ADDRESS 0x008953B4 /end MEASUREMENT
/begin MEASUREMENT speedgoat_test_SN5659_R2021b_IO682_B.DataTypeConversion_h "" FLOAT64_IEEE speedgoat_test_SN5659_R2021b_IO682_CM_double 0 0 -1.7E+308 1.7E+308 ECU_ADDRESS 0x00894F00 /end MEASUREMENT
/begin MEASUREMENT speedgoat_test_SN5659_R2021b_IO682_B.Decode1_b "" FLOAT64_IEEE speedgoat_test_SN5659_R2021b_IO682_CM_double 0 0 -1.7E+308 1.7E+308 ECU_ADDRESS 0x00894E60 /end MEASUREMENT
/begin MEASUREMENT speedgoat_test_SN5659_R2021b_IO682_B.Decode1_d "" FLOAT64_IEEE speedgoat_test_SN5659_R2021b_IO682_CM_double 0 0 -1.7E+308 1.7E+308 ECU_ADDRESS 0x00893668 /end MEASUREMENT
/begin MEASUREMENT speedgoat_test_SN5659_R2021b_IO682_B.Decode1_gi "" FLOAT64_IEEE speedgoat_test_SN5659_R2021b_IO682_CM_double 0 0 -1.7E+308 1.7E+308 ECU_ADDRESS 0x00894AB0 /end MEASUREMENT
/begin MEASUREMENT speedgoat_test_SN5659_R2021b_IO682_B.Decode1_io "" FLOAT64_IEEE speedgoat_test_SN5659_R2021b_IO682_CM_double 0 0 -1.7E+308 1.7E+308 ECU_ADDRESS 0x008948D8 /end MEASUREMENT
/begin MEASUREMENT speedgoat_test_SN5659_R2021b_IO682_B.Decode1_m "" FLOAT64_IEEE speedgoat_test_SN5659_R2021b_IO682_CM_double 0 0 -1.7E+308 1.7E+308 ECU_ADDRESS 0x00893490 /end MEASUREMENT
/begin MEASUREMENT speedgoat_test_SN5659_R2021b_IO682_B.Decode1_p "" FLOAT64_IEEE speedgoat_test_SN5659_R2021b_IO682_CM_double 0 0 -1.7E+308 1.7E+308 ECU_ADDRESS 0x00894528 /end MEASUREMENT
/begin MEASUREMENT speedgoat_test_SN5659_R2021b_IO682_B.Decode1_p1 "" FLOAT64_IEEE speedgoat_test_SN5659_R2021b_IO682_CM_double 0 0 -1.7E+308 1.7E+308 ECU_ADDRESS 0x00894C88 /end MEASUREMENT
/begin MEASUREMENT speedgoat_test_SN5659_R2021b_IO682_B.Decode1_pf "" FLOAT64_IEEE speedgoat_test_SN5659_R2021b_IO682_CM_double 0 0 -1.7E+308 1.7E+308 ECU_ADDRESS 0x00894700 /end MEASUREMENT
/begin MEASUREMENT speedgoat_test_SN5659_R2021b_IO682_B.Decode2 "" FLOAT64_IEEE speedgoat_test_SN5659_R2021b_IO682_CM_double 0 0 -1.7E+308 1.7E+308 ECU_ADDRESS 0x00893498 /end MEASUREMENT
/begin MEASUREMENT speedgoat_test_SN5659_R2021b_IO682_B.Decode2_ba "" FLOAT64_IEEE speedgoat_test_SN5659_R2021b_IO682_CM_double 0 0 -1.7E+308 1.7E+308 ECU_ADDRESS 0x00894530 /end MEASUREMENT
/begin MEASUREMENT speedgoat_test_SN5659_R2021b_IO682_B.Decode2_f "" FLOAT64_IEEE speedgoat_test_SN5659_R2021b_IO682_CM_double 0 0 -1.7E+308 1.7E+308 ECU_ADDRESS 0x00894AB8 /end MEASUREMENT
/begin MEASUREMENT speedgoat_test_SN5659_R2021b_IO682_B.Decode2_h "" FLOAT64_IEEE speedgoat_test_SN5659_R2021b_IO682_CM_double 0 0 -1.7E+308 1.7E+308 ECU_ADDRESS 0x00894C90 /end MEASUREMENT
/begin MEASUREMENT speedgoat_test_SN5659_R2021b_IO682_B.Decode2_k "" FLOAT64_IEEE speedgoat_test_SN5659_R2021b_IO682_CM_double 0 0 -1.7E+308 1.7E+308 ECU_ADDRESS 0x00894708 /end MEASUREMENT
/begin MEASUREMENT speedgoat_test_SN5659_R2021b_IO682_B.Decode2_nz "" FLOAT64_IEEE speedgoat_test_SN5659_R2021b_IO682_CM_double 0 0 -1.7E+308 1.7E+308 ECU_ADDRESS 0x00894E68 /end MEASUREMENT
/begin MEASUREMENT speedgoat_test_SN5659_R2021b_IO682_B.Decode3_a "" FLOAT64_IEEE speedgoat_test_SN5659_R2021b_IO682_CM_double 0 0 -1.7E+308 1.7E+308 ECU_ADDRESS 0x00894538 /end MEASUREMENT
/begin MEASUREMENT speedgoat_test_SN5659_R2021b_IO682_B.Decode3_b "" FLOAT64_IEEE speedgoat_test_SN5659_R2021b_IO682_CM_double 0 0 -1.7E+308 1.7E+308 ECU_ADDRESS 0x00894710 /end MEASUREMENT
/begin MEASUREMENT speedgoat_test_SN5659_R2021b_IO682_B.Decode3_c "" FLOAT64_IEEE speedgoat_test_SN5659_R2021b_IO682_CM_double 0 0 -1.7E+308 1.7E+308 ECU_ADDRESS 0x00893678 /end MEASUREMENT
/begin MEASUREMENT speedgoat_test_SN5659_R2021b_IO682_B.Decode3_l "" FLOAT64_IEEE speedgoat_test_SN5659_R2021b_IO682_CM_double 0 0 -1.7E+308 1.7E+308 ECU_ADDRESS 0x008934A0 /end MEASUREMENT
/begin MEASUREMENT speedgoat_test_SN5659_R2021b_IO682_B.Decode3_lc "" FLOAT64_IEEE speedgoat_test_SN5659_R2021b_IO682_CM_double 0 0 -1.7E+308 1.7E+308 ECU_ADDRESS 0x00894C98 /end MEASUREMENT
/begin MEASUREMENT speedgoat_test_SN5659_R2021b_IO682_B.Decode3_mj "" FLOAT64_IEEE speedgoat_test_SN5659_R2021b_IO682_CM_double 0 0 -1.7E+308 1.7E+308 ECU_ADDRESS 0x00894E70 /end MEASUREMENT
/begin MEASUREMENT speedgoat_test_SN5659_R2021b_IO682_B.Decode3_ny "" FLOAT64_IEEE speedgoat_test_SN5659_R2021b_IO682_CM_double 0 0 -1.7E+308 1.7E+308 ECU_ADDRESS 0x008948E8 /end MEASUREMENT
/begin MEASUREMENT speedgoat_test_SN5659_R2021b_IO682_B.Decode3_o4 "" FLOAT64_IEEE speedgoat_test_SN5659_R2021b_IO682_CM_double 0 0 -1.7E+308 1.7E+308 ECU_ADDRESS 0x00894AC0 /end MEASUREMENT
/begin MEASUREMENT speedgoat_test_SN5659_R2021b_IO682_B.Decode4_d "" FLOAT64_IEEE speedgoat_test_SN5659_R2021b_IO682_CM_double 0 0 -1.7E+308 1.7E+308 ECU_ADDRESS 0x008934A8 /end MEASUREMENT
/begin MEASUREMENT speedgoat_test_SN5659_R2021b_IO682_B.Decode4_f "" FLOAT64_IEEE speedgoat_test_SN5659_R2021b_IO682_CM_double 0 0 -1.7E+308 1.7E+308 ECU_ADDRESS 0x00894540 /end MEASUREMENT
/begin MEASUREMENT speedgoat_test_SN5659_R2021b_IO682_B.Decode4_f4 "" FLOAT64_IEEE speedgoat_test_SN5659_R2021b_IO682_CM_double 0 0 -1.7E+308 1.7E+308 ECU_ADDRESS 0x00894AC8 /end MEASUREMENT
/begin MEASUREMENT speedgoat_test_SN5659_R2021b_IO682_B.Decode4_ff "" FLOAT64_IEEE speedgoat_test_SN5659_R2021b_IO682_CM_double 0 0 -1.7E+308 1.7E+308 ECU_ADDRESS 0x00894718 /end MEASUREMENT
/begin MEASUREMENT speedgoat_test_SN5659_R2021b_IO682_B.Decode4_j "" FLOAT64_IEEE speedgoat_test_SN5659_R2021b_IO682_CM_double 0 0 -1.7E+308 1.7E+308 ECU_ADDRESS 0x008948F0 /end MEASUREMENT
/begin MEASUREMENT speedgoat_test_SN5659_R2021b_IO682_B.Decode4_l "" FLOAT64_IEEE speedgoat_test_SN5659_R2021b_IO682_CM_double 0 0 -1.7E+308 1.7E+308 ECU_ADDRESS 0x00894CA0 /end MEASUREMENT
/begin MEASUREMENT speedgoat_test_SN5659_R2021b_IO682_B.Decode4_m "" FLOAT64_IEEE speedgoat_test_SN5659_R2021b_IO682_CM_double 0 0 -1.7E+308 1.7E+308 ECU_ADDRESS 0x00894E78 /end MEASUREMENT
/begin MEASUREMENT speedgoat_test_SN5659_R2021b_IO682_B.Decode4_o "" FLOAT64_IEEE speedgoat_test_SN5659_R2021b_IO682_CM_double 0 0 -1.7E+308 1.7E+308 ECU_ADDRESS 0x00893680 /end MEASUREMENT
/begin MEASUREMENT speedgoat_test_SN5659_R2021b_IO682_B.Decode5_b "" FLOAT64_IEEE speedgoat_test_SN5659_R2021b_IO682_CM_double 0 0 -1.7E+308 1.7E+308 ECU_ADDRESS 0x008948E0 /end MEASUREMENT
/begin MEASUREMENT speedgoat_test_SN5659_R2021b_IO682_B.Decode5_p "" FLOAT64_IEEE speedgoat_test_SN5659_R2021b_IO682_CM_double 0 0 -1.7E+308 1.7E+308 ECU_ADDRESS 0x00893670 /end MEASUREMENT
/begin MEASUREMENT speedgoat_test_SN5659_R2021b_IO682_B.Divide_k "" FLOAT64_IEEE speedgoat_test_SN5659_R2021b_IO682_CM_double 0 0 -1.7E+308 1.7E+308 ECU_ADDRESS 0x00894F20 /end MEASUREMENT
/begin MEASUREMENT speedgoat_test_SN5659_R2021b_IO682_B.Encode1 "" FLOAT64_IEEE speedgoat_test_SN5659_R2021b_IO682_CM_double 0 0 -1.7E+308 1.7E+308 ECU_ADDRESS 0x00894EA8 /end MEASUREMENT
/begin MEASUREMENT speedgoat_test_SN5659_R2021b_IO682_B.Encode1_b "" FLOAT64_IEEE speedgoat_test_SN5659_R2021b_IO682_CM_double 0 0 -1.7E+308 1.7E+308 ECU_ADDRESS 0x00894EF8 /end MEASUREMENT
/begin MEASUREMENT speedgoat_test_SN5659_R2021b_IO682_B.Encode2 "" FLOAT64_IEEE speedgoat_test_SN5659_R2021b_IO682_CM_double 0 0 -1.7E+308 1.7E+308 ECU_ADDRESS 0x00894EE8 /end MEASUREMENT
/begin MEASUREMENT speedgoat_test_SN5659_R2021b_IO682_B.Encode2_p "" FLOAT64_IEEE speedgoat_test_SN5659_R2021b_IO682_CM_double 0 0 -1.7E+308 1.7E+308 ECU_ADDRESS 0x00894F08 /end MEASUREMENT
/begin MEASUREMENT speedgoat_test_SN5659_R2021b_IO682_B.Encode3 "" FLOAT64_IEEE speedgoat_test_SN5659_R2021b_IO682_CM_double 0 0 -1.7E+308 1.7E+308 ECU_ADDRESS 0x00894EC8 /end MEASUREMENT
/begin MEASUREMENT speedgoat_test_SN5659_R2021b_IO682_B.Encode3_i "" FLOAT64_IEEE speedgoat_test_SN5659_R2021b_IO682_CM_double 0 0 -1.7E+308 1.7E+308 ECU_ADDRESS 0x00894F18 /end MEASUREMENT
/begin MEASUREMENT speedgoat_test_SN5659_R2021b_IO682_B.Encode4 "" FLOAT64_IEEE speedgoat_test_SN5659_R2021b_IO682_CM_double 0 0 -1.7E+308 1.7E+308 ECU_ADDRESS 0x00894F38 /end MEASUREMENT
/begin MEASUREMENT speedgoat_test_SN5659_R2021b_IO682_B.Encode5 "" FLOAT64_IEEE speedgoat_test_SN5659_R2021b_IO682_CM_double 0 0 -1.7E+308 1.7E+308 ECU_ADDRESS 0x00894EB8 /end MEASUREMENT
/begin MEASUREMENT speedgoat_test_SN5659_R2021b_IO682_B.FixPtSum1 "" UWORD speedgoat_test_SN5659_R2021b_IO682_CM_uint16 0 0 0 65535 ECU_ADDRESS 0x008954E2 /end MEASUREMENT
/begin MEASUREMENT speedgoat_test_SN5659_R2021b_IO682_B.FixPtSwitch "" UWORD speedgoat_test_SN5659_R2021b_IO682_CM_uint16 0 0 0 65535 ECU_ADDRESS 0x008954E4 /end MEASUREMENT
/begin MEASUREMENT speedgoat_test_SN5659_R2021b_IO682_B.Mask_a "" ULONG speedgoat_test_SN5659_R2021b_IO682_CM_uint32 0 0 0 2147483646 ECU_ADDRESS 0x008953B8 /end MEASUREMENT
/begin MEASUREMENT speedgoat_test_SN5659_R2021b_IO682_B.Multiply_h "" FLOAT64_IEEE speedgoat_test_SN5659_R2021b_IO682_CM_double 0 0 -1.7E+308 1.7E+308 ECU_ADDRESS 0x00894F28 /end MEASUREMENT
/begin MEASUREMENT speedgoat_test_SN5659_R2021b_IO682_B.Output "" UWORD speedgoat_test_SN5659_R2021b_IO682_CM_uint16 0 0 0 65535 ECU_ADDRESS 0x008954E0 /end MEASUREMENT
/begin MEASUREMENT speedgoat_test_SN5659_R2021b_IO682_B.Output_o "" UBYTE speedgoat_test_SN5659_R2021b_IO682_CM_uint8 0 0 0 255 ECU_ADDRESS 0x00895534 /end MEASUREMENT
/begin MEASUREMENT speedgoat_test_SN5659_R2021b_IO682_B.Randomnumber "" FLOAT64_IEEE speedgoat_test_SN5659_R2021b_IO682_CM_double 0 0 -1.7E+308 1.7E+308 ECU_ADDRESS 0x00894EA0 /end MEASUREMENT
/begin MEASUREMENT speedgoat_test_SN5659_R2021b_IO682_B.Randomnumber_c "" FLOAT64_IEEE speedgoat_test_SN5659_R2021b_IO682_CM_double 0 0 -1.7E+308 1.7E+308 ECU_ADDRESS 0x00894EF0 /end MEASUREMENT
/begin MEASUREMENT speedgoat_test_SN5659_R2021b_IO682_B.ShifttoSDIslot_l "" ULONG speedgoat_test_SN5659_R2021b_IO682_CM_uint32 0 0 0 2147483646 ECU_ADDRESS 0x008953C0 /end MEASUREMENT
/begin MEASUREMENT speedgoat_test_SN5659_R2021b_IO682_B.ShifttoSSMslot_h "" ULONG speedgoat_test_SN5659_R2021b_IO682_CM_uint32 0 0 0 2147483646 ECU_ADDRESS 0x008953BC /end MEASUREMENT
/begin MEASUREMENT speedgoat_test_SN5659_R2021b_IO682_B.Sinewave "" FLOAT64_IEEE speedgoat_test_SN5659_R2021b_IO682_CM_double 0 0 -1.7E+308 1.7E+308 ECU_ADDRESS 0x00894EC0 /end MEASUREMENT
/begin MEASUREMENT speedgoat_test_SN5659_R2021b_IO682_B.Sinewave_o "" FLOAT64_IEEE speedgoat_test_SN5659_R2021b_IO682_CM_double 0 0 -1.7E+308 1.7E+308 ECU_ADDRESS 0x00894F10 /end MEASUREMENT
/begin MEASUREMENT speedgoat_test_SN5659_R2021b_IO682_DW.NextOutput "" FLOAT64_IEEE speedgoat_test_SN5659_R2021b_IO682_CM_double 0 0 -1.7E+308 1.7E+308 ECU_ADDRESS 0x00892760 /end MEASUREMENT
/begin MEASUREMENT speedgoat_test_SN5659_R2021b_IO682_DW.NextOutput_a "" FLOAT64_IEEE speedgoat_test_SN5659_R2021b_IO682_CM_double 0 0 -1.7E+308 1.7E+308 ECU_ADDRESS 0x00892778 /end MEASUREMENT
/begin MEASUREMENT speedgoat_test_SN5659_R2021b_IO682_DW.Output_DSTATE "" UWORD speedgoat_test_SN5659_R2021b_IO682_CM_uint16 0 0 0 65535 ECU_ADDRESS 0x008930F0 /end MEASUREMENT
/begin MEASUREMENT speedgoat_test_SN5659_R2021b_IO682_DW.RandSeed "" ULONG speedgoat_test_SN5659_R2021b_IO682_CM_uint32 0 0 0 2147483646 ECU_ADDRESS 0x00892EB0 /end MEASUREMENT
/begin MEASUREMENT speedgoat_test_SN5659_R2021b_IO682_DW.RandSeed_m "" ULONG speedgoat_test_SN5659_R2021b_IO682_CM_uint32 0 0 0 2147483646 ECU_ADDRESS 0x00892EB4 /end MEASUREMENT
/begin MEASUREMENT speedgoat_test_SN5659_R2021b_IO682_DW.lastCos "" FLOAT64_IEEE speedgoat_test_SN5659_R2021b_IO682_CM_double 0 0 -1.7E+308 1.7E+308 ECU_ADDRESS 0x00892770 /end MEASUREMENT
/begin MEASUREMENT speedgoat_test_SN5659_R2021b_IO682_DW.lastCos_p "" FLOAT64_IEEE speedgoat_test_SN5659_R2021b_IO682_CM_double 0 0 -1.7E+308 1.7E+308 ECU_ADDRESS 0x00892788 /end MEASUREMENT
/begin MEASUREMENT speedgoat_test_SN5659_R2021b_IO682_DW.lastSin "" FLOAT64_IEEE speedgoat_test_SN5659_R2021b_IO682_CM_double 0 0 -1.7E+308 1.7E+308 ECU_ADDRESS 0x00892768 /end MEASUREMENT
/begin MEASUREMENT speedgoat_test_SN5659_R2021b_IO682_DW.lastSin_c "" FLOAT64_IEEE speedgoat_test_SN5659_R2021b_IO682_CM_double 0 0 -1.7E+308 1.7E+308 ECU_ADDRESS 0x00892780 /end MEASUREMENT
/begin MEASUREMENT speedgoat_test_SN5659_R2021b_IO682_DW.systemEnable "" SLONG speedgoat_test_SN5659_R2021b_IO682_CM_int32 0 0 -2147483648 2147483647 ECU_ADDRESS 0x00892E70 /end MEASUREMENT
/begin MEASUREMENT speedgoat_test_SN5659_R2021b_IO682_DW.systemEnable_n "" SLONG speedgoat_test_SN5659_R2021b_IO682_CM_int32 0 0 -2147483648 2147483647 ECU_ADDRESS 0x00892E74 /end MEASUREMENT
/begin COMPU_METHOD speedgoat_test_SN5659_R2021b_IO682_CM_double "" IDENTICAL "%15.10" "" /end COMPU_METHOD
/begin COMPU_METHOD speedgoat_test_SN5659_R2021b_IO682_CM_int32 "" IDENTICAL "%10.0" "" /end COMPU_METHOD
/begin COMPU_METHOD speedgoat_test_SN5659_R2021b_IO682_CM_uint16 "" IDENTICAL "%5.0" "" /end COMPU_METHOD
/begin COMPU_METHOD speedgoat_test_SN5659_R2021b_IO682_CM_uint32 "" IDENTICAL "%10.0" "" /end COMPU_METHOD
/begin COMPU_METHOD speedgoat_test_SN5659_R2021b_IO682_CM_uint8 "" IDENTICAL "%3.0" "" /end COMPU_METHOD
/begin RECORD_LAYOUT Scalar_FLOAT64_IEEE FNC_VALUES 1 FLOAT64_IEEE COLUMN_DIR DIRECT /end RECORD_LAYOUT
/begin RECORD_LAYOUT Scalar_ULONG FNC_VALUES 1 ULONG COLUMN_DIR DIRECT /end RECORD_LAYOUT
/begin RECORD_LAYOUT Scalar_UWORD FNC_VALUES 1 UWORD COLUMN_DIR DIRECT /end RECORD_LAYOUT
/begin GROUP speedgoat_test_SN5659_R2021b_IO682_IO682_Decode_Channel_2 "speedgoat_test_SN5659_R2021b_IO682/IO682/Decode Channel 2"
 /begin REF_CHARACTERISTIC speedgoat_test_SN5659__cal_impl.Decode1_P10_k speedgoat_test_SN5659__cal_impl.Decode1_P11_e speedgoat_test_SN5659__cal_impl.Decode1_P12_p speedgoat_test_SN5659__cal_impl.Decode1_P13_a speedgoat_test_SN5659__cal_impl.Decode1_P14_o speedgoat_test_SN5659__cal_impl.Decode1_P15_l speedgoat_test_SN5659__cal_impl.Decode1_P16_j speedgoat_test_SN5659__cal_impl.Decode1_P1_c speedgoat_test_SN5659__cal_impl.Decode1_P2_g speedgoat_test_SN5659__cal_impl.Decode1_P3_b speedgoat_test_SN5659__cal_impl.Decode1_P4_b speedgoat_test_SN5659__cal_impl.Decode1_P5_f speedgoat_test_SN5659__cal_impl.Decode1_P6_f speedgoat_test_SN5659__cal_impl.Decode1_P7_h speedgoat_test_SN5659__cal_impl.Decode1_P8_c speedgoat_test_SN5659__cal_impl.Decode1_P9_p speedgoat_test_SN5659__cal_impl.Decode2_P1 speedgoat_test_SN5659__cal_impl.Decode2_P10 speedgoat_test_SN5659__cal_impl.Decode2_P11 speedgoat_test_SN5659__cal_impl.Decode2_P12 speedgoat_test_SN5659__cal_impl.Decode2_P13 speedgoat_test_SN5659__cal_impl.Decode2_P14 speedgoat_test_SN5659__cal_impl.Decode2_P15 speedgoat_test_SN5659__cal_impl.Decode2_P16 speedgoat_test_SN5659__cal_impl.Decode2_P2 speedgoat_test_SN5659__cal_impl.Decode2_P3 speedgoat_test_SN5659__cal_impl.Decode2_P4 speedgoat_test_SN5659__cal_impl.Decode2_P5 speedgoat_test_SN5659__cal_impl.Decode2_P6 speedgoat_test_SN5659__cal_impl.Decode2_P7 speedgoat_test_SN5659__cal_impl.Decode2_P8 speedgoat_test_SN5659__cal_impl.Decode2_P9 speedgoat_test_SN5659__cal_impl.Decode3_P10_a speedgoat_test_SN5659__cal_impl.Decode3_P11_b speedgoat_test_SN5659__cal_impl.Decode3_P12_p speedgoat_test_SN5659__cal_impl.Decode3_P13_d speedgoat_test_SN5659__cal_impl.Decode3_P14_j speedgoat_test_SN5659__cal_impl.Decode3_P15_d speedgoat_test_SN5659__cal_impl.Decode3_P16_b speedgoat_test_SN5659__cal_impl.Decode3_P1_a speedgoat_test_SN5659__cal_impl.Decode3_P2_l speedgoat_test_SN5659__cal_impl.Decode3_P3_p speedgoat_test_SN5659__cal_impl.Decode3_P4_m speedgoat_test_SN5659__cal_impl.Decode3_P5_c speedgoat_test_SN5659__cal_impl.Decode3_P6_k speedgoat_test_SN5659__cal_impl.Decode3_P7_k speedgoat_test_SN5659__cal_impl.Decode3_P8_g speedgoat_test_SN5659__cal_impl.Decode3_P9_h speedgoat_test_SN5659__cal_impl.Decode4_P10_b speedgoat_test_SN5659__cal_impl.Decode4_P11_m speedgoat_test_SN5659__cal_impl.Decode4_P12_d speedgoat_test_SN5659__cal_impl.Decode4_P13_p speedgoat_test_SN5659__cal_impl.Decode4_P14_h speedgoat_test_SN5659__cal_impl.Decode4_P15_c speedgoat_test_SN5659__cal_impl.Decode4_P16_g speedgoat_test_SN5659__cal_impl.Decode4_P1_g speedgoat_test_SN5659__cal_impl.Decode4_P2_p speedgoat_test_SN5659__cal_impl.Decode4_P3_c speedgoat_test_SN5659__cal_impl.Decode4_P4_e speedgoat_test_SN5659__cal_impl.Decode4_P5_p speedgoat_test_SN5659__cal_impl.Decode4_P6_h speedgoat_test_SN5659__cal_impl.Decode4_P7_f speedgoat_test_SN5659__cal_impl.Decode4_P8_b speedgoat_test_SN5659__cal_impl.Decode4_P9_a /end REF_CHARACTERISTIC
 /begin REF_MEASUREMENT speedgoat_test_SN5659_R2021b_IO682_B.Decode1_m speedgoat_test_SN5659_R2021b_IO682_B.Decode2 speedgoat_test_SN5659_R2021b_IO682_B.Decode3_l speedgoat_test_SN5659_R2021b_IO682_B.Decode4_d /end REF_MEASUREMENT
/end GROUP
/begin GROUP speedgoat_test_SN5659_R2021b_IO682_IO682_Decode_Channel_3 "speedgoat_test_SN5659_R2021b_IO682/IO682/Decode Channel 3"
 /begin REF_CHARACTERISTIC speedgoat_test_SN5659__cal_impl.Decode1_P10_aa speedgoat_test_SN5659__cal_impl.Decode1_P11_ei speedgoat_test_SN5659__cal_impl.Decode1_P12_jm speedgoat_test_SN5659__cal_impl.Decode1_P13_e speedgoat_test_SN5659__cal_impl.Decode1_P14_id speedgoat_test_SN5659__cal_impl.Decode1_P15_l0 speedgoat_test_SN5659__cal_impl.Decode1_P16_g speedgoat_test_SN5659__cal_impl.Decode1_P1_p speedgoat_test_SN5659__cal_impl.Decode1_P2_d speedgoat_test_SN5659__cal_impl.Decode1_P3_n speedgoat_test_SN5659__cal_impl.Decode1_P4_pr speedgoat_test_SN5659__cal_impl.Decode1_P5_p speedgoat_test_SN5659__cal_impl.Decode1_P6_o speedgoat_test_SN5659__cal_impl.Decode1_P7_bo speedgoat_test_SN5659__cal_impl.Decode1_P8_ga speedgoat_test_SN5659__cal_impl.Decode1_P9_c speedgoat_test_SN5659__cal_impl.Decode2_P10_bf speedgoat_test_SN5659__cal_impl.Decode2_P11_ff speedgoat_test_SN5659__cal_impl.Decode2_P12_b speedgoat_test_SN5659__cal_impl.Decode2_P13_c speedgoat_test_SN5659__cal_impl.Decode2_P14_f2 speedgoat_test_SN5659__cal_impl.Decode2_P15_go speedgoat_test_SN5659__cal_impl.Decode2_P16_cw speedgoat_test_SN5659__cal_impl.Decode2_P1_i speedgoat_test_SN5659__cal_impl.Decode2_P2_ef speedgoat_test_SN5659__cal_impl.Decode2_P3_c speedgoat_test_SN5659__cal_impl.Decode2_P4_e speedgoat_test_SN5659__cal_impl.Decode2_P5_l speedgoat_test_SN5659__cal_impl.Decode2_P6_n speedgoat_test_SN5659__cal_impl.Decode2_P7_ja speedgoat_test_SN5659__cal_impl.Decode2_P8_g speedgoat_test_SN5659__cal_impl.Decode2_P9_e speedgoat_test_SN5659__cal_impl.Decode3_P10_i speedgoat_test_SN5659__cal_impl.Decode3_P11_m speedgoat_test_SN5659__cal_impl.Decode3_P12_ls speedgoat_test_SN5659__cal_impl.Decode3_P13_ez speedgoat_test_SN5659__cal_impl.Decode3_P14_m speedgoat_test_SN5659__cal_impl.Decode3_P15_h speedgoat_test_SN5659__cal_impl.Decode3_P16_g speedgoat_test_SN5659__cal_impl.Decode3_P1_m speedgoat_test_SN5659__cal_impl.Decode3_P2_c speedgoat_test_SN5659__cal_impl.Decode3_P3_i speedgoat_test_SN5659__cal_impl.Decode3_P4_m4 speedgoat_test_SN5659__cal_impl.Decode3_P5_nh speedgoat_test_SN5659__cal_impl.Decode3_P6_l speedgoat_test_SN5659__cal_impl.Decode3_P7_bv speedgoat_test_SN5659__cal_impl.Decode3_P8_ig speedgoat_test_SN5659__cal_impl.Decode3_P9_m5 speedgoat_test_SN5659__cal_impl.Decode4_P10_o speedgoat_test_SN5659__cal_impl.Decode4_P11_j speedgoat_test_SN5659__cal_impl.Decode4_P12_j speedgoat_test_SN5659__cal_impl.Decode4_P13_io speedgoat_test_SN5659__cal_impl.Decode4_P14_l4 speedgoat_test_SN5659__cal_impl.Decode4_P15_dv speedgoat_test_SN5659__cal_impl.Decode4_P16_j speedgoat_test_SN5659__cal_impl.Decode4_P1_f speedgoat_test_SN5659__cal_impl.Decode4_P2_pq speedgoat_test_SN5659__cal_impl.Decode4_P3_k speedgoat_test_SN5659__cal_impl.Decode4_P4_ft speedgoat_test_SN5659__cal_impl.Decode4_P5_d speedgoat_test_SN5659__cal_impl.Decode4_P6_m speedgoat_test_SN5659__cal_impl.Decode4_P7_nw speedgoat_test_SN5659__cal_impl.Decode4_P8_n speedgoat_test_SN5659__cal_impl.Decode4_P9_dp /end REF_CHARACTERISTIC
 /begin REF_MEASUREMENT speedgoat_test_SN5659_R2021b_IO682_B.Decode1_p speedgoat_test_SN5659_R2021b_IO682_B.Decode2_ba speedgoat_test_SN5659_R2021b_IO682_B.Decode3_a speedgoat_test_SN5659_R2021b_IO682_B.Decode4_f /end REF_MEASUREMENT
/end GROUP
/begin GROUP speedgoat_test_SN5659_R2021b_IO682_IO682_Decode_Channel_4 "speedgoat_test_SN5659_R2021b_IO682/IO682/Decode Channel 4"
 /begin REF_CHARACTERISTIC speedgoat_test_SN5659__cal_impl.Decode1_P10_d speedgoat_test_SN5659__cal_impl.Decode1_P11_c speedgoat_test_SN5659__cal_impl.Decode1_P12_po speedgoat_test_SN5659__cal_impl.Decode1_P13_p speedgoat_test_SN5659__cal_impl.Decode1_P14_da speedgoat_test_SN5659__cal_impl.Decode1_P15_gw speedgoat_test_SN5659__cal_impl.Decode1_P16_be speedgoat_test_SN5659__cal_impl.Decode1_P1_k speedgoat_test_SN5659__cal_impl.Decode1_P2_e1 speedgoat_test_SN5659__cal_impl.Decode1_P3_ng speedgoat_test_SN5659__cal_impl.Decode1_P4_h speedgoat_test_SN5659__cal_impl.Decode1_P5_d speedgoat_test_SN5659__cal_impl.Decode1_P6_pa speedgoat_test_SN5659__cal_impl.Decode1_P7_l speedgoat_test_SN5659__cal_impl.Decode1_P8_o speedgoat_test_SN5659__cal_impl.Decode1_P9_a speedgoat_test_SN5659__cal_impl.Decode2_P10_f speedgoat_test_SN5659__cal_impl.Decode2_P11_fz speedgoat_test_SN5659__cal_impl.Decode2_P12_bf speedgoat_test_SN5659__cal_impl.Decode2_P13_m speedgoat_test_SN5659__cal_impl.Decode2_P14_j speedgoat_test_SN5659__cal_impl.Decode2_P15_jl speedgoat_test_SN5659__cal_impl.Decode2_P16_f speedgoat_test_SN5659__cal_impl.Decode2_P1_p speedgoat_test_SN5659__cal_impl.Decode2_P2_kc speedgoat_test_SN5659__cal_impl.Decode2_P3_i speedgoat_test_SN5659__cal_impl.Decode2_P4_b speedgoat_test_SN5659__cal_impl.Decode2_P5_d speedgoat_test_SN5659__cal_impl.Decode2_P6_m speedgoat_test_SN5659__cal_impl.Decode2_P7_h speedgoat_test_SN5659__cal_impl.Decode2_P8_bd speedgoat_test_SN5659__cal_impl.Decode2_P9_lp speedgoat_test_SN5659__cal_impl.Decode3_P10_oo speedgoat_test_SN5659__cal_impl.Decode3_P11_mj speedgoat_test_SN5659__cal_impl.Decode3_P12_kuc speedgoat_test_SN5659__cal_impl.Decode3_P13_my speedgoat_test_SN5659__cal_impl.Decode3_P14_c speedgoat_test_SN5659__cal_impl.Decode3_P15_k speedgoat_test_SN5659__cal_impl.Decode3_P16_p speedgoat_test_SN5659__cal_impl.Decode3_P1_mu speedgoat_test_SN5659__cal_impl.Decode3_P2_ow speedgoat_test_SN5659__cal_impl.Decode3_P3_ht speedgoat_test_SN5659__cal_impl.Decode3_P4_g speedgoat_test_SN5659__cal_impl.Decode3_P5_e speedgoat_test_SN5659__cal_impl.Decode3_P6_g speedgoat_test_SN5659__cal_impl.Decode3_P7_m speedgoat_test_SN5659__cal_impl.Decode3_P8_a speedgoat_test_SN5659__cal_impl.Decode3_P9_dw speedgoat_test_SN5659__cal_impl.Decode4_P10_bv speedgoat_test_SN5659__cal_impl.Decode4_P11_a speedgoat_test_SN5659__cal_impl.Decode4_P12_nu speedgoat_test_SN5659__cal_impl.Decode4_P13_aq speedgoat_test_SN5659__cal_impl.Decode4_P14_dy speedgoat_test_SN5659__cal_impl.Decode4_P15_n speedgoat_test_SN5659__cal_impl.Decode4_P16_gq speedgoat_test_SN5659__cal_impl.Decode4_P1_px speedgoat_test_SN5659__cal_impl.Decode4_P2_e speedgoat_test_SN5659__cal_impl.Decode4_P3_g speedgoat_test_SN5659__cal_impl.Decode4_P4_g speedgoat_test_SN5659__cal_impl.Decode4_P5_cm speedgoat_test_SN5659__cal_impl.Decode4_P6_awi speedgoat_test_SN5659__cal_impl.Decode4_P7_h0 speedgoat_test_SN5659__cal_impl.Decode4_P8_p speedgoat_test_SN5659__cal_impl.Decode4_P9_p /end REF_CHARACTERISTIC
 /begin REF_MEASUREMENT speedgoat_test_SN5659_R2021b_IO682_B.Decode1_pf speedgoat_test_SN5659_R2021b_IO682_B.Decode2_k speedgoat_test_SN5659_R2021b_IO682_B.Decode3_b speedgoat_test_SN5659_R2021b_IO682_B.Decode4_ff /end REF_MEASUREMENT
/end GROUP
/begin GROUP speedgoat_test_SN5659_R2021b_IO682_IO682_Decode_Channel_5 "speedgoat_test_SN5659_R2021b_IO682/IO682/Decode Channel 5"
 /begin REF_CHARACTERISTIC speedgoat_test_SN5659__cal_impl.Decode1_P10_j speedgoat_test_SN5659__cal_impl.Decode1_P11_ee speedgoat_test_SN5659__cal_impl.Decode1_P12_d5 speedgoat_test_SN5659__cal_impl.Decode1_P13_ad speedgoat_test_SN5659__cal_impl.Decode1_P14_j speedgoat_test_SN5659__cal_impl.Decode1_P15_au speedgoat_test_SN5659__cal_impl.Decode1_P16_l speedgoat_test_SN5659__cal_impl.Decode1_P1_h speedgoat_test_SN5659__cal_impl.Decode1_P2_c speedgoat_test_SN5659__cal_impl.Decode1_P3_d speedgoat_test_SN5659__cal_impl.Decode1_P4_me speedgoat_test_SN5659__cal_impl.Decode1_P5_d5 speedgoat_test_SN5659__cal_impl.Decode1_P6_i3 speedgoat_test_SN5659__cal_impl.Decode1_P7_d3 speedgoat_test_SN5659__cal_impl.Decode1_P8_c5 speedgoat_test_SN5659__cal_impl.Decode1_P9_pu speedgoat_test_SN5659__cal_impl.Decode3_P10_k5 speedgoat_test_SN5659__cal_impl.Decode3_P11_bg speedgoat_test_SN5659__cal_impl.Decode3_P12_pa speedgoat_test_SN5659__cal_impl.Decode3_P13_k speedgoat_test_SN5659__cal_impl.Decode3_P14_nc speedgoat_test_SN5659__cal_impl.Decode3_P15_n speedgoat_test_SN5659__cal_impl.Decode3_P16_i speedgoat_test_SN5659__cal_impl.Decode3_P1_n speedgoat_test_SN5659__cal_impl.Decode3_P2_pu speedgoat_test_SN5659__cal_impl.Decode3_P3_e speedgoat_test_SN5659__cal_impl.Decode3_P4_jl speedgoat_test_SN5659__cal_impl.Decode3_P5_o speedgoat_test_SN5659__cal_impl.Decode3_P6_ib speedgoat_test_SN5659__cal_impl.Decode3_P7_fx speedgoat_test_SN5659__cal_impl.Decode3_P8_b speedgoat_test_SN5659__cal_impl.Decode3_P9_dy speedgoat_test_SN5659__cal_impl.Decode4_P10_mz speedgoat_test_SN5659__cal_impl.Decode4_P11_c speedgoat_test_SN5659__cal_impl.Decode4_P12_ff speedgoat_test_SN5659__cal_impl.Decode4_P13_n speedgoat_test_SN5659__cal_impl.Decode4_P14_lo speedgoat_test_SN5659__cal_impl.Decode4_P15_p speedgoat_test_SN5659__cal_impl.Decode4_P16_ec speedgoat_test_SN5659__cal_impl.Decode4_P1_m speedgoat_test_SN5659__cal_impl.Decode4_P2_h speedgoat_test_SN5659__cal_impl.Decode4_P3_n speedgoat_test_SN5659__cal_impl.Decode4_P4_b speedgoat_test_SN5659__cal_impl.Decode4_P5_m speedgoat_test_SN5659__cal_impl.Decode4_P6_d speedgoat_test_SN5659__cal_impl.Decode4_P7_a speedgoat_test_SN5659__cal_impl.Decode4_P8_l speedgoat_test_SN5659__cal_impl.Decode4_P9_p0 speedgoat_test_SN5659__cal_impl.Decode5_P10_k2 speedgoat_test_SN5659__cal_impl.Decode5_P11_i speedgoat_test_SN5659__cal_impl.Decode5_P12_h speedgoat_test_SN5659__cal_impl.Decode5_P13_p speedgoat_test_SN5659__cal_impl.Decode5_P14_cm speedgoat_test_SN5659__cal_impl.Decode5_P15_b speedgoat_test_SN5659__cal_impl.Decode5_P16_o speedgoat_test_SN5659__cal_impl.Decode5_P1_p speedgoat_test_SN5659__cal_impl.Decode5_P2_f0 speedgoat_test_SN5659__cal_impl.Decode5_P3_o speedgoat_test_SN5659__cal_impl.Decode5_P4_f5 speedgoat_test_SN5659__cal_impl.Decode5_P5_d speedgoat_test_SN5659__cal_impl.Decode5_P6_c speedgoat_test_SN5659__cal_impl.Decode5_P7_m speedgoat_test_SN5659__cal_impl.Decode5_P8_c speedgoat_test_SN5659__cal_impl.Decode5_P9_h /end REF_CHARACTERISTIC
 /begin REF_MEASUREMENT speedgoat_test_SN5659_R2021b_IO682_B.Decode1_io speedgoat_test_SN5659_R2021b_IO682_B.Decode3_ny speedgoat_test_SN5659_R2021b_IO682_B.Decode4_j speedgoat_test_SN5659_R2021b_IO682_B.Decode5_b /end REF_MEASUREMENT
/end GROUP
/begin GROUP speedgoat_test_SN5659_R2021b_IO682_IO682_Decode_Channel_6 "speedgoat_test_SN5659_R2021b_IO682/IO682/Decode Channel 6"
 /begin REF_CHARACTERISTIC speedgoat_test_SN5659__cal_impl.Decode1_P10_e1 speedgoat_test_SN5659__cal_impl.Decode1_P11_al speedgoat_test_SN5659__cal_impl.Decode1_P12_kj speedgoat_test_SN5659__cal_impl.Decode1_P13_m speedgoat_test_SN5659__cal_impl.Decode1_P14_a speedgoat_test_SN5659__cal_impl.Decode1_P15_aw speedgoat_test_SN5659__cal_impl.Decode1_P16_eq speedgoat_test_SN5659__cal_impl.Decode1_P1_cw speedgoat_test_SN5659__cal_impl.Decode1_P2_bu speedgoat_test_SN5659__cal_impl.Decode1_P3_a speedgoat_test_SN5659__cal_impl.Decode1_P4_j speedgoat_test_SN5659__cal_impl.Decode1_P5_m3 speedgoat_test_SN5659__cal_impl.Decode1_P6_bi speedgoat_test_SN5659__cal_impl.Decode1_P7_m1 speedgoat_test_SN5659__cal_impl.Decode1_P8_f speedgoat_test_SN5659__cal_impl.Decode1_P9_ie speedgoat_test_SN5659__cal_impl.Decode2_P10_e speedgoat_test_SN5659__cal_impl.Decode2_P11_p speedgoat_test_SN5659__cal_impl.Decode2_P12_id speedgoat_test_SN5659__cal_impl.Decode2_P13_b speedgoat_test_SN5659__cal_impl.Decode2_P14_d speedgoat_test_SN5659__cal_impl.Decode2_P15_b speedgoat_test_SN5659__cal_impl.Decode2_P16_d speedgoat_test_SN5659__cal_impl.Decode2_P1_k speedgoat_test_SN5659__cal_impl.Decode2_P2_kx speedgoat_test_SN5659__cal_impl.Decode2_P3_b5 speedgoat_test_SN5659__cal_impl.Decode2_P4_a speedgoat_test_SN5659__cal_impl.Decode2_P5_jm speedgoat_test_SN5659__cal_impl.Decode2_P6_lx speedgoat_test_SN5659__cal_impl.Decode2_P7_k speedgoat_test_SN5659__cal_impl.Decode2_P8_h4 speedgoat_test_SN5659__cal_impl.Decode2_P9_gq speedgoat_test_SN5659__cal_impl.Decode3_P10_av speedgoat_test_SN5659__cal_impl.Decode3_P11_ku speedgoat_test_SN5659__cal_impl.Decode3_P12_e speedgoat_test_SN5659__cal_impl.Decode3_P13_fu speedgoat_test_SN5659__cal_impl.Decode3_P14_ph speedgoat_test_SN5659__cal_impl.Decode3_P15_hq speedgoat_test_SN5659__cal_impl.Decode3_P16_iz speedgoat_test_SN5659__cal_impl.Decode3_P1_p speedgoat_test_SN5659__cal_impl.Decode3_P2_f speedgoat_test_SN5659__cal_impl.Decode3_P3_d speedgoat_test_SN5659__cal_impl.Decode3_P4_dj speedgoat_test_SN5659__cal_impl.Decode3_P5_j speedgoat_test_SN5659__cal_impl.Decode3_P6_f speedgoat_test_SN5659__cal_impl.Decode3_P7_p speedgoat_test_SN5659__cal_impl.Decode3_P8_f speedgoat_test_SN5659__cal_impl.Decode3_P9_ig speedgoat_test_SN5659__cal_impl.Decode4_P10_l speedgoat_test_SN5659__cal_impl.Decode4_P11_dk speedgoat_test_SN5659__cal_impl.Decode4_P12_i speedgoat_test_SN5659__cal_impl.Decode4_P13_gv speedgoat_test_SN5659__cal_impl.Decode4_P14_m speedgoat_test_SN5659__cal_impl.Decode4_P15_pv speedgoat_test_SN5659__cal_impl.Decode4_P16_ad speedgoat_test_SN5659__cal_impl.Decode4_P1_fa speedgoat_test_SN5659__cal_impl.Decode4_P2_e5 speedgoat_test_SN5659__cal_impl.Decode4_P3_p4 speedgoat_test_SN5659__cal_impl.Decode4_P4_p2 speedgoat_test_SN5659__cal_impl.Decode4_P5_cd speedgoat_test_SN5659__cal_impl.Decode4_P6_fd speedgoat_test_SN5659__cal_impl.Decode4_P7_g2 speedgoat_test_SN5659__cal_impl.Decode4_P8_lu speedgoat_test_SN5659__cal_impl.Decode4_P9_j /end REF_CHARACTERISTIC
 /begin REF_MEASUREMENT speedgoat_test_SN5659_R2021b_IO682_B.Decode1_gi speedgoat_test_SN5659_R2021b_IO682_B.Decode2_f speedgoat_test_SN5659_R2021b_IO682_B.Decode3_o4 speedgoat_test_SN5659_R2021b_IO682_B.Decode4_f4 /end REF_MEASUREMENT
/end GROUP
/begin GROUP speedgoat_test_SN5659_R2021b_IO682_IO682_Decode_Channel_7 "speedgoat_test_SN5659_R2021b_IO682/IO682/Decode Channel 7"
 /begin REF_CHARACTERISTIC speedgoat_test_SN5659__cal_impl.Decode1_P10_g speedgoat_test_SN5659__cal_impl.Decode1_P11_eo speedgoat_test_SN5659__cal_impl.Decode1_P12_m speedgoat_test_SN5659__cal_impl.Decode1_P13_fl speedgoat_test_SN5659__cal_impl.Decode1_P14_f speedgoat_test_SN5659__cal_impl.Decode1_P15_nq speedgoat_test_SN5659__cal_impl.Decode1_P16_ju speedgoat_test_SN5659__cal_impl.Decode1_P1_hw speedgoat_test_SN5659__cal_impl.Decode1_P2_m speedgoat_test_SN5659__cal_impl.Decode1_P3_ci speedgoat_test_SN5659__cal_impl.Decode1_P4_bf speedgoat_test_SN5659__cal_impl.Decode1_P5_kb speedgoat_test_SN5659__cal_impl.Decode1_P6_jf speedgoat_test_SN5659__cal_impl.Decode1_P7_ob speedgoat_test_SN5659__cal_impl.Decode1_P8_a speedgoat_test_SN5659__cal_impl.Decode1_P9_op speedgoat_test_SN5659__cal_impl.Decode2_P10_l speedgoat_test_SN5659__cal_impl.Decode2_P11_h speedgoat_test_SN5659__cal_impl.Decode2_P12_d speedgoat_test_SN5659__cal_impl.Decode2_P13_d speedgoat_test_SN5659__cal_impl.Decode2_P14_k speedgoat_test_SN5659__cal_impl.Decode2_P15_l speedgoat_test_SN5659__cal_impl.Decode2_P16_h speedgoat_test_SN5659__cal_impl.Decode2_P1_b speedgoat_test_SN5659__cal_impl.Decode2_P2_jg speedgoat_test_SN5659__cal_impl.Decode2_P3_m speedgoat_test_SN5659__cal_impl.Decode2_P4_ff speedgoat_test_SN5659__cal_impl.Decode2_P5_h speedgoat_test_SN5659__cal_impl.Decode2_P6_b speedgoat_test_SN5659__cal_impl.Decode2_P7_c speedgoat_test_SN5659__cal_impl.Decode2_P8_k speedgoat_test_SN5659__cal_impl.Decode2_P9_gj speedgoat_test_SN5659__cal_impl.Decode3_P10_lv speedgoat_test_SN5659__cal_impl.Decode3_P11_n speedgoat_test_SN5659__cal_impl.Decode3_P12_pg speedgoat_test_SN5659__cal_impl.Decode3_P13_bw speedgoat_test_SN5659__cal_impl.Decode3_P14_o speedgoat_test_SN5659__cal_impl.Decode3_P15_o speedgoat_test_SN5659__cal_impl.Decode3_P16_c speedgoat_test_SN5659__cal_impl.Decode3_P1_ew speedgoat_test_SN5659__cal_impl.Decode3_P2_ll speedgoat_test_SN5659__cal_impl.Decode3_P3_o speedgoat_test_SN5659__cal_impl.Decode3_P4_av speedgoat_test_SN5659__cal_impl.Decode3_P5_as speedgoat_test_SN5659__cal_impl.Decode3_P6_j speedgoat_test_SN5659__cal_impl.Decode3_P7_fb speedgoat_test_SN5659__cal_impl.Decode3_P8_d speedgoat_test_SN5659__cal_impl.Decode3_P9_f speedgoat_test_SN5659__cal_impl.Decode4_P10_ax speedgoat_test_SN5659__cal_impl.Decode4_P11_mt speedgoat_test_SN5659__cal_impl.Decode4_P12_ik speedgoat_test_SN5659__cal_impl.Decode4_P13_cn speedgoat_test_SN5659__cal_impl.Decode4_P14_fz speedgoat_test_SN5659__cal_impl.Decode4_P15_l speedgoat_test_SN5659__cal_impl.Decode4_P16_du speedgoat_test_SN5659__cal_impl.Decode4_P1_d speedgoat_test_SN5659__cal_impl.Decode4_P2_b speedgoat_test_SN5659__cal_impl.Decode4_P3_mv speedgoat_test_SN5659__cal_impl.Decode4_P4_kx speedgoat_test_SN5659__cal_impl.Decode4_P5_ia speedgoat_test_SN5659__cal_impl.Decode4_P6_an speedgoat_test_SN5659__cal_impl.Decode4_P7_c speedgoat_test_SN5659__cal_impl.Decode4_P8_o speedgoat_test_SN5659__cal_impl.Decode4_P9_c /end REF_CHARACTERISTIC
 /begin REF_MEASUREMENT speedgoat_test_SN5659_R2021b_IO682_B.Decode1_p1 speedgoat_test_SN5659_R2021b_IO682_B.Decode2_h speedgoat_test_SN5659_R2021b_IO682_B.Decode3_lc speedgoat_test_SN5659_R2021b_IO682_B.Decode4_l /end REF_MEASUREMENT
/end GROUP
/begin GROUP speedgoat_test_SN5659_R2021b_IO682_IO682_Decode_Channel_8 "speedgoat_test_SN5659_R2021b_IO682/IO682/Decode Channel 8"
 /begin REF_CHARACTERISTIC speedgoat_test_SN5659__cal_impl.Decode1_P10_m speedgoat_test_SN5659__cal_impl.Decode1_P11_d speedgoat_test_SN5659__cal_impl.Decode1_P12_n speedgoat_test_SN5659__cal_impl.Decode1_P13_cn speedgoat_test_SN5659__cal_impl.Decode1_P14_fq speedgoat_test_SN5659__cal_impl.Decode1_P15_p speedgoat_test_SN5659__cal_impl.Decode1_P16_fi speedgoat_test_SN5659__cal_impl.Decode1_P1_pi speedgoat_test_SN5659__cal_impl.Decode1_P2_mk speedgoat_test_SN5659__cal_impl.Decode1_P3_gr speedgoat_test_SN5659__cal_impl.Decode1_P4_n speedgoat_test_SN5659__cal_impl.Decode1_P5_h speedgoat_test_SN5659__cal_impl.Decode1_P6_e speedgoat_test_SN5659__cal_impl.Decode1_P7_j speedgoat_test_SN5659__cal_impl.Decode1_P8_a1 speedgoat_test_SN5659__cal_impl.Decode1_P9_dz speedgoat_test_SN5659__cal_impl.Decode2_P10_cg speedgoat_test_SN5659__cal_impl.Decode2_P11_kl speedgoat_test_SN5659__cal_impl.Decode2_P12_m speedgoat_test_SN5659__cal_impl.Decode2_P13_bk speedgoat_test_SN5659__cal_impl.Decode2_P14_kg speedgoat_test_SN5659__cal_impl.Decode2_P15_gh speedgoat_test_SN5659__cal_impl.Decode2_P16_a speedgoat_test_SN5659__cal_impl.Decode2_P1_i0 speedgoat_test_SN5659__cal_impl.Decode2_P2_mg speedgoat_test_SN5659__cal_impl.Decode2_P3_p speedgoat_test_SN5659__cal_impl.Decode2_P4_bb speedgoat_test_SN5659__cal_impl.Decode2_P5_ju speedgoat_test_SN5659__cal_impl.Decode2_P6_hg speedgoat_test_SN5659__cal_impl.Decode2_P7_ht speedgoat_test_SN5659__cal_impl.Decode2_P8_fr speedgoat_test_SN5659__cal_impl.Decode2_P9_m speedgoat_test_SN5659__cal_impl.Decode3_P10_g speedgoat_test_SN5659__cal_impl.Decode3_P11_o speedgoat_test_SN5659__cal_impl.Decode3_P12_ak speedgoat_test_SN5659__cal_impl.Decode3_P13_e1 speedgoat_test_SN5659__cal_impl.Decode3_P14_od speedgoat_test_SN5659__cal_impl.Decode3_P15_i speedgoat_test_SN5659__cal_impl.Decode3_P16_m speedgoat_test_SN5659__cal_impl.Decode3_P1_nz speedgoat_test_SN5659__cal_impl.Decode3_P2_n speedgoat_test_SN5659__cal_impl.Decode3_P3_a speedgoat_test_SN5659__cal_impl.Decode3_P4_c speedgoat_test_SN5659__cal_impl.Decode3_P5_gt speedgoat_test_SN5659__cal_impl.Decode3_P6_ov speedgoat_test_SN5659__cal_impl.Decode3_P7_ix speedgoat_test_SN5659__cal_impl.Decode3_P8_n speedgoat_test_SN5659__cal_impl.Decode3_P9_p speedgoat_test_SN5659__cal_impl.Decode4_P10_k speedgoat_test_SN5659__cal_impl.Decode4_P11_mg speedgoat_test_SN5659__cal_impl.Decode4_P12_ci speedgoat_test_SN5659__cal_impl.Decode4_P13_l speedgoat_test_SN5659__cal_impl.Decode4_P14_b speedgoat_test_SN5659__cal_impl.Decode4_P15_h speedgoat_test_SN5659__cal_impl.Decode4_P16_n speedgoat_test_SN5659__cal_impl.Decode4_P1_ml speedgoat_test_SN5659__cal_impl.Decode4_P2_l1 speedgoat_test_SN5659__cal_impl.Decode4_P3_i speedgoat_test_SN5659__cal_impl.Decode4_P4_f1 speedgoat_test_SN5659__cal_impl.Decode4_P5_h speedgoat_test_SN5659__cal_impl.Decode4_P6_g speedgoat_test_SN5659__cal_impl.Decode4_P7_j speedgoat_test_SN5659__cal_impl.Decode4_P8_mv speedgoat_test_SN5659__cal_impl.Decode4_P9_g /end REF_CHARACTERISTIC
 /begin REF_MEASUREMENT speedgoat_test_SN5659_R2021b_IO682_B.Decode1_b speedgoat_test_SN5659_R2021b_IO682_B.Decode2_nz speedgoat_test_SN5659_R2021b_IO682_B.Decode3_mj speedgoat_test_SN5659_R2021b_IO682_B.Decode4_m /end REF_MEASUREMENT
/end GROUP
/begin GROUP speedgoat_test_SN5659_R2021b_IO682_IO682_Decode_Channel_9 "speedgoat_test_SN5659_R2021b_IO682/IO682/Decode Channel 9"
 /begin REF_CHARACTERISTIC speedgoat_test_SN5659__cal_impl.Decode1_P10_l speedgoat_test_SN5659__cal_impl.Decode1_P11_eu speedgoat_test_SN5659__cal_impl.Decode1_P12_pl speedgoat_test_SN5659__cal_impl.Decode1_P13_f speedgoat_test_SN5659__cal_impl.Decode1_P14_m speedgoat_test_SN5659__cal_impl.Decode1_P15_b speedgoat_test_SN5659__cal_impl.Decode1_P16_b speedgoat_test_SN5659__cal_impl.Decode1_P1_c2 speedgoat_test_SN5659__cal_impl.Decode1_P2_b speedgoat_test_SN5659__cal_impl.Decode1_P3_g speedgoat_test_SN5659__cal_impl.Decode1_P4_e speedgoat_test_SN5659__cal_impl.Decode1_P5_n speedgoat_test_SN5659__cal_impl.Decode1_P6_j speedgoat_test_SN5659__cal_impl.Decode1_P7_k speedgoat_test_SN5659__cal_impl.Decode1_P8_l speedgoat_test_SN5659__cal_impl.Decode1_P9_k speedgoat_test_SN5659__cal_impl.Decode3_P10_k speedgoat_test_SN5659__cal_impl.Decode3_P11_e speedgoat_test_SN5659__cal_impl.Decode3_P12_i speedgoat_test_SN5659__cal_impl.Decode3_P13_j speedgoat_test_SN5659__cal_impl.Decode3_P14_p speedgoat_test_SN5659__cal_impl.Decode3_P15_m speedgoat_test_SN5659__cal_impl.Decode3_P16_n speedgoat_test_SN5659__cal_impl.Decode3_P1_c speedgoat_test_SN5659__cal_impl.Decode3_P2_j speedgoat_test_SN5659__cal_impl.Decode3_P3_j speedgoat_test_SN5659__cal_impl.Decode3_P4_p speedgoat_test_SN5659__cal_impl.Decode3_P5_b speedgoat_test_SN5659__cal_impl.Decode3_P6_h speedgoat_test_SN5659__cal_impl.Decode3_P7_d speedgoat_test_SN5659__cal_impl.Decode3_P8_h speedgoat_test_SN5659__cal_impl.Decode3_P9_i speedgoat_test_SN5659__cal_impl.Decode4_P10_d speedgoat_test_SN5659__cal_impl.Decode4_P11_g speedgoat_test_SN5659__cal_impl.Decode4_P12_e speedgoat_test_SN5659__cal_impl.Decode4_P13_o speedgoat_test_SN5659__cal_impl.Decode4_P14_k speedgoat_test_SN5659__cal_impl.Decode4_P15_j speedgoat_test_SN5659__cal_impl.Decode4_P16_b speedgoat_test_SN5659__cal_impl.Decode4_P1_i speedgoat_test_SN5659__cal_impl.Decode4_P2_k speedgoat_test_SN5659__cal_impl.Decode4_P3_l speedgoat_test_SN5659__cal_impl.Decode4_P4_k speedgoat_test_SN5659__cal_impl.Decode4_P5_i speedgoat_test_SN5659__cal_impl.Decode4_P6_n speedgoat_test_SN5659__cal_impl.Decode4_P7_n speedgoat_test_SN5659__cal_impl.Decode4_P8_g speedgoat_test_SN5659__cal_impl.Decode4_P9_e speedgoat_test_SN5659__cal_impl.Decode5_P10_m speedgoat_test_SN5659__cal_impl.Decode5_P11_g speedgoat_test_SN5659__cal_impl.Decode5_P12_m speedgoat_test_SN5659__cal_impl.Decode5_P13_c speedgoat_test_SN5659__cal_impl.Decode5_P14_c speedgoat_test_SN5659__cal_impl.Decode5_P15_j speedgoat_test_SN5659__cal_impl.Decode5_P16_a speedgoat_test_SN5659__cal_impl.Decode5_P1_n speedgoat_test_SN5659__cal_impl.Decode5_P2_m speedgoat_test_SN5659__cal_impl.Decode5_P3_i speedgoat_test_SN5659__cal_impl.Decode5_P4_f speedgoat_test_SN5659__cal_impl.Decode5_P5_m speedgoat_test_SN5659__cal_impl.Decode5_P6_m speedgoat_test_SN5659__cal_impl.Decode5_P7_n speedgoat_test_SN5659__cal_impl.Decode5_P8_b speedgoat_test_SN5659__cal_impl.Decode5_P9_n /end REF_CHARACTERISTIC
 /begin REF_MEASUREMENT speedgoat_test_SN5659_R2021b_IO682_B.Decode1_d speedgoat_test_SN5659_R2021b_IO682_B.Decode3_c speedgoat_test_SN5659_R2021b_IO682_B.Decode4_o speedgoat_test_SN5659_R2021b_IO682_B.Decode5_p /end REF_MEASUREMENT
/end GROUP
/begin GROUP speedgoat_test_SN5659_R2021b_IO682_IO682_Encode_Channel_1 "speedgoat_test_SN5659_R2021b_IO682/IO682/Encode Channel 1"
 /begin SUB_GROUP speedgoat_test_SN5659_R2021b_IO682_IO682_Encode_Channel_1_Counter_Limited speedgoat_test_SN5659_R2021b_IO682_IO682_Encode_Channel_1_Prepare_RAW_value /end SUB_GROUP
 /begin REF_CHARACTERISTIC speedgoat_test_SN5659__cal_impl.Constant_Value speedgoat_test_SN5659__cal_impl.Encode1_P1 speedgoat_test_SN5659__cal_impl.Encode1_P10 speedgoat_test_SN5659__cal_impl.Encode1_P11 speedgoat_test_SN5659__cal_impl.Encode1_P12 speedgoat_test_SN5659__cal_impl.Encode1_P13 speedgoat_test_SN5659__cal_impl.Encode1_P14 speedgoat_test_SN5659__cal_impl.Encode1_P15 speedgoat_test_SN5659__cal_impl.Encode1_P2 speedgoat_test_SN5659__cal_impl.Encode1_P3 speedgoat_test_SN5659__cal_impl.Encode1_P4 speedgoat_test_SN5659__cal_impl.Encode1_P5 speedgoat_test_SN5659__cal_impl.Encode1_P6 speedgoat_test_SN5659__cal_impl.Encode1_P7 speedgoat_test_SN5659__cal_impl.Encode1_P8 speedgoat_test_SN5659__cal_impl.Encode1_P9 speedgoat_test_SN5659__cal_impl.Encode2_P1 speedgoat_test_SN5659__cal_impl.Encode2_P10 speedgoat_test_SN5659__cal_impl.Encode2_P11 speedgoat_test_SN5659__cal_impl.Encode2_P12 speedgoat_test_SN5659__cal_impl.Encode2_P13 speedgoat_test_SN5659__cal_impl.Encode2_P14 speedgoat_test_SN5659__cal_impl.Encode2_P15 speedgoat_test_SN5659__cal_impl.Encode2_P2 speedgoat_test_SN5659__cal_impl.Encode2_P3 speedgoat_test_SN5659__cal_impl.Encode2_P4 speedgoat_test_SN5659__cal_impl.Encode2_P5 speedgoat_test_SN5659__cal_impl.Encode2_P6 speedgoat_test_SN5659__cal_impl.Encode2_P7 speedgoat_test_SN5659__cal_impl.Encode2_P8 speedgoat_test_SN5659__cal_impl.Encode2_P9 speedgoat_test_SN5659__cal_impl.Encode3_P1 speedgoat_test_SN5659__cal_impl.Encode3_P10 speedgoat_test_SN5659__cal_impl.Encode3_P11 speedgoat_test_SN5659__cal_impl.Encode3_P12 speedgoat_test_SN5659__cal_impl.Encode3_P13 speedgoat_test_SN5659__cal_impl.Encode3_P14 speedgoat_test_SN5659__cal_impl.Encode3_P15 speedgoat_test_SN5659__cal_impl.Encode3_P2 speedgoat_test_SN5659__cal_impl.Encode3_P3 speedgoat_test_SN5659__cal_impl.Encode3_P4 speedgoat_test_SN5659__cal_impl.Encode3_P5 speedgoat_test_SN5659__cal_impl.Encode3_P6 speedgoat_test_SN5659__cal_impl.Encode3_P7 speedgoat_test_SN5659__cal_impl.Encode3_P8 speedgoat_test_SN5659__cal_impl.Encode3_P9 speedgoat_test_SN5659__cal_impl.Encode5_P1 speedgoat_test_SN5659__cal_impl.Encode5_P10 speedgoat_test_SN5659__cal_impl.Encode5_P11 speedgoat_test_SN5659__cal_impl.Encode5_P12 speedgoat_test_SN5659__cal_impl.Encode5_P13 speedgoat_test_SN5659__cal_impl.Encode5_P14 speedgoat_test_SN5659__cal_impl.Encode5_P15 speedgoat_test_SN5659__cal_impl.Encode5_P2 speedgoat_test_SN5659__cal_impl.Encode5_P3 speedgoat_test_SN5659__cal_impl.Encode5_P4 speedgoat_test_SN5659__cal_impl.Encode5_P5 speedgoat_test_SN5659__cal_impl.Encode5_P6 speedgoat_test_SN5659__cal_impl.Encode5_P7 speedgoat_test_SN5659__cal_impl.Encode5_P8 speedgoat_test_SN5659__cal_impl.Encode5_P9 speedgoat_test_SN5659__cal_impl.Randomnumber_Mean speedgoat_test_SN5659__cal_impl.Randomnumber_Seed speedgoat_test_SN5659__cal_impl.Randomnumber_StdDev speedgoat_test_SN5659__cal_impl.Sinewave_Amp speedgoat_test_SN5659__cal_impl.Sinewave_Bias speedgoat_test_SN5659__cal_impl.Sinewave_Freq speedgoat_test_SN5659__cal_impl.Sinewave_HCos speedgoat_test_SN5659__cal_impl.Sinewave_Hsin speedgoat_test_SN5659__cal_impl.Sinewave_PCos speedgoat_test_SN5659__cal_impl.Sinewave_PSin /end REF_CHARACTERISTIC
 /begin REF_MEASUREMENT speedgoat_test_SN5659_R2021b_IO682_B.DataTypeConversion speedgoat_test_SN5659_R2021b_IO682_B.DataTypeConversion1 speedgoat_test_SN5659_R2021b_IO682_B.Encode1 speedgoat_test_SN5659_R2021b_IO682_B.Encode2 speedgoat_test_SN5659_R2021b_IO682_B.Encode3 speedgoat_test_SN5659_R2021b_IO682_B.Encode5 speedgoat_test_SN5659_R2021b_IO682_B.Output_o speedgoat_test_SN5659_R2021b_IO682_B.Randomnumber speedgoat_test_SN5659_R2021b_IO682_B.Sinewave speedgoat_test_SN5659_R2021b_IO682_DW.NextOutput speedgoat_test_SN5659_R2021b_IO682_DW.RandSeed speedgoat_test_SN5659_R2021b_IO682_DW.lastCos speedgoat_test_SN5659_R2021b_IO682_DW.lastSin speedgoat_test_SN5659_R2021b_IO682_DW.systemEnable /end REF_MEASUREMENT
/end GROUP
/begin GROUP speedgoat_test_SN5659_R2021b_IO682_IO682_Encode_Channel_10 "speedgoat_test_SN5659_R2021b_IO682/IO682/Encode Channel 10"
 /begin SUB_GROUP speedgoat_test_SN5659_R2021b_IO682_IO682_Encode_Channel_10_Counter_Limited speedgoat_test_SN5659_R2021b_IO682_IO682_Encode_Channel_10_Prepare_RAW_value /end SUB_GROUP
 /begin REF_CHARACTERISTIC speedgoat_test_SN5659__cal_impl.Constant_Value_j speedgoat_test_SN5659__cal_impl.Encode1_P10_a speedgoat_test_SN5659__cal_impl.Encode1_P11_g speedgoat_test_SN5659__cal_impl.Encode1_P12_n speedgoat_test_SN5659__cal_impl.Encode1_P13_j speedgoat_test_SN5659__cal_impl.Encode1_P14_h speedgoat_test_SN5659__cal_impl.Encode1_P15_h speedgoat_test_SN5659__cal_impl.Encode1_P1_a speedgoat_test_SN5659__cal_impl.Encode1_P2_h speedgoat_test_SN5659__cal_impl.Encode1_P3_o speedgoat_test_SN5659__cal_impl.Encode1_P4_d speedgoat_test_SN5659__cal_impl.Encode1_P5_o speedgoat_test_SN5659__cal_impl.Encode1_P6_n speedgoat_test_SN5659__cal_impl.Encode1_P7_g speedgoat_test_SN5659__cal_impl.Encode1_P8_p speedgoat_test_SN5659__cal_impl.Encode1_P9_m speedgoat_test_SN5659__cal_impl.Encode2_P10_n speedgoat_test_SN5659__cal_impl.Encode2_P11_j speedgoat_test_SN5659__cal_impl.Encode2_P12_b speedgoat_test_SN5659__cal_impl.Encode2_P13_j speedgoat_test_SN5659__cal_impl.Encode2_P14_c speedgoat_test_SN5659__cal_impl.Encode2_P15_j speedgoat_test_SN5659__cal_impl.Encode2_P1_h speedgoat_test_SN5659__cal_impl.Encode2_P2_m speedgoat_test_SN5659__cal_impl.Encode2_P3_o speedgoat_test_SN5659__cal_impl.Encode2_P4_g speedgoat_test_SN5659__cal_impl.Encode2_P5_g speedgoat_test_SN5659__cal_impl.Encode2_P6_j speedgoat_test_SN5659__cal_impl.Encode2_P7_d speedgoat_test_SN5659__cal_impl.Encode2_P8_f speedgoat_test_SN5659__cal_impl.Encode2_P9_p speedgoat_test_SN5659__cal_impl.Encode3_P10_n speedgoat_test_SN5659__cal_impl.Encode3_P11_l speedgoat_test_SN5659__cal_impl.Encode3_P12_e speedgoat_test_SN5659__cal_impl.Encode3_P13_o speedgoat_test_SN5659__cal_impl.Encode3_P14_e speedgoat_test_SN5659__cal_impl.Encode3_P15_p speedgoat_test_SN5659__cal_impl.Encode3_P1_l speedgoat_test_SN5659__cal_impl.Encode3_P2_j speedgoat_test_SN5659__cal_impl.Encode3_P3_n speedgoat_test_SN5659__cal_impl.Encode3_P4_g speedgoat_test_SN5659__cal_impl.Encode3_P5_k speedgoat_test_SN5659__cal_impl.Encode3_P6_h speedgoat_test_SN5659__cal_impl.Encode3_P7_b speedgoat_test_SN5659__cal_impl.Encode3_P8_e speedgoat_test_SN5659__cal_impl.Encode3_P9_g speedgoat_test_SN5659__cal_impl.Encode4_P1 speedgoat_test_SN5659__cal_impl.Encode4_P10 speedgoat_test_SN5659__cal_impl.Encode4_P11 speedgoat_test_SN5659__cal_impl.Encode4_P12 speedgoat_test_SN5659__cal_impl.Encode4_P13 speedgoat_test_SN5659__cal_impl.Encode4_P14 speedgoat_test_SN5659__cal_impl.Encode4_P15 speedgoat_test_SN5659__cal_impl.Encode4_P2 speedgoat_test_SN5659__cal_impl.Encode4_P3 speedgoat_test_SN5659__cal_impl.Encode4_P4 speedgoat_test_SN5659__cal_impl.Encode4_P5 speedgoat_test_SN5659__cal_impl.Encode4_P6 speedgoat_test_SN5659__cal_impl.Encode4_P7 speedgoat_test_SN5659__cal_impl.Encode4_P8 speedgoat_test_SN5659__cal_impl.Encode4_P9 speedgoat_test_SN5659__cal_impl.Randomnumber_Mean_f speedgoat_test_SN5659__cal_impl.Randomnumber_Seed_n speedgoat_test_SN5659__cal_impl.Randomnumber_StdDev_a speedgoat_test_SN5659__cal_impl.Sinewave_Amp_o speedgoat_test_SN5659__cal_impl.Sinewave_Bias_k speedgoat_test_SN5659__cal_impl.Sinewave_Freq_p speedgoat_test_SN5659__cal_impl.Sinewave_HCos_l speedgoat_test_SN5659__cal_impl.Sinewave_Hsin_j speedgoat_test_SN5659__cal_impl.Sinewave_PCos_c speedgoat_test_SN5659__cal_impl.Sinewave_PSin_p /end REF_CHARACTERISTIC
 /begin REF_MEASUREMENT speedgoat_test_SN5659_R2021b_IO682_B.DataTypeConversion1_g speedgoat_test_SN5659_R2021b_IO682_B.DataTypeConversion_h speedgoat_test_SN5659_R2021b_IO682_B.Encode1_b speedgoat_test_SN5659_R2021b_IO682_B.Encode2_p speedgoat_test_SN5659_R2021b_IO682_B.Encode3_i speedgoat_test_SN5659_R2021b_IO682_B.Encode4 speedgoat_test_SN5659_R2021b_IO682_B.Output speedgoat_test_SN5659_R2021b_IO682_B.Randomnumber_c speedgoat_test_SN5659_R2021b_IO682_B.Sinewave_o speedgoat_test_SN5659_R2021b_IO682_DW.NextOutput_a speedgoat_test_SN5659_R2021b_IO682_DW.RandSeed_m speedgoat_test_SN5659_R2021b_IO682_DW.lastCos_p speedgoat_test_SN5659_R2021b_IO682_DW.lastSin_c speedgoat_test_SN5659_R2021b_IO682_DW.systemEnable_n /end REF_MEASUREMENT
/end GROUP
/begin GROUP speedgoat_test_SN5659_R2021b_IO682_IO682_Encode_Channel_10_Counter_Limited "speedgoat_test_SN5659_R2021b_IO682/IO682/Encode Channel 10/Counter
Limited"
 /begin SUB_GROUP speedgoat_test_SN5659_R2021b_IO682_IO682_Encode_Channel_10_Counter_Limited_Increment_Real_World speedgoat_test_SN5659_R2021b_IO682_IO682_Encode_Channel_10_Counter_Limited_Wrap_To_Zero /end SUB_GROUP
 /begin REF_CHARACTERISTIC speedgoat_test_SN5659__cal_impl.Output_InitialCondition /end REF_CHARACTERISTIC
 /begin REF_MEASUREMENT speedgoat_test_SN5659_R2021b_IO682_B.FixPtSwitch speedgoat_test_SN5659_R2021b_IO682_B.Output speedgoat_test_SN5659_R2021b_IO682_DW.Output_DSTATE /end REF_MEASUREMENT
/end GROUP
/begin GROUP speedgoat_test_SN5659_R2021b_IO682_IO682_Encode_Channel_10_Counter_Limited_Increment_Real_World "speedgoat_test_SN5659_R2021b_IO682/IO682/Encode Channel 10/Counter
Limited/Increment
Real World" /begin REF_CHARACTERISTIC speedgoat_test_SN5659__cal_impl.FixPtConstant_Value /end REF_CHARACTERISTIC
 /begin REF_MEASUREMENT speedgoat_test_SN5659_R2021b_IO682_B.FixPtSum1 speedgoat_test_SN5659_R2021b_IO682_B.Output /end REF_MEASUREMENT
/end GROUP
/begin GROUP speedgoat_test_SN5659_R2021b_IO682_IO682_Encode_Channel_10_Counter_Limited_Wrap_To_Zero "speedgoat_test_SN5659_R2021b_IO682/IO682/Encode Channel 10/Counter
Limited/Wrap To Zero"
 /begin REF_CHARACTERISTIC speedgoat_test_SN5659__cal_impl.Constant_Value_c speedgoat_test_SN5659__cal_impl.CounterLimited_uplimit /end REF_CHARACTERISTIC
 /begin REF_MEASUREMENT speedgoat_test_SN5659_R2021b_IO682_B.FixPtSum1 speedgoat_test_SN5659_R2021b_IO682_B.FixPtSwitch /end REF_MEASUREMENT
/end GROUP
/begin GROUP speedgoat_test_SN5659_R2021b_IO682_IO682_Encode_Channel_10_Prepare_RAW_value "speedgoat_test_SN5659_R2021b_IO682/IO682/Encode Channel 10/Prepare RAW value"
 /begin REF_CHARACTERISTIC speedgoat_test_SN5659__cal_impl.Label_Value_d speedgoat_test_SN5659__cal_impl.Mask_BitMask_h speedgoat_test_SN5659__cal_impl.SDI_Value_d speedgoat_test_SN5659__cal_impl.SSM_Value_o speedgoat_test_SN5659__cal_impl.Scale_Value_l speedgoat_test_SN5659__cal_impl.shiftthedoublevalue27bitsleft_o /end REF_CHARACTERISTIC
 /begin REF_MEASUREMENT speedgoat_test_SN5659_R2021b_IO682_B.BitwiseOperator_m speedgoat_test_SN5659_R2021b_IO682_B.DataTypeConversion1_g speedgoat_test_SN5659_R2021b_IO682_B.DataTypeConversion_c speedgoat_test_SN5659_R2021b_IO682_B.Divide_k speedgoat_test_SN5659_R2021b_IO682_B.Mask_a speedgoat_test_SN5659_R2021b_IO682_B.Multiply_h speedgoat_test_SN5659_R2021b_IO682_B.ShifttoSDIslot_l speedgoat_test_SN5659_R2021b_IO682_B.ShifttoSSMslot_h /end REF_MEASUREMENT
/end GROUP
/begin GROUP speedgoat_test_SN5659_R2021b_IO682_IO682_Encode_Channel_1_Counter_Limited "speedgoat_test_SN5659_R2021b_IO682/IO682/Encode Channel 1/Counter
Limited" /begin REF_MEASUREMENT speedgoat_test_SN5659_R2021b_IO682_B.Output_o /end REF_MEASUREMENT /end GROUP
/begin GROUP speedgoat_test_SN5659_R2021b_IO682_IO682_Encode_Channel_1_Counter_Limited_Increment_Real_World "speedgoat_test_SN5659_R2021b_IO682/IO682/Encode Channel 1/Counter
Limited/Increment
Real World" /begin REF_MEASUREMENT speedgoat_test_SN5659_R2021b_IO682_B.Output_o /end REF_MEASUREMENT /end GROUP
/begin GROUP speedgoat_test_SN5659_R2021b_IO682_IO682_Encode_Channel_1_Prepare_RAW_value "speedgoat_test_SN5659_R2021b_IO682/IO682/Encode Channel 1/Prepare RAW value" /begin REF_MEASUREMENT speedgoat_test_SN5659_R2021b_IO682_B.DataTypeConversion1 /end REF_MEASUREMENT /end GROUP
/end MODULE
/end PROJECT
