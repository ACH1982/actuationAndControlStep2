/******************************************************************************
* ASAP2 file: speedgoat_test_SN5659_R2021b_IO682.a2l
* Code generation for model "speedgoat_test_SN5659_R2021b_IO682".
* Model version : 3.0
* Simulink Coder version : 10.4 R2021b
* C source code generated on : Fri Apr 08 15:00:20 2022
* Target selection: slrealtime.tlc
* Embedded hardware selection: Intel->x86-64 (Linux 64)
* Code generation objectives: Unspecified
* Validation result: Not run
* (add additional file header information here)
******************************************************************************/
ASAP2_VERSION 1 71
/begin PROJECT ProjectName "Project Comment Goes Here"
/begin HEADER "Header Comments go here" /end HEADER
/begin MODULE ModuleName "Module Comment Goes Here"
/begin IF_DATA XCP
 /begin PROTOCOL_LAYER 0x0100 0x03E8 0x00C8 0x0000 0x0000 0x0000 0x0000 0x0000 0xFC 0x0578 BYTE_ORDER_MSB_LAST ADDRESS_GRANULARITY_BYTE OPTIONAL_CMD ALLOC_ODT_ENTRY OPTIONAL_CMD ALLOC_ODT OPTIONAL_CMD ALLOC_DAQ OPTIONAL_CMD FREE_DAQ OPTIONAL_CMD GET_DAQ_RESOLUTION_INFO OPTIONAL_CMD GET_DAQ_PROCESSOR_INFO OPTIONAL_CMD START_STOP_SYNCH OPTIONAL_CMD START_STOP_DAQ_LIST OPTIONAL_CMD SET_DAQ_LIST_MODE OPTIONAL_CMD WRITE_DAQ OPTIONAL_CMD SET_DAQ_PTR OPTIONAL_CMD GET_CAL_PAGE OPTIONAL_CMD SET_CAL_PAGE OPTIONAL_CMD COPY_CAL_PAGE OPTIONAL_CMD SHORT_DOWNLOAD OPTIONAL_CMD DOWNLOAD_MAX OPTIONAL_CMD DOWNLOAD OPTIONAL_CMD SHORT_UPLOAD OPTIONAL_CMD UPLOAD OPTIONAL_CMD SET_MTA /end PROTOCOL_LAYER
 /begin DAQ DYNAMIC 0x0000 0x0080 0x00 OPTIMISATION_TYPE_DEFAULT ADDRESS_EXTENSION_FREE IDENTIFICATION_FIELD_TYPE_RELATIVE_WORD_ALIGNED GRANULARITY_ODT_ENTRY_SIZE_DAQ_BYTE 0xFF OVERLOAD_INDICATION_PID PRESCALER_SUPPORTED /begin STIM GRANULARITY_ODT_ENTRY_SIZE_STIM_BYTE 0xFF /end STIM /begin TIMESTAMP_SUPPORTED 0x0001 SIZE_DWORD UNIT_1US TIMESTAMP_FIXED /end TIMESTAMP_SUPPORTED /begin EVENT "5 ms" "5 ms" 0x0000 DAQ 0xFF 0x05 0x06 0x00 /end EVENT /end DAQ
 /begin XCP_ON_UDP_IP 0x0100 0x15B3 ADDRESS "192.168.7.2" /end XCP_ON_UDP_IP
/end IF_DATA
/begin MOD_PAR "MOD PAR Comment Goes Here"
 /begin MEMORY_SEGMENT speedgoat_test_SN5659__cal_impl "speedgoat_test_SN5659__cal_impl" DATA FLASH INTERN 0x00833020 0xD730 -1 -1 -1 -1 -1
  /begin IF_DATA XCP
   /begin SEGMENT 0x00 0x02 0x00 0x00 0x00
    /begin PAGE 0x00 ECU_ACCESS_DONT_CARE XCP_READ_ACCESS_DONT_CARE XCP_WRITE_ACCESS_NOT_ALLOWED /end PAGE
    /begin PAGE 0x01 ECU_ACCESS_DONT_CARE XCP_READ_ACCESS_DONT_CARE XCP_WRITE_ACCESS_DONT_CARE /end PAGE
   /end SEGMENT
  /end IF_DATA
 /end MEMORY_SEGMENT
/end MOD_PAR
/begin MOD_COMMON "Mod Common Comment Here" BYTE_ORDER MSB_LAST ALIGNMENT_BYTE 1 ALIGNMENT_WORD 2 ALIGNMENT_LONG 4 ALIGNMENT_FLOAT32_IEEE 4 ALIGNMENT_FLOAT64_IEEE 8 ALIGNMENT_INT64 8 /end MOD_COMMON
/begin CHARACTERISTIC speedgoat_test_SN5659__cal_impl.Decode1_P1 "" VALUE 0x00833638 Scalar_FLOAT64_IEEE 0 speedgoat_test_SN5659_R2021b_IO682_CM_double -1.7E+308 1.7E+308 /end CHARACTERISTIC
/begin CHARACTERISTIC speedgoat_test_SN5659__cal_impl.Decode1_P10 "" VAL_BLK 0x00833710 Scalar_FLOAT64_IEEE 0 speedgoat_test_SN5659_R2021b_IO682_CM_double -1.7E+308 1.7E+308 MATRIX_DIM 2 1 /end CHARACTERISTIC
/begin CHARACTERISTIC speedgoat_test_SN5659__cal_impl.Decode1_P10_a "" VAL_BLK 0x00836538 Scalar_FLOAT64_IEEE 0 speedgoat_test_SN5659_R2021b_IO682_CM_double -1.7E+308 1.7E+308 MATRIX_DIM 2 1 /end CHARACTERISTIC
/begin CHARACTERISTIC speedgoat_test_SN5659__cal_impl.Decode1_P10_e "" VAL_BLK 0x00837268 Scalar_FLOAT64_IEEE 0 speedgoat_test_SN5659_R2021b_IO682_CM_double -1.7E+308 1.7E+308 MATRIX_DIM 2 1 /end CHARACTERISTIC
/begin CHARACTERISTIC speedgoat_test_SN5659__cal_impl.Decode1_P10_h "" VAL_BLK 0x00834AD8 Scalar_FLOAT64_IEEE 0 speedgoat_test_SN5659_R2021b_IO682_CM_double -1.7E+308 1.7E+308 MATRIX_DIM 2 1 /end CHARACTERISTIC
/begin CHARACTERISTIC speedgoat_test_SN5659__cal_impl.Decode1_P10_k1 "" VAL_BLK 0x00835808 Scalar_FLOAT64_IEEE 0 speedgoat_test_SN5659_R2021b_IO682_CM_double -1.7E+308 1.7E+308 MATRIX_DIM 2 1 /end CHARACTERISTIC
/begin CHARACTERISTIC speedgoat_test_SN5659__cal_impl.Decode1_P10_lb "" VAL_BLK 0x00835EA0 Scalar_FLOAT64_IEEE 0 speedgoat_test_SN5659_R2021b_IO682_CM_double -1.7E+308 1.7E+308 MATRIX_DIM 2 1 /end CHARACTERISTIC
/begin CHARACTERISTIC speedgoat_test_SN5659__cal_impl.Decode1_P10_lbu "" VAL_BLK 0x00836BD0 Scalar_FLOAT64_IEEE 0 speedgoat_test_SN5659_R2021b_IO682_CM_double -1.7E+308 1.7E+308 MATRIX_DIM 2 1 /end CHARACTERISTIC
/begin CHARACTERISTIC speedgoat_test_SN5659__cal_impl.Decode1_P10_lm "" VAL_BLK 0x00835170 Scalar_FLOAT64_IEEE 0 speedgoat_test_SN5659_R2021b_IO682_CM_double -1.7E+308 1.7E+308 MATRIX_DIM 2 1 /end CHARACTERISTIC
/begin CHARACTERISTIC speedgoat_test_SN5659__cal_impl.Decode1_P11 "" VALUE 0x00833730 Scalar_FLOAT64_IEEE 0 speedgoat_test_SN5659_R2021b_IO682_CM_double -1.7E+308 1.7E+308 /end CHARACTERISTIC
/begin CHARACTERISTIC speedgoat_test_SN5659__cal_impl.Decode1_P11_a "" VALUE 0x00837288 Scalar_FLOAT64_IEEE 0 speedgoat_test_SN5659_R2021b_IO682_CM_double -1.7E+308 1.7E+308 /end CHARACTERISTIC
/begin CHARACTERISTIC speedgoat_test_SN5659__cal_impl.Decode1_P11_f "" VALUE 0x00835190 Scalar_FLOAT64_IEEE 0 speedgoat_test_SN5659_R2021b_IO682_CM_double -1.7E+308 1.7E+308 /end CHARACTERISTIC
/begin CHARACTERISTIC speedgoat_test_SN5659__cal_impl.Decode1_P11_fz "" VALUE 0x00836BF0 Scalar_FLOAT64_IEEE 0 speedgoat_test_SN5659_R2021b_IO682_CM_double -1.7E+308 1.7E+308 /end CHARACTERISTIC
/begin CHARACTERISTIC speedgoat_test_SN5659__cal_impl.Decode1_P11_g "" VALUE 0x00836558 Scalar_FLOAT64_IEEE 0 speedgoat_test_SN5659_R2021b_IO682_CM_double -1.7E+308 1.7E+308 /end CHARACTERISTIC
/begin CHARACTERISTIC speedgoat_test_SN5659__cal_impl.Decode1_P11_i "" VALUE 0x00835828 Scalar_FLOAT64_IEEE 0 speedgoat_test_SN5659_R2021b_IO682_CM_double -1.7E+308 1.7E+308 /end CHARACTERISTIC
/begin CHARACTERISTIC speedgoat_test_SN5659__cal_impl.Decode1_P11_m "" VALUE 0x00835EC0 Scalar_FLOAT64_IEEE 0 speedgoat_test_SN5659_R2021b_IO682_CM_double -1.7E+308 1.7E+308 /end CHARACTERISTIC
/begin CHARACTERISTIC speedgoat_test_SN5659__cal_impl.Decode1_P11_p "" VALUE 0x00834AF8 Scalar_FLOAT64_IEEE 0 speedgoat_test_SN5659_R2021b_IO682_CM_double -1.7E+308 1.7E+308 /end CHARACTERISTIC
/begin CHARACTERISTIC speedgoat_test_SN5659__cal_impl.Decode1_P12 "" VALUE 0x00833748 Scalar_FLOAT64_IEEE 0 speedgoat_test_SN5659_R2021b_IO682_CM_double -1.7E+308 1.7E+308 /end CHARACTERISTIC
/begin CHARACTERISTIC speedgoat_test_SN5659__cal_impl.Decode1_P12_a "" VALUE 0x008372A0 Scalar_FLOAT64_IEEE 0 speedgoat_test_SN5659_R2021b_IO682_CM_double -1.7E+308 1.7E+308 /end CHARACTERISTIC
/begin CHARACTERISTIC speedgoat_test_SN5659__cal_impl.Decode1_P12_b "" VALUE 0x00835ED8 Scalar_FLOAT64_IEEE 0 speedgoat_test_SN5659_R2021b_IO682_CM_double -1.7E+308 1.7E+308 /end CHARACTERISTIC
/begin CHARACTERISTIC speedgoat_test_SN5659__cal_impl.Decode1_P12_d "" VALUE 0x00836570 Scalar_FLOAT64_IEEE 0 speedgoat_test_SN5659_R2021b_IO682_CM_double -1.7E+308 1.7E+308 /end CHARACTERISTIC
/begin CHARACTERISTIC speedgoat_test_SN5659__cal_impl.Decode1_P12_h "" VALUE 0x00834B10 Scalar_FLOAT64_IEEE 0 speedgoat_test_SN5659_R2021b_IO682_CM_double -1.7E+308 1.7E+308 /end CHARACTERISTIC
/begin CHARACTERISTIC speedgoat_test_SN5659__cal_impl.Decode1_P12_j "" VALUE 0x00835840 Scalar_FLOAT64_IEEE 0 speedgoat_test_SN5659_R2021b_IO682_CM_double -1.7E+308 1.7E+308 /end CHARACTERISTIC
/begin CHARACTERISTIC speedgoat_test_SN5659__cal_impl.Decode1_P12_k "" VALUE 0x00836C08 Scalar_FLOAT64_IEEE 0 speedgoat_test_SN5659_R2021b_IO682_CM_double -1.7E+308 1.7E+308 /end CHARACTERISTIC
/begin CHARACTERISTIC speedgoat_test_SN5659__cal_impl.Decode1_P12_pv "" VALUE 0x008351A8 Scalar_FLOAT64_IEEE 0 speedgoat_test_SN5659_R2021b_IO682_CM_double -1.7E+308 1.7E+308 /end CHARACTERISTIC
/begin CHARACTERISTIC speedgoat_test_SN5659__cal_impl.Decode1_P13 "" VALUE 0x00833760 Scalar_FLOAT64_IEEE 0 speedgoat_test_SN5659_R2021b_IO682_CM_double -1.7E+308 1.7E+308 /end CHARACTERISTIC
/begin CHARACTERISTIC speedgoat_test_SN5659__cal_impl.Decode1_P13_aa "" VALUE 0x00835858 Scalar_FLOAT64_IEEE 0 speedgoat_test_SN5659_R2021b_IO682_CM_double -1.7E+308 1.7E+308 /end CHARACTERISTIC
/begin CHARACTERISTIC speedgoat_test_SN5659__cal_impl.Decode1_P13_c "" VALUE 0x00836588 Scalar_FLOAT64_IEEE 0 speedgoat_test_SN5659_R2021b_IO682_CM_double -1.7E+308 1.7E+308 /end CHARACTERISTIC
/begin CHARACTERISTIC speedgoat_test_SN5659__cal_impl.Decode1_P13_d "" VALUE 0x00836C20 Scalar_FLOAT64_IEEE 0 speedgoat_test_SN5659_R2021b_IO682_CM_double -1.7E+308 1.7E+308 /end CHARACTERISTIC
/begin CHARACTERISTIC speedgoat_test_SN5659__cal_impl.Decode1_P13_fg "" VALUE 0x008351C0 Scalar_FLOAT64_IEEE 0 speedgoat_test_SN5659_R2021b_IO682_CM_double -1.7E+308 1.7E+308 /end CHARACTERISTIC
/begin CHARACTERISTIC speedgoat_test_SN5659__cal_impl.Decode1_P13_k "" VALUE 0x008372B8 Scalar_FLOAT64_IEEE 0 speedgoat_test_SN5659_R2021b_IO682_CM_double -1.7E+308 1.7E+308 /end CHARACTERISTIC
/begin CHARACTERISTIC speedgoat_test_SN5659__cal_impl.Decode1_P13_l "" VALUE 0x00834B28 Scalar_FLOAT64_IEEE 0 speedgoat_test_SN5659_R2021b_IO682_CM_double -1.7E+308 1.7E+308 /end CHARACTERISTIC
/begin CHARACTERISTIC speedgoat_test_SN5659__cal_impl.Decode1_P13_lz "" VALUE 0x00835EF0 Scalar_FLOAT64_IEEE 0 speedgoat_test_SN5659_R2021b_IO682_CM_double -1.7E+308 1.7E+308 /end CHARACTERISTIC
/begin CHARACTERISTIC speedgoat_test_SN5659__cal_impl.Decode1_P14 "" VALUE 0x00833778 Scalar_FLOAT64_IEEE 0 speedgoat_test_SN5659_R2021b_IO682_CM_double -1.7E+308 1.7E+308 /end CHARACTERISTIC
/begin CHARACTERISTIC speedgoat_test_SN5659__cal_impl.Decode1_P14_d "" VALUE 0x00835870 Scalar_FLOAT64_IEEE 0 speedgoat_test_SN5659_R2021b_IO682_CM_double -1.7E+308 1.7E+308 /end CHARACTERISTIC
/begin CHARACTERISTIC speedgoat_test_SN5659__cal_impl.Decode1_P14_g "" VALUE 0x00834B40 Scalar_FLOAT64_IEEE 0 speedgoat_test_SN5659_R2021b_IO682_CM_double -1.7E+308 1.7E+308 /end CHARACTERISTIC
/begin CHARACTERISTIC speedgoat_test_SN5659__cal_impl.Decode1_P14_gc "" VALUE 0x008365A0 Scalar_FLOAT64_IEEE 0 speedgoat_test_SN5659_R2021b_IO682_CM_double -1.7E+308 1.7E+308 /end CHARACTERISTIC
/begin CHARACTERISTIC speedgoat_test_SN5659__cal_impl.Decode1_P14_gk "" VALUE 0x008351D8 Scalar_FLOAT64_IEEE 0 speedgoat_test_SN5659_R2021b_IO682_CM_double -1.7E+308 1.7E+308 /end CHARACTERISTIC
/begin CHARACTERISTIC speedgoat_test_SN5659__cal_impl.Decode1_P14_i "" VALUE 0x00836C38 Scalar_FLOAT64_IEEE 0 speedgoat_test_SN5659_R2021b_IO682_CM_double -1.7E+308 1.7E+308 /end CHARACTERISTIC
/begin CHARACTERISTIC speedgoat_test_SN5659__cal_impl.Decode1_P14_k "" VALUE 0x00835F08 Scalar_FLOAT64_IEEE 0 speedgoat_test_SN5659_R2021b_IO682_CM_double -1.7E+308 1.7E+308 /end CHARACTERISTIC
/begin CHARACTERISTIC speedgoat_test_SN5659__cal_impl.Decode1_P14_o4 "" VALUE 0x008372D0 Scalar_FLOAT64_IEEE 0 speedgoat_test_SN5659_R2021b_IO682_CM_double -1.7E+308 1.7E+308 /end CHARACTERISTIC
/begin CHARACTERISTIC speedgoat_test_SN5659__cal_impl.Decode1_P15 "" VALUE 0x00833790 Scalar_FLOAT64_IEEE 0 speedgoat_test_SN5659_R2021b_IO682_CM_double -1.7E+308 1.7E+308 /end CHARACTERISTIC
/begin CHARACTERISTIC speedgoat_test_SN5659__cal_impl.Decode1_P15_a "" VALUE 0x008351F0 Scalar_FLOAT64_IEEE 0 speedgoat_test_SN5659_R2021b_IO682_CM_double -1.7E+308 1.7E+308 /end CHARACTERISTIC
/begin CHARACTERISTIC speedgoat_test_SN5659__cal_impl.Decode1_P15_be "" VALUE 0x008372E8 Scalar_FLOAT64_IEEE 0 speedgoat_test_SN5659_R2021b_IO682_CM_double -1.7E+308 1.7E+308 /end CHARACTERISTIC
/begin CHARACTERISTIC speedgoat_test_SN5659__cal_impl.Decode1_P15_g "" VALUE 0x00834B58 Scalar_FLOAT64_IEEE 0 speedgoat_test_SN5659_R2021b_IO682_CM_double -1.7E+308 1.7E+308 /end CHARACTERISTIC
/begin CHARACTERISTIC speedgoat_test_SN5659__cal_impl.Decode1_P15_h "" VALUE 0x00835888 Scalar_FLOAT64_IEEE 0 speedgoat_test_SN5659_R2021b_IO682_CM_double -1.7E+308 1.7E+308 /end CHARACTERISTIC
/begin CHARACTERISTIC speedgoat_test_SN5659__cal_impl.Decode1_P15_h1 "" VALUE 0x00835F20 Scalar_FLOAT64_IEEE 0 speedgoat_test_SN5659_R2021b_IO682_CM_double -1.7E+308 1.7E+308 /end CHARACTERISTIC
/begin CHARACTERISTIC speedgoat_test_SN5659__cal_impl.Decode1_P15_j "" VALUE 0x008365B8 Scalar_FLOAT64_IEEE 0 speedgoat_test_SN5659_R2021b_IO682_CM_double -1.7E+308 1.7E+308 /end CHARACTERISTIC
/begin CHARACTERISTIC speedgoat_test_SN5659__cal_impl.Decode1_P15_n "" VALUE 0x00836C50 Scalar_FLOAT64_IEEE 0 speedgoat_test_SN5659_R2021b_IO682_CM_double -1.7E+308 1.7E+308 /end CHARACTERISTIC
/begin CHARACTERISTIC speedgoat_test_SN5659__cal_impl.Decode1_P16 "" VALUE 0x008337A8 Scalar_FLOAT64_IEEE 0 speedgoat_test_SN5659_R2021b_IO682_CM_double -1.7E+308 1.7E+308 /end CHARACTERISTIC
/begin CHARACTERISTIC speedgoat_test_SN5659__cal_impl.Decode1_P16_e "" VALUE 0x00834B70 Scalar_FLOAT64_IEEE 0 speedgoat_test_SN5659_R2021b_IO682_CM_double -1.7E+308 1.7E+308 /end CHARACTERISTIC
/begin CHARACTERISTIC speedgoat_test_SN5659__cal_impl.Decode1_P16_ey "" VALUE 0x00837300 Scalar_FLOAT64_IEEE 0 speedgoat_test_SN5659_R2021b_IO682_CM_double -1.7E+308 1.7E+308 /end CHARACTERISTIC
/begin CHARACTERISTIC speedgoat_test_SN5659__cal_impl.Decode1_P16_f "" VALUE 0x00835F38 Scalar_FLOAT64_IEEE 0 speedgoat_test_SN5659_R2021b_IO682_CM_double -1.7E+308 1.7E+308 /end CHARACTERISTIC
/begin CHARACTERISTIC speedgoat_test_SN5659__cal_impl.Decode1_P16_jd "" VALUE 0x008365D0 Scalar_FLOAT64_IEEE 0 speedgoat_test_SN5659_R2021b_IO682_CM_double -1.7E+308 1.7E+308 /end CHARACTERISTIC
/begin CHARACTERISTIC speedgoat_test_SN5659__cal_impl.Decode1_P16_js "" VALUE 0x00836C68 Scalar_FLOAT64_IEEE 0 speedgoat_test_SN5659_R2021b_IO682_CM_double -1.7E+308 1.7E+308 /end CHARACTERISTIC
/begin CHARACTERISTIC speedgoat_test_SN5659__cal_impl.Decode1_P16_m "" VALUE 0x008358A0 Scalar_FLOAT64_IEEE 0 speedgoat_test_SN5659_R2021b_IO682_CM_double -1.7E+308 1.7E+308 /end CHARACTERISTIC
/begin CHARACTERISTIC speedgoat_test_SN5659__cal_impl.Decode1_P16_n "" VALUE 0x00835208 Scalar_FLOAT64_IEEE 0 speedgoat_test_SN5659_R2021b_IO682_CM_double -1.7E+308 1.7E+308 /end CHARACTERISTIC
/begin CHARACTERISTIC speedgoat_test_SN5659__cal_impl.Decode1_P1_d "" VALUE 0x00836460 Scalar_FLOAT64_IEEE 0 speedgoat_test_SN5659_R2021b_IO682_CM_double -1.7E+308 1.7E+308 /end CHARACTERISTIC
/begin CHARACTERISTIC speedgoat_test_SN5659__cal_impl.Decode1_P1_e "" VALUE 0x00835730 Scalar_FLOAT64_IEEE 0 speedgoat_test_SN5659_R2021b_IO682_CM_double -1.7E+308 1.7E+308 /end CHARACTERISTIC
/begin CHARACTERISTIC speedgoat_test_SN5659__cal_impl.Decode1_P1_e3 "" VALUE 0x00835DC8 Scalar_FLOAT64_IEEE 0 speedgoat_test_SN5659_R2021b_IO682_CM_double -1.7E+308 1.7E+308 /end CHARACTERISTIC
/begin CHARACTERISTIC speedgoat_test_SN5659__cal_impl.Decode1_P1_i "" VALUE 0x00837190 Scalar_FLOAT64_IEEE 0 speedgoat_test_SN5659_R2021b_IO682_CM_double -1.7E+308 1.7E+308 /end CHARACTERISTIC
/begin CHARACTERISTIC speedgoat_test_SN5659__cal_impl.Decode1_P1_l "" VALUE 0x00836AF8 Scalar_FLOAT64_IEEE 0 speedgoat_test_SN5659_R2021b_IO682_CM_double -1.7E+308 1.7E+308 /end CHARACTERISTIC
/begin CHARACTERISTIC speedgoat_test_SN5659__cal_impl.Decode1_P1_n "" VALUE 0x00834A00 Scalar_FLOAT64_IEEE 0 speedgoat_test_SN5659_R2021b_IO682_CM_double -1.7E+308 1.7E+308 /end CHARACTERISTIC
/begin CHARACTERISTIC speedgoat_test_SN5659__cal_impl.Decode1_P1_ng "" VALUE 0x00835098 Scalar_FLOAT64_IEEE 0 speedgoat_test_SN5659_R2021b_IO682_CM_double -1.7E+308 1.7E+308 /end CHARACTERISTIC
/begin CHARACTERISTIC speedgoat_test_SN5659__cal_impl.Decode1_P2 "" VALUE 0x00833650 Scalar_FLOAT64_IEEE 0 speedgoat_test_SN5659_R2021b_IO682_CM_double -1.7E+308 1.7E+308 /end CHARACTERISTIC
/begin CHARACTERISTIC speedgoat_test_SN5659__cal_impl.Decode1_P2_e "" VALUE 0x00835DE0 Scalar_FLOAT64_IEEE 0 speedgoat_test_SN5659_R2021b_IO682_CM_double -1.7E+308 1.7E+308 /end CHARACTERISTIC
/begin CHARACTERISTIC speedgoat_test_SN5659__cal_impl.Decode1_P2_en "" VALUE 0x00836478 Scalar_FLOAT64_IEEE 0 speedgoat_test_SN5659_R2021b_IO682_CM_double -1.7E+308 1.7E+308 /end CHARACTERISTIC
/begin CHARACTERISTIC speedgoat_test_SN5659__cal_impl.Decode1_P2_f "" VALUE 0x00836B10 Scalar_FLOAT64_IEEE 0 speedgoat_test_SN5659_R2021b_IO682_CM_double -1.7E+308 1.7E+308 /end CHARACTERISTIC
/begin CHARACTERISTIC speedgoat_test_SN5659__cal_impl.Decode1_P2_j "" VALUE 0x008371A8 Scalar_FLOAT64_IEEE 0 speedgoat_test_SN5659_R2021b_IO682_CM_double -1.7E+308 1.7E+308 /end CHARACTERISTIC
/begin CHARACTERISTIC speedgoat_test_SN5659__cal_impl.Decode1_P2_k "" VALUE 0x008350B0 Scalar_FLOAT64_IEEE 0 speedgoat_test_SN5659_R2021b_IO682_CM_double -1.7E+308 1.7E+308 /end CHARACTERISTIC
/begin CHARACTERISTIC speedgoat_test_SN5659__cal_impl.Decode1_P2_o "" VALUE 0x00834A18 Scalar_FLOAT64_IEEE 0 speedgoat_test_SN5659_R2021b_IO682_CM_double -1.7E+308 1.7E+308 /end CHARACTERISTIC
/begin CHARACTERISTIC speedgoat_test_SN5659__cal_impl.Decode1_P2_ov "" VALUE 0x00835748 Scalar_FLOAT64_IEEE 0 speedgoat_test_SN5659_R2021b_IO682_CM_double -1.7E+308 1.7E+308 /end CHARACTERISTIC
/begin CHARACTERISTIC speedgoat_test_SN5659__cal_impl.Decode1_P3 "" VALUE 0x00833668 Scalar_FLOAT64_IEEE 0 speedgoat_test_SN5659_R2021b_IO682_CM_double -1.7E+308 1.7E+308 /end CHARACTERISTIC
/begin CHARACTERISTIC speedgoat_test_SN5659__cal_impl.Decode1_P3_c "" VALUE 0x00836490 Scalar_FLOAT64_IEEE 0 speedgoat_test_SN5659_R2021b_IO682_CM_double -1.7E+308 1.7E+308 /end CHARACTERISTIC
/begin CHARACTERISTIC speedgoat_test_SN5659__cal_impl.Decode1_P3_f "" VALUE 0x008350C8 Scalar_FLOAT64_IEEE 0 speedgoat_test_SN5659_R2021b_IO682_CM_double -1.7E+308 1.7E+308 /end CHARACTERISTIC
/begin CHARACTERISTIC speedgoat_test_SN5659__cal_impl.Decode1_P3_f2 "" VALUE 0x008371C0 Scalar_FLOAT64_IEEE 0 speedgoat_test_SN5659_R2021b_IO682_CM_double -1.7E+308 1.7E+308 /end CHARACTERISTIC
/begin CHARACTERISTIC speedgoat_test_SN5659__cal_impl.Decode1_P3_j "" VALUE 0x00835DF8 Scalar_FLOAT64_IEEE 0 speedgoat_test_SN5659_R2021b_IO682_CM_double -1.7E+308 1.7E+308 /end CHARACTERISTIC
/begin CHARACTERISTIC speedgoat_test_SN5659__cal_impl.Decode1_P3_j5 "" VALUE 0x00836B28 Scalar_FLOAT64_IEEE 0 speedgoat_test_SN5659_R2021b_IO682_CM_double -1.7E+308 1.7E+308 /end CHARACTERISTIC
/begin CHARACTERISTIC speedgoat_test_SN5659__cal_impl.Decode1_P3_o "" VALUE 0x00834A30 Scalar_FLOAT64_IEEE 0 speedgoat_test_SN5659_R2021b_IO682_CM_double -1.7E+308 1.7E+308 /end CHARACTERISTIC
/begin CHARACTERISTIC speedgoat_test_SN5659__cal_impl.Decode1_P3_p "" VALUE 0x00835760 Scalar_FLOAT64_IEEE 0 speedgoat_test_SN5659_R2021b_IO682_CM_double -1.7E+308 1.7E+308 /end CHARACTERISTIC
/begin CHARACTERISTIC speedgoat_test_SN5659__cal_impl.Decode1_P4 "" VALUE 0x00833680 Scalar_FLOAT64_IEEE 0 speedgoat_test_SN5659_R2021b_IO682_CM_double -1.7E+308 1.7E+308 /end CHARACTERISTIC
/begin CHARACTERISTIC speedgoat_test_SN5659__cal_impl.Decode1_P4_c "" VALUE 0x008350E0 Scalar_FLOAT64_IEEE 0 speedgoat_test_SN5659_R2021b_IO682_CM_double -1.7E+308 1.7E+308 /end CHARACTERISTIC
/begin CHARACTERISTIC speedgoat_test_SN5659__cal_impl.Decode1_P4_cf "" VALUE 0x00836B40 Scalar_FLOAT64_IEEE 0 speedgoat_test_SN5659_R2021b_IO682_CM_double -1.7E+308 1.7E+308 /end CHARACTERISTIC
/begin CHARACTERISTIC speedgoat_test_SN5659__cal_impl.Decode1_P4_i "" VALUE 0x00835E10 Scalar_FLOAT64_IEEE 0 speedgoat_test_SN5659_R2021b_IO682_CM_double -1.7E+308 1.7E+308 /end CHARACTERISTIC
/begin CHARACTERISTIC speedgoat_test_SN5659__cal_impl.Decode1_P4_l "" VALUE 0x00834A48 Scalar_FLOAT64_IEEE 0 speedgoat_test_SN5659_R2021b_IO682_CM_double -1.7E+308 1.7E+308 /end CHARACTERISTIC
/begin CHARACTERISTIC speedgoat_test_SN5659__cal_impl.Decode1_P4_ls "" VALUE 0x00835778 Scalar_FLOAT64_IEEE 0 speedgoat_test_SN5659_R2021b_IO682_CM_double -1.7E+308 1.7E+308 /end CHARACTERISTIC
/begin CHARACTERISTIC speedgoat_test_SN5659__cal_impl.Decode1_P4_m "" VALUE 0x008364A8 Scalar_FLOAT64_IEEE 0 speedgoat_test_SN5659_R2021b_IO682_CM_double -1.7E+308 1.7E+308 /end CHARACTERISTIC
/begin CHARACTERISTIC speedgoat_test_SN5659__cal_impl.Decode1_P4_p "" VALUE 0x008371D8 Scalar_FLOAT64_IEEE 0 speedgoat_test_SN5659_R2021b_IO682_CM_double -1.7E+308 1.7E+308 /end CHARACTERISTIC
/begin CHARACTERISTIC speedgoat_test_SN5659__cal_impl.Decode1_P5 "" VALUE 0x00833698 Scalar_FLOAT64_IEEE 0 speedgoat_test_SN5659_R2021b_IO682_CM_double -1.7E+308 1.7E+308 /end CHARACTERISTIC
/begin CHARACTERISTIC speedgoat_test_SN5659__cal_impl.Decode1_P5_a "" VALUE 0x00836B58 Scalar_FLOAT64_IEEE 0 speedgoat_test_SN5659_R2021b_IO682_CM_double -1.7E+308 1.7E+308 /end CHARACTERISTIC
/begin CHARACTERISTIC speedgoat_test_SN5659__cal_impl.Decode1_P5_c "" VALUE 0x008364C0 Scalar_FLOAT64_IEEE 0 speedgoat_test_SN5659_R2021b_IO682_CM_double -1.7E+308 1.7E+308 /end CHARACTERISTIC
/begin CHARACTERISTIC speedgoat_test_SN5659__cal_impl.Decode1_P5_fb "" VALUE 0x008350F8 Scalar_FLOAT64_IEEE 0 speedgoat_test_SN5659_R2021b_IO682_CM_double -1.7E+308 1.7E+308 /end CHARACTERISTIC
/begin CHARACTERISTIC speedgoat_test_SN5659__cal_impl.Decode1_P5_k "" VALUE 0x00834A60 Scalar_FLOAT64_IEEE 0 speedgoat_test_SN5659_R2021b_IO682_CM_double -1.7E+308 1.7E+308 /end CHARACTERISTIC
/begin CHARACTERISTIC speedgoat_test_SN5659__cal_impl.Decode1_P5_m "" VALUE 0x00835790 Scalar_FLOAT64_IEEE 0 speedgoat_test_SN5659_R2021b_IO682_CM_double -1.7E+308 1.7E+308 /end CHARACTERISTIC
/begin CHARACTERISTIC speedgoat_test_SN5659__cal_impl.Decode1_P5_nq "" VALUE 0x008371F0 Scalar_FLOAT64_IEEE 0 speedgoat_test_SN5659_R2021b_IO682_CM_double -1.7E+308 1.7E+308 /end CHARACTERISTIC
/begin CHARACTERISTIC speedgoat_test_SN5659__cal_impl.Decode1_P5_o "" VALUE 0x00835E28 Scalar_FLOAT64_IEEE 0 speedgoat_test_SN5659_R2021b_IO682_CM_double -1.7E+308 1.7E+308 /end CHARACTERISTIC
/begin CHARACTERISTIC speedgoat_test_SN5659__cal_impl.Decode1_P6 "" VALUE 0x008336B0 Scalar_FLOAT64_IEEE 0 speedgoat_test_SN5659_R2021b_IO682_CM_double -1.7E+308 1.7E+308 /end CHARACTERISTIC
/begin CHARACTERISTIC speedgoat_test_SN5659__cal_impl.Decode1_P6_b "" VALUE 0x00835110 Scalar_FLOAT64_IEEE 0 speedgoat_test_SN5659_R2021b_IO682_CM_double -1.7E+308 1.7E+308 /end CHARACTERISTIC
/begin CHARACTERISTIC speedgoat_test_SN5659__cal_impl.Decode1_P6_ba "" VALUE 0x00837208 Scalar_FLOAT64_IEEE 0 speedgoat_test_SN5659_R2021b_IO682_CM_double -1.7E+308 1.7E+308 /end CHARACTERISTIC
/begin CHARACTERISTIC speedgoat_test_SN5659__cal_impl.Decode1_P6_d "" VALUE 0x00834A78 Scalar_FLOAT64_IEEE 0 speedgoat_test_SN5659_R2021b_IO682_CM_double -1.7E+308 1.7E+308 /end CHARACTERISTIC
/begin CHARACTERISTIC speedgoat_test_SN5659__cal_impl.Decode1_P6_fp "" VALUE 0x00836B70 Scalar_FLOAT64_IEEE 0 speedgoat_test_SN5659_R2021b_IO682_CM_double -1.7E+308 1.7E+308 /end CHARACTERISTIC
/begin CHARACTERISTIC speedgoat_test_SN5659__cal_impl.Decode1_P6_i "" VALUE 0x008364D8 Scalar_FLOAT64_IEEE 0 speedgoat_test_SN5659_R2021b_IO682_CM_double -1.7E+308 1.7E+308 /end CHARACTERISTIC
/begin CHARACTERISTIC speedgoat_test_SN5659__cal_impl.Decode1_P6_n "" VALUE 0x008357A8 Scalar_FLOAT64_IEEE 0 speedgoat_test_SN5659_R2021b_IO682_CM_double -1.7E+308 1.7E+308 /end CHARACTERISTIC
/begin CHARACTERISTIC speedgoat_test_SN5659__cal_impl.Decode1_P6_p "" VALUE 0x00835E40 Scalar_FLOAT64_IEEE 0 speedgoat_test_SN5659_R2021b_IO682_CM_double -1.7E+308 1.7E+308 /end CHARACTERISTIC
/begin CHARACTERISTIC speedgoat_test_SN5659__cal_impl.Decode1_P7 "" VALUE 0x008336C8 Scalar_FLOAT64_IEEE 0 speedgoat_test_SN5659_R2021b_IO682_CM_double -1.7E+308 1.7E+308 /end CHARACTERISTIC
/begin CHARACTERISTIC speedgoat_test_SN5659__cal_impl.Decode1_P7_a "" VALUE 0x00834A90 Scalar_FLOAT64_IEEE 0 speedgoat_test_SN5659_R2021b_IO682_CM_double -1.7E+308 1.7E+308 /end CHARACTERISTIC
/begin CHARACTERISTIC speedgoat_test_SN5659__cal_impl.Decode1_P7_b "" VALUE 0x00836B88 Scalar_FLOAT64_IEEE 0 speedgoat_test_SN5659_R2021b_IO682_CM_double -1.7E+308 1.7E+308 /end CHARACTERISTIC
/begin CHARACTERISTIC speedgoat_test_SN5659__cal_impl.Decode1_P7_d "" VALUE 0x008357C0 Scalar_FLOAT64_IEEE 0 speedgoat_test_SN5659_R2021b_IO682_CM_double -1.7E+308 1.7E+308 /end CHARACTERISTIC
/begin CHARACTERISTIC speedgoat_test_SN5659__cal_impl.Decode1_P7_dn "" VALUE 0x00835E58 Scalar_FLOAT64_IEEE 0 speedgoat_test_SN5659_R2021b_IO682_CM_double -1.7E+308 1.7E+308 /end CHARACTERISTIC
/begin CHARACTERISTIC speedgoat_test_SN5659__cal_impl.Decode1_P7_hm "" VALUE 0x00837220 Scalar_FLOAT64_IEEE 0 speedgoat_test_SN5659_R2021b_IO682_CM_double -1.7E+308 1.7E+308 /end CHARACTERISTIC
/begin CHARACTERISTIC speedgoat_test_SN5659__cal_impl.Decode1_P7_m "" VALUE 0x00835128 Scalar_FLOAT64_IEEE 0 speedgoat_test_SN5659_R2021b_IO682_CM_double -1.7E+308 1.7E+308 /end CHARACTERISTIC
/begin CHARACTERISTIC speedgoat_test_SN5659__cal_impl.Decode1_P7_o "" VALUE 0x008364F0 Scalar_FLOAT64_IEEE 0 speedgoat_test_SN5659_R2021b_IO682_CM_double -1.7E+308 1.7E+308 /end CHARACTERISTIC
/begin CHARACTERISTIC speedgoat_test_SN5659__cal_impl.Decode1_P8 "" VALUE 0x008336E0 Scalar_FLOAT64_IEEE 0 speedgoat_test_SN5659_R2021b_IO682_CM_double -1.7E+308 1.7E+308 /end CHARACTERISTIC
/begin CHARACTERISTIC speedgoat_test_SN5659__cal_impl.Decode1_P8_e "" VALUE 0x00835140 Scalar_FLOAT64_IEEE 0 speedgoat_test_SN5659_R2021b_IO682_CM_double -1.7E+308 1.7E+308 /end CHARACTERISTIC
/begin CHARACTERISTIC speedgoat_test_SN5659__cal_impl.Decode1_P8_g "" VALUE 0x00834AA8 Scalar_FLOAT64_IEEE 0 speedgoat_test_SN5659_R2021b_IO682_CM_double -1.7E+308 1.7E+308 /end CHARACTERISTIC
/begin CHARACTERISTIC speedgoat_test_SN5659__cal_impl.Decode1_P8_gl "" VALUE 0x00837238 Scalar_FLOAT64_IEEE 0 speedgoat_test_SN5659_R2021b_IO682_CM_double -1.7E+308 1.7E+308 /end CHARACTERISTIC
/begin CHARACTERISTIC speedgoat_test_SN5659__cal_impl.Decode1_P8_i "" VALUE 0x00836508 Scalar_FLOAT64_IEEE 0 speedgoat_test_SN5659_R2021b_IO682_CM_double -1.7E+308 1.7E+308 /end CHARACTERISTIC
/begin CHARACTERISTIC speedgoat_test_SN5659__cal_impl.Decode1_P8_lr "" VALUE 0x00835E70 Scalar_FLOAT64_IEEE 0 speedgoat_test_SN5659_R2021b_IO682_CM_double -1.7E+308 1.7E+308 /end CHARACTERISTIC
/begin CHARACTERISTIC speedgoat_test_SN5659__cal_impl.Decode1_P8_p "" VALUE 0x008357D8 Scalar_FLOAT64_IEEE 0 speedgoat_test_SN5659_R2021b_IO682_CM_double -1.7E+308 1.7E+308 /end CHARACTERISTIC
/begin CHARACTERISTIC speedgoat_test_SN5659__cal_impl.Decode1_P8_pw "" VALUE 0x00836BA0 Scalar_FLOAT64_IEEE 0 speedgoat_test_SN5659_R2021b_IO682_CM_double -1.7E+308 1.7E+308 /end CHARACTERISTIC
/begin CHARACTERISTIC speedgoat_test_SN5659__cal_impl.Decode1_P9 "" VALUE 0x008336F8 Scalar_FLOAT64_IEEE 0 speedgoat_test_SN5659_R2021b_IO682_CM_double -1.7E+308 1.7E+308 /end CHARACTERISTIC
/begin CHARACTERISTIC speedgoat_test_SN5659__cal_impl.Decode1_P9_b "" VALUE 0x00835158 Scalar_FLOAT64_IEEE 0 speedgoat_test_SN5659_R2021b_IO682_CM_double -1.7E+308 1.7E+308 /end CHARACTERISTIC
/begin CHARACTERISTIC speedgoat_test_SN5659__cal_impl.Decode1_P9_d "" VALUE 0x00836BB8 Scalar_FLOAT64_IEEE 0 speedgoat_test_SN5659_R2021b_IO682_CM_double -1.7E+308 1.7E+308 /end CHARACTERISTIC
/begin CHARACTERISTIC speedgoat_test_SN5659__cal_impl.Decode1_P9_dd "" VALUE 0x00837250 Scalar_FLOAT64_IEEE 0 speedgoat_test_SN5659_R2021b_IO682_CM_double -1.7E+308 1.7E+308 /end CHARACTERISTIC
/begin CHARACTERISTIC speedgoat_test_SN5659__cal_impl.Decode1_P9_g "" VALUE 0x008357F0 Scalar_FLOAT64_IEEE 0 speedgoat_test_SN5659_R2021b_IO682_CM_double -1.7E+308 1.7E+308 /end CHARACTERISTIC
/begin CHARACTERISTIC speedgoat_test_SN5659__cal_impl.Decode1_P9_i "" VALUE 0x00835E88 Scalar_FLOAT64_IEEE 0 speedgoat_test_SN5659_R2021b_IO682_CM_double -1.7E+308 1.7E+308 /end CHARACTERISTIC
/begin CHARACTERISTIC speedgoat_test_SN5659__cal_impl.Decode1_P9_l "" VALUE 0x00836520 Scalar_FLOAT64_IEEE 0 speedgoat_test_SN5659_R2021b_IO682_CM_double -1.7E+308 1.7E+308 /end CHARACTERISTIC
/begin CHARACTERISTIC speedgoat_test_SN5659__cal_impl.Decode1_P9_o "" VALUE 0x00834AC0 Scalar_FLOAT64_IEEE 0 speedgoat_test_SN5659_R2021b_IO682_CM_double -1.7E+308 1.7E+308 /end CHARACTERISTIC
/begin CHARACTERISTIC speedgoat_test_SN5659__cal_impl.Decode2_P10_b "" VAL_BLK 0x00836D58 Scalar_FLOAT64_IEEE 0 speedgoat_test_SN5659_R2021b_IO682_CM_double -1.7E+308 1.7E+308 MATRIX_DIM 2 1 /end CHARACTERISTIC
/begin CHARACTERISTIC speedgoat_test_SN5659__cal_impl.Decode2_P10_c "" VAL_BLK 0x008352F8 Scalar_FLOAT64_IEEE 0 speedgoat_test_SN5659_R2021b_IO682_CM_double -1.7E+308 1.7E+308 MATRIX_DIM 2 1 /end CHARACTERISTIC
/begin CHARACTERISTIC speedgoat_test_SN5659__cal_impl.Decode2_P10_h "" VAL_BLK 0x00834C60 Scalar_FLOAT64_IEEE 0 speedgoat_test_SN5659_R2021b_IO682_CM_double -1.7E+308 1.7E+308 MATRIX_DIM 2 1 /end CHARACTERISTIC
/begin CHARACTERISTIC speedgoat_test_SN5659__cal_impl.Decode2_P10_j "" VAL_BLK 0x00835990 Scalar_FLOAT64_IEEE 0 speedgoat_test_SN5659_R2021b_IO682_CM_double -1.7E+308 1.7E+308 MATRIX_DIM 2 1 /end CHARACTERISTIC
/begin CHARACTERISTIC speedgoat_test_SN5659__cal_impl.Decode2_P10_js "" VAL_BLK 0x008373F0 Scalar_FLOAT64_IEEE 0 speedgoat_test_SN5659_R2021b_IO682_CM_double -1.7E+308 1.7E+308 MATRIX_DIM 2 1 /end CHARACTERISTIC
/begin CHARACTERISTIC speedgoat_test_SN5659__cal_impl.Decode2_P10_n "" VAL_BLK 0x008366C0 Scalar_FLOAT64_IEEE 0 speedgoat_test_SN5659_R2021b_IO682_CM_double -1.7E+308 1.7E+308 MATRIX_DIM 2 1 /end CHARACTERISTIC
/begin CHARACTERISTIC speedgoat_test_SN5659__cal_impl.Decode2_P11_b "" VALUE 0x00836D78 Scalar_FLOAT64_IEEE 0 speedgoat_test_SN5659_R2021b_IO682_CM_double -1.7E+308 1.7E+308 /end CHARACTERISTIC
/begin CHARACTERISTIC speedgoat_test_SN5659__cal_impl.Decode2_P11_f "" VALUE 0x00835318 Scalar_FLOAT64_IEEE 0 speedgoat_test_SN5659_R2021b_IO682_CM_double -1.7E+308 1.7E+308 /end CHARACTERISTIC
/begin CHARACTERISTIC speedgoat_test_SN5659__cal_impl.Decode2_P11_j "" VALUE 0x00834C80 Scalar_FLOAT64_IEEE 0 speedgoat_test_SN5659_R2021b_IO682_CM_double -1.7E+308 1.7E+308 /end CHARACTERISTIC
/begin CHARACTERISTIC speedgoat_test_SN5659__cal_impl.Decode2_P11_jv "" VALUE 0x00837410 Scalar_FLOAT64_IEEE 0 speedgoat_test_SN5659_R2021b_IO682_CM_double -1.7E+308 1.7E+308 /end CHARACTERISTIC
/begin CHARACTERISTIC speedgoat_test_SN5659__cal_impl.Decode2_P11_k "" VALUE 0x008366E0 Scalar_FLOAT64_IEEE 0 speedgoat_test_SN5659_R2021b_IO682_CM_double -1.7E+308 1.7E+308 /end CHARACTERISTIC
/begin CHARACTERISTIC speedgoat_test_SN5659__cal_impl.Decode2_P11_m "" VALUE 0x008359B0 Scalar_FLOAT64_IEEE 0 speedgoat_test_SN5659_R2021b_IO682_CM_double -1.7E+308 1.7E+308 /end CHARACTERISTIC
/begin CHARACTERISTIC speedgoat_test_SN5659__cal_impl.Decode2_P12_f "" VALUE 0x00835330 Scalar_FLOAT64_IEEE 0 speedgoat_test_SN5659_R2021b_IO682_CM_double -1.7E+308 1.7E+308 /end CHARACTERISTIC
/begin CHARACTERISTIC speedgoat_test_SN5659__cal_impl.Decode2_P12_g "" VALUE 0x00834C98 Scalar_FLOAT64_IEEE 0 speedgoat_test_SN5659_R2021b_IO682_CM_double -1.7E+308 1.7E+308 /end CHARACTERISTIC
/begin CHARACTERISTIC speedgoat_test_SN5659__cal_impl.Decode2_P12_i "" VALUE 0x008366F8 Scalar_FLOAT64_IEEE 0 speedgoat_test_SN5659_R2021b_IO682_CM_double -1.7E+308 1.7E+308 /end CHARACTERISTIC
/begin CHARACTERISTIC speedgoat_test_SN5659__cal_impl.Decode2_P12_k "" VALUE 0x008359C8 Scalar_FLOAT64_IEEE 0 speedgoat_test_SN5659_R2021b_IO682_CM_double -1.7E+308 1.7E+308 /end CHARACTERISTIC
/begin CHARACTERISTIC speedgoat_test_SN5659__cal_impl.Decode2_P12_l "" VALUE 0x00836D90 Scalar_FLOAT64_IEEE 0 speedgoat_test_SN5659_R2021b_IO682_CM_double -1.7E+308 1.7E+308 /end CHARACTERISTIC
/begin CHARACTERISTIC speedgoat_test_SN5659__cal_impl.Decode2_P12_p "" VALUE 0x00837428 Scalar_FLOAT64_IEEE 0 speedgoat_test_SN5659_R2021b_IO682_CM_double -1.7E+308 1.7E+308 /end CHARACTERISTIC
/begin CHARACTERISTIC speedgoat_test_SN5659__cal_impl.Decode2_P13_e "" VALUE 0x00836710 Scalar_FLOAT64_IEEE 0 speedgoat_test_SN5659_R2021b_IO682_CM_double -1.7E+308 1.7E+308 /end CHARACTERISTIC
/begin CHARACTERISTIC speedgoat_test_SN5659__cal_impl.Decode2_P13_f "" VALUE 0x00836DA8 Scalar_FLOAT64_IEEE 0 speedgoat_test_SN5659_R2021b_IO682_CM_double -1.7E+308 1.7E+308 /end CHARACTERISTIC
/begin CHARACTERISTIC speedgoat_test_SN5659__cal_impl.Decode2_P13_i "" VALUE 0x00834CB0 Scalar_FLOAT64_IEEE 0 speedgoat_test_SN5659_R2021b_IO682_CM_double -1.7E+308 1.7E+308 /end CHARACTERISTIC
/begin CHARACTERISTIC speedgoat_test_SN5659__cal_impl.Decode2_P13_iy "" VALUE 0x00837440 Scalar_FLOAT64_IEEE 0 speedgoat_test_SN5659_R2021b_IO682_CM_double -1.7E+308 1.7E+308 /end CHARACTERISTIC
/begin CHARACTERISTIC speedgoat_test_SN5659__cal_impl.Decode2_P13_j "" VALUE 0x008359E0 Scalar_FLOAT64_IEEE 0 speedgoat_test_SN5659_R2021b_IO682_CM_double -1.7E+308 1.7E+308 /end CHARACTERISTIC
/begin CHARACTERISTIC speedgoat_test_SN5659__cal_impl.Decode2_P13_k "" VALUE 0x00835348 Scalar_FLOAT64_IEEE 0 speedgoat_test_SN5659_R2021b_IO682_CM_double -1.7E+308 1.7E+308 /end CHARACTERISTIC
/begin CHARACTERISTIC speedgoat_test_SN5659__cal_impl.Decode2_P14_b "" VALUE 0x00836728 Scalar_FLOAT64_IEEE 0 speedgoat_test_SN5659_R2021b_IO682_CM_double -1.7E+308 1.7E+308 /end CHARACTERISTIC
/begin CHARACTERISTIC speedgoat_test_SN5659__cal_impl.Decode2_P14_e "" VALUE 0x00834CC8 Scalar_FLOAT64_IEEE 0 speedgoat_test_SN5659_R2021b_IO682_CM_double -1.7E+308 1.7E+308 /end CHARACTERISTIC
/begin CHARACTERISTIC speedgoat_test_SN5659__cal_impl.Decode2_P14_f "" VALUE 0x00837458 Scalar_FLOAT64_IEEE 0 speedgoat_test_SN5659_R2021b_IO682_CM_double -1.7E+308 1.7E+308 /end CHARACTERISTIC
/begin CHARACTERISTIC speedgoat_test_SN5659__cal_impl.Decode2_P14_m "" VALUE 0x00835360 Scalar_FLOAT64_IEEE 0 speedgoat_test_SN5659_R2021b_IO682_CM_double -1.7E+308 1.7E+308 /end CHARACTERISTIC
/begin CHARACTERISTIC speedgoat_test_SN5659__cal_impl.Decode2_P14_mb "" VALUE 0x00836DC0 Scalar_FLOAT64_IEEE 0 speedgoat_test_SN5659_R2021b_IO682_CM_double -1.7E+308 1.7E+308 /end CHARACTERISTIC
/begin CHARACTERISTIC speedgoat_test_SN5659__cal_impl.Decode2_P14_o "" VALUE 0x008359F8 Scalar_FLOAT64_IEEE 0 speedgoat_test_SN5659_R2021b_IO682_CM_double -1.7E+308 1.7E+308 /end CHARACTERISTIC
/begin CHARACTERISTIC speedgoat_test_SN5659__cal_impl.Decode2_P15_a "" VALUE 0x00834CE0 Scalar_FLOAT64_IEEE 0 speedgoat_test_SN5659_R2021b_IO682_CM_double -1.7E+308 1.7E+308 /end CHARACTERISTIC
/begin CHARACTERISTIC speedgoat_test_SN5659__cal_impl.Decode2_P15_c "" VALUE 0x00835378 Scalar_FLOAT64_IEEE 0 speedgoat_test_SN5659_R2021b_IO682_CM_double -1.7E+308 1.7E+308 /end CHARACTERISTIC
/begin CHARACTERISTIC speedgoat_test_SN5659__cal_impl.Decode2_P15_cj "" VALUE 0x00837470 Scalar_FLOAT64_IEEE 0 speedgoat_test_SN5659_R2021b_IO682_CM_double -1.7E+308 1.7E+308 /end CHARACTERISTIC
/begin CHARACTERISTIC speedgoat_test_SN5659__cal_impl.Decode2_P15_g "" VALUE 0x00835A10 Scalar_FLOAT64_IEEE 0 speedgoat_test_SN5659_R2021b_IO682_CM_double -1.7E+308 1.7E+308 /end CHARACTERISTIC
/begin CHARACTERISTIC speedgoat_test_SN5659__cal_impl.Decode2_P15_j "" VALUE 0x00836DD8 Scalar_FLOAT64_IEEE 0 speedgoat_test_SN5659_R2021b_IO682_CM_double -1.7E+308 1.7E+308 /end CHARACTERISTIC
/begin CHARACTERISTIC speedgoat_test_SN5659__cal_impl.Decode2_P15_n "" VALUE 0x00836740 Scalar_FLOAT64_IEEE 0 speedgoat_test_SN5659_R2021b_IO682_CM_double -1.7E+308 1.7E+308 /end CHARACTERISTIC
/begin CHARACTERISTIC speedgoat_test_SN5659__cal_impl.Decode2_P16_c "" VALUE 0x00834CF8 Scalar_FLOAT64_IEEE 0 speedgoat_test_SN5659_R2021b_IO682_CM_double -1.7E+308 1.7E+308 /end CHARACTERISTIC
/begin CHARACTERISTIC speedgoat_test_SN5659__cal_impl.Decode2_P16_cj "" VALUE 0x00835A28 Scalar_FLOAT64_IEEE 0 speedgoat_test_SN5659_R2021b_IO682_CM_double -1.7E+308 1.7E+308 /end CHARACTERISTIC
/begin CHARACTERISTIC speedgoat_test_SN5659__cal_impl.Decode2_P16_i "" VALUE 0x00837488 Scalar_FLOAT64_IEEE 0 speedgoat_test_SN5659_R2021b_IO682_CM_double -1.7E+308 1.7E+308 /end CHARACTERISTIC
/begin CHARACTERISTIC speedgoat_test_SN5659__cal_impl.Decode2_P16_j "" VALUE 0x00836DF0 Scalar_FLOAT64_IEEE 0 speedgoat_test_SN5659_R2021b_IO682_CM_double -1.7E+308 1.7E+308 /end CHARACTERISTIC
/begin CHARACTERISTIC speedgoat_test_SN5659__cal_impl.Decode2_P16_m "" VALUE 0x00835390 Scalar_FLOAT64_IEEE 0 speedgoat_test_SN5659_R2021b_IO682_CM_double -1.7E+308 1.7E+308 /end CHARACTERISTIC
/begin CHARACTERISTIC speedgoat_test_SN5659__cal_impl.Decode2_P16_n "" VALUE 0x00836758 Scalar_FLOAT64_IEEE 0 speedgoat_test_SN5659_R2021b_IO682_CM_double -1.7E+308 1.7E+308 /end CHARACTERISTIC
/begin CHARACTERISTIC speedgoat_test_SN5659__cal_impl.Decode2_P1_c "" VALUE 0x00837318 Scalar_FLOAT64_IEEE 0 speedgoat_test_SN5659_R2021b_IO682_CM_double -1.7E+308 1.7E+308 /end CHARACTERISTIC
/begin CHARACTERISTIC speedgoat_test_SN5659__cal_impl.Decode2_P1_d "" VALUE 0x00834B88 Scalar_FLOAT64_IEEE 0 speedgoat_test_SN5659_R2021b_IO682_CM_double -1.7E+308 1.7E+308 /end CHARACTERISTIC
/begin CHARACTERISTIC speedgoat_test_SN5659__cal_impl.Decode2_P1_e "" VALUE 0x008358B8 Scalar_FLOAT64_IEEE 0 speedgoat_test_SN5659_R2021b_IO682_CM_double -1.7E+308 1.7E+308 /end CHARACTERISTIC
/begin CHARACTERISTIC speedgoat_test_SN5659__cal_impl.Decode2_P1_g "" VALUE 0x00835220 Scalar_FLOAT64_IEEE 0 speedgoat_test_SN5659_R2021b_IO682_CM_double -1.7E+308 1.7E+308 /end CHARACTERISTIC
/begin CHARACTERISTIC speedgoat_test_SN5659__cal_impl.Decode2_P1_h "" VALUE 0x008365E8 Scalar_FLOAT64_IEEE 0 speedgoat_test_SN5659_R2021b_IO682_CM_double -1.7E+308 1.7E+308 /end CHARACTERISTIC
/begin CHARACTERISTIC speedgoat_test_SN5659__cal_impl.Decode2_P1_o "" VALUE 0x00836C80 Scalar_FLOAT64_IEEE 0 speedgoat_test_SN5659_R2021b_IO682_CM_double -1.7E+308 1.7E+308 /end CHARACTERISTIC
/begin CHARACTERISTIC speedgoat_test_SN5659__cal_impl.Decode2_P2_e "" VALUE 0x00835238 Scalar_FLOAT64_IEEE 0 speedgoat_test_SN5659_R2021b_IO682_CM_double -1.7E+308 1.7E+308 /end CHARACTERISTIC
/begin CHARACTERISTIC speedgoat_test_SN5659__cal_impl.Decode2_P2_ex "" VALUE 0x00836C98 Scalar_FLOAT64_IEEE 0 speedgoat_test_SN5659_R2021b_IO682_CM_double -1.7E+308 1.7E+308 /end CHARACTERISTIC
/begin CHARACTERISTIC speedgoat_test_SN5659__cal_impl.Decode2_P2_h "" VALUE 0x00836600 Scalar_FLOAT64_IEEE 0 speedgoat_test_SN5659_R2021b_IO682_CM_double -1.7E+308 1.7E+308 /end CHARACTERISTIC
/begin CHARACTERISTIC speedgoat_test_SN5659__cal_impl.Decode2_P2_j "" VALUE 0x008358D0 Scalar_FLOAT64_IEEE 0 speedgoat_test_SN5659_R2021b_IO682_CM_double -1.7E+308 1.7E+308 /end CHARACTERISTIC
/begin CHARACTERISTIC speedgoat_test_SN5659__cal_impl.Decode2_P2_k "" VALUE 0x00837330 Scalar_FLOAT64_IEEE 0 speedgoat_test_SN5659_R2021b_IO682_CM_double -1.7E+308 1.7E+308 /end CHARACTERISTIC
/begin CHARACTERISTIC speedgoat_test_SN5659__cal_impl.Decode2_P2_m "" VALUE 0x00834BA0 Scalar_FLOAT64_IEEE 0 speedgoat_test_SN5659_R2021b_IO682_CM_double -1.7E+308 1.7E+308 /end CHARACTERISTIC
/begin CHARACTERISTIC speedgoat_test_SN5659__cal_impl.Decode2_P3_a "" VALUE 0x00834BB8 Scalar_FLOAT64_IEEE 0 speedgoat_test_SN5659_R2021b_IO682_CM_double -1.7E+308 1.7E+308 /end CHARACTERISTIC
/begin CHARACTERISTIC speedgoat_test_SN5659__cal_impl.Decode2_P3_b "" VALUE 0x00837348 Scalar_FLOAT64_IEEE 0 speedgoat_test_SN5659_R2021b_IO682_CM_double -1.7E+308 1.7E+308 /end CHARACTERISTIC
/begin CHARACTERISTIC speedgoat_test_SN5659__cal_impl.Decode2_P3_d "" VALUE 0x00836618 Scalar_FLOAT64_IEEE 0 speedgoat_test_SN5659_R2021b_IO682_CM_double -1.7E+308 1.7E+308 /end CHARACTERISTIC
/begin CHARACTERISTIC speedgoat_test_SN5659__cal_impl.Decode2_P3_e "" VALUE 0x00835250 Scalar_FLOAT64_IEEE 0 speedgoat_test_SN5659_R2021b_IO682_CM_double -1.7E+308 1.7E+308 /end CHARACTERISTIC
/begin CHARACTERISTIC speedgoat_test_SN5659__cal_impl.Decode2_P3_g "" VALUE 0x00836CB0 Scalar_FLOAT64_IEEE 0 speedgoat_test_SN5659_R2021b_IO682_CM_double -1.7E+308 1.7E+308 /end CHARACTERISTIC
/begin CHARACTERISTIC speedgoat_test_SN5659__cal_impl.Decode2_P3_k "" VALUE 0x008358E8 Scalar_FLOAT64_IEEE 0 speedgoat_test_SN5659_R2021b_IO682_CM_double -1.7E+308 1.7E+308 /end CHARACTERISTIC
/begin CHARACTERISTIC speedgoat_test_SN5659__cal_impl.Decode2_P4_c "" VALUE 0x00835900 Scalar_FLOAT64_IEEE 0 speedgoat_test_SN5659_R2021b_IO682_CM_double -1.7E+308 1.7E+308 /end CHARACTERISTIC
/begin CHARACTERISTIC speedgoat_test_SN5659__cal_impl.Decode2_P4_f "" VALUE 0x00836630 Scalar_FLOAT64_IEEE 0 speedgoat_test_SN5659_R2021b_IO682_CM_double -1.7E+308 1.7E+308 /end CHARACTERISTIC
/begin CHARACTERISTIC speedgoat_test_SN5659__cal_impl.Decode2_P4_g "" VALUE 0x00834BD0 Scalar_FLOAT64_IEEE 0 speedgoat_test_SN5659_R2021b_IO682_CM_double -1.7E+308 1.7E+308 /end CHARACTERISTIC
/begin CHARACTERISTIC speedgoat_test_SN5659__cal_impl.Decode2_P4_j "" VALUE 0x00836CC8 Scalar_FLOAT64_IEEE 0 speedgoat_test_SN5659_R2021b_IO682_CM_double -1.7E+308 1.7E+308 /end CHARACTERISTIC
/begin CHARACTERISTIC speedgoat_test_SN5659__cal_impl.Decode2_P4_l "" VALUE 0x00835268 Scalar_FLOAT64_IEEE 0 speedgoat_test_SN5659_R2021b_IO682_CM_double -1.7E+308 1.7E+308 /end CHARACTERISTIC
/begin CHARACTERISTIC speedgoat_test_SN5659__cal_impl.Decode2_P4_o "" VALUE 0x00837360 Scalar_FLOAT64_IEEE 0 speedgoat_test_SN5659_R2021b_IO682_CM_double -1.7E+308 1.7E+308 /end CHARACTERISTIC
/begin CHARACTERISTIC speedgoat_test_SN5659__cal_impl.Decode2_P5_c "" VALUE 0x00835918 Scalar_FLOAT64_IEEE 0 speedgoat_test_SN5659_R2021b_IO682_CM_double -1.7E+308 1.7E+308 /end CHARACTERISTIC
/begin CHARACTERISTIC speedgoat_test_SN5659__cal_impl.Decode2_P5_e "" VALUE 0x00836CE0 Scalar_FLOAT64_IEEE 0 speedgoat_test_SN5659_R2021b_IO682_CM_double -1.7E+308 1.7E+308 /end CHARACTERISTIC
/begin CHARACTERISTIC speedgoat_test_SN5659__cal_impl.Decode2_P5_f "" VALUE 0x00835280 Scalar_FLOAT64_IEEE 0 speedgoat_test_SN5659_R2021b_IO682_CM_double -1.7E+308 1.7E+308 /end CHARACTERISTIC
/begin CHARACTERISTIC speedgoat_test_SN5659__cal_impl.Decode2_P5_g "" VALUE 0x00834BE8 Scalar_FLOAT64_IEEE 0 speedgoat_test_SN5659_R2021b_IO682_CM_double -1.7E+308 1.7E+308 /end CHARACTERISTIC
/begin CHARACTERISTIC speedgoat_test_SN5659__cal_impl.Decode2_P5_gd "" VALUE 0x00836648 Scalar_FLOAT64_IEEE 0 speedgoat_test_SN5659_R2021b_IO682_CM_double -1.7E+308 1.7E+308 /end CHARACTERISTIC
/begin CHARACTERISTIC speedgoat_test_SN5659__cal_impl.Decode2_P5_j "" VALUE 0x00837378 Scalar_FLOAT64_IEEE 0 speedgoat_test_SN5659_R2021b_IO682_CM_double -1.7E+308 1.7E+308 /end CHARACTERISTIC
/begin CHARACTERISTIC speedgoat_test_SN5659__cal_impl.Decode2_P6_h "" VALUE 0x00837390 Scalar_FLOAT64_IEEE 0 speedgoat_test_SN5659_R2021b_IO682_CM_double -1.7E+308 1.7E+308 /end CHARACTERISTIC
/begin CHARACTERISTIC speedgoat_test_SN5659__cal_impl.Decode2_P6_l "" VALUE 0x00834C00 Scalar_FLOAT64_IEEE 0 speedgoat_test_SN5659_R2021b_IO682_CM_double -1.7E+308 1.7E+308 /end CHARACTERISTIC
/begin CHARACTERISTIC speedgoat_test_SN5659__cal_impl.Decode2_P6_o "" VALUE 0x00835298 Scalar_FLOAT64_IEEE 0 speedgoat_test_SN5659_R2021b_IO682_CM_double -1.7E+308 1.7E+308 /end CHARACTERISTIC
/begin CHARACTERISTIC speedgoat_test_SN5659__cal_impl.Decode2_P6_oa "" VALUE 0x00836660 Scalar_FLOAT64_IEEE 0 speedgoat_test_SN5659_R2021b_IO682_CM_double -1.7E+308 1.7E+308 /end CHARACTERISTIC
/begin CHARACTERISTIC speedgoat_test_SN5659__cal_impl.Decode2_P6_p "" VALUE 0x00835930 Scalar_FLOAT64_IEEE 0 speedgoat_test_SN5659_R2021b_IO682_CM_double -1.7E+308 1.7E+308 /end CHARACTERISTIC
/begin CHARACTERISTIC speedgoat_test_SN5659__cal_impl.Decode2_P6_pp "" VALUE 0x00836CF8 Scalar_FLOAT64_IEEE 0 speedgoat_test_SN5659_R2021b_IO682_CM_double -1.7E+308 1.7E+308 /end CHARACTERISTIC
/begin CHARACTERISTIC speedgoat_test_SN5659__cal_impl.Decode2_P7_g "" VALUE 0x00834C18 Scalar_FLOAT64_IEEE 0 speedgoat_test_SN5659_R2021b_IO682_CM_double -1.7E+308 1.7E+308 /end CHARACTERISTIC
/begin CHARACTERISTIC speedgoat_test_SN5659__cal_impl.Decode2_P7_j "" VALUE 0x00836678 Scalar_FLOAT64_IEEE 0 speedgoat_test_SN5659_R2021b_IO682_CM_double -1.7E+308 1.7E+308 /end CHARACTERISTIC
/begin CHARACTERISTIC speedgoat_test_SN5659__cal_impl.Decode2_P7_jq "" VALUE 0x008373A8 Scalar_FLOAT64_IEEE 0 speedgoat_test_SN5659_R2021b_IO682_CM_double -1.7E+308 1.7E+308 /end CHARACTERISTIC
/begin CHARACTERISTIC speedgoat_test_SN5659__cal_impl.Decode2_P7_m "" VALUE 0x008352B0 Scalar_FLOAT64_IEEE 0 speedgoat_test_SN5659_R2021b_IO682_CM_double -1.7E+308 1.7E+308 /end CHARACTERISTIC
/begin CHARACTERISTIC speedgoat_test_SN5659__cal_impl.Decode2_P7_mb "" VALUE 0x00836D10 Scalar_FLOAT64_IEEE 0 speedgoat_test_SN5659_R2021b_IO682_CM_double -1.7E+308 1.7E+308 /end CHARACTERISTIC
/begin CHARACTERISTIC speedgoat_test_SN5659__cal_impl.Decode2_P7_o "" VALUE 0x00835948 Scalar_FLOAT64_IEEE 0 speedgoat_test_SN5659_R2021b_IO682_CM_double -1.7E+308 1.7E+308 /end CHARACTERISTIC
/begin CHARACTERISTIC speedgoat_test_SN5659__cal_impl.Decode2_P8_b "" VALUE 0x00835960 Scalar_FLOAT64_IEEE 0 speedgoat_test_SN5659_R2021b_IO682_CM_double -1.7E+308 1.7E+308 /end CHARACTERISTIC
/begin CHARACTERISTIC speedgoat_test_SN5659__cal_impl.Decode2_P8_c "" VALUE 0x00836D28 Scalar_FLOAT64_IEEE 0 speedgoat_test_SN5659_R2021b_IO682_CM_double -1.7E+308 1.7E+308 /end CHARACTERISTIC
/begin CHARACTERISTIC speedgoat_test_SN5659__cal_impl.Decode2_P8_f "" VALUE 0x008352C8 Scalar_FLOAT64_IEEE 0 speedgoat_test_SN5659_R2021b_IO682_CM_double -1.7E+308 1.7E+308 /end CHARACTERISTIC
/begin CHARACTERISTIC speedgoat_test_SN5659__cal_impl.Decode2_P8_h "" VALUE 0x00836690 Scalar_FLOAT64_IEEE 0 speedgoat_test_SN5659_R2021b_IO682_CM_double -1.7E+308 1.7E+308 /end CHARACTERISTIC
/begin CHARACTERISTIC speedgoat_test_SN5659__cal_impl.Decode2_P8_j "" VALUE 0x008373C0 Scalar_FLOAT64_IEEE 0 speedgoat_test_SN5659_R2021b_IO682_CM_double -1.7E+308 1.7E+308 /end CHARACTERISTIC
/begin CHARACTERISTIC speedgoat_test_SN5659__cal_impl.Decode2_P8_l "" VALUE 0x00834C30 Scalar_FLOAT64_IEEE 0 speedgoat_test_SN5659_R2021b_IO682_CM_double -1.7E+308 1.7E+308 /end CHARACTERISTIC
/begin CHARACTERISTIC speedgoat_test_SN5659__cal_impl.Decode2_P9_c "" VALUE 0x008373D8 Scalar_FLOAT64_IEEE 0 speedgoat_test_SN5659_R2021b_IO682_CM_double -1.7E+308 1.7E+308 /end CHARACTERISTIC
/begin CHARACTERISTIC speedgoat_test_SN5659__cal_impl.Decode2_P9_g "" VALUE 0x00835978 Scalar_FLOAT64_IEEE 0 speedgoat_test_SN5659_R2021b_IO682_CM_double -1.7E+308 1.7E+308 /end CHARACTERISTIC
/begin CHARACTERISTIC speedgoat_test_SN5659__cal_impl.Decode2_P9_l "" VALUE 0x00834C48 Scalar_FLOAT64_IEEE 0 speedgoat_test_SN5659_R2021b_IO682_CM_double -1.7E+308 1.7E+308 /end CHARACTERISTIC
/begin CHARACTERISTIC speedgoat_test_SN5659__cal_impl.Decode2_P9_n "" VALUE 0x00836D40 Scalar_FLOAT64_IEEE 0 speedgoat_test_SN5659_R2021b_IO682_CM_double -1.7E+308 1.7E+308 /end CHARACTERISTIC
/begin CHARACTERISTIC speedgoat_test_SN5659__cal_impl.Decode2_P9_p "" VALUE 0x008352E0 Scalar_FLOAT64_IEEE 0 speedgoat_test_SN5659_R2021b_IO682_CM_double -1.7E+308 1.7E+308 /end CHARACTERISTIC
/begin CHARACTERISTIC speedgoat_test_SN5659__cal_impl.Decode2_P9_pb "" VALUE 0x008366A8 Scalar_FLOAT64_IEEE 0 speedgoat_test_SN5659_R2021b_IO682_CM_double -1.7E+308 1.7E+308 /end CHARACTERISTIC
/begin CHARACTERISTIC speedgoat_test_SN5659__cal_impl.Decode3_P1 "" VALUE 0x00833948 Scalar_FLOAT64_IEEE 0 speedgoat_test_SN5659_R2021b_IO682_CM_double -1.7E+308 1.7E+308 /end CHARACTERISTIC
/begin CHARACTERISTIC speedgoat_test_SN5659__cal_impl.Decode3_P10 "" VAL_BLK 0x00833A20 Scalar_FLOAT64_IEEE 0 speedgoat_test_SN5659_R2021b_IO682_CM_double -1.7E+308 1.7E+308 MATRIX_DIM 2 1 /end CHARACTERISTIC
/begin CHARACTERISTIC speedgoat_test_SN5659__cal_impl.Decode3_P10_b "" VAL_BLK 0x008361B0 Scalar_FLOAT64_IEEE 0 speedgoat_test_SN5659_R2021b_IO682_CM_double -1.7E+308 1.7E+308 MATRIX_DIM 2 1 /end CHARACTERISTIC
/begin CHARACTERISTIC speedgoat_test_SN5659__cal_impl.Decode3_P10_c "" VAL_BLK 0x00836848 Scalar_FLOAT64_IEEE 0 speedgoat_test_SN5659_R2021b_IO682_CM_double -1.7E+308 1.7E+308 MATRIX_DIM 2 1 /end CHARACTERISTIC
/begin CHARACTERISTIC speedgoat_test_SN5659__cal_impl.Decode3_P10_f "" VAL_BLK 0x00835480 Scalar_FLOAT64_IEEE 0 speedgoat_test_SN5659_R2021b_IO682_CM_double -1.7E+308 1.7E+308 MATRIX_DIM 2 1 /end CHARACTERISTIC
/begin CHARACTERISTIC speedgoat_test_SN5659__cal_impl.Decode3_P10_l "" VAL_BLK 0x00834DE8 Scalar_FLOAT64_IEEE 0 speedgoat_test_SN5659_R2021b_IO682_CM_double -1.7E+308 1.7E+308 MATRIX_DIM 2 1 /end CHARACTERISTIC
/begin CHARACTERISTIC speedgoat_test_SN5659__cal_impl.Decode3_P10_m "" VAL_BLK 0x00837578 Scalar_FLOAT64_IEEE 0 speedgoat_test_SN5659_R2021b_IO682_CM_double -1.7E+308 1.7E+308 MATRIX_DIM 2 1 /end CHARACTERISTIC
/begin CHARACTERISTIC speedgoat_test_SN5659__cal_impl.Decode3_P10_n "" VAL_BLK 0x00836EE0 Scalar_FLOAT64_IEEE 0 speedgoat_test_SN5659_R2021b_IO682_CM_double -1.7E+308 1.7E+308 MATRIX_DIM 2 1 /end CHARACTERISTIC
/begin CHARACTERISTIC speedgoat_test_SN5659__cal_impl.Decode3_P10_o "" VAL_BLK 0x00835B18 Scalar_FLOAT64_IEEE 0 speedgoat_test_SN5659_R2021b_IO682_CM_double -1.7E+308 1.7E+308 MATRIX_DIM 2 1 /end CHARACTERISTIC
/begin CHARACTERISTIC speedgoat_test_SN5659__cal_impl.Decode3_P11 "" VALUE 0x00833A40 Scalar_FLOAT64_IEEE 0 speedgoat_test_SN5659_R2021b_IO682_CM_double -1.7E+308 1.7E+308 /end CHARACTERISTIC
/begin CHARACTERISTIC speedgoat_test_SN5659__cal_impl.Decode3_P11_a "" VALUE 0x008361D0 Scalar_FLOAT64_IEEE 0 speedgoat_test_SN5659_R2021b_IO682_CM_double -1.7E+308 1.7E+308 /end CHARACTERISTIC
/begin CHARACTERISTIC speedgoat_test_SN5659__cal_impl.Decode3_P11_bu "" VALUE 0x00837598 Scalar_FLOAT64_IEEE 0 speedgoat_test_SN5659_R2021b_IO682_CM_double -1.7E+308 1.7E+308 /end CHARACTERISTIC
/begin CHARACTERISTIC speedgoat_test_SN5659__cal_impl.Decode3_P11_d "" VALUE 0x00836868 Scalar_FLOAT64_IEEE 0 speedgoat_test_SN5659_R2021b_IO682_CM_double -1.7E+308 1.7E+308 /end CHARACTERISTIC
/begin CHARACTERISTIC speedgoat_test_SN5659__cal_impl.Decode3_P11_h "" VALUE 0x008354A0 Scalar_FLOAT64_IEEE 0 speedgoat_test_SN5659_R2021b_IO682_CM_double -1.7E+308 1.7E+308 /end CHARACTERISTIC
/begin CHARACTERISTIC speedgoat_test_SN5659__cal_impl.Decode3_P11_i "" VALUE 0x00834E08 Scalar_FLOAT64_IEEE 0 speedgoat_test_SN5659_R2021b_IO682_CM_double -1.7E+308 1.7E+308 /end CHARACTERISTIC
/begin CHARACTERISTIC speedgoat_test_SN5659__cal_impl.Decode3_P11_k "" VALUE 0x00835B38 Scalar_FLOAT64_IEEE 0 speedgoat_test_SN5659_R2021b_IO682_CM_double -1.7E+308 1.7E+308 /end CHARACTERISTIC
/begin CHARACTERISTIC speedgoat_test_SN5659__cal_impl.Decode3_P11_k1 "" VALUE 0x00836F00 Scalar_FLOAT64_IEEE 0 speedgoat_test_SN5659_R2021b_IO682_CM_double -1.7E+308 1.7E+308 /end CHARACTERISTIC
/begin CHARACTERISTIC speedgoat_test_SN5659__cal_impl.Decode3_P12 "" VALUE 0x00833A58 Scalar_FLOAT64_IEEE 0 speedgoat_test_SN5659_R2021b_IO682_CM_double -1.7E+308 1.7E+308 /end CHARACTERISTIC
/begin CHARACTERISTIC speedgoat_test_SN5659__cal_impl.Decode3_P12_a "" VALUE 0x00834E20 Scalar_FLOAT64_IEEE 0 speedgoat_test_SN5659_R2021b_IO682_CM_double -1.7E+308 1.7E+308 /end CHARACTERISTIC
/begin CHARACTERISTIC speedgoat_test_SN5659__cal_impl.Decode3_P12_b "" VALUE 0x00836880 Scalar_FLOAT64_IEEE 0 speedgoat_test_SN5659_R2021b_IO682_CM_double -1.7E+308 1.7E+308 /end CHARACTERISTIC
/begin CHARACTERISTIC speedgoat_test_SN5659__cal_impl.Decode3_P12_f "" VALUE 0x008375B0 Scalar_FLOAT64_IEEE 0 speedgoat_test_SN5659_R2021b_IO682_CM_double -1.7E+308 1.7E+308 /end CHARACTERISTIC
/begin CHARACTERISTIC speedgoat_test_SN5659__cal_impl.Decode3_P12_k "" VALUE 0x008354B8 Scalar_FLOAT64_IEEE 0 speedgoat_test_SN5659_R2021b_IO682_CM_double -1.7E+308 1.7E+308 /end CHARACTERISTIC
/begin CHARACTERISTIC speedgoat_test_SN5659__cal_impl.Decode3_P12_ku "" VALUE 0x00835B50 Scalar_FLOAT64_IEEE 0 speedgoat_test_SN5659_R2021b_IO682_CM_double -1.7E+308 1.7E+308 /end CHARACTERISTIC
/begin CHARACTERISTIC speedgoat_test_SN5659__cal_impl.Decode3_P12_l "" VALUE 0x00836F18 Scalar_FLOAT64_IEEE 0 speedgoat_test_SN5659_R2021b_IO682_CM_double -1.7E+308 1.7E+308 /end CHARACTERISTIC
/begin CHARACTERISTIC speedgoat_test_SN5659__cal_impl.Decode3_P12_pk "" VALUE 0x008361E8 Scalar_FLOAT64_IEEE 0 speedgoat_test_SN5659_R2021b_IO682_CM_double -1.7E+308 1.7E+308 /end CHARACTERISTIC
/begin CHARACTERISTIC speedgoat_test_SN5659__cal_impl.Decode3_P13 "" VALUE 0x00833A70 Scalar_FLOAT64_IEEE 0 speedgoat_test_SN5659_R2021b_IO682_CM_double -1.7E+308 1.7E+308 /end CHARACTERISTIC
/begin CHARACTERISTIC speedgoat_test_SN5659__cal_impl.Decode3_P13_b "" VALUE 0x00834E38 Scalar_FLOAT64_IEEE 0 speedgoat_test_SN5659_R2021b_IO682_CM_double -1.7E+308 1.7E+308 /end CHARACTERISTIC
/begin CHARACTERISTIC speedgoat_test_SN5659__cal_impl.Decode3_P13_dz "" VALUE 0x00836200 Scalar_FLOAT64_IEEE 0 speedgoat_test_SN5659_R2021b_IO682_CM_double -1.7E+308 1.7E+308 /end CHARACTERISTIC
/begin CHARACTERISTIC speedgoat_test_SN5659__cal_impl.Decode3_P13_e "" VALUE 0x00835B68 Scalar_FLOAT64_IEEE 0 speedgoat_test_SN5659_R2021b_IO682_CM_double -1.7E+308 1.7E+308 /end CHARACTERISTIC
/begin CHARACTERISTIC speedgoat_test_SN5659__cal_impl.Decode3_P13_f "" VALUE 0x008375C8 Scalar_FLOAT64_IEEE 0 speedgoat_test_SN5659_R2021b_IO682_CM_double -1.7E+308 1.7E+308 /end CHARACTERISTIC
/begin CHARACTERISTIC speedgoat_test_SN5659__cal_impl.Decode3_P13_i "" VALUE 0x00836898 Scalar_FLOAT64_IEEE 0 speedgoat_test_SN5659_R2021b_IO682_CM_double -1.7E+308 1.7E+308 /end CHARACTERISTIC
/begin CHARACTERISTIC speedgoat_test_SN5659__cal_impl.Decode3_P13_l "" VALUE 0x00836F30 Scalar_FLOAT64_IEEE 0 speedgoat_test_SN5659_R2021b_IO682_CM_double -1.7E+308 1.7E+308 /end CHARACTERISTIC
/begin CHARACTERISTIC speedgoat_test_SN5659__cal_impl.Decode3_P13_m "" VALUE 0x008354D0 Scalar_FLOAT64_IEEE 0 speedgoat_test_SN5659_R2021b_IO682_CM_double -1.7E+308 1.7E+308 /end CHARACTERISTIC
/begin CHARACTERISTIC speedgoat_test_SN5659__cal_impl.Decode3_P14 "" VALUE 0x00833A88 Scalar_FLOAT64_IEEE 0 speedgoat_test_SN5659_R2021b_IO682_CM_double -1.7E+308 1.7E+308 /end CHARACTERISTIC
/begin CHARACTERISTIC speedgoat_test_SN5659__cal_impl.Decode3_P14_f "" VALUE 0x00836218 Scalar_FLOAT64_IEEE 0 speedgoat_test_SN5659_R2021b_IO682_CM_double -1.7E+308 1.7E+308 /end CHARACTERISTIC
/begin CHARACTERISTIC speedgoat_test_SN5659__cal_impl.Decode3_P14_fx "" VALUE 0x00836F48 Scalar_FLOAT64_IEEE 0 speedgoat_test_SN5659_R2021b_IO682_CM_double -1.7E+308 1.7E+308 /end CHARACTERISTIC
/begin CHARACTERISTIC speedgoat_test_SN5659__cal_impl.Decode3_P14_jy "" VALUE 0x00835B80 Scalar_FLOAT64_IEEE 0 speedgoat_test_SN5659_R2021b_IO682_CM_double -1.7E+308 1.7E+308 /end CHARACTERISTIC
/begin CHARACTERISTIC speedgoat_test_SN5659__cal_impl.Decode3_P14_k "" VALUE 0x008368B0 Scalar_FLOAT64_IEEE 0 speedgoat_test_SN5659_R2021b_IO682_CM_double -1.7E+308 1.7E+308 /end CHARACTERISTIC
/begin CHARACTERISTIC speedgoat_test_SN5659__cal_impl.Decode3_P14_l "" VALUE 0x008354E8 Scalar_FLOAT64_IEEE 0 speedgoat_test_SN5659_R2021b_IO682_CM_double -1.7E+308 1.7E+308 /end CHARACTERISTIC
/begin CHARACTERISTIC speedgoat_test_SN5659__cal_impl.Decode3_P14_n "" VALUE 0x008375E0 Scalar_FLOAT64_IEEE 0 speedgoat_test_SN5659_R2021b_IO682_CM_double -1.7E+308 1.7E+308 /end CHARACTERISTIC
/begin CHARACTERISTIC speedgoat_test_SN5659__cal_impl.Decode3_P14_px "" VALUE 0x00834E50 Scalar_FLOAT64_IEEE 0 speedgoat_test_SN5659_R2021b_IO682_CM_double -1.7E+308 1.7E+308 /end CHARACTERISTIC
/begin CHARACTERISTIC speedgoat_test_SN5659__cal_impl.Decode3_P15 "" VALUE 0x00833AA0 Scalar_FLOAT64_IEEE 0 speedgoat_test_SN5659_R2021b_IO682_CM_double -1.7E+308 1.7E+308 /end CHARACTERISTIC
/begin CHARACTERISTIC speedgoat_test_SN5659__cal_impl.Decode3_P15_b "" VALUE 0x008375F8 Scalar_FLOAT64_IEEE 0 speedgoat_test_SN5659_R2021b_IO682_CM_double -1.7E+308 1.7E+308 /end CHARACTERISTIC
/begin CHARACTERISTIC speedgoat_test_SN5659__cal_impl.Decode3_P15_e "" VALUE 0x00836230 Scalar_FLOAT64_IEEE 0 speedgoat_test_SN5659_R2021b_IO682_CM_double -1.7E+308 1.7E+308 /end CHARACTERISTIC
/begin CHARACTERISTIC speedgoat_test_SN5659__cal_impl.Decode3_P15_j "" VALUE 0x00834E68 Scalar_FLOAT64_IEEE 0 speedgoat_test_SN5659_R2021b_IO682_CM_double -1.7E+308 1.7E+308 /end CHARACTERISTIC
/begin CHARACTERISTIC speedgoat_test_SN5659__cal_impl.Decode3_P15_jx "" VALUE 0x008368C8 Scalar_FLOAT64_IEEE 0 speedgoat_test_SN5659_R2021b_IO682_CM_double -1.7E+308 1.7E+308 /end CHARACTERISTIC
/begin CHARACTERISTIC speedgoat_test_SN5659__cal_impl.Decode3_P15_l "" VALUE 0x00835500 Scalar_FLOAT64_IEEE 0 speedgoat_test_SN5659_R2021b_IO682_CM_double -1.7E+308 1.7E+308 /end CHARACTERISTIC
/begin CHARACTERISTIC speedgoat_test_SN5659__cal_impl.Decode3_P15_l0 "" VALUE 0x00835B98 Scalar_FLOAT64_IEEE 0 speedgoat_test_SN5659_R2021b_IO682_CM_double -1.7E+308 1.7E+308 /end CHARACTERISTIC
/begin CHARACTERISTIC speedgoat_test_SN5659__cal_impl.Decode3_P15_p "" VALUE 0x00836F60 Scalar_FLOAT64_IEEE 0 speedgoat_test_SN5659_R2021b_IO682_CM_double -1.7E+308 1.7E+308 /end CHARACTERISTIC
/begin CHARACTERISTIC speedgoat_test_SN5659__cal_impl.Decode3_P16 "" VALUE 0x00833AB8 Scalar_FLOAT64_IEEE 0 speedgoat_test_SN5659_R2021b_IO682_CM_double -1.7E+308 1.7E+308 /end CHARACTERISTIC
/begin CHARACTERISTIC speedgoat_test_SN5659__cal_impl.Decode3_P16_b1 "" VALUE 0x00834E80 Scalar_FLOAT64_IEEE 0 speedgoat_test_SN5659_R2021b_IO682_CM_double -1.7E+308 1.7E+308 /end CHARACTERISTIC
/begin CHARACTERISTIC speedgoat_test_SN5659__cal_impl.Decode3_P16_e "" VALUE 0x00836248 Scalar_FLOAT64_IEEE 0 speedgoat_test_SN5659_R2021b_IO682_CM_double -1.7E+308 1.7E+308 /end CHARACTERISTIC
/begin CHARACTERISTIC speedgoat_test_SN5659__cal_impl.Decode3_P16_f "" VALUE 0x008368E0 Scalar_FLOAT64_IEEE 0 speedgoat_test_SN5659_R2021b_IO682_CM_double -1.7E+308 1.7E+308 /end CHARACTERISTIC
/begin CHARACTERISTIC speedgoat_test_SN5659__cal_impl.Decode3_P16_fl "" VALUE 0x00837610 Scalar_FLOAT64_IEEE 0 speedgoat_test_SN5659_R2021b_IO682_CM_double -1.7E+308 1.7E+308 /end CHARACTERISTIC
/begin CHARACTERISTIC speedgoat_test_SN5659__cal_impl.Decode3_P16_h "" VALUE 0x00835518 Scalar_FLOAT64_IEEE 0 speedgoat_test_SN5659_R2021b_IO682_CM_double -1.7E+308 1.7E+308 /end CHARACTERISTIC
/begin CHARACTERISTIC speedgoat_test_SN5659__cal_impl.Decode3_P16_hp "" VALUE 0x00835BB0 Scalar_FLOAT64_IEEE 0 speedgoat_test_SN5659_R2021b_IO682_CM_double -1.7E+308 1.7E+308 /end CHARACTERISTIC
/begin CHARACTERISTIC speedgoat_test_SN5659__cal_impl.Decode3_P16_o "" VALUE 0x00836F78 Scalar_FLOAT64_IEEE 0 speedgoat_test_SN5659_R2021b_IO682_CM_double -1.7E+308 1.7E+308 /end CHARACTERISTIC
/begin CHARACTERISTIC speedgoat_test_SN5659__cal_impl.Decode3_P1_a1 "" VALUE 0x00834D10 Scalar_FLOAT64_IEEE 0 speedgoat_test_SN5659_R2021b_IO682_CM_double -1.7E+308 1.7E+308 /end CHARACTERISTIC
/begin CHARACTERISTIC speedgoat_test_SN5659__cal_impl.Decode3_P1_a1u "" VALUE 0x008360D8 Scalar_FLOAT64_IEEE 0 speedgoat_test_SN5659_R2021b_IO682_CM_double -1.7E+308 1.7E+308 /end CHARACTERISTIC
/begin CHARACTERISTIC speedgoat_test_SN5659__cal_impl.Decode3_P1_b "" VALUE 0x00836E08 Scalar_FLOAT64_IEEE 0 speedgoat_test_SN5659_R2021b_IO682_CM_double -1.7E+308 1.7E+308 /end CHARACTERISTIC
/begin CHARACTERISTIC speedgoat_test_SN5659__cal_impl.Decode3_P1_cm "" VALUE 0x00835A40 Scalar_FLOAT64_IEEE 0 speedgoat_test_SN5659_R2021b_IO682_CM_double -1.7E+308 1.7E+308 /end CHARACTERISTIC
/begin CHARACTERISTIC speedgoat_test_SN5659__cal_impl.Decode3_P1_e "" VALUE 0x00836770 Scalar_FLOAT64_IEEE 0 speedgoat_test_SN5659_R2021b_IO682_CM_double -1.7E+308 1.7E+308 /end CHARACTERISTIC
/begin CHARACTERISTIC speedgoat_test_SN5659__cal_impl.Decode3_P1_k "" VALUE 0x008353A8 Scalar_FLOAT64_IEEE 0 speedgoat_test_SN5659_R2021b_IO682_CM_double -1.7E+308 1.7E+308 /end CHARACTERISTIC
/begin CHARACTERISTIC speedgoat_test_SN5659__cal_impl.Decode3_P1_kn "" VALUE 0x008374A0 Scalar_FLOAT64_IEEE 0 speedgoat_test_SN5659_R2021b_IO682_CM_double -1.7E+308 1.7E+308 /end CHARACTERISTIC
/begin CHARACTERISTIC speedgoat_test_SN5659__cal_impl.Decode3_P2 "" VALUE 0x00833960 Scalar_FLOAT64_IEEE 0 speedgoat_test_SN5659_R2021b_IO682_CM_double -1.7E+308 1.7E+308 /end CHARACTERISTIC
/begin CHARACTERISTIC speedgoat_test_SN5659__cal_impl.Decode3_P2_h "" VALUE 0x00835A58 Scalar_FLOAT64_IEEE 0 speedgoat_test_SN5659_R2021b_IO682_CM_double -1.7E+308 1.7E+308 /end CHARACTERISTIC
/begin CHARACTERISTIC speedgoat_test_SN5659__cal_impl.Decode3_P2_js "" VALUE 0x008374B8 Scalar_FLOAT64_IEEE 0 speedgoat_test_SN5659_R2021b_IO682_CM_double -1.7E+308 1.7E+308 /end CHARACTERISTIC
/begin CHARACTERISTIC speedgoat_test_SN5659__cal_impl.Decode3_P2_l2 "" VALUE 0x00836788 Scalar_FLOAT64_IEEE 0 speedgoat_test_SN5659_R2021b_IO682_CM_double -1.7E+308 1.7E+308 /end CHARACTERISTIC
/begin CHARACTERISTIC speedgoat_test_SN5659__cal_impl.Decode3_P2_ls "" VALUE 0x00836E20 Scalar_FLOAT64_IEEE 0 speedgoat_test_SN5659_R2021b_IO682_CM_double -1.7E+308 1.7E+308 /end CHARACTERISTIC
/begin CHARACTERISTIC speedgoat_test_SN5659__cal_impl.Decode3_P2_o "" VALUE 0x008353C0 Scalar_FLOAT64_IEEE 0 speedgoat_test_SN5659_R2021b_IO682_CM_double -1.7E+308 1.7E+308 /end CHARACTERISTIC
/begin CHARACTERISTIC speedgoat_test_SN5659__cal_impl.Decode3_P2_of "" VALUE 0x008360F0 Scalar_FLOAT64_IEEE 0 speedgoat_test_SN5659_R2021b_IO682_CM_double -1.7E+308 1.7E+308 /end CHARACTERISTIC
/begin CHARACTERISTIC speedgoat_test_SN5659__cal_impl.Decode3_P2_p "" VALUE 0x00834D28 Scalar_FLOAT64_IEEE 0 speedgoat_test_SN5659_R2021b_IO682_CM_double -1.7E+308 1.7E+308 /end CHARACTERISTIC
/begin CHARACTERISTIC speedgoat_test_SN5659__cal_impl.Decode3_P3 "" VALUE 0x00833978 Scalar_FLOAT64_IEEE 0 speedgoat_test_SN5659_R2021b_IO682_CM_double -1.7E+308 1.7E+308 /end CHARACTERISTIC
/begin CHARACTERISTIC speedgoat_test_SN5659__cal_impl.Decode3_P3_b "" VALUE 0x00835A70 Scalar_FLOAT64_IEEE 0 speedgoat_test_SN5659_R2021b_IO682_CM_double -1.7E+308 1.7E+308 /end CHARACTERISTIC
/begin CHARACTERISTIC speedgoat_test_SN5659__cal_impl.Decode3_P3_c "" VALUE 0x008353D8 Scalar_FLOAT64_IEEE 0 speedgoat_test_SN5659_R2021b_IO682_CM_double -1.7E+308 1.7E+308 /end CHARACTERISTIC
/begin CHARACTERISTIC speedgoat_test_SN5659__cal_impl.Decode3_P3_cq "" VALUE 0x008367A0 Scalar_FLOAT64_IEEE 0 speedgoat_test_SN5659_R2021b_IO682_CM_double -1.7E+308 1.7E+308 /end CHARACTERISTIC
/begin CHARACTERISTIC speedgoat_test_SN5659__cal_impl.Decode3_P3_h "" VALUE 0x00834D40 Scalar_FLOAT64_IEEE 0 speedgoat_test_SN5659_R2021b_IO682_CM_double -1.7E+308 1.7E+308 /end CHARACTERISTIC
/begin CHARACTERISTIC speedgoat_test_SN5659__cal_impl.Decode3_P3_jq "" VALUE 0x008374D0 Scalar_FLOAT64_IEEE 0 speedgoat_test_SN5659_R2021b_IO682_CM_double -1.7E+308 1.7E+308 /end CHARACTERISTIC
/begin CHARACTERISTIC speedgoat_test_SN5659__cal_impl.Decode3_P3_l "" VALUE 0x00836E38 Scalar_FLOAT64_IEEE 0 speedgoat_test_SN5659_R2021b_IO682_CM_double -1.7E+308 1.7E+308 /end CHARACTERISTIC
/begin CHARACTERISTIC speedgoat_test_SN5659__cal_impl.Decode3_P3_pi "" VALUE 0x00836108 Scalar_FLOAT64_IEEE 0 speedgoat_test_SN5659_R2021b_IO682_CM_double -1.7E+308 1.7E+308 /end CHARACTERISTIC
/begin CHARACTERISTIC speedgoat_test_SN5659__cal_impl.Decode3_P4 "" VALUE 0x00833990 Scalar_FLOAT64_IEEE 0 speedgoat_test_SN5659_R2021b_IO682_CM_double -1.7E+308 1.7E+308 /end CHARACTERISTIC
/begin CHARACTERISTIC speedgoat_test_SN5659__cal_impl.Decode3_P4_a "" VALUE 0x00836120 Scalar_FLOAT64_IEEE 0 speedgoat_test_SN5659_R2021b_IO682_CM_double -1.7E+308 1.7E+308 /end CHARACTERISTIC
/begin CHARACTERISTIC speedgoat_test_SN5659__cal_impl.Decode3_P4_d "" VALUE 0x00834D58 Scalar_FLOAT64_IEEE 0 speedgoat_test_SN5659_R2021b_IO682_CM_double -1.7E+308 1.7E+308 /end CHARACTERISTIC
/begin CHARACTERISTIC speedgoat_test_SN5659__cal_impl.Decode3_P4_i "" VALUE 0x008353F0 Scalar_FLOAT64_IEEE 0 speedgoat_test_SN5659_R2021b_IO682_CM_double -1.7E+308 1.7E+308 /end CHARACTERISTIC
/begin CHARACTERISTIC speedgoat_test_SN5659__cal_impl.Decode3_P4_j "" VALUE 0x008367B8 Scalar_FLOAT64_IEEE 0 speedgoat_test_SN5659_R2021b_IO682_CM_double -1.7E+308 1.7E+308 /end CHARACTERISTIC
/begin CHARACTERISTIC speedgoat_test_SN5659__cal_impl.Decode3_P4_ja "" VALUE 0x00836E50 Scalar_FLOAT64_IEEE 0 speedgoat_test_SN5659_R2021b_IO682_CM_double -1.7E+308 1.7E+308 /end CHARACTERISTIC
/begin CHARACTERISTIC speedgoat_test_SN5659__cal_impl.Decode3_P4_o "" VALUE 0x00835A88 Scalar_FLOAT64_IEEE 0 speedgoat_test_SN5659_R2021b_IO682_CM_double -1.7E+308 1.7E+308 /end CHARACTERISTIC
/begin CHARACTERISTIC speedgoat_test_SN5659__cal_impl.Decode3_P4_o3 "" VALUE 0x008374E8 Scalar_FLOAT64_IEEE 0 speedgoat_test_SN5659_R2021b_IO682_CM_double -1.7E+308 1.7E+308 /end CHARACTERISTIC
/begin CHARACTERISTIC speedgoat_test_SN5659__cal_impl.Decode3_P5 "" VALUE 0x008339A8 Scalar_FLOAT64_IEEE 0 speedgoat_test_SN5659_R2021b_IO682_CM_double -1.7E+308 1.7E+308 /end CHARACTERISTIC
/begin CHARACTERISTIC speedgoat_test_SN5659__cal_impl.Decode3_P5_a "" VALUE 0x00835408 Scalar_FLOAT64_IEEE 0 speedgoat_test_SN5659_R2021b_IO682_CM_double -1.7E+308 1.7E+308 /end CHARACTERISTIC
/begin CHARACTERISTIC speedgoat_test_SN5659__cal_impl.Decode3_P5_ae "" VALUE 0x00835AA0 Scalar_FLOAT64_IEEE 0 speedgoat_test_SN5659_R2021b_IO682_CM_double -1.7E+308 1.7E+308 /end CHARACTERISTIC
/begin CHARACTERISTIC speedgoat_test_SN5659__cal_impl.Decode3_P5_f "" VALUE 0x00836E68 Scalar_FLOAT64_IEEE 0 speedgoat_test_SN5659_R2021b_IO682_CM_double -1.7E+308 1.7E+308 /end CHARACTERISTIC
/begin CHARACTERISTIC speedgoat_test_SN5659__cal_impl.Decode3_P5_g "" VALUE 0x00837500 Scalar_FLOAT64_IEEE 0 speedgoat_test_SN5659_R2021b_IO682_CM_double -1.7E+308 1.7E+308 /end CHARACTERISTIC
/begin CHARACTERISTIC speedgoat_test_SN5659__cal_impl.Decode3_P5_h "" VALUE 0x00836138 Scalar_FLOAT64_IEEE 0 speedgoat_test_SN5659_R2021b_IO682_CM_double -1.7E+308 1.7E+308 /end CHARACTERISTIC
/begin CHARACTERISTIC speedgoat_test_SN5659__cal_impl.Decode3_P5_m "" VALUE 0x00834D70 Scalar_FLOAT64_IEEE 0 speedgoat_test_SN5659_R2021b_IO682_CM_double -1.7E+308 1.7E+308 /end CHARACTERISTIC
/begin CHARACTERISTIC speedgoat_test_SN5659__cal_impl.Decode3_P5_n "" VALUE 0x008367D0 Scalar_FLOAT64_IEEE 0 speedgoat_test_SN5659_R2021b_IO682_CM_double -1.7E+308 1.7E+308 /end CHARACTERISTIC
/begin CHARACTERISTIC speedgoat_test_SN5659__cal_impl.Decode3_P6 "" VALUE 0x008339C0 Scalar_FLOAT64_IEEE 0 speedgoat_test_SN5659_R2021b_IO682_CM_double -1.7E+308 1.7E+308 /end CHARACTERISTIC
/begin CHARACTERISTIC speedgoat_test_SN5659__cal_impl.Decode3_P6_d "" VALUE 0x00835AB8 Scalar_FLOAT64_IEEE 0 speedgoat_test_SN5659_R2021b_IO682_CM_double -1.7E+308 1.7E+308 /end CHARACTERISTIC
/begin CHARACTERISTIC speedgoat_test_SN5659__cal_impl.Decode3_P6_d3 "" VALUE 0x00836E80 Scalar_FLOAT64_IEEE 0 speedgoat_test_SN5659_R2021b_IO682_CM_double -1.7E+308 1.7E+308 /end CHARACTERISTIC
/begin CHARACTERISTIC speedgoat_test_SN5659__cal_impl.Decode3_P6_e "" VALUE 0x008367E8 Scalar_FLOAT64_IEEE 0 speedgoat_test_SN5659_R2021b_IO682_CM_double -1.7E+308 1.7E+308 /end CHARACTERISTIC
/begin CHARACTERISTIC speedgoat_test_SN5659__cal_impl.Decode3_P6_i "" VALUE 0x00835420 Scalar_FLOAT64_IEEE 0 speedgoat_test_SN5659_R2021b_IO682_CM_double -1.7E+308 1.7E+308 /end CHARACTERISTIC
/begin CHARACTERISTIC speedgoat_test_SN5659__cal_impl.Decode3_P6_ih "" VALUE 0x00837518 Scalar_FLOAT64_IEEE 0 speedgoat_test_SN5659_R2021b_IO682_CM_double -1.7E+308 1.7E+308 /end CHARACTERISTIC
/begin CHARACTERISTIC speedgoat_test_SN5659__cal_impl.Decode3_P6_o "" VALUE 0x00834D88 Scalar_FLOAT64_IEEE 0 speedgoat_test_SN5659_R2021b_IO682_CM_double -1.7E+308 1.7E+308 /end CHARACTERISTIC
/begin CHARACTERISTIC speedgoat_test_SN5659__cal_impl.Decode3_P6_ot "" VALUE 0x00836150 Scalar_FLOAT64_IEEE 0 speedgoat_test_SN5659_R2021b_IO682_CM_double -1.7E+308 1.7E+308 /end CHARACTERISTIC
/begin CHARACTERISTIC speedgoat_test_SN5659__cal_impl.Decode3_P7 "" VALUE 0x008339D8 Scalar_FLOAT64_IEEE 0 speedgoat_test_SN5659_R2021b_IO682_CM_double -1.7E+308 1.7E+308 /end CHARACTERISTIC
/begin CHARACTERISTIC speedgoat_test_SN5659__cal_impl.Decode3_P7_b "" VALUE 0x00836800 Scalar_FLOAT64_IEEE 0 speedgoat_test_SN5659_R2021b_IO682_CM_double -1.7E+308 1.7E+308 /end CHARACTERISTIC
/begin CHARACTERISTIC speedgoat_test_SN5659__cal_impl.Decode3_P7_c "" VALUE 0x00835438 Scalar_FLOAT64_IEEE 0 speedgoat_test_SN5659_R2021b_IO682_CM_double -1.7E+308 1.7E+308 /end CHARACTERISTIC
/begin CHARACTERISTIC speedgoat_test_SN5659__cal_impl.Decode3_P7_cp "" VALUE 0x00837530 Scalar_FLOAT64_IEEE 0 speedgoat_test_SN5659_R2021b_IO682_CM_double -1.7E+308 1.7E+308 /end CHARACTERISTIC
/begin CHARACTERISTIC speedgoat_test_SN5659__cal_impl.Decode3_P7_e "" VALUE 0x00835AD0 Scalar_FLOAT64_IEEE 0 speedgoat_test_SN5659_R2021b_IO682_CM_double -1.7E+308 1.7E+308 /end CHARACTERISTIC
/begin CHARACTERISTIC speedgoat_test_SN5659__cal_impl.Decode3_P7_f "" VALUE 0x00836168 Scalar_FLOAT64_IEEE 0 speedgoat_test_SN5659_R2021b_IO682_CM_double -1.7E+308 1.7E+308 /end CHARACTERISTIC
/begin CHARACTERISTIC speedgoat_test_SN5659__cal_impl.Decode3_P7_i "" VALUE 0x00836E98 Scalar_FLOAT64_IEEE 0 speedgoat_test_SN5659_R2021b_IO682_CM_double -1.7E+308 1.7E+308 /end CHARACTERISTIC
/begin CHARACTERISTIC speedgoat_test_SN5659__cal_impl.Decode3_P7_kc "" VALUE 0x00834DA0 Scalar_FLOAT64_IEEE 0 speedgoat_test_SN5659_R2021b_IO682_CM_double -1.7E+308 1.7E+308 /end CHARACTERISTIC
/begin CHARACTERISTIC speedgoat_test_SN5659__cal_impl.Decode3_P8 "" VALUE 0x008339F0 Scalar_FLOAT64_IEEE 0 speedgoat_test_SN5659_R2021b_IO682_CM_double -1.7E+308 1.7E+308 /end CHARACTERISTIC
/begin CHARACTERISTIC speedgoat_test_SN5659__cal_impl.Decode3_P8_e "" VALUE 0x00836180 Scalar_FLOAT64_IEEE 0 speedgoat_test_SN5659_R2021b_IO682_CM_double -1.7E+308 1.7E+308 /end CHARACTERISTIC
/begin CHARACTERISTIC speedgoat_test_SN5659__cal_impl.Decode3_P8_g0 "" VALUE 0x00835450 Scalar_FLOAT64_IEEE 0 speedgoat_test_SN5659_R2021b_IO682_CM_double -1.7E+308 1.7E+308 /end CHARACTERISTIC
/begin CHARACTERISTIC speedgoat_test_SN5659__cal_impl.Decode3_P8_i "" VALUE 0x00835AE8 Scalar_FLOAT64_IEEE 0 speedgoat_test_SN5659_R2021b_IO682_CM_double -1.7E+308 1.7E+308 /end CHARACTERISTIC
/begin CHARACTERISTIC speedgoat_test_SN5659__cal_impl.Decode3_P8_l "" VALUE 0x00837548 Scalar_FLOAT64_IEEE 0 speedgoat_test_SN5659_R2021b_IO682_CM_double -1.7E+308 1.7E+308 /end CHARACTERISTIC
/begin CHARACTERISTIC speedgoat_test_SN5659__cal_impl.Decode3_P8_m "" VALUE 0x00834DB8 Scalar_FLOAT64_IEEE 0 speedgoat_test_SN5659_R2021b_IO682_CM_double -1.7E+308 1.7E+308 /end CHARACTERISTIC
/begin CHARACTERISTIC speedgoat_test_SN5659__cal_impl.Decode3_P8_m3 "" VALUE 0x00836EB0 Scalar_FLOAT64_IEEE 0 speedgoat_test_SN5659_R2021b_IO682_CM_double -1.7E+308 1.7E+308 /end CHARACTERISTIC
/begin CHARACTERISTIC speedgoat_test_SN5659__cal_impl.Decode3_P8_p "" VALUE 0x00836818 Scalar_FLOAT64_IEEE 0 speedgoat_test_SN5659_R2021b_IO682_CM_double -1.7E+308 1.7E+308 /end CHARACTERISTIC
/begin CHARACTERISTIC speedgoat_test_SN5659__cal_impl.Decode3_P9 "" VALUE 0x00833A08 Scalar_FLOAT64_IEEE 0 speedgoat_test_SN5659_R2021b_IO682_CM_double -1.7E+308 1.7E+308 /end CHARACTERISTIC
/begin CHARACTERISTIC speedgoat_test_SN5659__cal_impl.Decode3_P9_d "" VALUE 0x00835468 Scalar_FLOAT64_IEEE 0 speedgoat_test_SN5659_R2021b_IO682_CM_double -1.7E+308 1.7E+308 /end CHARACTERISTIC
/begin CHARACTERISTIC speedgoat_test_SN5659__cal_impl.Decode3_P9_h1 "" VALUE 0x00836EC8 Scalar_FLOAT64_IEEE 0 speedgoat_test_SN5659_R2021b_IO682_CM_double -1.7E+308 1.7E+308 /end CHARACTERISTIC
/begin CHARACTERISTIC speedgoat_test_SN5659__cal_impl.Decode3_P9_hu "" VALUE 0x00836830 Scalar_FLOAT64_IEEE 0 speedgoat_test_SN5659_R2021b_IO682_CM_double -1.7E+308 1.7E+308 /end CHARACTERISTIC
/begin CHARACTERISTIC speedgoat_test_SN5659__cal_impl.Decode3_P9_hv "" VALUE 0x00837560 Scalar_FLOAT64_IEEE 0 speedgoat_test_SN5659_R2021b_IO682_CM_double -1.7E+308 1.7E+308 /end CHARACTERISTIC
/begin CHARACTERISTIC speedgoat_test_SN5659__cal_impl.Decode3_P9_m "" VALUE 0x00836198 Scalar_FLOAT64_IEEE 0 speedgoat_test_SN5659_R2021b_IO682_CM_double -1.7E+308 1.7E+308 /end CHARACTERISTIC
/begin CHARACTERISTIC speedgoat_test_SN5659__cal_impl.Decode3_P9_o "" VALUE 0x00834DD0 Scalar_FLOAT64_IEEE 0 speedgoat_test_SN5659_R2021b_IO682_CM_double -1.7E+308 1.7E+308 /end CHARACTERISTIC
/begin CHARACTERISTIC speedgoat_test_SN5659__cal_impl.Decode3_P9_o2 "" VALUE 0x00835B00 Scalar_FLOAT64_IEEE 0 speedgoat_test_SN5659_R2021b_IO682_CM_double -1.7E+308 1.7E+308 /end CHARACTERISTIC
/begin CHARACTERISTIC speedgoat_test_SN5659__cal_impl.Decode4_P1 "" VALUE 0x00833AD0 Scalar_FLOAT64_IEEE 0 speedgoat_test_SN5659_R2021b_IO682_CM_double -1.7E+308 1.7E+308 /end CHARACTERISTIC
/begin CHARACTERISTIC speedgoat_test_SN5659__cal_impl.Decode4_P10 "" VAL_BLK 0x00833BA8 Scalar_FLOAT64_IEEE 0 speedgoat_test_SN5659_R2021b_IO682_CM_double -1.7E+308 1.7E+308 MATRIX_DIM 2 1 /end CHARACTERISTIC
/begin CHARACTERISTIC speedgoat_test_SN5659__cal_impl.Decode4_P10_a "" VAL_BLK 0x00837700 Scalar_FLOAT64_IEEE 0 speedgoat_test_SN5659_R2021b_IO682_CM_double -1.7E+308 1.7E+308 MATRIX_DIM 2 1 /end CHARACTERISTIC
/begin CHARACTERISTIC speedgoat_test_SN5659__cal_impl.Decode4_P10_bm "" VAL_BLK 0x00836338 Scalar_FLOAT64_IEEE 0 speedgoat_test_SN5659_R2021b_IO682_CM_double -1.7E+308 1.7E+308 MATRIX_DIM 2 1 /end CHARACTERISTIC
/begin CHARACTERISTIC speedgoat_test_SN5659__cal_impl.Decode4_P10_e "" VAL_BLK 0x00837068 Scalar_FLOAT64_IEEE 0 speedgoat_test_SN5659_R2021b_IO682_CM_double -1.7E+308 1.7E+308 MATRIX_DIM 2 1 /end CHARACTERISTIC
/begin CHARACTERISTIC speedgoat_test_SN5659__cal_impl.Decode4_P10_f "" VAL_BLK 0x00835CA0 Scalar_FLOAT64_IEEE 0 speedgoat_test_SN5659_R2021b_IO682_CM_double -1.7E+308 1.7E+308 MATRIX_DIM 2 1 /end CHARACTERISTIC
/begin CHARACTERISTIC speedgoat_test_SN5659__cal_impl.Decode4_P10_g "" VAL_BLK 0x00834F70 Scalar_FLOAT64_IEEE 0 speedgoat_test_SN5659_R2021b_IO682_CM_double -1.7E+308 1.7E+308 MATRIX_DIM 2 1 /end CHARACTERISTIC
/begin CHARACTERISTIC speedgoat_test_SN5659__cal_impl.Decode4_P10_h "" VAL_BLK 0x008369D0 Scalar_FLOAT64_IEEE 0 speedgoat_test_SN5659_R2021b_IO682_CM_double -1.7E+308 1.7E+308 MATRIX_DIM 2 1 /end CHARACTERISTIC
/begin CHARACTERISTIC speedgoat_test_SN5659__cal_impl.Decode4_P10_m "" VAL_BLK 0x00835608 Scalar_FLOAT64_IEEE 0 speedgoat_test_SN5659_R2021b_IO682_CM_double -1.7E+308 1.7E+308 MATRIX_DIM 2 1 /end CHARACTERISTIC
/begin CHARACTERISTIC speedgoat_test_SN5659__cal_impl.Decode4_P11 "" VALUE 0x00833BC8 Scalar_FLOAT64_IEEE 0 speedgoat_test_SN5659_R2021b_IO682_CM_double -1.7E+308 1.7E+308 /end CHARACTERISTIC
/begin CHARACTERISTIC speedgoat_test_SN5659__cal_impl.Decode4_P11_d "" VALUE 0x00835628 Scalar_FLOAT64_IEEE 0 speedgoat_test_SN5659_R2021b_IO682_CM_double -1.7E+308 1.7E+308 /end CHARACTERISTIC
/begin CHARACTERISTIC speedgoat_test_SN5659__cal_impl.Decode4_P11_gt "" VALUE 0x00837088 Scalar_FLOAT64_IEEE 0 speedgoat_test_SN5659_R2021b_IO682_CM_double -1.7E+308 1.7E+308 /end CHARACTERISTIC
/begin CHARACTERISTIC speedgoat_test_SN5659__cal_impl.Decode4_P11_h "" VALUE 0x00834F90 Scalar_FLOAT64_IEEE 0 speedgoat_test_SN5659_R2021b_IO682_CM_double -1.7E+308 1.7E+308 /end CHARACTERISTIC
/begin CHARACTERISTIC speedgoat_test_SN5659__cal_impl.Decode4_P11_hn "" VALUE 0x00837720 Scalar_FLOAT64_IEEE 0 speedgoat_test_SN5659_R2021b_IO682_CM_double -1.7E+308 1.7E+308 /end CHARACTERISTIC
/begin CHARACTERISTIC speedgoat_test_SN5659__cal_impl.Decode4_P11_l "" VALUE 0x00836358 Scalar_FLOAT64_IEEE 0 speedgoat_test_SN5659_R2021b_IO682_CM_double -1.7E+308 1.7E+308 /end CHARACTERISTIC
/begin CHARACTERISTIC speedgoat_test_SN5659__cal_impl.Decode4_P11_n "" VALUE 0x008369F0 Scalar_FLOAT64_IEEE 0 speedgoat_test_SN5659_R2021b_IO682_CM_double -1.7E+308 1.7E+308 /end CHARACTERISTIC
/begin CHARACTERISTIC speedgoat_test_SN5659__cal_impl.Decode4_P11_p "" VALUE 0x00835CC0 Scalar_FLOAT64_IEEE 0 speedgoat_test_SN5659_R2021b_IO682_CM_double -1.7E+308 1.7E+308 /end CHARACTERISTIC
/begin CHARACTERISTIC speedgoat_test_SN5659__cal_impl.Decode4_P12 "" VALUE 0x00833BE0 Scalar_FLOAT64_IEEE 0 speedgoat_test_SN5659_R2021b_IO682_CM_double -1.7E+308 1.7E+308 /end CHARACTERISTIC
/begin CHARACTERISTIC speedgoat_test_SN5659__cal_impl.Decode4_P12_c "" VALUE 0x00836A08 Scalar_FLOAT64_IEEE 0 speedgoat_test_SN5659_R2021b_IO682_CM_double -1.7E+308 1.7E+308 /end CHARACTERISTIC
/begin CHARACTERISTIC speedgoat_test_SN5659__cal_impl.Decode4_P12_f "" VALUE 0x00834FA8 Scalar_FLOAT64_IEEE 0 speedgoat_test_SN5659_R2021b_IO682_CM_double -1.7E+308 1.7E+308 /end CHARACTERISTIC
/begin CHARACTERISTIC speedgoat_test_SN5659__cal_impl.Decode4_P12_g "" VALUE 0x00835CD8 Scalar_FLOAT64_IEEE 0 speedgoat_test_SN5659_R2021b_IO682_CM_double -1.7E+308 1.7E+308 /end CHARACTERISTIC
/begin CHARACTERISTIC speedgoat_test_SN5659__cal_impl.Decode4_P12_k "" VALUE 0x00835640 Scalar_FLOAT64_IEEE 0 speedgoat_test_SN5659_R2021b_IO682_CM_double -1.7E+308 1.7E+308 /end CHARACTERISTIC
/begin CHARACTERISTIC speedgoat_test_SN5659__cal_impl.Decode4_P12_ko "" VALUE 0x00837738 Scalar_FLOAT64_IEEE 0 speedgoat_test_SN5659_R2021b_IO682_CM_double -1.7E+308 1.7E+308 /end CHARACTERISTIC
/begin CHARACTERISTIC speedgoat_test_SN5659__cal_impl.Decode4_P12_n "" VALUE 0x008370A0 Scalar_FLOAT64_IEEE 0 speedgoat_test_SN5659_R2021b_IO682_CM_double -1.7E+308 1.7E+308 /end CHARACTERISTIC
/begin CHARACTERISTIC speedgoat_test_SN5659__cal_impl.Decode4_P12_o "" VALUE 0x00836370 Scalar_FLOAT64_IEEE 0 speedgoat_test_SN5659_R2021b_IO682_CM_double -1.7E+308 1.7E+308 /end CHARACTERISTIC
/begin CHARACTERISTIC speedgoat_test_SN5659__cal_impl.Decode4_P13 "" VALUE 0x00833BF8 Scalar_FLOAT64_IEEE 0 speedgoat_test_SN5659_R2021b_IO682_CM_double -1.7E+308 1.7E+308 /end CHARACTERISTIC
/begin CHARACTERISTIC speedgoat_test_SN5659__cal_impl.Decode4_P13_a "" VALUE 0x00835CF0 Scalar_FLOAT64_IEEE 0 speedgoat_test_SN5659_R2021b_IO682_CM_double -1.7E+308 1.7E+308 /end CHARACTERISTIC
/begin CHARACTERISTIC speedgoat_test_SN5659__cal_impl.Decode4_P13_c "" VALUE 0x00836388 Scalar_FLOAT64_IEEE 0 speedgoat_test_SN5659_R2021b_IO682_CM_double -1.7E+308 1.7E+308 /end CHARACTERISTIC
/begin CHARACTERISTIC speedgoat_test_SN5659__cal_impl.Decode4_P13_ct "" VALUE 0x00836A20 Scalar_FLOAT64_IEEE 0 speedgoat_test_SN5659_R2021b_IO682_CM_double -1.7E+308 1.7E+308 /end CHARACTERISTIC
/begin CHARACTERISTIC speedgoat_test_SN5659__cal_impl.Decode4_P13_f "" VALUE 0x00835658 Scalar_FLOAT64_IEEE 0 speedgoat_test_SN5659_R2021b_IO682_CM_double -1.7E+308 1.7E+308 /end CHARACTERISTIC
/begin CHARACTERISTIC speedgoat_test_SN5659__cal_impl.Decode4_P13_g "" VALUE 0x00834FC0 Scalar_FLOAT64_IEEE 0 speedgoat_test_SN5659_R2021b_IO682_CM_double -1.7E+308 1.7E+308 /end CHARACTERISTIC
/begin CHARACTERISTIC speedgoat_test_SN5659__cal_impl.Decode4_P13_h "" VALUE 0x00837750 Scalar_FLOAT64_IEEE 0 speedgoat_test_SN5659_R2021b_IO682_CM_double -1.7E+308 1.7E+308 /end CHARACTERISTIC
/begin CHARACTERISTIC speedgoat_test_SN5659__cal_impl.Decode4_P13_i "" VALUE 0x008370B8 Scalar_FLOAT64_IEEE 0 speedgoat_test_SN5659_R2021b_IO682_CM_double -1.7E+308 1.7E+308 /end CHARACTERISTIC
/begin CHARACTERISTIC speedgoat_test_SN5659__cal_impl.Decode4_P14 "" VALUE 0x00833C10 Scalar_FLOAT64_IEEE 0 speedgoat_test_SN5659_R2021b_IO682_CM_double -1.7E+308 1.7E+308 /end CHARACTERISTIC
/begin CHARACTERISTIC speedgoat_test_SN5659__cal_impl.Decode4_P14_a "" VALUE 0x008370D0 Scalar_FLOAT64_IEEE 0 speedgoat_test_SN5659_R2021b_IO682_CM_double -1.7E+308 1.7E+308 /end CHARACTERISTIC
/begin CHARACTERISTIC speedgoat_test_SN5659__cal_impl.Decode4_P14_aq "" VALUE 0x00837768 Scalar_FLOAT64_IEEE 0 speedgoat_test_SN5659_R2021b_IO682_CM_double -1.7E+308 1.7E+308 /end CHARACTERISTIC
/begin CHARACTERISTIC speedgoat_test_SN5659__cal_impl.Decode4_P14_d "" VALUE 0x00835670 Scalar_FLOAT64_IEEE 0 speedgoat_test_SN5659_R2021b_IO682_CM_double -1.7E+308 1.7E+308 /end CHARACTERISTIC
/begin CHARACTERISTIC speedgoat_test_SN5659__cal_impl.Decode4_P14_f "" VALUE 0x00834FD8 Scalar_FLOAT64_IEEE 0 speedgoat_test_SN5659_R2021b_IO682_CM_double -1.7E+308 1.7E+308 /end CHARACTERISTIC
/begin CHARACTERISTIC speedgoat_test_SN5659__cal_impl.Decode4_P14_j "" VALUE 0x00836A38 Scalar_FLOAT64_IEEE 0 speedgoat_test_SN5659_R2021b_IO682_CM_double -1.7E+308 1.7E+308 /end CHARACTERISTIC
/begin CHARACTERISTIC speedgoat_test_SN5659__cal_impl.Decode4_P14_l "" VALUE 0x008363A0 Scalar_FLOAT64_IEEE 0 speedgoat_test_SN5659_R2021b_IO682_CM_double -1.7E+308 1.7E+308 /end CHARACTERISTIC
/begin CHARACTERISTIC speedgoat_test_SN5659__cal_impl.Decode4_P14_n "" VALUE 0x00835D08 Scalar_FLOAT64_IEEE 0 speedgoat_test_SN5659_R2021b_IO682_CM_double -1.7E+308 1.7E+308 /end CHARACTERISTIC
/begin CHARACTERISTIC speedgoat_test_SN5659__cal_impl.Decode4_P15 "" VALUE 0x00833C28 Scalar_FLOAT64_IEEE 0 speedgoat_test_SN5659_R2021b_IO682_CM_double -1.7E+308 1.7E+308 /end CHARACTERISTIC
/begin CHARACTERISTIC speedgoat_test_SN5659__cal_impl.Decode4_P15_a "" VALUE 0x00834FF0 Scalar_FLOAT64_IEEE 0 speedgoat_test_SN5659_R2021b_IO682_CM_double -1.7E+308 1.7E+308 /end CHARACTERISTIC
/begin CHARACTERISTIC speedgoat_test_SN5659__cal_impl.Decode4_P15_d "" VALUE 0x00835D20 Scalar_FLOAT64_IEEE 0 speedgoat_test_SN5659_R2021b_IO682_CM_double -1.7E+308 1.7E+308 /end CHARACTERISTIC
/begin CHARACTERISTIC speedgoat_test_SN5659__cal_impl.Decode4_P15_dw "" VALUE 0x00836A50 Scalar_FLOAT64_IEEE 0 speedgoat_test_SN5659_R2021b_IO682_CM_double -1.7E+308 1.7E+308 /end CHARACTERISTIC
/begin CHARACTERISTIC speedgoat_test_SN5659__cal_impl.Decode4_P15_f "" VALUE 0x00835688 Scalar_FLOAT64_IEEE 0 speedgoat_test_SN5659_R2021b_IO682_CM_double -1.7E+308 1.7E+308 /end CHARACTERISTIC
/begin CHARACTERISTIC speedgoat_test_SN5659__cal_impl.Decode4_P15_ft "" VALUE 0x00837780 Scalar_FLOAT64_IEEE 0 speedgoat_test_SN5659_R2021b_IO682_CM_double -1.7E+308 1.7E+308 /end CHARACTERISTIC
/begin CHARACTERISTIC speedgoat_test_SN5659__cal_impl.Decode4_P15_i "" VALUE 0x008363B8 Scalar_FLOAT64_IEEE 0 speedgoat_test_SN5659_R2021b_IO682_CM_double -1.7E+308 1.7E+308 /end CHARACTERISTIC
/begin CHARACTERISTIC speedgoat_test_SN5659__cal_impl.Decode4_P15_i0 "" VALUE 0x008370E8 Scalar_FLOAT64_IEEE 0 speedgoat_test_SN5659_R2021b_IO682_CM_double -1.7E+308 1.7E+308 /end CHARACTERISTIC
/begin CHARACTERISTIC speedgoat_test_SN5659__cal_impl.Decode4_P16 "" VALUE 0x00833C40 Scalar_FLOAT64_IEEE 0 speedgoat_test_SN5659_R2021b_IO682_CM_double -1.7E+308 1.7E+308 /end CHARACTERISTIC
/begin CHARACTERISTIC speedgoat_test_SN5659__cal_impl.Decode4_P16_a "" VALUE 0x00837798 Scalar_FLOAT64_IEEE 0 speedgoat_test_SN5659_R2021b_IO682_CM_double -1.7E+308 1.7E+308 /end CHARACTERISTIC
/begin CHARACTERISTIC speedgoat_test_SN5659__cal_impl.Decode4_P16_c "" VALUE 0x008363D0 Scalar_FLOAT64_IEEE 0 speedgoat_test_SN5659_R2021b_IO682_CM_double -1.7E+308 1.7E+308 /end CHARACTERISTIC
/begin CHARACTERISTIC speedgoat_test_SN5659__cal_impl.Decode4_P16_d "" VALUE 0x00835D38 Scalar_FLOAT64_IEEE 0 speedgoat_test_SN5659_R2021b_IO682_CM_double -1.7E+308 1.7E+308 /end CHARACTERISTIC
/begin CHARACTERISTIC speedgoat_test_SN5659__cal_impl.Decode4_P16_e "" VALUE 0x008356A0 Scalar_FLOAT64_IEEE 0 speedgoat_test_SN5659_R2021b_IO682_CM_double -1.7E+308 1.7E+308 /end CHARACTERISTIC
/begin CHARACTERISTIC speedgoat_test_SN5659__cal_impl.Decode4_P16_l "" VALUE 0x00837100 Scalar_FLOAT64_IEEE 0 speedgoat_test_SN5659_R2021b_IO682_CM_double -1.7E+308 1.7E+308 /end CHARACTERISTIC
/begin CHARACTERISTIC speedgoat_test_SN5659__cal_impl.Decode4_P16_o "" VALUE 0x00836A68 Scalar_FLOAT64_IEEE 0 speedgoat_test_SN5659_R2021b_IO682_CM_double -1.7E+308 1.7E+308 /end CHARACTERISTIC
/begin CHARACTERISTIC speedgoat_test_SN5659__cal_impl.Decode4_P16_p "" VALUE 0x00835008 Scalar_FLOAT64_IEEE 0 speedgoat_test_SN5659_R2021b_IO682_CM_double -1.7E+308 1.7E+308 /end CHARACTERISTIC
/begin CHARACTERISTIC speedgoat_test_SN5659__cal_impl.Decode4_P1_a "" VALUE 0x008368F8 Scalar_FLOAT64_IEEE 0 speedgoat_test_SN5659_R2021b_IO682_CM_double -1.7E+308 1.7E+308 /end CHARACTERISTIC
/begin CHARACTERISTIC speedgoat_test_SN5659__cal_impl.Decode4_P1_c "" VALUE 0x00835530 Scalar_FLOAT64_IEEE 0 speedgoat_test_SN5659_R2021b_IO682_CM_double -1.7E+308 1.7E+308 /end CHARACTERISTIC
/begin CHARACTERISTIC speedgoat_test_SN5659__cal_impl.Decode4_P1_k "" VALUE 0x00835BC8 Scalar_FLOAT64_IEEE 0 speedgoat_test_SN5659_R2021b_IO682_CM_double -1.7E+308 1.7E+308 /end CHARACTERISTIC
/begin CHARACTERISTIC speedgoat_test_SN5659__cal_impl.Decode4_P1_kt "" VALUE 0x00836F90 Scalar_FLOAT64_IEEE 0 speedgoat_test_SN5659_R2021b_IO682_CM_double -1.7E+308 1.7E+308 /end CHARACTERISTIC
/begin CHARACTERISTIC speedgoat_test_SN5659__cal_impl.Decode4_P1_n "" VALUE 0x00837628 Scalar_FLOAT64_IEEE 0 speedgoat_test_SN5659_R2021b_IO682_CM_double -1.7E+308 1.7E+308 /end CHARACTERISTIC
/begin CHARACTERISTIC speedgoat_test_SN5659__cal_impl.Decode4_P1_p "" VALUE 0x00834E98 Scalar_FLOAT64_IEEE 0 speedgoat_test_SN5659_R2021b_IO682_CM_double -1.7E+308 1.7E+308 /end CHARACTERISTIC
/begin CHARACTERISTIC speedgoat_test_SN5659__cal_impl.Decode4_P1_pt "" VALUE 0x00836260 Scalar_FLOAT64_IEEE 0 speedgoat_test_SN5659_R2021b_IO682_CM_double -1.7E+308 1.7E+308 /end CHARACTERISTIC
/begin CHARACTERISTIC speedgoat_test_SN5659__cal_impl.Decode4_P2 "" VALUE 0x00833AE8 Scalar_FLOAT64_IEEE 0 speedgoat_test_SN5659_R2021b_IO682_CM_double -1.7E+308 1.7E+308 /end CHARACTERISTIC
/begin CHARACTERISTIC speedgoat_test_SN5659__cal_impl.Decode4_P2_c "" VALUE 0x00836278 Scalar_FLOAT64_IEEE 0 speedgoat_test_SN5659_R2021b_IO682_CM_double -1.7E+308 1.7E+308 /end CHARACTERISTIC
/begin CHARACTERISTIC speedgoat_test_SN5659__cal_impl.Decode4_P2_j "" VALUE 0x00834EB0 Scalar_FLOAT64_IEEE 0 speedgoat_test_SN5659_R2021b_IO682_CM_double -1.7E+308 1.7E+308 /end CHARACTERISTIC
/begin CHARACTERISTIC speedgoat_test_SN5659__cal_impl.Decode4_P2_l "" VALUE 0x00835548 Scalar_FLOAT64_IEEE 0 speedgoat_test_SN5659_R2021b_IO682_CM_double -1.7E+308 1.7E+308 /end CHARACTERISTIC
/begin CHARACTERISTIC speedgoat_test_SN5659__cal_impl.Decode4_P2_lo "" VALUE 0x00836FA8 Scalar_FLOAT64_IEEE 0 speedgoat_test_SN5659_R2021b_IO682_CM_double -1.7E+308 1.7E+308 /end CHARACTERISTIC
/begin CHARACTERISTIC speedgoat_test_SN5659__cal_impl.Decode4_P2_m "" VALUE 0x00836910 Scalar_FLOAT64_IEEE 0 speedgoat_test_SN5659_R2021b_IO682_CM_double -1.7E+308 1.7E+308 /end CHARACTERISTIC
/begin CHARACTERISTIC speedgoat_test_SN5659__cal_impl.Decode4_P2_n "" VALUE 0x00837640 Scalar_FLOAT64_IEEE 0 speedgoat_test_SN5659_R2021b_IO682_CM_double -1.7E+308 1.7E+308 /end CHARACTERISTIC
/begin CHARACTERISTIC speedgoat_test_SN5659__cal_impl.Decode4_P2_p0 "" VALUE 0x00835BE0 Scalar_FLOAT64_IEEE 0 speedgoat_test_SN5659_R2021b_IO682_CM_double -1.7E+308 1.7E+308 /end CHARACTERISTIC
/begin CHARACTERISTIC speedgoat_test_SN5659__cal_impl.Decode4_P3 "" VALUE 0x00833B00 Scalar_FLOAT64_IEEE 0 speedgoat_test_SN5659_R2021b_IO682_CM_double -1.7E+308 1.7E+308 /end CHARACTERISTIC
/begin CHARACTERISTIC speedgoat_test_SN5659__cal_impl.Decode4_P3_b "" VALUE 0x00836FC0 Scalar_FLOAT64_IEEE 0 speedgoat_test_SN5659_R2021b_IO682_CM_double -1.7E+308 1.7E+308 /end CHARACTERISTIC
/begin CHARACTERISTIC speedgoat_test_SN5659__cal_impl.Decode4_P3_cw "" VALUE 0x00835BF8 Scalar_FLOAT64_IEEE 0 speedgoat_test_SN5659_R2021b_IO682_CM_double -1.7E+308 1.7E+308 /end CHARACTERISTIC
/begin CHARACTERISTIC speedgoat_test_SN5659__cal_impl.Decode4_P3_e "" VALUE 0x00835560 Scalar_FLOAT64_IEEE 0 speedgoat_test_SN5659_R2021b_IO682_CM_double -1.7E+308 1.7E+308 /end CHARACTERISTIC
/begin CHARACTERISTIC speedgoat_test_SN5659__cal_impl.Decode4_P3_j "" VALUE 0x00837658 Scalar_FLOAT64_IEEE 0 speedgoat_test_SN5659_R2021b_IO682_CM_double -1.7E+308 1.7E+308 /end CHARACTERISTIC
/begin CHARACTERISTIC speedgoat_test_SN5659__cal_impl.Decode4_P3_m "" VALUE 0x00836290 Scalar_FLOAT64_IEEE 0 speedgoat_test_SN5659_R2021b_IO682_CM_double -1.7E+308 1.7E+308 /end CHARACTERISTIC
/begin CHARACTERISTIC speedgoat_test_SN5659__cal_impl.Decode4_P3_mr "" VALUE 0x00836928 Scalar_FLOAT64_IEEE 0 speedgoat_test_SN5659_R2021b_IO682_CM_double -1.7E+308 1.7E+308 /end CHARACTERISTIC
/begin CHARACTERISTIC speedgoat_test_SN5659__cal_impl.Decode4_P3_p "" VALUE 0x00834EC8 Scalar_FLOAT64_IEEE 0 speedgoat_test_SN5659_R2021b_IO682_CM_double -1.7E+308 1.7E+308 /end CHARACTERISTIC
/begin CHARACTERISTIC speedgoat_test_SN5659__cal_impl.Decode4_P4 "" VALUE 0x00833B18 Scalar_FLOAT64_IEEE 0 speedgoat_test_SN5659_R2021b_IO682_CM_double -1.7E+308 1.7E+308 /end CHARACTERISTIC
/begin CHARACTERISTIC speedgoat_test_SN5659__cal_impl.Decode4_P4_f "" VALUE 0x00836940 Scalar_FLOAT64_IEEE 0 speedgoat_test_SN5659_R2021b_IO682_CM_double -1.7E+308 1.7E+308 /end CHARACTERISTIC
/begin CHARACTERISTIC speedgoat_test_SN5659__cal_impl.Decode4_P4_h "" VALUE 0x008362A8 Scalar_FLOAT64_IEEE 0 speedgoat_test_SN5659_R2021b_IO682_CM_double -1.7E+308 1.7E+308 /end CHARACTERISTIC
/begin CHARACTERISTIC speedgoat_test_SN5659__cal_impl.Decode4_P4_hj "" VALUE 0x00837670 Scalar_FLOAT64_IEEE 0 speedgoat_test_SN5659_R2021b_IO682_CM_double -1.7E+308 1.7E+308 /end CHARACTERISTIC
/begin CHARACTERISTIC speedgoat_test_SN5659__cal_impl.Decode4_P4_hz "" VALUE 0x00836FD8 Scalar_FLOAT64_IEEE 0 speedgoat_test_SN5659_R2021b_IO682_CM_double -1.7E+308 1.7E+308 /end CHARACTERISTIC
/begin CHARACTERISTIC speedgoat_test_SN5659__cal_impl.Decode4_P4_i "" VALUE 0x00835578 Scalar_FLOAT64_IEEE 0 speedgoat_test_SN5659_R2021b_IO682_CM_double -1.7E+308 1.7E+308 /end CHARACTERISTIC
/begin CHARACTERISTIC speedgoat_test_SN5659__cal_impl.Decode4_P4_l "" VALUE 0x00834EE0 Scalar_FLOAT64_IEEE 0 speedgoat_test_SN5659_R2021b_IO682_CM_double -1.7E+308 1.7E+308 /end CHARACTERISTIC
/begin CHARACTERISTIC speedgoat_test_SN5659__cal_impl.Decode4_P4_p "" VALUE 0x00835C10 Scalar_FLOAT64_IEEE 0 speedgoat_test_SN5659_R2021b_IO682_CM_double -1.7E+308 1.7E+308 /end CHARACTERISTIC
/begin CHARACTERISTIC speedgoat_test_SN5659__cal_impl.Decode4_P5 "" VALUE 0x00833B30 Scalar_FLOAT64_IEEE 0 speedgoat_test_SN5659_R2021b_IO682_CM_double -1.7E+308 1.7E+308 /end CHARACTERISTIC
/begin CHARACTERISTIC speedgoat_test_SN5659__cal_impl.Decode4_P5_a "" VALUE 0x00835C28 Scalar_FLOAT64_IEEE 0 speedgoat_test_SN5659_R2021b_IO682_CM_double -1.7E+308 1.7E+308 /end CHARACTERISTIC
/begin CHARACTERISTIC speedgoat_test_SN5659__cal_impl.Decode4_P5_c "" VALUE 0x00834EF8 Scalar_FLOAT64_IEEE 0 speedgoat_test_SN5659_R2021b_IO682_CM_double -1.7E+308 1.7E+308 /end CHARACTERISTIC
/begin CHARACTERISTIC speedgoat_test_SN5659__cal_impl.Decode4_P5_cn "" VALUE 0x00836958 Scalar_FLOAT64_IEEE 0 speedgoat_test_SN5659_R2021b_IO682_CM_double -1.7E+308 1.7E+308 /end CHARACTERISTIC
/begin CHARACTERISTIC speedgoat_test_SN5659__cal_impl.Decode4_P5_cq "" VALUE 0x008362C0 Scalar_FLOAT64_IEEE 0 speedgoat_test_SN5659_R2021b_IO682_CM_double -1.7E+308 1.7E+308 /end CHARACTERISTIC
/begin CHARACTERISTIC speedgoat_test_SN5659__cal_impl.Decode4_P5_e "" VALUE 0x00835590 Scalar_FLOAT64_IEEE 0 speedgoat_test_SN5659_R2021b_IO682_CM_double -1.7E+308 1.7E+308 /end CHARACTERISTIC
/begin CHARACTERISTIC speedgoat_test_SN5659__cal_impl.Decode4_P5_k "" VALUE 0x00837688 Scalar_FLOAT64_IEEE 0 speedgoat_test_SN5659_R2021b_IO682_CM_double -1.7E+308 1.7E+308 /end CHARACTERISTIC
/begin CHARACTERISTIC speedgoat_test_SN5659__cal_impl.Decode4_P5_l "" VALUE 0x00836FF0 Scalar_FLOAT64_IEEE 0 speedgoat_test_SN5659_R2021b_IO682_CM_double -1.7E+308 1.7E+308 /end CHARACTERISTIC
/begin CHARACTERISTIC speedgoat_test_SN5659__cal_impl.Decode4_P6 "" VALUE 0x00833B48 Scalar_FLOAT64_IEEE 0 speedgoat_test_SN5659_R2021b_IO682_CM_double -1.7E+308 1.7E+308 /end CHARACTERISTIC
/begin CHARACTERISTIC speedgoat_test_SN5659__cal_impl.Decode4_P6_a "" VALUE 0x00835C40 Scalar_FLOAT64_IEEE 0 speedgoat_test_SN5659_R2021b_IO682_CM_double -1.7E+308 1.7E+308 /end CHARACTERISTIC
/begin CHARACTERISTIC speedgoat_test_SN5659__cal_impl.Decode4_P6_aj "" VALUE 0x008376A0 Scalar_FLOAT64_IEEE 0 speedgoat_test_SN5659_R2021b_IO682_CM_double -1.7E+308 1.7E+308 /end CHARACTERISTIC
/begin CHARACTERISTIC speedgoat_test_SN5659__cal_impl.Decode4_P6_aw "" VALUE 0x00836970 Scalar_FLOAT64_IEEE 0 speedgoat_test_SN5659_R2021b_IO682_CM_double -1.7E+308 1.7E+308 /end CHARACTERISTIC
/begin CHARACTERISTIC speedgoat_test_SN5659__cal_impl.Decode4_P6_c "" VALUE 0x00834F10 Scalar_FLOAT64_IEEE 0 speedgoat_test_SN5659_R2021b_IO682_CM_double -1.7E+308 1.7E+308 /end CHARACTERISTIC
/begin CHARACTERISTIC speedgoat_test_SN5659__cal_impl.Decode4_P6_e "" VALUE 0x008362D8 Scalar_FLOAT64_IEEE 0 speedgoat_test_SN5659_R2021b_IO682_CM_double -1.7E+308 1.7E+308 /end CHARACTERISTIC
/begin CHARACTERISTIC speedgoat_test_SN5659__cal_impl.Decode4_P6_f "" VALUE 0x00837008 Scalar_FLOAT64_IEEE 0 speedgoat_test_SN5659_R2021b_IO682_CM_double -1.7E+308 1.7E+308 /end CHARACTERISTIC
/begin CHARACTERISTIC speedgoat_test_SN5659__cal_impl.Decode4_P6_p "" VALUE 0x008355A8 Scalar_FLOAT64_IEEE 0 speedgoat_test_SN5659_R2021b_IO682_CM_double -1.7E+308 1.7E+308 /end CHARACTERISTIC
/begin CHARACTERISTIC speedgoat_test_SN5659__cal_impl.Decode4_P7 "" VALUE 0x00833B60 Scalar_FLOAT64_IEEE 0 speedgoat_test_SN5659_R2021b_IO682_CM_double -1.7E+308 1.7E+308 /end CHARACTERISTIC
/begin CHARACTERISTIC speedgoat_test_SN5659__cal_impl.Decode4_P7_b "" VALUE 0x00836988 Scalar_FLOAT64_IEEE 0 speedgoat_test_SN5659_R2021b_IO682_CM_double -1.7E+308 1.7E+308 /end CHARACTERISTIC
/begin CHARACTERISTIC speedgoat_test_SN5659__cal_impl.Decode4_P7_d "" VALUE 0x008362F0 Scalar_FLOAT64_IEEE 0 speedgoat_test_SN5659_R2021b_IO682_CM_double -1.7E+308 1.7E+308 /end CHARACTERISTIC
/begin CHARACTERISTIC speedgoat_test_SN5659__cal_impl.Decode4_P7_fb "" VALUE 0x00837020 Scalar_FLOAT64_IEEE 0 speedgoat_test_SN5659_R2021b_IO682_CM_double -1.7E+308 1.7E+308 /end CHARACTERISTIC
/begin CHARACTERISTIC speedgoat_test_SN5659__cal_impl.Decode4_P7_g "" VALUE 0x00835C58 Scalar_FLOAT64_IEEE 0 speedgoat_test_SN5659_R2021b_IO682_CM_double -1.7E+308 1.7E+308 /end CHARACTERISTIC
/begin CHARACTERISTIC speedgoat_test_SN5659__cal_impl.Decode4_P7_h "" VALUE 0x008376B8 Scalar_FLOAT64_IEEE 0 speedgoat_test_SN5659_R2021b_IO682_CM_double -1.7E+308 1.7E+308 /end CHARACTERISTIC
/begin CHARACTERISTIC speedgoat_test_SN5659__cal_impl.Decode4_P7_nt "" VALUE 0x00834F28 Scalar_FLOAT64_IEEE 0 speedgoat_test_SN5659_R2021b_IO682_CM_double -1.7E+308 1.7E+308 /end CHARACTERISTIC
/begin CHARACTERISTIC speedgoat_test_SN5659__cal_impl.Decode4_P7_o "" VALUE 0x008355C0 Scalar_FLOAT64_IEEE 0 speedgoat_test_SN5659_R2021b_IO682_CM_double -1.7E+308 1.7E+308 /end CHARACTERISTIC
/begin CHARACTERISTIC speedgoat_test_SN5659__cal_impl.Decode4_P8 "" VALUE 0x00833B78 Scalar_FLOAT64_IEEE 0 speedgoat_test_SN5659_R2021b_IO682_CM_double -1.7E+308 1.7E+308 /end CHARACTERISTIC
/begin CHARACTERISTIC speedgoat_test_SN5659__cal_impl.Decode4_P8_d "" VALUE 0x00837038 Scalar_FLOAT64_IEEE 0 speedgoat_test_SN5659_R2021b_IO682_CM_double -1.7E+308 1.7E+308 /end CHARACTERISTIC
/begin CHARACTERISTIC speedgoat_test_SN5659__cal_impl.Decode4_P8_e "" VALUE 0x008355D8 Scalar_FLOAT64_IEEE 0 speedgoat_test_SN5659_R2021b_IO682_CM_double -1.7E+308 1.7E+308 /end CHARACTERISTIC
/begin CHARACTERISTIC speedgoat_test_SN5659__cal_impl.Decode4_P8_gh "" VALUE 0x00836308 Scalar_FLOAT64_IEEE 0 speedgoat_test_SN5659_R2021b_IO682_CM_double -1.7E+308 1.7E+308 /end CHARACTERISTIC
/begin CHARACTERISTIC speedgoat_test_SN5659__cal_impl.Decode4_P8_i "" VALUE 0x00835C70 Scalar_FLOAT64_IEEE 0 speedgoat_test_SN5659_R2021b_IO682_CM_double -1.7E+308 1.7E+308 /end CHARACTERISTIC
/begin CHARACTERISTIC speedgoat_test_SN5659__cal_impl.Decode4_P8_iy "" VALUE 0x008376D0 Scalar_FLOAT64_IEEE 0 speedgoat_test_SN5659_R2021b_IO682_CM_double -1.7E+308 1.7E+308 /end CHARACTERISTIC
/begin CHARACTERISTIC speedgoat_test_SN5659__cal_impl.Decode4_P8_j "" VALUE 0x00834F40 Scalar_FLOAT64_IEEE 0 speedgoat_test_SN5659_R2021b_IO682_CM_double -1.7E+308 1.7E+308 /end CHARACTERISTIC
/begin CHARACTERISTIC speedgoat_test_SN5659__cal_impl.Decode4_P8_m "" VALUE 0x008369A0 Scalar_FLOAT64_IEEE 0 speedgoat_test_SN5659_R2021b_IO682_CM_double -1.7E+308 1.7E+308 /end CHARACTERISTIC
/begin CHARACTERISTIC speedgoat_test_SN5659__cal_impl.Decode4_P9 "" VALUE 0x00833B90 Scalar_FLOAT64_IEEE 0 speedgoat_test_SN5659_R2021b_IO682_CM_double -1.7E+308 1.7E+308 /end CHARACTERISTIC
/begin CHARACTERISTIC speedgoat_test_SN5659__cal_impl.Decode4_P9_ay "" VALUE 0x008355F0 Scalar_FLOAT64_IEEE 0 speedgoat_test_SN5659_R2021b_IO682_CM_double -1.7E+308 1.7E+308 /end CHARACTERISTIC
/begin CHARACTERISTIC speedgoat_test_SN5659__cal_impl.Decode4_P9_b "" VALUE 0x00834F58 Scalar_FLOAT64_IEEE 0 speedgoat_test_SN5659_R2021b_IO682_CM_double -1.7E+308 1.7E+308 /end CHARACTERISTIC
/begin CHARACTERISTIC speedgoat_test_SN5659__cal_impl.Decode4_P9_bz "" VALUE 0x008376E8 Scalar_FLOAT64_IEEE 0 speedgoat_test_SN5659_R2021b_IO682_CM_double -1.7E+308 1.7E+308 /end CHARACTERISTIC
/begin CHARACTERISTIC speedgoat_test_SN5659__cal_impl.Decode4_P9_d "" VALUE 0x00835C88 Scalar_FLOAT64_IEEE 0 speedgoat_test_SN5659_R2021b_IO682_CM_double -1.7E+308 1.7E+308 /end CHARACTERISTIC
/begin CHARACTERISTIC speedgoat_test_SN5659__cal_impl.Decode4_P9_l "" VALUE 0x00837050 Scalar_FLOAT64_IEEE 0 speedgoat_test_SN5659_R2021b_IO682_CM_double -1.7E+308 1.7E+308 /end CHARACTERISTIC
/begin CHARACTERISTIC speedgoat_test_SN5659__cal_impl.Decode4_P9_n "" VALUE 0x00836320 Scalar_FLOAT64_IEEE 0 speedgoat_test_SN5659_R2021b_IO682_CM_double -1.7E+308 1.7E+308 /end CHARACTERISTIC
/begin CHARACTERISTIC speedgoat_test_SN5659__cal_impl.Decode4_P9_o "" VALUE 0x008369B8 Scalar_FLOAT64_IEEE 0 speedgoat_test_SN5659_R2021b_IO682_CM_double -1.7E+308 1.7E+308 /end CHARACTERISTIC
/begin CHARACTERISTIC speedgoat_test_SN5659__cal_impl.Decode5_P1 "" VALUE 0x008337C0 Scalar_FLOAT64_IEEE 0 speedgoat_test_SN5659_R2021b_IO682_CM_double -1.7E+308 1.7E+308 /end CHARACTERISTIC
/begin CHARACTERISTIC speedgoat_test_SN5659__cal_impl.Decode5_P10 "" VAL_BLK 0x00833898 Scalar_FLOAT64_IEEE 0 speedgoat_test_SN5659_R2021b_IO682_CM_double -1.7E+308 1.7E+308 MATRIX_DIM 2 1 /end CHARACTERISTIC
/begin CHARACTERISTIC speedgoat_test_SN5659__cal_impl.Decode5_P10_k "" VAL_BLK 0x00836028 Scalar_FLOAT64_IEEE 0 speedgoat_test_SN5659_R2021b_IO682_CM_double -1.7E+308 1.7E+308 MATRIX_DIM 2 1 /end CHARACTERISTIC
/begin CHARACTERISTIC speedgoat_test_SN5659__cal_impl.Decode5_P11 "" VALUE 0x008338B8 Scalar_FLOAT64_IEEE 0 speedgoat_test_SN5659_R2021b_IO682_CM_double -1.7E+308 1.7E+308 /end CHARACTERISTIC
/begin CHARACTERISTIC speedgoat_test_SN5659__cal_impl.Decode5_P11_c "" VALUE 0x00836048 Scalar_FLOAT64_IEEE 0 speedgoat_test_SN5659_R2021b_IO682_CM_double -1.7E+308 1.7E+308 /end CHARACTERISTIC
/begin CHARACTERISTIC speedgoat_test_SN5659__cal_impl.Decode5_P12 "" VALUE 0x008338D0 Scalar_FLOAT64_IEEE 0 speedgoat_test_SN5659_R2021b_IO682_CM_double -1.7E+308 1.7E+308 /end CHARACTERISTIC
/begin CHARACTERISTIC speedgoat_test_SN5659__cal_impl.Decode5_P12_e "" VALUE 0x00836060 Scalar_FLOAT64_IEEE 0 speedgoat_test_SN5659_R2021b_IO682_CM_double -1.7E+308 1.7E+308 /end CHARACTERISTIC
/begin CHARACTERISTIC speedgoat_test_SN5659__cal_impl.Decode5_P13 "" VALUE 0x008338E8 Scalar_FLOAT64_IEEE 0 speedgoat_test_SN5659_R2021b_IO682_CM_double -1.7E+308 1.7E+308 /end CHARACTERISTIC
/begin CHARACTERISTIC speedgoat_test_SN5659__cal_impl.Decode5_P13_o "" VALUE 0x00836078 Scalar_FLOAT64_IEEE 0 speedgoat_test_SN5659_R2021b_IO682_CM_double -1.7E+308 1.7E+308 /end CHARACTERISTIC
/begin CHARACTERISTIC speedgoat_test_SN5659__cal_impl.Decode5_P14 "" VALUE 0x00833900 Scalar_FLOAT64_IEEE 0 speedgoat_test_SN5659_R2021b_IO682_CM_double -1.7E+308 1.7E+308 /end CHARACTERISTIC
/begin CHARACTERISTIC speedgoat_test_SN5659__cal_impl.Decode5_P14_g "" VALUE 0x00836090 Scalar_FLOAT64_IEEE 0 speedgoat_test_SN5659_R2021b_IO682_CM_double -1.7E+308 1.7E+308 /end CHARACTERISTIC
/begin CHARACTERISTIC speedgoat_test_SN5659__cal_impl.Decode5_P15 "" VALUE 0x00833918 Scalar_FLOAT64_IEEE 0 speedgoat_test_SN5659_R2021b_IO682_CM_double -1.7E+308 1.7E+308 /end CHARACTERISTIC
/begin CHARACTERISTIC speedgoat_test_SN5659__cal_impl.Decode5_P15_o "" VALUE 0x008360A8 Scalar_FLOAT64_IEEE 0 speedgoat_test_SN5659_R2021b_IO682_CM_double -1.7E+308 1.7E+308 /end CHARACTERISTIC
/begin CHARACTERISTIC speedgoat_test_SN5659__cal_impl.Decode5_P16 "" VALUE 0x00833930 Scalar_FLOAT64_IEEE 0 speedgoat_test_SN5659_R2021b_IO682_CM_double -1.7E+308 1.7E+308 /end CHARACTERISTIC
/begin CHARACTERISTIC speedgoat_test_SN5659__cal_impl.Decode5_P16_m "" VALUE 0x008360C0 Scalar_FLOAT64_IEEE 0 speedgoat_test_SN5659_R2021b_IO682_CM_double -1.7E+308 1.7E+308 /end CHARACTERISTIC
/begin CHARACTERISTIC speedgoat_test_SN5659__cal_impl.Decode5_P1_m "" VALUE 0x00835F50 Scalar_FLOAT64_IEEE 0 speedgoat_test_SN5659_R2021b_IO682_CM_double -1.7E+308 1.7E+308 /end CHARACTERISTIC
/begin CHARACTERISTIC speedgoat_test_SN5659__cal_impl.Decode5_P2 "" VALUE 0x008337D8 Scalar_FLOAT64_IEEE 0 speedgoat_test_SN5659_R2021b_IO682_CM_double -1.7E+308 1.7E+308 /end CHARACTERISTIC
/begin CHARACTERISTIC speedgoat_test_SN5659__cal_impl.Decode5_P2_f "" VALUE 0x00835F68 Scalar_FLOAT64_IEEE 0 speedgoat_test_SN5659_R2021b_IO682_CM_double -1.7E+308 1.7E+308 /end CHARACTERISTIC
/begin CHARACTERISTIC speedgoat_test_SN5659__cal_impl.Decode5_P3 "" VALUE 0x008337F0 Scalar_FLOAT64_IEEE 0 speedgoat_test_SN5659_R2021b_IO682_CM_double -1.7E+308 1.7E+308 /end CHARACTERISTIC
/begin CHARACTERISTIC speedgoat_test_SN5659__cal_impl.Decode5_P3_d "" VALUE 0x00835F80 Scalar_FLOAT64_IEEE 0 speedgoat_test_SN5659_R2021b_IO682_CM_double -1.7E+308 1.7E+308 /end CHARACTERISTIC
/begin CHARACTERISTIC speedgoat_test_SN5659__cal_impl.Decode5_P4 "" VALUE 0x00833808 Scalar_FLOAT64_IEEE 0 speedgoat_test_SN5659_R2021b_IO682_CM_double -1.7E+308 1.7E+308 /end CHARACTERISTIC
/begin CHARACTERISTIC speedgoat_test_SN5659__cal_impl.Decode5_P4_j "" VALUE 0x00835F98 Scalar_FLOAT64_IEEE 0 speedgoat_test_SN5659_R2021b_IO682_CM_double -1.7E+308 1.7E+308 /end CHARACTERISTIC
/begin CHARACTERISTIC speedgoat_test_SN5659__cal_impl.Decode5_P5 "" VALUE 0x00833820 Scalar_FLOAT64_IEEE 0 speedgoat_test_SN5659_R2021b_IO682_CM_double -1.7E+308 1.7E+308 /end CHARACTERISTIC
/begin CHARACTERISTIC speedgoat_test_SN5659__cal_impl.Decode5_P5_n "" VALUE 0x00835FB0 Scalar_FLOAT64_IEEE 0 speedgoat_test_SN5659_R2021b_IO682_CM_double -1.7E+308 1.7E+308 /end CHARACTERISTIC
/begin CHARACTERISTIC speedgoat_test_SN5659__cal_impl.Decode5_P6 "" VALUE 0x00833838 Scalar_FLOAT64_IEEE 0 speedgoat_test_SN5659_R2021b_IO682_CM_double -1.7E+308 1.7E+308 /end CHARACTERISTIC
/begin CHARACTERISTIC speedgoat_test_SN5659__cal_impl.Decode5_P6_b "" VALUE 0x00835FC8 Scalar_FLOAT64_IEEE 0 speedgoat_test_SN5659_R2021b_IO682_CM_double -1.7E+308 1.7E+308 /end CHARACTERISTIC
/begin CHARACTERISTIC speedgoat_test_SN5659__cal_impl.Decode5_P7 "" VALUE 0x00833850 Scalar_FLOAT64_IEEE 0 speedgoat_test_SN5659_R2021b_IO682_CM_double -1.7E+308 1.7E+308 /end CHARACTERISTIC
/begin CHARACTERISTIC speedgoat_test_SN5659__cal_impl.Decode5_P7_j "" VALUE 0x00835FE0 Scalar_FLOAT64_IEEE 0 speedgoat_test_SN5659_R2021b_IO682_CM_double -1.7E+308 1.7E+308 /end CHARACTERISTIC
/begin CHARACTERISTIC speedgoat_test_SN5659__cal_impl.Decode5_P8 "" VALUE 0x00833868 Scalar_FLOAT64_IEEE 0 speedgoat_test_SN5659_R2021b_IO682_CM_double -1.7E+308 1.7E+308 /end CHARACTERISTIC
/begin CHARACTERISTIC speedgoat_test_SN5659__cal_impl.Decode5_P8_d "" VALUE 0x00835FF8 Scalar_FLOAT64_IEEE 0 speedgoat_test_SN5659_R2021b_IO682_CM_double -1.7E+308 1.7E+308 /end CHARACTERISTIC
/begin CHARACTERISTIC speedgoat_test_SN5659__cal_impl.Decode5_P9 "" VALUE 0x00833880 Scalar_FLOAT64_IEEE 0 speedgoat_test_SN5659_R2021b_IO682_CM_double -1.7E+308 1.7E+308 /end CHARACTERISTIC
/begin CHARACTERISTIC speedgoat_test_SN5659__cal_impl.Decode5_P9_i "" VALUE 0x00836010 Scalar_FLOAT64_IEEE 0 speedgoat_test_SN5659_R2021b_IO682_CM_double -1.7E+308 1.7E+308 /end CHARACTERISTIC
/begin CHARACTERISTIC speedgoat_test_SN5659__cal_impl.Receivev210_P1 "" VALUE 0x00835020 Scalar_FLOAT64_IEEE 0 speedgoat_test_SN5659_R2021b_IO682_CM_double -1.7E+308 1.7E+308 /end CHARACTERISTIC
/begin CHARACTERISTIC speedgoat_test_SN5659__cal_impl.Receivev210_P2 "" VALUE 0x00835038 Scalar_FLOAT64_IEEE 0 speedgoat_test_SN5659_R2021b_IO682_CM_double -1.7E+308 1.7E+308 /end CHARACTERISTIC
/begin CHARACTERISTIC speedgoat_test_SN5659__cal_impl.Receivev210_P3 "" VALUE 0x00835050 Scalar_FLOAT64_IEEE 0 speedgoat_test_SN5659_R2021b_IO682_CM_double -1.7E+308 1.7E+308 /end CHARACTERISTIC
/begin CHARACTERISTIC speedgoat_test_SN5659__cal_impl.Receivev210_P4 "" VALUE 0x00835068 Scalar_FLOAT64_IEEE 0 speedgoat_test_SN5659_R2021b_IO682_CM_double -1.7E+308 1.7E+308 /end CHARACTERISTIC
/begin CHARACTERISTIC speedgoat_test_SN5659__cal_impl.Receivev210_P5 "" VALUE 0x00835080 Scalar_FLOAT64_IEEE 0 speedgoat_test_SN5659_R2021b_IO682_CM_double -1.7E+308 1.7E+308 /end CHARACTERISTIC
/begin CHARACTERISTIC speedgoat_test_SN5659__cal_impl.Receivev211_P1 "" VALUE 0x008356B8 Scalar_FLOAT64_IEEE 0 speedgoat_test_SN5659_R2021b_IO682_CM_double -1.7E+308 1.7E+308 /end CHARACTERISTIC
/begin CHARACTERISTIC speedgoat_test_SN5659__cal_impl.Receivev211_P2 "" VALUE 0x008356D0 Scalar_FLOAT64_IEEE 0 speedgoat_test_SN5659_R2021b_IO682_CM_double -1.7E+308 1.7E+308 /end CHARACTERISTIC
/begin CHARACTERISTIC speedgoat_test_SN5659__cal_impl.Receivev211_P3 "" VALUE 0x008356E8 Scalar_FLOAT64_IEEE 0 speedgoat_test_SN5659_R2021b_IO682_CM_double -1.7E+308 1.7E+308 /end CHARACTERISTIC
/begin CHARACTERISTIC speedgoat_test_SN5659__cal_impl.Receivev211_P4 "" VALUE 0x00835700 Scalar_FLOAT64_IEEE 0 speedgoat_test_SN5659_R2021b_IO682_CM_double -1.7E+308 1.7E+308 /end CHARACTERISTIC
/begin CHARACTERISTIC speedgoat_test_SN5659__cal_impl.Receivev211_P5 "" VALUE 0x00835718 Scalar_FLOAT64_IEEE 0 speedgoat_test_SN5659_R2021b_IO682_CM_double -1.7E+308 1.7E+308 /end CHARACTERISTIC
/begin CHARACTERISTIC speedgoat_test_SN5659__cal_impl.Receivev212_P1 "" VALUE 0x00835D50 Scalar_FLOAT64_IEEE 0 speedgoat_test_SN5659_R2021b_IO682_CM_double -1.7E+308 1.7E+308 /end CHARACTERISTIC
/begin CHARACTERISTIC speedgoat_test_SN5659__cal_impl.Receivev212_P2 "" VALUE 0x00835D68 Scalar_FLOAT64_IEEE 0 speedgoat_test_SN5659_R2021b_IO682_CM_double -1.7E+308 1.7E+308 /end CHARACTERISTIC
/begin CHARACTERISTIC speedgoat_test_SN5659__cal_impl.Receivev212_P3 "" VALUE 0x00835D80 Scalar_FLOAT64_IEEE 0 speedgoat_test_SN5659_R2021b_IO682_CM_double -1.7E+308 1.7E+308 /end CHARACTERISTIC
/begin CHARACTERISTIC speedgoat_test_SN5659__cal_impl.Receivev212_P4 "" VALUE 0x00835D98 Scalar_FLOAT64_IEEE 0 speedgoat_test_SN5659_R2021b_IO682_CM_double -1.7E+308 1.7E+308 /end CHARACTERISTIC
/begin CHARACTERISTIC speedgoat_test_SN5659__cal_impl.Receivev212_P5 "" VALUE 0x00835DB0 Scalar_FLOAT64_IEEE 0 speedgoat_test_SN5659_R2021b_IO682_CM_double -1.7E+308 1.7E+308 /end CHARACTERISTIC
/begin CHARACTERISTIC speedgoat_test_SN5659__cal_impl.Receivev213_P1 "" VALUE 0x008363E8 Scalar_FLOAT64_IEEE 0 speedgoat_test_SN5659_R2021b_IO682_CM_double -1.7E+308 1.7E+308 /end CHARACTERISTIC
/begin CHARACTERISTIC speedgoat_test_SN5659__cal_impl.Receivev213_P2 "" VALUE 0x00836400 Scalar_FLOAT64_IEEE 0 speedgoat_test_SN5659_R2021b_IO682_CM_double -1.7E+308 1.7E+308 /end CHARACTERISTIC
/begin CHARACTERISTIC speedgoat_test_SN5659__cal_impl.Receivev213_P3 "" VALUE 0x00836418 Scalar_FLOAT64_IEEE 0 speedgoat_test_SN5659_R2021b_IO682_CM_double -1.7E+308 1.7E+308 /end CHARACTERISTIC
/begin CHARACTERISTIC speedgoat_test_SN5659__cal_impl.Receivev213_P4 "" VALUE 0x00836430 Scalar_FLOAT64_IEEE 0 speedgoat_test_SN5659_R2021b_IO682_CM_double -1.7E+308 1.7E+308 /end CHARACTERISTIC
/begin CHARACTERISTIC speedgoat_test_SN5659__cal_impl.Receivev213_P5 "" VALUE 0x00836448 Scalar_FLOAT64_IEEE 0 speedgoat_test_SN5659_R2021b_IO682_CM_double -1.7E+308 1.7E+308 /end CHARACTERISTIC
/begin CHARACTERISTIC speedgoat_test_SN5659__cal_impl.Receivev214_P1 "" VALUE 0x00836A80 Scalar_FLOAT64_IEEE 0 speedgoat_test_SN5659_R2021b_IO682_CM_double -1.7E+308 1.7E+308 /end CHARACTERISTIC
/begin CHARACTERISTIC speedgoat_test_SN5659__cal_impl.Receivev214_P2 "" VALUE 0x00836A98 Scalar_FLOAT64_IEEE 0 speedgoat_test_SN5659_R2021b_IO682_CM_double -1.7E+308 1.7E+308 /end CHARACTERISTIC
/begin CHARACTERISTIC speedgoat_test_SN5659__cal_impl.Receivev214_P3 "" VALUE 0x00836AB0 Scalar_FLOAT64_IEEE 0 speedgoat_test_SN5659_R2021b_IO682_CM_double -1.7E+308 1.7E+308 /end CHARACTERISTIC
/begin CHARACTERISTIC speedgoat_test_SN5659__cal_impl.Receivev214_P4 "" VALUE 0x00836AC8 Scalar_FLOAT64_IEEE 0 speedgoat_test_SN5659_R2021b_IO682_CM_double -1.7E+308 1.7E+308 /end CHARACTERISTIC
/begin CHARACTERISTIC speedgoat_test_SN5659__cal_impl.Receivev214_P5 "" VALUE 0x00836AE0 Scalar_FLOAT64_IEEE 0 speedgoat_test_SN5659_R2021b_IO682_CM_double -1.7E+308 1.7E+308 /end CHARACTERISTIC
/begin CHARACTERISTIC speedgoat_test_SN5659__cal_impl.Receivev215_P1 "" VALUE 0x00837118 Scalar_FLOAT64_IEEE 0 speedgoat_test_SN5659_R2021b_IO682_CM_double -1.7E+308 1.7E+308 /end CHARACTERISTIC
/begin CHARACTERISTIC speedgoat_test_SN5659__cal_impl.Receivev215_P2 "" VALUE 0x00837130 Scalar_FLOAT64_IEEE 0 speedgoat_test_SN5659_R2021b_IO682_CM_double -1.7E+308 1.7E+308 /end CHARACTERISTIC
/begin CHARACTERISTIC speedgoat_test_SN5659__cal_impl.Receivev215_P3 "" VALUE 0x00837148 Scalar_FLOAT64_IEEE 0 speedgoat_test_SN5659_R2021b_IO682_CM_double -1.7E+308 1.7E+308 /end CHARACTERISTIC
/begin CHARACTERISTIC speedgoat_test_SN5659__cal_impl.Receivev215_P4 "" VALUE 0x00837160 Scalar_FLOAT64_IEEE 0 speedgoat_test_SN5659_R2021b_IO682_CM_double -1.7E+308 1.7E+308 /end CHARACTERISTIC
/begin CHARACTERISTIC speedgoat_test_SN5659__cal_impl.Receivev215_P5 "" VALUE 0x00837178 Scalar_FLOAT64_IEEE 0 speedgoat_test_SN5659_R2021b_IO682_CM_double -1.7E+308 1.7E+308 /end CHARACTERISTIC
/begin CHARACTERISTIC speedgoat_test_SN5659__cal_impl.Receivev21_P1 "" VALUE 0x00833C58 Scalar_FLOAT64_IEEE 0 speedgoat_test_SN5659_R2021b_IO682_CM_double -1.7E+308 1.7E+308 /end CHARACTERISTIC
/begin CHARACTERISTIC speedgoat_test_SN5659__cal_impl.Receivev21_P2 "" VALUE 0x00833C70 Scalar_FLOAT64_IEEE 0 speedgoat_test_SN5659_R2021b_IO682_CM_double -1.7E+308 1.7E+308 /end CHARACTERISTIC
/begin CHARACTERISTIC speedgoat_test_SN5659__cal_impl.Receivev21_P3 "" VALUE 0x00833C88 Scalar_FLOAT64_IEEE 0 speedgoat_test_SN5659_R2021b_IO682_CM_double -1.7E+308 1.7E+308 /end CHARACTERISTIC
/begin CHARACTERISTIC speedgoat_test_SN5659__cal_impl.Receivev21_P4 "" VALUE 0x00833CA0 Scalar_FLOAT64_IEEE 0 speedgoat_test_SN5659_R2021b_IO682_CM_double -1.7E+308 1.7E+308 /end CHARACTERISTIC
/begin CHARACTERISTIC speedgoat_test_SN5659__cal_impl.Receivev21_P5 "" VALUE 0x00833CB8 Scalar_FLOAT64_IEEE 0 speedgoat_test_SN5659_R2021b_IO682_CM_double -1.7E+308 1.7E+308 /end CHARACTERISTIC
/begin CHARACTERISTIC speedgoat_test_SN5659__cal_impl.Receivev22_P1 "" VALUE 0x008377B0 Scalar_FLOAT64_IEEE 0 speedgoat_test_SN5659_R2021b_IO682_CM_double -1.7E+308 1.7E+308 /end CHARACTERISTIC
/begin CHARACTERISTIC speedgoat_test_SN5659__cal_impl.Receivev22_P2 "" VALUE 0x008377C8 Scalar_FLOAT64_IEEE 0 speedgoat_test_SN5659_R2021b_IO682_CM_double -1.7E+308 1.7E+308 /end CHARACTERISTIC
/begin CHARACTERISTIC speedgoat_test_SN5659__cal_impl.Receivev22_P3 "" VALUE 0x008377E0 Scalar_FLOAT64_IEEE 0 speedgoat_test_SN5659_R2021b_IO682_CM_double -1.7E+308 1.7E+308 /end CHARACTERISTIC
/begin CHARACTERISTIC speedgoat_test_SN5659__cal_impl.Receivev22_P4 "" VALUE 0x008377F8 Scalar_FLOAT64_IEEE 0 speedgoat_test_SN5659_R2021b_IO682_CM_double -1.7E+308 1.7E+308 /end CHARACTERISTIC
/begin CHARACTERISTIC speedgoat_test_SN5659__cal_impl.Receivev22_P5 "" VALUE 0x00837810 Scalar_FLOAT64_IEEE 0 speedgoat_test_SN5659_R2021b_IO682_CM_double -1.7E+308 1.7E+308 /end CHARACTERISTIC
/begin CHARACTERISTIC speedgoat_test_SN5659__cal_impl.Receivev23_P1 "" VALUE 0x00837E48 Scalar_FLOAT64_IEEE 0 speedgoat_test_SN5659_R2021b_IO682_CM_double -1.7E+308 1.7E+308 /end CHARACTERISTIC
/begin CHARACTERISTIC speedgoat_test_SN5659__cal_impl.Receivev23_P2 "" VALUE 0x00837E60 Scalar_FLOAT64_IEEE 0 speedgoat_test_SN5659_R2021b_IO682_CM_double -1.7E+308 1.7E+308 /end CHARACTERISTIC
/begin CHARACTERISTIC speedgoat_test_SN5659__cal_impl.Receivev23_P3 "" VALUE 0x00837E78 Scalar_FLOAT64_IEEE 0 speedgoat_test_SN5659_R2021b_IO682_CM_double -1.7E+308 1.7E+308 /end CHARACTERISTIC
/begin CHARACTERISTIC speedgoat_test_SN5659__cal_impl.Receivev23_P4 "" VALUE 0x00837E90 Scalar_FLOAT64_IEEE 0 speedgoat_test_SN5659_R2021b_IO682_CM_double -1.7E+308 1.7E+308 /end CHARACTERISTIC
/begin CHARACTERISTIC speedgoat_test_SN5659__cal_impl.Receivev23_P5 "" VALUE 0x00837EA8 Scalar_FLOAT64_IEEE 0 speedgoat_test_SN5659_R2021b_IO682_CM_double -1.7E+308 1.7E+308 /end CHARACTERISTIC
/begin CHARACTERISTIC speedgoat_test_SN5659__cal_impl.Receivev24_P1 "" VALUE 0x008384E0 Scalar_FLOAT64_IEEE 0 speedgoat_test_SN5659_R2021b_IO682_CM_double -1.7E+308 1.7E+308 /end CHARACTERISTIC
/begin CHARACTERISTIC speedgoat_test_SN5659__cal_impl.Receivev24_P2 "" VALUE 0x008384F8 Scalar_FLOAT64_IEEE 0 speedgoat_test_SN5659_R2021b_IO682_CM_double -1.7E+308 1.7E+308 /end CHARACTERISTIC
/begin CHARACTERISTIC speedgoat_test_SN5659__cal_impl.Receivev24_P3 "" VALUE 0x00838510 Scalar_FLOAT64_IEEE 0 speedgoat_test_SN5659_R2021b_IO682_CM_double -1.7E+308 1.7E+308 /end CHARACTERISTIC
/begin CHARACTERISTIC speedgoat_test_SN5659__cal_impl.Receivev24_P4 "" VALUE 0x00838528 Scalar_FLOAT64_IEEE 0 speedgoat_test_SN5659_R2021b_IO682_CM_double -1.7E+308 1.7E+308 /end CHARACTERISTIC
/begin CHARACTERISTIC speedgoat_test_SN5659__cal_impl.Receivev24_P5 "" VALUE 0x00838540 Scalar_FLOAT64_IEEE 0 speedgoat_test_SN5659_R2021b_IO682_CM_double -1.7E+308 1.7E+308 /end CHARACTERISTIC
/begin CHARACTERISTIC speedgoat_test_SN5659__cal_impl.Receivev25_P1 "" VALUE 0x00838B78 Scalar_FLOAT64_IEEE 0 speedgoat_test_SN5659_R2021b_IO682_CM_double -1.7E+308 1.7E+308 /end CHARACTERISTIC
/begin CHARACTERISTIC speedgoat_test_SN5659__cal_impl.Receivev25_P2 "" VALUE 0x00838B90 Scalar_FLOAT64_IEEE 0 speedgoat_test_SN5659_R2021b_IO682_CM_double -1.7E+308 1.7E+308 /end CHARACTERISTIC
/begin CHARACTERISTIC speedgoat_test_SN5659__cal_impl.Receivev25_P3 "" VALUE 0x00838BA8 Scalar_FLOAT64_IEEE 0 speedgoat_test_SN5659_R2021b_IO682_CM_double -1.7E+308 1.7E+308 /end CHARACTERISTIC
/begin CHARACTERISTIC speedgoat_test_SN5659__cal_impl.Receivev25_P4 "" VALUE 0x00838BC0 Scalar_FLOAT64_IEEE 0 speedgoat_test_SN5659_R2021b_IO682_CM_double -1.7E+308 1.7E+308 /end CHARACTERISTIC
/begin CHARACTERISTIC speedgoat_test_SN5659__cal_impl.Receivev25_P5 "" VALUE 0x00838BD8 Scalar_FLOAT64_IEEE 0 speedgoat_test_SN5659_R2021b_IO682_CM_double -1.7E+308 1.7E+308 /end CHARACTERISTIC
/begin CHARACTERISTIC speedgoat_test_SN5659__cal_impl.Receivev26_P1 "" VALUE 0x00839210 Scalar_FLOAT64_IEEE 0 speedgoat_test_SN5659_R2021b_IO682_CM_double -1.7E+308 1.7E+308 /end CHARACTERISTIC
/begin CHARACTERISTIC speedgoat_test_SN5659__cal_impl.Receivev26_P2 "" VALUE 0x00839228 Scalar_FLOAT64_IEEE 0 speedgoat_test_SN5659_R2021b_IO682_CM_double -1.7E+308 1.7E+308 /end CHARACTERISTIC
/begin CHARACTERISTIC speedgoat_test_SN5659__cal_impl.Receivev26_P3 "" VALUE 0x00839240 Scalar_FLOAT64_IEEE 0 speedgoat_test_SN5659_R2021b_IO682_CM_double -1.7E+308 1.7E+308 /end CHARACTERISTIC
/begin CHARACTERISTIC speedgoat_test_SN5659__cal_impl.Receivev26_P4 "" VALUE 0x00839258 Scalar_FLOAT64_IEEE 0 speedgoat_test_SN5659_R2021b_IO682_CM_double -1.7E+308 1.7E+308 /end CHARACTERISTIC
/begin CHARACTERISTIC speedgoat_test_SN5659__cal_impl.Receivev26_P5 "" VALUE 0x00839270 Scalar_FLOAT64_IEEE 0 speedgoat_test_SN5659_R2021b_IO682_CM_double -1.7E+308 1.7E+308 /end CHARACTERISTIC
/begin CHARACTERISTIC speedgoat_test_SN5659__cal_impl.Receivev27_P1 "" VALUE 0x008398A8 Scalar_FLOAT64_IEEE 0 speedgoat_test_SN5659_R2021b_IO682_CM_double -1.7E+308 1.7E+308 /end CHARACTERISTIC
/begin CHARACTERISTIC speedgoat_test_SN5659__cal_impl.Receivev27_P2 "" VALUE 0x008398C0 Scalar_FLOAT64_IEEE 0 speedgoat_test_SN5659_R2021b_IO682_CM_double -1.7E+308 1.7E+308 /end CHARACTERISTIC
/begin CHARACTERISTIC speedgoat_test_SN5659__cal_impl.Receivev27_P3 "" VALUE 0x008398D8 Scalar_FLOAT64_IEEE 0 speedgoat_test_SN5659_R2021b_IO682_CM_double -1.7E+308 1.7E+308 /end CHARACTERISTIC
/begin CHARACTERISTIC speedgoat_test_SN5659__cal_impl.Receivev27_P4 "" VALUE 0x008398F0 Scalar_FLOAT64_IEEE 0 speedgoat_test_SN5659_R2021b_IO682_CM_double -1.7E+308 1.7E+308 /end CHARACTERISTIC
/begin CHARACTERISTIC speedgoat_test_SN5659__cal_impl.Receivev27_P5 "" VALUE 0x00839908 Scalar_FLOAT64_IEEE 0 speedgoat_test_SN5659_R2021b_IO682_CM_double -1.7E+308 1.7E+308 /end CHARACTERISTIC
/begin CHARACTERISTIC speedgoat_test_SN5659__cal_impl.Receivev28_P1 "" VALUE 0x008342F0 Scalar_FLOAT64_IEEE 0 speedgoat_test_SN5659_R2021b_IO682_CM_double -1.7E+308 1.7E+308 /end CHARACTERISTIC
/begin CHARACTERISTIC speedgoat_test_SN5659__cal_impl.Receivev28_P2 "" VALUE 0x00834308 Scalar_FLOAT64_IEEE 0 speedgoat_test_SN5659_R2021b_IO682_CM_double -1.7E+308 1.7E+308 /end CHARACTERISTIC
/begin CHARACTERISTIC speedgoat_test_SN5659__cal_impl.Receivev28_P3 "" VALUE 0x00834320 Scalar_FLOAT64_IEEE 0 speedgoat_test_SN5659_R2021b_IO682_CM_double -1.7E+308 1.7E+308 /end CHARACTERISTIC
/begin CHARACTERISTIC speedgoat_test_SN5659__cal_impl.Receivev28_P4 "" VALUE 0x00834338 Scalar_FLOAT64_IEEE 0 speedgoat_test_SN5659_R2021b_IO682_CM_double -1.7E+308 1.7E+308 /end CHARACTERISTIC
/begin CHARACTERISTIC speedgoat_test_SN5659__cal_impl.Receivev28_P5 "" VALUE 0x00834350 Scalar_FLOAT64_IEEE 0 speedgoat_test_SN5659_R2021b_IO682_CM_double -1.7E+308 1.7E+308 /end CHARACTERISTIC
/begin CHARACTERISTIC speedgoat_test_SN5659__cal_impl.Receivev29_P1 "" VALUE 0x00834988 Scalar_FLOAT64_IEEE 0 speedgoat_test_SN5659_R2021b_IO682_CM_double -1.7E+308 1.7E+308 /end CHARACTERISTIC
/begin CHARACTERISTIC speedgoat_test_SN5659__cal_impl.Receivev29_P2 "" VALUE 0x008349A0 Scalar_FLOAT64_IEEE 0 speedgoat_test_SN5659_R2021b_IO682_CM_double -1.7E+308 1.7E+308 /end CHARACTERISTIC
/begin CHARACTERISTIC speedgoat_test_SN5659__cal_impl.Receivev29_P3 "" VALUE 0x008349B8 Scalar_FLOAT64_IEEE 0 speedgoat_test_SN5659_R2021b_IO682_CM_double -1.7E+308 1.7E+308 /end CHARACTERISTIC
/begin CHARACTERISTIC speedgoat_test_SN5659__cal_impl.Receivev29_P4 "" VALUE 0x008349D0 Scalar_FLOAT64_IEEE 0 speedgoat_test_SN5659_R2021b_IO682_CM_double -1.7E+308 1.7E+308 /end CHARACTERISTIC
/begin CHARACTERISTIC speedgoat_test_SN5659__cal_impl.Receivev29_P5 "" VALUE 0x008349E8 Scalar_FLOAT64_IEEE 0 speedgoat_test_SN5659_R2021b_IO682_CM_double -1.7E+308 1.7E+308 /end CHARACTERISTIC
/begin CHARACTERISTIC speedgoat_test_SN5659__cal_impl.Receivev2_P1 "" VALUE 0x008335C0 Scalar_FLOAT64_IEEE 0 speedgoat_test_SN5659_R2021b_IO682_CM_double -1.7E+308 1.7E+308 /end CHARACTERISTIC
/begin CHARACTERISTIC speedgoat_test_SN5659__cal_impl.Receivev2_P2 "" VALUE 0x008335D8 Scalar_FLOAT64_IEEE 0 speedgoat_test_SN5659_R2021b_IO682_CM_double -1.7E+308 1.7E+308 /end CHARACTERISTIC
/begin CHARACTERISTIC speedgoat_test_SN5659__cal_impl.Receivev2_P3 "" VALUE 0x008335F0 Scalar_FLOAT64_IEEE 0 speedgoat_test_SN5659_R2021b_IO682_CM_double -1.7E+308 1.7E+308 /end CHARACTERISTIC
/begin CHARACTERISTIC speedgoat_test_SN5659__cal_impl.Receivev2_P4 "" VALUE 0x00833608 Scalar_FLOAT64_IEEE 0 speedgoat_test_SN5659_R2021b_IO682_CM_double -1.7E+308 1.7E+308 /end CHARACTERISTIC
/begin CHARACTERISTIC speedgoat_test_SN5659__cal_impl.Receivev2_P5 "" VALUE 0x00833620 Scalar_FLOAT64_IEEE 0 speedgoat_test_SN5659_R2021b_IO682_CM_double -1.7E+308 1.7E+308 /end CHARACTERISTIC
/begin CHARACTERISTIC speedgoat_test_SN5659__cal_impl.Sendv210_P1 "" VALUE 0x0083B248 Scalar_FLOAT64_IEEE 0 speedgoat_test_SN5659_R2021b_IO682_CM_double -1.7E+308 1.7E+308 /end CHARACTERISTIC
/begin CHARACTERISTIC speedgoat_test_SN5659__cal_impl.Sendv210_P2 "" VALUE 0x0083B260 Scalar_FLOAT64_IEEE 0 speedgoat_test_SN5659_R2021b_IO682_CM_double -1.7E+308 1.7E+308 /end CHARACTERISTIC
/begin CHARACTERISTIC speedgoat_test_SN5659__cal_impl.Sendv210_P3 "" VALUE 0x0083B278 Scalar_FLOAT64_IEEE 0 speedgoat_test_SN5659_R2021b_IO682_CM_double -1.7E+308 1.7E+308 /end CHARACTERISTIC
/begin CHARACTERISTIC speedgoat_test_SN5659__cal_impl.Sendv211_P1 "" VALUE 0x0083B8B8 Scalar_FLOAT64_IEEE 0 speedgoat_test_SN5659_R2021b_IO682_CM_double -1.7E+308 1.7E+308 /end CHARACTERISTIC
/begin CHARACTERISTIC speedgoat_test_SN5659__cal_impl.Sendv211_P2 "" VALUE 0x0083B8D0 Scalar_FLOAT64_IEEE 0 speedgoat_test_SN5659_R2021b_IO682_CM_double -1.7E+308 1.7E+308 /end CHARACTERISTIC
/begin CHARACTERISTIC speedgoat_test_SN5659__cal_impl.Sendv211_P3 "" VALUE 0x0083B8E8 Scalar_FLOAT64_IEEE 0 speedgoat_test_SN5659_R2021b_IO682_CM_double -1.7E+308 1.7E+308 /end CHARACTERISTIC
/begin CHARACTERISTIC speedgoat_test_SN5659__cal_impl.Sendv212_P1 "" VALUE 0x0083BF28 Scalar_FLOAT64_IEEE 0 speedgoat_test_SN5659_R2021b_IO682_CM_double -1.7E+308 1.7E+308 /end CHARACTERISTIC
/begin CHARACTERISTIC speedgoat_test_SN5659__cal_impl.Sendv212_P2 "" VALUE 0x0083BF40 Scalar_FLOAT64_IEEE 0 speedgoat_test_SN5659_R2021b_IO682_CM_double -1.7E+308 1.7E+308 /end CHARACTERISTIC
/begin CHARACTERISTIC speedgoat_test_SN5659__cal_impl.Sendv212_P3 "" VALUE 0x0083BF58 Scalar_FLOAT64_IEEE 0 speedgoat_test_SN5659_R2021b_IO682_CM_double -1.7E+308 1.7E+308 /end CHARACTERISTIC
/begin CHARACTERISTIC speedgoat_test_SN5659__cal_impl.Sendv213_P1 "" VALUE 0x0083C598 Scalar_FLOAT64_IEEE 0 speedgoat_test_SN5659_R2021b_IO682_CM_double -1.7E+308 1.7E+308 /end CHARACTERISTIC
/begin CHARACTERISTIC speedgoat_test_SN5659__cal_impl.Sendv213_P2 "" VALUE 0x0083C5B0 Scalar_FLOAT64_IEEE 0 speedgoat_test_SN5659_R2021b_IO682_CM_double -1.7E+308 1.7E+308 /end CHARACTERISTIC
/begin CHARACTERISTIC speedgoat_test_SN5659__cal_impl.Sendv213_P3 "" VALUE 0x0083C5C8 Scalar_FLOAT64_IEEE 0 speedgoat_test_SN5659_R2021b_IO682_CM_double -1.7E+308 1.7E+308 /end CHARACTERISTIC
/begin CHARACTERISTIC speedgoat_test_SN5659__cal_impl.Sendv214_P1 "" VALUE 0x0083CC08 Scalar_FLOAT64_IEEE 0 speedgoat_test_SN5659_R2021b_IO682_CM_double -1.7E+308 1.7E+308 /end CHARACTERISTIC
/begin CHARACTERISTIC speedgoat_test_SN5659__cal_impl.Sendv214_P2 "" VALUE 0x0083CC20 Scalar_FLOAT64_IEEE 0 speedgoat_test_SN5659_R2021b_IO682_CM_double -1.7E+308 1.7E+308 /end CHARACTERISTIC
/begin CHARACTERISTIC speedgoat_test_SN5659__cal_impl.Sendv214_P3 "" VALUE 0x0083CC38 Scalar_FLOAT64_IEEE 0 speedgoat_test_SN5659_R2021b_IO682_CM_double -1.7E+308 1.7E+308 /end CHARACTERISTIC
/begin CHARACTERISTIC speedgoat_test_SN5659__cal_impl.Sendv215_P1 "" VALUE 0x0083D278 Scalar_FLOAT64_IEEE 0 speedgoat_test_SN5659_R2021b_IO682_CM_double -1.7E+308 1.7E+308 /end CHARACTERISTIC
/begin CHARACTERISTIC speedgoat_test_SN5659__cal_impl.Sendv215_P2 "" VALUE 0x0083D290 Scalar_FLOAT64_IEEE 0 speedgoat_test_SN5659_R2021b_IO682_CM_double -1.7E+308 1.7E+308 /end CHARACTERISTIC
/begin CHARACTERISTIC speedgoat_test_SN5659__cal_impl.Sendv215_P3 "" VALUE 0x0083D2A8 Scalar_FLOAT64_IEEE 0 speedgoat_test_SN5659_R2021b_IO682_CM_double -1.7E+308 1.7E+308 /end CHARACTERISTIC
/begin CHARACTERISTIC speedgoat_test_SN5659__cal_impl.Sendv21_P1 "" VALUE 0x0083D8E8 Scalar_FLOAT64_IEEE 0 speedgoat_test_SN5659_R2021b_IO682_CM_double -1.7E+308 1.7E+308 /end CHARACTERISTIC
/begin CHARACTERISTIC speedgoat_test_SN5659__cal_impl.Sendv21_P2 "" VALUE 0x0083D900 Scalar_FLOAT64_IEEE 0 speedgoat_test_SN5659_R2021b_IO682_CM_double -1.7E+308 1.7E+308 /end CHARACTERISTIC
/begin CHARACTERISTIC speedgoat_test_SN5659__cal_impl.Sendv21_P3 "" VALUE 0x0083D918 Scalar_FLOAT64_IEEE 0 speedgoat_test_SN5659_R2021b_IO682_CM_double -1.7E+308 1.7E+308 /end CHARACTERISTIC
/begin CHARACTERISTIC speedgoat_test_SN5659__cal_impl.Sendv22_P1 "" VALUE 0x0083DF58 Scalar_FLOAT64_IEEE 0 speedgoat_test_SN5659_R2021b_IO682_CM_double -1.7E+308 1.7E+308 /end CHARACTERISTIC
/begin CHARACTERISTIC speedgoat_test_SN5659__cal_impl.Sendv22_P2 "" VALUE 0x0083DF70 Scalar_FLOAT64_IEEE 0 speedgoat_test_SN5659_R2021b_IO682_CM_double -1.7E+308 1.7E+308 /end CHARACTERISTIC
/begin CHARACTERISTIC speedgoat_test_SN5659__cal_impl.Sendv22_P3 "" VALUE 0x0083DF88 Scalar_FLOAT64_IEEE 0 speedgoat_test_SN5659_R2021b_IO682_CM_double -1.7E+308 1.7E+308 /end CHARACTERISTIC
/begin CHARACTERISTIC speedgoat_test_SN5659__cal_impl.Sendv23_P1 "" VALUE 0x0083E5C8 Scalar_FLOAT64_IEEE 0 speedgoat_test_SN5659_R2021b_IO682_CM_double -1.7E+308 1.7E+308 /end CHARACTERISTIC
/begin CHARACTERISTIC speedgoat_test_SN5659__cal_impl.Sendv23_P2 "" VALUE 0x0083E5E0 Scalar_FLOAT64_IEEE 0 speedgoat_test_SN5659_R2021b_IO682_CM_double -1.7E+308 1.7E+308 /end CHARACTERISTIC
/begin CHARACTERISTIC speedgoat_test_SN5659__cal_impl.Sendv23_P3 "" VALUE 0x0083E5F8 Scalar_FLOAT64_IEEE 0 speedgoat_test_SN5659_R2021b_IO682_CM_double -1.7E+308 1.7E+308 /end CHARACTERISTIC
/begin CHARACTERISTIC speedgoat_test_SN5659__cal_impl.Sendv24_P1 "" VALUE 0x0083EC38 Scalar_FLOAT64_IEEE 0 speedgoat_test_SN5659_R2021b_IO682_CM_double -1.7E+308 1.7E+308 /end CHARACTERISTIC
/begin CHARACTERISTIC speedgoat_test_SN5659__cal_impl.Sendv24_P2 "" VALUE 0x0083EC50 Scalar_FLOAT64_IEEE 0 speedgoat_test_SN5659_R2021b_IO682_CM_double -1.7E+308 1.7E+308 /end CHARACTERISTIC
/begin CHARACTERISTIC speedgoat_test_SN5659__cal_impl.Sendv24_P3 "" VALUE 0x0083EC68 Scalar_FLOAT64_IEEE 0 speedgoat_test_SN5659_R2021b_IO682_CM_double -1.7E+308 1.7E+308 /end CHARACTERISTIC
/begin CHARACTERISTIC speedgoat_test_SN5659__cal_impl.Sendv25_P1 "" VALUE 0x0083F2A8 Scalar_FLOAT64_IEEE 0 speedgoat_test_SN5659_R2021b_IO682_CM_double -1.7E+308 1.7E+308 /end CHARACTERISTIC
/begin CHARACTERISTIC speedgoat_test_SN5659__cal_impl.Sendv25_P2 "" VALUE 0x0083F2C0 Scalar_FLOAT64_IEEE 0 speedgoat_test_SN5659_R2021b_IO682_CM_double -1.7E+308 1.7E+308 /end CHARACTERISTIC
/begin CHARACTERISTIC speedgoat_test_SN5659__cal_impl.Sendv25_P3 "" VALUE 0x0083F2D8 Scalar_FLOAT64_IEEE 0 speedgoat_test_SN5659_R2021b_IO682_CM_double -1.7E+308 1.7E+308 /end CHARACTERISTIC
/begin CHARACTERISTIC speedgoat_test_SN5659__cal_impl.Sendv26_P1 "" VALUE 0x0083F918 Scalar_FLOAT64_IEEE 0 speedgoat_test_SN5659_R2021b_IO682_CM_double -1.7E+308 1.7E+308 /end CHARACTERISTIC
/begin CHARACTERISTIC speedgoat_test_SN5659__cal_impl.Sendv26_P2 "" VALUE 0x0083F930 Scalar_FLOAT64_IEEE 0 speedgoat_test_SN5659_R2021b_IO682_CM_double -1.7E+308 1.7E+308 /end CHARACTERISTIC
/begin CHARACTERISTIC speedgoat_test_SN5659__cal_impl.Sendv26_P3 "" VALUE 0x0083F948 Scalar_FLOAT64_IEEE 0 speedgoat_test_SN5659_R2021b_IO682_CM_double -1.7E+308 1.7E+308 /end CHARACTERISTIC
/begin CHARACTERISTIC speedgoat_test_SN5659__cal_impl.Sendv27_P1 "" VALUE 0x0083FF88 Scalar_FLOAT64_IEEE 0 speedgoat_test_SN5659_R2021b_IO682_CM_double -1.7E+308 1.7E+308 /end CHARACTERISTIC
/begin CHARACTERISTIC speedgoat_test_SN5659__cal_impl.Sendv27_P2 "" VALUE 0x0083FFA0 Scalar_FLOAT64_IEEE 0 speedgoat_test_SN5659_R2021b_IO682_CM_double -1.7E+308 1.7E+308 /end CHARACTERISTIC
/begin CHARACTERISTIC speedgoat_test_SN5659__cal_impl.Sendv27_P3 "" VALUE 0x0083FFB8 Scalar_FLOAT64_IEEE 0 speedgoat_test_SN5659_R2021b_IO682_CM_double -1.7E+308 1.7E+308 /end CHARACTERISTIC
/begin CHARACTERISTIC speedgoat_test_SN5659__cal_impl.Sendv28_P1 "" VALUE 0x008405F8 Scalar_FLOAT64_IEEE 0 speedgoat_test_SN5659_R2021b_IO682_CM_double -1.7E+308 1.7E+308 /end CHARACTERISTIC
/begin CHARACTERISTIC speedgoat_test_SN5659__cal_impl.Sendv28_P2 "" VALUE 0x00840610 Scalar_FLOAT64_IEEE 0 speedgoat_test_SN5659_R2021b_IO682_CM_double -1.7E+308 1.7E+308 /end CHARACTERISTIC
/begin CHARACTERISTIC speedgoat_test_SN5659__cal_impl.Sendv28_P3 "" VALUE 0x00840628 Scalar_FLOAT64_IEEE 0 speedgoat_test_SN5659_R2021b_IO682_CM_double -1.7E+308 1.7E+308 /end CHARACTERISTIC
/begin CHARACTERISTIC speedgoat_test_SN5659__cal_impl.Sendv29_P1 "" VALUE 0x0083ABD8 Scalar_FLOAT64_IEEE 0 speedgoat_test_SN5659_R2021b_IO682_CM_double -1.7E+308 1.7E+308 /end CHARACTERISTIC
/begin CHARACTERISTIC speedgoat_test_SN5659__cal_impl.Sendv29_P2 "" VALUE 0x0083ABF0 Scalar_FLOAT64_IEEE 0 speedgoat_test_SN5659_R2021b_IO682_CM_double -1.7E+308 1.7E+308 /end CHARACTERISTIC
/begin CHARACTERISTIC speedgoat_test_SN5659__cal_impl.Sendv29_P3 "" VALUE 0x0083AC08 Scalar_FLOAT64_IEEE 0 speedgoat_test_SN5659_R2021b_IO682_CM_double -1.7E+308 1.7E+308 /end CHARACTERISTIC
/begin CHARACTERISTIC speedgoat_test_SN5659__cal_impl.Sendv2_P1 "" VALUE 0x0083A568 Scalar_FLOAT64_IEEE 0 speedgoat_test_SN5659_R2021b_IO682_CM_double -1.7E+308 1.7E+308 /end CHARACTERISTIC
/begin CHARACTERISTIC speedgoat_test_SN5659__cal_impl.Sendv2_P2 "" VALUE 0x0083A580 Scalar_FLOAT64_IEEE 0 speedgoat_test_SN5659_R2021b_IO682_CM_double -1.7E+308 1.7E+308 /end CHARACTERISTIC
/begin CHARACTERISTIC speedgoat_test_SN5659__cal_impl.Sendv2_P3 "" VALUE 0x0083A598 Scalar_FLOAT64_IEEE 0 speedgoat_test_SN5659_R2021b_IO682_CM_double -1.7E+308 1.7E+308 /end CHARACTERISTIC
/begin CHARACTERISTIC speedgoat_test_SN5659__cal_impl.Setupv2_P1 "" VALUE 0x00833090 Scalar_FLOAT64_IEEE 0 speedgoat_test_SN5659_R2021b_IO682_CM_double -1.7E+308 1.7E+308 /end CHARACTERISTIC
/begin CHARACTERISTIC speedgoat_test_SN5659__cal_impl.Setupv2_P2 "" VALUE 0x008330A8 Scalar_FLOAT64_IEEE 0 speedgoat_test_SN5659_R2021b_IO682_CM_double -1.7E+308 1.7E+308 /end CHARACTERISTIC
/begin CHARACTERISTIC speedgoat_test_SN5659__cal_impl.Setupv2_P3 "" VALUE 0x008330C0 Scalar_FLOAT64_IEEE 0 speedgoat_test_SN5659_R2021b_IO682_CM_double -1.7E+308 1.7E+308 /end CHARACTERISTIC
/begin CHARACTERISTIC speedgoat_test_SN5659__cal_impl.Setupv2_P4 "" VALUE 0x008330D8 Scalar_FLOAT64_IEEE 0 speedgoat_test_SN5659_R2021b_IO682_CM_double -1.7E+308 1.7E+308 /end CHARACTERISTIC
/begin CHARACTERISTIC speedgoat_test_SN5659__cal_impl.Setupv2_P5 "" VALUE 0x008330F0 Scalar_FLOAT64_IEEE 0 speedgoat_test_SN5659_R2021b_IO682_CM_double -1.7E+308 1.7E+308 /end CHARACTERISTIC
/begin CHARACTERISTIC speedgoat_test_SN5659__cal_impl.Setupv2_P6 "" VALUE 0x00833108 Scalar_FLOAT64_IEEE 0 speedgoat_test_SN5659_R2021b_IO682_CM_double -1.7E+308 1.7E+308 /end CHARACTERISTIC
/begin CHARACTERISTIC speedgoat_test_SN5659__cal_impl.Setupv2_P7 "" VAL_BLK 0x00833120 Scalar_FLOAT64_IEEE 0 speedgoat_test_SN5659_R2021b_IO682_CM_double -1.7E+308 1.7E+308 MATRIX_DIM 5 16 /end CHARACTERISTIC
/begin CHARACTERISTIC speedgoat_test_SN5659__cal_impl.Setupv2_P8 "" VAL_BLK 0x008333B0 Scalar_FLOAT64_IEEE 0 speedgoat_test_SN5659_R2021b_IO682_CM_double -1.7E+308 1.7E+308 MATRIX_DIM 4 16 /end CHARACTERISTIC
/begin MEASUREMENT speedgoat_test_SN5659_R2021b_IO682_B.Decode1 "" FLOAT64_IEEE speedgoat_test_SN5659_R2021b_IO682_CM_double 0 0 -1.7E+308 1.7E+308 ECU_ADDRESS 0x008932B8 /end MEASUREMENT
/begin MEASUREMENT speedgoat_test_SN5659_R2021b_IO682_B.Decode1_a "" FLOAT64_IEEE speedgoat_test_SN5659_R2021b_IO682_CM_double 0 0 -1.7E+308 1.7E+308 ECU_ADDRESS 0x00893BF0 /end MEASUREMENT
/begin MEASUREMENT speedgoat_test_SN5659_R2021b_IO682_B.Decode1_al "" FLOAT64_IEEE speedgoat_test_SN5659_R2021b_IO682_CM_double 0 0 -1.7E+308 1.7E+308 ECU_ADDRESS 0x00894350 /end MEASUREMENT
/begin MEASUREMENT speedgoat_test_SN5659_R2021b_IO682_B.Decode1_f "" FLOAT64_IEEE speedgoat_test_SN5659_R2021b_IO682_CM_double 0 0 -1.7E+308 1.7E+308 ECU_ADDRESS 0x00893A18 /end MEASUREMENT
/begin MEASUREMENT speedgoat_test_SN5659_R2021b_IO682_B.Decode1_g "" FLOAT64_IEEE speedgoat_test_SN5659_R2021b_IO682_CM_double 0 0 -1.7E+308 1.7E+308 ECU_ADDRESS 0x00893840 /end MEASUREMENT
/begin MEASUREMENT speedgoat_test_SN5659_R2021b_IO682_B.Decode1_i "" FLOAT64_IEEE speedgoat_test_SN5659_R2021b_IO682_CM_double 0 0 -1.7E+308 1.7E+308 ECU_ADDRESS 0x00893DC8 /end MEASUREMENT
/begin MEASUREMENT speedgoat_test_SN5659_R2021b_IO682_B.Decode1_my "" FLOAT64_IEEE speedgoat_test_SN5659_R2021b_IO682_CM_double 0 0 -1.7E+308 1.7E+308 ECU_ADDRESS 0x00893FA0 /end MEASUREMENT
/begin MEASUREMENT speedgoat_test_SN5659_R2021b_IO682_B.Decode1_n "" FLOAT64_IEEE speedgoat_test_SN5659_R2021b_IO682_CM_double 0 0 -1.7E+308 1.7E+308 ECU_ADDRESS 0x00894178 /end MEASUREMENT
/begin MEASUREMENT speedgoat_test_SN5659_R2021b_IO682_B.Decode2_b "" FLOAT64_IEEE speedgoat_test_SN5659_R2021b_IO682_CM_double 0 0 -1.7E+308 1.7E+308 ECU_ADDRESS 0x00894180 /end MEASUREMENT
/begin MEASUREMENT speedgoat_test_SN5659_R2021b_IO682_B.Decode2_i "" FLOAT64_IEEE speedgoat_test_SN5659_R2021b_IO682_CM_double 0 0 -1.7E+308 1.7E+308 ECU_ADDRESS 0x00893FA8 /end MEASUREMENT
/begin MEASUREMENT speedgoat_test_SN5659_R2021b_IO682_B.Decode2_j "" FLOAT64_IEEE speedgoat_test_SN5659_R2021b_IO682_CM_double 0 0 -1.7E+308 1.7E+308 ECU_ADDRESS 0x00893A20 /end MEASUREMENT
/begin MEASUREMENT speedgoat_test_SN5659_R2021b_IO682_B.Decode2_j2 "" FLOAT64_IEEE speedgoat_test_SN5659_R2021b_IO682_CM_double 0 0 -1.7E+308 1.7E+308 ECU_ADDRESS 0x00893BF8 /end MEASUREMENT
/begin MEASUREMENT speedgoat_test_SN5659_R2021b_IO682_B.Decode2_l "" FLOAT64_IEEE speedgoat_test_SN5659_R2021b_IO682_CM_double 0 0 -1.7E+308 1.7E+308 ECU_ADDRESS 0x00894358 /end MEASUREMENT
/begin MEASUREMENT speedgoat_test_SN5659_R2021b_IO682_B.Decode2_n "" FLOAT64_IEEE speedgoat_test_SN5659_R2021b_IO682_CM_double 0 0 -1.7E+308 1.7E+308 ECU_ADDRESS 0x00893848 /end MEASUREMENT
/begin MEASUREMENT speedgoat_test_SN5659_R2021b_IO682_B.Decode3 "" FLOAT64_IEEE speedgoat_test_SN5659_R2021b_IO682_CM_double 0 0 -1.7E+308 1.7E+308 ECU_ADDRESS 0x008932C8 /end MEASUREMENT
/begin MEASUREMENT speedgoat_test_SN5659_R2021b_IO682_B.Decode3_cq "" FLOAT64_IEEE speedgoat_test_SN5659_R2021b_IO682_CM_double 0 0 -1.7E+308 1.7E+308 ECU_ADDRESS 0x00894188 /end MEASUREMENT
/begin MEASUREMENT speedgoat_test_SN5659_R2021b_IO682_B.Decode3_j "" FLOAT64_IEEE speedgoat_test_SN5659_R2021b_IO682_CM_double 0 0 -1.7E+308 1.7E+308 ECU_ADDRESS 0x00893850 /end MEASUREMENT
/begin MEASUREMENT speedgoat_test_SN5659_R2021b_IO682_B.Decode3_k "" FLOAT64_IEEE speedgoat_test_SN5659_R2021b_IO682_CM_double 0 0 -1.7E+308 1.7E+308 ECU_ADDRESS 0x00893A28 /end MEASUREMENT
/begin MEASUREMENT speedgoat_test_SN5659_R2021b_IO682_B.Decode3_m "" FLOAT64_IEEE speedgoat_test_SN5659_R2021b_IO682_CM_double 0 0 -1.7E+308 1.7E+308 ECU_ADDRESS 0x00893C00 /end MEASUREMENT
/begin MEASUREMENT speedgoat_test_SN5659_R2021b_IO682_B.Decode3_n "" FLOAT64_IEEE speedgoat_test_SN5659_R2021b_IO682_CM_double 0 0 -1.7E+308 1.7E+308 ECU_ADDRESS 0x00893FB0 /end MEASUREMENT
/begin MEASUREMENT speedgoat_test_SN5659_R2021b_IO682_B.Decode3_o "" FLOAT64_IEEE speedgoat_test_SN5659_R2021b_IO682_CM_double 0 0 -1.7E+308 1.7E+308 ECU_ADDRESS 0x00893DD8 /end MEASUREMENT
/begin MEASUREMENT speedgoat_test_SN5659_R2021b_IO682_B.Decode3_ou "" FLOAT64_IEEE speedgoat_test_SN5659_R2021b_IO682_CM_double 0 0 -1.7E+308 1.7E+308 ECU_ADDRESS 0x00894360 /end MEASUREMENT
/begin MEASUREMENT speedgoat_test_SN5659_R2021b_IO682_B.Decode4 "" FLOAT64_IEEE speedgoat_test_SN5659_R2021b_IO682_CM_double 0 0 -1.7E+308 1.7E+308 ECU_ADDRESS 0x008932D0 /end MEASUREMENT
/begin MEASUREMENT speedgoat_test_SN5659_R2021b_IO682_B.Decode4_a "" FLOAT64_IEEE speedgoat_test_SN5659_R2021b_IO682_CM_double 0 0 -1.7E+308 1.7E+308 ECU_ADDRESS 0x00893C08 /end MEASUREMENT
/begin MEASUREMENT speedgoat_test_SN5659_R2021b_IO682_B.Decode4_b "" FLOAT64_IEEE speedgoat_test_SN5659_R2021b_IO682_CM_double 0 0 -1.7E+308 1.7E+308 ECU_ADDRESS 0x00893DE0 /end MEASUREMENT
/begin MEASUREMENT speedgoat_test_SN5659_R2021b_IO682_B.Decode4_c "" FLOAT64_IEEE speedgoat_test_SN5659_R2021b_IO682_CM_double 0 0 -1.7E+308 1.7E+308 ECU_ADDRESS 0x00893A30 /end MEASUREMENT
/begin MEASUREMENT speedgoat_test_SN5659_R2021b_IO682_B.Decode4_c1 "" FLOAT64_IEEE speedgoat_test_SN5659_R2021b_IO682_CM_double 0 0 -1.7E+308 1.7E+308 ECU_ADDRESS 0x00893FB8 /end MEASUREMENT
/begin MEASUREMENT speedgoat_test_SN5659_R2021b_IO682_B.Decode4_h "" FLOAT64_IEEE speedgoat_test_SN5659_R2021b_IO682_CM_double 0 0 -1.7E+308 1.7E+308 ECU_ADDRESS 0x00893858 /end MEASUREMENT
/begin MEASUREMENT speedgoat_test_SN5659_R2021b_IO682_B.Decode4_oi "" FLOAT64_IEEE speedgoat_test_SN5659_R2021b_IO682_CM_double 0 0 -1.7E+308 1.7E+308 ECU_ADDRESS 0x00894190 /end MEASUREMENT
/begin MEASUREMENT speedgoat_test_SN5659_R2021b_IO682_B.Decode4_p "" FLOAT64_IEEE speedgoat_test_SN5659_R2021b_IO682_CM_double 0 0 -1.7E+308 1.7E+308 ECU_ADDRESS 0x00894368 /end MEASUREMENT
/begin MEASUREMENT speedgoat_test_SN5659_R2021b_IO682_B.Decode5 "" FLOAT64_IEEE speedgoat_test_SN5659_R2021b_IO682_CM_double 0 0 -1.7E+308 1.7E+308 ECU_ADDRESS 0x008932C0 /end MEASUREMENT
/begin MEASUREMENT speedgoat_test_SN5659_R2021b_IO682_B.Decode5_i "" FLOAT64_IEEE speedgoat_test_SN5659_R2021b_IO682_CM_double 0 0 -1.7E+308 1.7E+308 ECU_ADDRESS 0x00893DD0 /end MEASUREMENT
/begin MEASUREMENT speedgoat_test_SN5659_R2021b_IO682_B.IO682_SerialIN_CH1 "" FLOAT64_IEEE speedgoat_test_SN5659_R2021b_IO682_CM_double 0 0 -1.7E+308 1.7E+308 LAYOUT COLUMN_DIR MATRIX_DIM 4 ECU_ADDRESS 0x008932D8 /end MEASUREMENT
/begin MEASUREMENT speedgoat_test_SN5659_R2021b_IO682_B.IO682_SerialIN_CH10 "" FLOAT64_IEEE speedgoat_test_SN5659_R2021b_IO682_CM_double 0 0 -1.7E+308 1.7E+308 LAYOUT COLUMN_DIR MATRIX_DIM 4 ECU_ADDRESS 0x00893860 /end MEASUREMENT
/begin MEASUREMENT speedgoat_test_SN5659_R2021b_IO682_B.IO682_SerialIN_CH11 "" FLOAT64_IEEE speedgoat_test_SN5659_R2021b_IO682_CM_double 0 0 -1.7E+308 1.7E+308 LAYOUT COLUMN_DIR MATRIX_DIM 4 ECU_ADDRESS 0x00893A38 /end MEASUREMENT
/begin MEASUREMENT speedgoat_test_SN5659_R2021b_IO682_B.IO682_SerialIN_CH12 "" FLOAT64_IEEE speedgoat_test_SN5659_R2021b_IO682_CM_double 0 0 -1.7E+308 1.7E+308 LAYOUT COLUMN_DIR MATRIX_DIM 4 ECU_ADDRESS 0x00893C10 /end MEASUREMENT
/begin MEASUREMENT speedgoat_test_SN5659_R2021b_IO682_B.IO682_SerialIN_CH13 "" FLOAT64_IEEE speedgoat_test_SN5659_R2021b_IO682_CM_double 0 0 -1.7E+308 1.7E+308 LAYOUT COLUMN_DIR MATRIX_DIM 4 ECU_ADDRESS 0x00893DE8 /end MEASUREMENT
/begin MEASUREMENT speedgoat_test_SN5659_R2021b_IO682_B.IO682_SerialIN_CH14 "" FLOAT64_IEEE speedgoat_test_SN5659_R2021b_IO682_CM_double 0 0 -1.7E+308 1.7E+308 LAYOUT COLUMN_DIR MATRIX_DIM 4 ECU_ADDRESS 0x00893FC0 /end MEASUREMENT
/begin MEASUREMENT speedgoat_test_SN5659_R2021b_IO682_B.IO682_SerialIN_CH15 "" FLOAT64_IEEE speedgoat_test_SN5659_R2021b_IO682_CM_double 0 0 -1.7E+308 1.7E+308 LAYOUT COLUMN_DIR MATRIX_DIM 4 ECU_ADDRESS 0x00894198 /end MEASUREMENT
/begin MEASUREMENT speedgoat_test_SN5659_R2021b_IO682_B.IO682_SerialIN_CH16 "" FLOAT64_IEEE speedgoat_test_SN5659_R2021b_IO682_CM_double 0 0 -1.7E+308 1.7E+308 LAYOUT COLUMN_DIR MATRIX_DIM 4 ECU_ADDRESS 0x00894370 /end MEASUREMENT
/begin MEASUREMENT speedgoat_test_SN5659_R2021b_IO682_B.IO682_SerialIN_CH2 "" FLOAT64_IEEE speedgoat_test_SN5659_R2021b_IO682_CM_double 0 0 -1.7E+308 1.7E+308 LAYOUT COLUMN_DIR MATRIX_DIM 4 ECU_ADDRESS 0x008934B0 /end MEASUREMENT
/begin MEASUREMENT speedgoat_test_SN5659_R2021b_IO682_B.IO682_SerialIN_CH3 "" FLOAT64_IEEE speedgoat_test_SN5659_R2021b_IO682_CM_double 0 0 -1.7E+308 1.7E+308 LAYOUT COLUMN_DIR MATRIX_DIM 4 ECU_ADDRESS 0x00894548 /end MEASUREMENT
/begin MEASUREMENT speedgoat_test_SN5659_R2021b_IO682_B.IO682_SerialIN_CH4 "" FLOAT64_IEEE speedgoat_test_SN5659_R2021b_IO682_CM_double 0 0 -1.7E+308 1.7E+308 LAYOUT COLUMN_DIR MATRIX_DIM 4 ECU_ADDRESS 0x00894720 /end MEASUREMENT
/begin MEASUREMENT speedgoat_test_SN5659_R2021b_IO682_B.IO682_SerialIN_CH5 "" FLOAT64_IEEE speedgoat_test_SN5659_R2021b_IO682_CM_double 0 0 -1.7E+308 1.7E+308 LAYOUT COLUMN_DIR MATRIX_DIM 4 ECU_ADDRESS 0x008948F8 /end MEASUREMENT
/begin MEASUREMENT speedgoat_test_SN5659_R2021b_IO682_B.IO682_SerialIN_CH6 "" FLOAT64_IEEE speedgoat_test_SN5659_R2021b_IO682_CM_double 0 0 -1.7E+308 1.7E+308 LAYOUT COLUMN_DIR MATRIX_DIM 4 ECU_ADDRESS 0x00894AD0 /end MEASUREMENT
/begin MEASUREMENT speedgoat_test_SN5659_R2021b_IO682_B.IO682_SerialIN_CH7 "" FLOAT64_IEEE speedgoat_test_SN5659_R2021b_IO682_CM_double 0 0 -1.7E+308 1.7E+308 LAYOUT COLUMN_DIR MATRIX_DIM 4 ECU_ADDRESS 0x00894CA8 /end MEASUREMENT
/begin MEASUREMENT speedgoat_test_SN5659_R2021b_IO682_B.IO682_SerialIN_CH8 "" FLOAT64_IEEE speedgoat_test_SN5659_R2021b_IO682_CM_double 0 0 -1.7E+308 1.7E+308 LAYOUT COLUMN_DIR MATRIX_DIM 4 ECU_ADDRESS 0x00894E80 /end MEASUREMENT
/begin MEASUREMENT speedgoat_test_SN5659_R2021b_IO682_B.IO682_SerialIN_CH9 "" FLOAT64_IEEE speedgoat_test_SN5659_R2021b_IO682_CM_double 0 0 -1.7E+308 1.7E+308 LAYOUT COLUMN_DIR MATRIX_DIM 4 ECU_ADDRESS 0x00893688 /end MEASUREMENT
/begin MEASUREMENT speedgoat_test_SN5659_R2021b_IO682_B.Receivev2 "" FLOAT64_IEEE speedgoat_test_SN5659_R2021b_IO682_CM_double 0 0 -1.7E+308 1.7E+308 LAYOUT COLUMN_DIR MATRIX_DIM 51 ECU_ADDRESS 0x00893120 /end MEASUREMENT
/begin MEASUREMENT speedgoat_test_SN5659_R2021b_IO682_B.Receivev21 "" FLOAT64_IEEE speedgoat_test_SN5659_R2021b_IO682_CM_double 0 0 -1.7E+308 1.7E+308 LAYOUT COLUMN_DIR MATRIX_DIM 51 ECU_ADDRESS 0x008932F8 /end MEASUREMENT
/begin MEASUREMENT speedgoat_test_SN5659_R2021b_IO682_B.Receivev210 "" FLOAT64_IEEE speedgoat_test_SN5659_R2021b_IO682_CM_double 0 0 -1.7E+308 1.7E+308 LAYOUT COLUMN_DIR MATRIX_DIM 51 ECU_ADDRESS 0x00893880 /end MEASUREMENT
/begin MEASUREMENT speedgoat_test_SN5659_R2021b_IO682_B.Receivev211 "" FLOAT64_IEEE speedgoat_test_SN5659_R2021b_IO682_CM_double 0 0 -1.7E+308 1.7E+308 LAYOUT COLUMN_DIR MATRIX_DIM 51 ECU_ADDRESS 0x00893A58 /end MEASUREMENT
/begin MEASUREMENT speedgoat_test_SN5659_R2021b_IO682_B.Receivev212 "" FLOAT64_IEEE speedgoat_test_SN5659_R2021b_IO682_CM_double 0 0 -1.7E+308 1.7E+308 LAYOUT COLUMN_DIR MATRIX_DIM 51 ECU_ADDRESS 0x00893C30 /end MEASUREMENT
/begin MEASUREMENT speedgoat_test_SN5659_R2021b_IO682_B.Receivev213 "" FLOAT64_IEEE speedgoat_test_SN5659_R2021b_IO682_CM_double 0 0 -1.7E+308 1.7E+308 LAYOUT COLUMN_DIR MATRIX_DIM 51 ECU_ADDRESS 0x00893E08 /end MEASUREMENT
/begin MEASUREMENT speedgoat_test_SN5659_R2021b_IO682_B.Receivev214 "" FLOAT64_IEEE speedgoat_test_SN5659_R2021b_IO682_CM_double 0 0 -1.7E+308 1.7E+308 LAYOUT COLUMN_DIR MATRIX_DIM 51 ECU_ADDRESS 0x00893FE0 /end MEASUREMENT
/begin MEASUREMENT speedgoat_test_SN5659_R2021b_IO682_B.Receivev215 "" FLOAT64_IEEE speedgoat_test_SN5659_R2021b_IO682_CM_double 0 0 -1.7E+308 1.7E+308 LAYOUT COLUMN_DIR MATRIX_DIM 51 ECU_ADDRESS 0x008941B8 /end MEASUREMENT
/begin MEASUREMENT speedgoat_test_SN5659_R2021b_IO682_B.Receivev22 "" FLOAT64_IEEE speedgoat_test_SN5659_R2021b_IO682_CM_double 0 0 -1.7E+308 1.7E+308 LAYOUT COLUMN_DIR MATRIX_DIM 51 ECU_ADDRESS 0x00894390 /end MEASUREMENT
/begin MEASUREMENT speedgoat_test_SN5659_R2021b_IO682_B.Receivev23 "" FLOAT64_IEEE speedgoat_test_SN5659_R2021b_IO682_CM_double 0 0 -1.7E+308 1.7E+308 LAYOUT COLUMN_DIR MATRIX_DIM 51 ECU_ADDRESS 0x00894568 /end MEASUREMENT
/begin MEASUREMENT speedgoat_test_SN5659_R2021b_IO682_B.Receivev24 "" FLOAT64_IEEE speedgoat_test_SN5659_R2021b_IO682_CM_double 0 0 -1.7E+308 1.7E+308 LAYOUT COLUMN_DIR MATRIX_DIM 51 ECU_ADDRESS 0x00894740 /end MEASUREMENT
/begin MEASUREMENT speedgoat_test_SN5659_R2021b_IO682_B.Receivev25 "" FLOAT64_IEEE speedgoat_test_SN5659_R2021b_IO682_CM_double 0 0 -1.7E+308 1.7E+308 LAYOUT COLUMN_DIR MATRIX_DIM 51 ECU_ADDRESS 0x00894918 /end MEASUREMENT
/begin MEASUREMENT speedgoat_test_SN5659_R2021b_IO682_B.Receivev26 "" FLOAT64_IEEE speedgoat_test_SN5659_R2021b_IO682_CM_double 0 0 -1.7E+308 1.7E+308 LAYOUT COLUMN_DIR MATRIX_DIM 51 ECU_ADDRESS 0x00894AF0 /end MEASUREMENT
/begin MEASUREMENT speedgoat_test_SN5659_R2021b_IO682_B.Receivev27 "" FLOAT64_IEEE speedgoat_test_SN5659_R2021b_IO682_CM_double 0 0 -1.7E+308 1.7E+308 LAYOUT COLUMN_DIR MATRIX_DIM 51 ECU_ADDRESS 0x00894CC8 /end MEASUREMENT
/begin MEASUREMENT speedgoat_test_SN5659_R2021b_IO682_B.Receivev28 "" FLOAT64_IEEE speedgoat_test_SN5659_R2021b_IO682_CM_double 0 0 -1.7E+308 1.7E+308 LAYOUT COLUMN_DIR MATRIX_DIM 51 ECU_ADDRESS 0x008934D0 /end MEASUREMENT
/begin MEASUREMENT speedgoat_test_SN5659_R2021b_IO682_B.Receivev29 "" FLOAT64_IEEE speedgoat_test_SN5659_R2021b_IO682_CM_double 0 0 -1.7E+308 1.7E+308 LAYOUT COLUMN_DIR MATRIX_DIM 51 ECU_ADDRESS 0x008936A8 /end MEASUREMENT
/begin COMPU_METHOD speedgoat_test_SN5659_R2021b_IO682_CM_double "" IDENTICAL "%15.10" "" /end COMPU_METHOD
/begin RECORD_LAYOUT Scalar_FLOAT64_IEEE FNC_VALUES 1 FLOAT64_IEEE COLUMN_DIR DIRECT /end RECORD_LAYOUT
/begin GROUP speedgoat_test_SN5659_R2021b_IO682 "speedgoat_test_SN5659_R2021b_IO682" ROOT /begin SUB_GROUP speedgoat_test_SN5659_R2021b_IO682_IO682 /end SUB_GROUP /end GROUP
/begin GROUP speedgoat_test_SN5659_R2021b_IO682_IO682 "speedgoat_test_SN5659_R2021b_IO682/IO682"
 /begin SUB_GROUP speedgoat_test_SN5659_R2021b_IO682_IO682_Decode_Channel_1 speedgoat_test_SN5659_R2021b_IO682_IO682_Decode_Channel_10 speedgoat_test_SN5659_R2021b_IO682_IO682_Decode_Channel_11 speedgoat_test_SN5659_R2021b_IO682_IO682_Decode_Channel_12 speedgoat_test_SN5659_R2021b_IO682_IO682_Decode_Channel_13 speedgoat_test_SN5659_R2021b_IO682_IO682_Decode_Channel_14 speedgoat_test_SN5659_R2021b_IO682_IO682_Decode_Channel_15 speedgoat_test_SN5659_R2021b_IO682_IO682_Decode_Channel_16 speedgoat_test_SN5659_R2021b_IO682_IO682_Decode_Channel_2 speedgoat_test_SN5659_R2021b_IO682_IO682_Decode_Channel_3 speedgoat_test_SN5659_R2021b_IO682_IO682_Decode_Channel_4 speedgoat_test_SN5659_R2021b_IO682_IO682_Decode_Channel_5 speedgoat_test_SN5659_R2021b_IO682_IO682_Decode_Channel_6 speedgoat_test_SN5659_R2021b_IO682_IO682_Decode_Channel_7 speedgoat_test_SN5659_R2021b_IO682_IO682_Decode_Channel_8 speedgoat_test_SN5659_R2021b_IO682_IO682_Decode_Channel_9 speedgoat_test_SN5659_R2021b_IO682_IO682_Encode_Channel_1 speedgoat_test_SN5659_R2021b_IO682_IO682_Encode_Channel_10 speedgoat_test_SN5659_R2021b_IO682_IO682_Encode_Channel_11 speedgoat_test_SN5659_R2021b_IO682_IO682_Encode_Channel_12 speedgoat_test_SN5659_R2021b_IO682_IO682_Encode_Channel_13 speedgoat_test_SN5659_R2021b_IO682_IO682_Encode_Channel_14 speedgoat_test_SN5659_R2021b_IO682_IO682_Encode_Channel_15 speedgoat_test_SN5659_R2021b_IO682_IO682_Encode_Channel_16 speedgoat_test_SN5659_R2021b_IO682_IO682_Encode_Channel_2 speedgoat_test_SN5659_R2021b_IO682_IO682_Encode_Channel_3 speedgoat_test_SN5659_R2021b_IO682_IO682_Encode_Channel_4 speedgoat_test_SN5659_R2021b_IO682_IO682_Encode_Channel_5 speedgoat_test_SN5659_R2021b_IO682_IO682_Encode_Channel_6 speedgoat_test_SN5659_R2021b_IO682_IO682_Encode_Channel_7 speedgoat_test_SN5659_R2021b_IO682_IO682_Encode_Channel_8 speedgoat_test_SN5659_R2021b_IO682_IO682_Encode_Channel_9 /end SUB_GROUP
 /begin REF_CHARACTERISTIC speedgoat_test_SN5659__cal_impl.Receivev210_P1 speedgoat_test_SN5659__cal_impl.Receivev210_P2 speedgoat_test_SN5659__cal_impl.Receivev210_P3 speedgoat_test_SN5659__cal_impl.Receivev210_P4 speedgoat_test_SN5659__cal_impl.Receivev210_P5 speedgoat_test_SN5659__cal_impl.Receivev211_P1 speedgoat_test_SN5659__cal_impl.Receivev211_P2 speedgoat_test_SN5659__cal_impl.Receivev211_P3 speedgoat_test_SN5659__cal_impl.Receivev211_P4 speedgoat_test_SN5659__cal_impl.Receivev211_P5 speedgoat_test_SN5659__cal_impl.Receivev212_P1 speedgoat_test_SN5659__cal_impl.Receivev212_P2 speedgoat_test_SN5659__cal_impl.Receivev212_P3 speedgoat_test_SN5659__cal_impl.Receivev212_P4 speedgoat_test_SN5659__cal_impl.Receivev212_P5 speedgoat_test_SN5659__cal_impl.Receivev213_P1 speedgoat_test_SN5659__cal_impl.Receivev213_P2 speedgoat_test_SN5659__cal_impl.Receivev213_P3 speedgoat_test_SN5659__cal_impl.Receivev213_P4 speedgoat_test_SN5659__cal_impl.Receivev213_P5 speedgoat_test_SN5659__cal_impl.Receivev214_P1 speedgoat_test_SN5659__cal_impl.Receivev214_P2 speedgoat_test_SN5659__cal_impl.Receivev214_P3 speedgoat_test_SN5659__cal_impl.Receivev214_P4 speedgoat_test_SN5659__cal_impl.Receivev214_P5 speedgoat_test_SN5659__cal_impl.Receivev215_P1 speedgoat_test_SN5659__cal_impl.Receivev215_P2 speedgoat_test_SN5659__cal_impl.Receivev215_P3 speedgoat_test_SN5659__cal_impl.Receivev215_P4 speedgoat_test_SN5659__cal_impl.Receivev215_P5 speedgoat_test_SN5659__cal_impl.Receivev21_P1 speedgoat_test_SN5659__cal_impl.Receivev21_P2 speedgoat_test_SN5659__cal_impl.Receivev21_P3 speedgoat_test_SN5659__cal_impl.Receivev21_P4 speedgoat_test_SN5659__cal_impl.Receivev21_P5 speedgoat_test_SN5659__cal_impl.Receivev22_P1 speedgoat_test_SN5659__cal_impl.Receivev22_P2 speedgoat_test_SN5659__cal_impl.Receivev22_P3 speedgoat_test_SN5659__cal_impl.Receivev22_P4 speedgoat_test_SN5659__cal_impl.Receivev22_P5 speedgoat_test_SN5659__cal_impl.Receivev23_P1 speedgoat_test_SN5659__cal_impl.Receivev23_P2 speedgoat_test_SN5659__cal_impl.Receivev23_P3 speedgoat_test_SN5659__cal_impl.Receivev23_P4 speedgoat_test_SN5659__cal_impl.Receivev23_P5 speedgoat_test_SN5659__cal_impl.Receivev24_P1 speedgoat_test_SN5659__cal_impl.Receivev24_P2 speedgoat_test_SN5659__cal_impl.Receivev24_P3 speedgoat_test_SN5659__cal_impl.Receivev24_P4 speedgoat_test_SN5659__cal_impl.Receivev24_P5 speedgoat_test_SN5659__cal_impl.Receivev25_P1 speedgoat_test_SN5659__cal_impl.Receivev25_P2 speedgoat_test_SN5659__cal_impl.Receivev25_P3 speedgoat_test_SN5659__cal_impl.Receivev25_P4 speedgoat_test_SN5659__cal_impl.Receivev25_P5 speedgoat_test_SN5659__cal_impl.Receivev26_P1 speedgoat_test_SN5659__cal_impl.Receivev26_P2 speedgoat_test_SN5659__cal_impl.Receivev26_P3 speedgoat_test_SN5659__cal_impl.Receivev26_P4 speedgoat_test_SN5659__cal_impl.Receivev26_P5 speedgoat_test_SN5659__cal_impl.Receivev27_P1 speedgoat_test_SN5659__cal_impl.Receivev27_P2 speedgoat_test_SN5659__cal_impl.Receivev27_P3 speedgoat_test_SN5659__cal_impl.Receivev27_P4 speedgoat_test_SN5659__cal_impl.Receivev27_P5 speedgoat_test_SN5659__cal_impl.Receivev28_P1 speedgoat_test_SN5659__cal_impl.Receivev28_P2 speedgoat_test_SN5659__cal_impl.Receivev28_P3 speedgoat_test_SN5659__cal_impl.Receivev28_P4 speedgoat_test_SN5659__cal_impl.Receivev28_P5 speedgoat_test_SN5659__cal_impl.Receivev29_P1 speedgoat_test_SN5659__cal_impl.Receivev29_P2 speedgoat_test_SN5659__cal_impl.Receivev29_P3 speedgoat_test_SN5659__cal_impl.Receivev29_P4 speedgoat_test_SN5659__cal_impl.Receivev29_P5 speedgoat_test_SN5659__cal_impl.Receivev2_P1 speedgoat_test_SN5659__cal_impl.Receivev2_P2 speedgoat_test_SN5659__cal_impl.Receivev2_P3 speedgoat_test_SN5659__cal_impl.Receivev2_P4 speedgoat_test_SN5659__cal_impl.Receivev2_P5 speedgoat_test_SN5659__cal_impl.Sendv210_P1 speedgoat_test_SN5659__cal_impl.Sendv210_P2 speedgoat_test_SN5659__cal_impl.Sendv210_P3 speedgoat_test_SN5659__cal_impl.Sendv211_P1 speedgoat_test_SN5659__cal_impl.Sendv211_P2 speedgoat_test_SN5659__cal_impl.Sendv211_P3 speedgoat_test_SN5659__cal_impl.Sendv212_P1 speedgoat_test_SN5659__cal_impl.Sendv212_P2 speedgoat_test_SN5659__cal_impl.Sendv212_P3 speedgoat_test_SN5659__cal_impl.Sendv213_P1 speedgoat_test_SN5659__cal_impl.Sendv213_P2 speedgoat_test_SN5659__cal_impl.Sendv213_P3 speedgoat_test_SN5659__cal_impl.Sendv214_P1 speedgoat_test_SN5659__cal_impl.Sendv214_P2 speedgoat_test_SN5659__cal_impl.Sendv214_P3 speedgoat_test_SN5659__cal_impl.Sendv215_P1 speedgoat_test_SN5659__cal_impl.Sendv215_P2 speedgoat_test_SN5659__cal_impl.Sendv215_P3 speedgoat_test_SN5659__cal_impl.Sendv21_P1 speedgoat_test_SN5659__cal_impl.Sendv21_P2 speedgoat_test_SN5659__cal_impl.Sendv21_P3 speedgoat_test_SN5659__cal_impl.Sendv22_P1 speedgoat_test_SN5659__cal_impl.Sendv22_P2 speedgoat_test_SN5659__cal_impl.Sendv22_P3 speedgoat_test_SN5659__cal_impl.Sendv23_P1 speedgoat_test_SN5659__cal_impl.Sendv23_P2 speedgoat_test_SN5659__cal_impl.Sendv23_P3 speedgoat_test_SN5659__cal_impl.Sendv24_P1 speedgoat_test_SN5659__cal_impl.Sendv24_P2 speedgoat_test_SN5659__cal_impl.Sendv24_P3 speedgoat_test_SN5659__cal_impl.Sendv25_P1 speedgoat_test_SN5659__cal_impl.Sendv25_P2 speedgoat_test_SN5659__cal_impl.Sendv25_P3 speedgoat_test_SN5659__cal_impl.Sendv26_P1 speedgoat_test_SN5659__cal_impl.Sendv26_P2 speedgoat_test_SN5659__cal_impl.Sendv26_P3 speedgoat_test_SN5659__cal_impl.Sendv27_P1 speedgoat_test_SN5659__cal_impl.Sendv27_P2 speedgoat_test_SN5659__cal_impl.Sendv27_P3 speedgoat_test_SN5659__cal_impl.Sendv28_P1 speedgoat_test_SN5659__cal_impl.Sendv28_P2 speedgoat_test_SN5659__cal_impl.Sendv28_P3 speedgoat_test_SN5659__cal_impl.Sendv29_P1 speedgoat_test_SN5659__cal_impl.Sendv29_P2 speedgoat_test_SN5659__cal_impl.Sendv29_P3 speedgoat_test_SN5659__cal_impl.Sendv2_P1 speedgoat_test_SN5659__cal_impl.Sendv2_P2 speedgoat_test_SN5659__cal_impl.Sendv2_P3 speedgoat_test_SN5659__cal_impl.Setupv2_P1 speedgoat_test_SN5659__cal_impl.Setupv2_P2 speedgoat_test_SN5659__cal_impl.Setupv2_P3 speedgoat_test_SN5659__cal_impl.Setupv2_P4 speedgoat_test_SN5659__cal_impl.Setupv2_P5 speedgoat_test_SN5659__cal_impl.Setupv2_P6 speedgoat_test_SN5659__cal_impl.Setupv2_P7 speedgoat_test_SN5659__cal_impl.Setupv2_P8 /end REF_CHARACTERISTIC
 /begin REF_MEASUREMENT speedgoat_test_SN5659_R2021b_IO682_B.IO682_SerialIN_CH1 speedgoat_test_SN5659_R2021b_IO682_B.IO682_SerialIN_CH10 speedgoat_test_SN5659_R2021b_IO682_B.IO682_SerialIN_CH11 speedgoat_test_SN5659_R2021b_IO682_B.IO682_SerialIN_CH12 speedgoat_test_SN5659_R2021b_IO682_B.IO682_SerialIN_CH13 speedgoat_test_SN5659_R2021b_IO682_B.IO682_SerialIN_CH14 speedgoat_test_SN5659_R2021b_IO682_B.IO682_SerialIN_CH15 speedgoat_test_SN5659_R2021b_IO682_B.IO682_SerialIN_CH16 speedgoat_test_SN5659_R2021b_IO682_B.IO682_SerialIN_CH2 speedgoat_test_SN5659_R2021b_IO682_B.IO682_SerialIN_CH3 speedgoat_test_SN5659_R2021b_IO682_B.IO682_SerialIN_CH4 speedgoat_test_SN5659_R2021b_IO682_B.IO682_SerialIN_CH5 speedgoat_test_SN5659_R2021b_IO682_B.IO682_SerialIN_CH6 speedgoat_test_SN5659_R2021b_IO682_B.IO682_SerialIN_CH7 speedgoat_test_SN5659_R2021b_IO682_B.IO682_SerialIN_CH8 speedgoat_test_SN5659_R2021b_IO682_B.IO682_SerialIN_CH9 speedgoat_test_SN5659_R2021b_IO682_B.Receivev2 speedgoat_test_SN5659_R2021b_IO682_B.Receivev21 speedgoat_test_SN5659_R2021b_IO682_B.Receivev210 speedgoat_test_SN5659_R2021b_IO682_B.Receivev211 speedgoat_test_SN5659_R2021b_IO682_B.Receivev212 speedgoat_test_SN5659_R2021b_IO682_B.Receivev213 speedgoat_test_SN5659_R2021b_IO682_B.Receivev214 speedgoat_test_SN5659_R2021b_IO682_B.Receivev215 speedgoat_test_SN5659_R2021b_IO682_B.Receivev22 speedgoat_test_SN5659_R2021b_IO682_B.Receivev23 speedgoat_test_SN5659_R2021b_IO682_B.Receivev24 speedgoat_test_SN5659_R2021b_IO682_B.Receivev25 speedgoat_test_SN5659_R2021b_IO682_B.Receivev26 speedgoat_test_SN5659_R2021b_IO682_B.Receivev27 speedgoat_test_SN5659_R2021b_IO682_B.Receivev28 speedgoat_test_SN5659_R2021b_IO682_B.Receivev29 speedgoat_test_SN5659_R2021b_IO682_DW.Receivev210_PWORK speedgoat_test_SN5659_R2021b_IO682_DW.Receivev211_PWORK speedgoat_test_SN5659_R2021b_IO682_DW.Receivev212_PWORK speedgoat_test_SN5659_R2021b_IO682_DW.Receivev213_PWORK speedgoat_test_SN5659_R2021b_IO682_DW.Receivev214_PWORK speedgoat_test_SN5659_R2021b_IO682_DW.Receivev215_PWORK speedgoat_test_SN5659_R2021b_IO682_DW.Receivev21_PWORK speedgoat_test_SN5659_R2021b_IO682_DW.Receivev22_PWORK speedgoat_test_SN5659_R2021b_IO682_DW.Receivev23_PWORK speedgoat_test_SN5659_R2021b_IO682_DW.Receivev24_PWORK speedgoat_test_SN5659_R2021b_IO682_DW.Receivev25_PWORK speedgoat_test_SN5659_R2021b_IO682_DW.Receivev26_PWORK speedgoat_test_SN5659_R2021b_IO682_DW.Receivev27_PWORK speedgoat_test_SN5659_R2021b_IO682_DW.Receivev28_PWORK speedgoat_test_SN5659_R2021b_IO682_DW.Receivev29_PWORK speedgoat_test_SN5659_R2021b_IO682_DW.Receivev2_PWORK speedgoat_test_SN5659_R2021b_IO682_DW.Scope10_PWORK speedgoat_test_SN5659_R2021b_IO682_DW.Scope11_PWORK speedgoat_test_SN5659_R2021b_IO682_DW.Scope4_PWORK speedgoat_test_SN5659_R2021b_IO682_DW.Scope5_PWORK speedgoat_test_SN5659_R2021b_IO682_DW.Scope6_PWORK speedgoat_test_SN5659_R2021b_IO682_DW.Scope7_PWORK speedgoat_test_SN5659_R2021b_IO682_DW.Scope8_PWORK speedgoat_test_SN5659_R2021b_IO682_DW.Scope9_PWORK speedgoat_test_SN5659_R2021b_IO682_DW.Sendv210_PWORK speedgoat_test_SN5659_R2021b_IO682_DW.Sendv211_PWORK speedgoat_test_SN5659_R2021b_IO682_DW.Sendv212_PWORK speedgoat_test_SN5659_R2021b_IO682_DW.Sendv213_PWORK speedgoat_test_SN5659_R2021b_IO682_DW.Sendv214_PWORK speedgoat_test_SN5659_R2021b_IO682_DW.Sendv215_PWORK speedgoat_test_SN5659_R2021b_IO682_DW.Sendv21_PWORK speedgoat_test_SN5659_R2021b_IO682_DW.Sendv22_PWORK speedgoat_test_SN5659_R2021b_IO682_DW.Sendv23_PWORK speedgoat_test_SN5659_R2021b_IO682_DW.Sendv24_PWORK speedgoat_test_SN5659_R2021b_IO682_DW.Sendv25_PWORK speedgoat_test_SN5659_R2021b_IO682_DW.Sendv26_PWORK speedgoat_test_SN5659_R2021b_IO682_DW.Sendv27_PWORK speedgoat_test_SN5659_R2021b_IO682_DW.Sendv28_PWORK speedgoat_test_SN5659_R2021b_IO682_DW.Sendv29_PWORK speedgoat_test_SN5659_R2021b_IO682_DW.Sendv2_PWORK speedgoat_test_SN5659_R2021b_IO682_DW.Setupv2_PWORK /end REF_MEASUREMENT
/end GROUP
/begin GROUP speedgoat_test_SN5659_R2021b_IO682_IO682_Decode_Channel_1 "speedgoat_test_SN5659_R2021b_IO682/IO682/Decode Channel 1"
 /begin REF_CHARACTERISTIC speedgoat_test_SN5659__cal_impl.Decode1_P1 speedgoat_test_SN5659__cal_impl.Decode1_P10 speedgoat_test_SN5659__cal_impl.Decode1_P11 speedgoat_test_SN5659__cal_impl.Decode1_P12 speedgoat_test_SN5659__cal_impl.Decode1_P13 speedgoat_test_SN5659__cal_impl.Decode1_P14 speedgoat_test_SN5659__cal_impl.Decode1_P15 speedgoat_test_SN5659__cal_impl.Decode1_P16 speedgoat_test_SN5659__cal_impl.Decode1_P2 speedgoat_test_SN5659__cal_impl.Decode1_P3 speedgoat_test_SN5659__cal_impl.Decode1_P4 speedgoat_test_SN5659__cal_impl.Decode1_P5 speedgoat_test_SN5659__cal_impl.Decode1_P6 speedgoat_test_SN5659__cal_impl.Decode1_P7 speedgoat_test_SN5659__cal_impl.Decode1_P8 speedgoat_test_SN5659__cal_impl.Decode1_P9 speedgoat_test_SN5659__cal_impl.Decode3_P1 speedgoat_test_SN5659__cal_impl.Decode3_P10 speedgoat_test_SN5659__cal_impl.Decode3_P11 speedgoat_test_SN5659__cal_impl.Decode3_P12 speedgoat_test_SN5659__cal_impl.Decode3_P13 speedgoat_test_SN5659__cal_impl.Decode3_P14 speedgoat_test_SN5659__cal_impl.Decode3_P15 speedgoat_test_SN5659__cal_impl.Decode3_P16 speedgoat_test_SN5659__cal_impl.Decode3_P2 speedgoat_test_SN5659__cal_impl.Decode3_P3 speedgoat_test_SN5659__cal_impl.Decode3_P4 speedgoat_test_SN5659__cal_impl.Decode3_P5 speedgoat_test_SN5659__cal_impl.Decode3_P6 speedgoat_test_SN5659__cal_impl.Decode3_P7 speedgoat_test_SN5659__cal_impl.Decode3_P8 speedgoat_test_SN5659__cal_impl.Decode3_P9 speedgoat_test_SN5659__cal_impl.Decode4_P1 speedgoat_test_SN5659__cal_impl.Decode4_P10 speedgoat_test_SN5659__cal_impl.Decode4_P11 speedgoat_test_SN5659__cal_impl.Decode4_P12 speedgoat_test_SN5659__cal_impl.Decode4_P13 speedgoat_test_SN5659__cal_impl.Decode4_P14 speedgoat_test_SN5659__cal_impl.Decode4_P15 speedgoat_test_SN5659__cal_impl.Decode4_P16 speedgoat_test_SN5659__cal_impl.Decode4_P2 speedgoat_test_SN5659__cal_impl.Decode4_P3 speedgoat_test_SN5659__cal_impl.Decode4_P4 speedgoat_test_SN5659__cal_impl.Decode4_P5 speedgoat_test_SN5659__cal_impl.Decode4_P6 speedgoat_test_SN5659__cal_impl.Decode4_P7 speedgoat_test_SN5659__cal_impl.Decode4_P8 speedgoat_test_SN5659__cal_impl.Decode4_P9 speedgoat_test_SN5659__cal_impl.Decode5_P1 speedgoat_test_SN5659__cal_impl.Decode5_P10 speedgoat_test_SN5659__cal_impl.Decode5_P11 speedgoat_test_SN5659__cal_impl.Decode5_P12 speedgoat_test_SN5659__cal_impl.Decode5_P13 speedgoat_test_SN5659__cal_impl.Decode5_P14 speedgoat_test_SN5659__cal_impl.Decode5_P15 speedgoat_test_SN5659__cal_impl.Decode5_P16 speedgoat_test_SN5659__cal_impl.Decode5_P2 speedgoat_test_SN5659__cal_impl.Decode5_P3 speedgoat_test_SN5659__cal_impl.Decode5_P4 speedgoat_test_SN5659__cal_impl.Decode5_P5 speedgoat_test_SN5659__cal_impl.Decode5_P6 speedgoat_test_SN5659__cal_impl.Decode5_P7 speedgoat_test_SN5659__cal_impl.Decode5_P8 speedgoat_test_SN5659__cal_impl.Decode5_P9 /end REF_CHARACTERISTIC
 /begin REF_MEASUREMENT speedgoat_test_SN5659_R2021b_IO682_B.Decode1 speedgoat_test_SN5659_R2021b_IO682_B.Decode3 speedgoat_test_SN5659_R2021b_IO682_B.Decode4 speedgoat_test_SN5659_R2021b_IO682_B.Decode5 speedgoat_test_SN5659_R2021b_IO682_B.Receivev2 /end REF_MEASUREMENT
/end GROUP
/begin GROUP speedgoat_test_SN5659_R2021b_IO682_IO682_Decode_Channel_10 "speedgoat_test_SN5659_R2021b_IO682/IO682/Decode Channel 10"
 /begin REF_CHARACTERISTIC speedgoat_test_SN5659__cal_impl.Decode1_P10_h speedgoat_test_SN5659__cal_impl.Decode1_P11_p speedgoat_test_SN5659__cal_impl.Decode1_P12_h speedgoat_test_SN5659__cal_impl.Decode1_P13_l speedgoat_test_SN5659__cal_impl.Decode1_P14_g speedgoat_test_SN5659__cal_impl.Decode1_P15_g speedgoat_test_SN5659__cal_impl.Decode1_P16_e speedgoat_test_SN5659__cal_impl.Decode1_P1_n speedgoat_test_SN5659__cal_impl.Decode1_P2_o speedgoat_test_SN5659__cal_impl.Decode1_P3_o speedgoat_test_SN5659__cal_impl.Decode1_P4_l speedgoat_test_SN5659__cal_impl.Decode1_P5_k speedgoat_test_SN5659__cal_impl.Decode1_P6_d speedgoat_test_SN5659__cal_impl.Decode1_P7_a speedgoat_test_SN5659__cal_impl.Decode1_P8_g speedgoat_test_SN5659__cal_impl.Decode1_P9_o speedgoat_test_SN5659__cal_impl.Decode2_P10_h speedgoat_test_SN5659__cal_impl.Decode2_P11_j speedgoat_test_SN5659__cal_impl.Decode2_P12_g speedgoat_test_SN5659__cal_impl.Decode2_P13_i speedgoat_test_SN5659__cal_impl.Decode2_P14_e speedgoat_test_SN5659__cal_impl.Decode2_P15_a speedgoat_test_SN5659__cal_impl.Decode2_P16_c speedgoat_test_SN5659__cal_impl.Decode2_P1_d speedgoat_test_SN5659__cal_impl.Decode2_P2_m speedgoat_test_SN5659__cal_impl.Decode2_P3_a speedgoat_test_SN5659__cal_impl.Decode2_P4_g speedgoat_test_SN5659__cal_impl.Decode2_P5_g speedgoat_test_SN5659__cal_impl.Decode2_P6_l speedgoat_test_SN5659__cal_impl.Decode2_P7_g speedgoat_test_SN5659__cal_impl.Decode2_P8_l speedgoat_test_SN5659__cal_impl.Decode2_P9_l speedgoat_test_SN5659__cal_impl.Decode3_P10_l speedgoat_test_SN5659__cal_impl.Decode3_P11_i speedgoat_test_SN5659__cal_impl.Decode3_P12_a speedgoat_test_SN5659__cal_impl.Decode3_P13_b speedgoat_test_SN5659__cal_impl.Decode3_P14_px speedgoat_test_SN5659__cal_impl.Decode3_P15_j speedgoat_test_SN5659__cal_impl.Decode3_P16_b1 speedgoat_test_SN5659__cal_impl.Decode3_P1_a1 speedgoat_test_SN5659__cal_impl.Decode3_P2_p speedgoat_test_SN5659__cal_impl.Decode3_P3_h speedgoat_test_SN5659__cal_impl.Decode3_P4_d speedgoat_test_SN5659__cal_impl.Decode3_P5_m speedgoat_test_SN5659__cal_impl.Decode3_P6_o speedgoat_test_SN5659__cal_impl.Decode3_P7_kc speedgoat_test_SN5659__cal_impl.Decode3_P8_m speedgoat_test_SN5659__cal_impl.Decode3_P9_o speedgoat_test_SN5659__cal_impl.Decode4_P10_g speedgoat_test_SN5659__cal_impl.Decode4_P11_h speedgoat_test_SN5659__cal_impl.Decode4_P12_f speedgoat_test_SN5659__cal_impl.Decode4_P13_g speedgoat_test_SN5659__cal_impl.Decode4_P14_f speedgoat_test_SN5659__cal_impl.Decode4_P15_a speedgoat_test_SN5659__cal_impl.Decode4_P16_p speedgoat_test_SN5659__cal_impl.Decode4_P1_p speedgoat_test_SN5659__cal_impl.Decode4_P2_j speedgoat_test_SN5659__cal_impl.Decode4_P3_p speedgoat_test_SN5659__cal_impl.Decode4_P4_l speedgoat_test_SN5659__cal_impl.Decode4_P5_c speedgoat_test_SN5659__cal_impl.Decode4_P6_c speedgoat_test_SN5659__cal_impl.Decode4_P7_nt speedgoat_test_SN5659__cal_impl.Decode4_P8_j speedgoat_test_SN5659__cal_impl.Decode4_P9_b /end REF_CHARACTERISTIC
 /begin REF_MEASUREMENT speedgoat_test_SN5659_R2021b_IO682_B.Decode1_g speedgoat_test_SN5659_R2021b_IO682_B.Decode2_n speedgoat_test_SN5659_R2021b_IO682_B.Decode3_j speedgoat_test_SN5659_R2021b_IO682_B.Decode4_h speedgoat_test_SN5659_R2021b_IO682_B.Receivev29 /end REF_MEASUREMENT
/end GROUP
/begin GROUP speedgoat_test_SN5659_R2021b_IO682_IO682_Decode_Channel_11 "speedgoat_test_SN5659_R2021b_IO682/IO682/Decode Channel 11"
 /begin REF_CHARACTERISTIC speedgoat_test_SN5659__cal_impl.Decode1_P10_lm speedgoat_test_SN5659__cal_impl.Decode1_P11_f speedgoat_test_SN5659__cal_impl.Decode1_P12_pv speedgoat_test_SN5659__cal_impl.Decode1_P13_fg speedgoat_test_SN5659__cal_impl.Decode1_P14_gk speedgoat_test_SN5659__cal_impl.Decode1_P15_a speedgoat_test_SN5659__cal_impl.Decode1_P16_n speedgoat_test_SN5659__cal_impl.Decode1_P1_ng speedgoat_test_SN5659__cal_impl.Decode1_P2_k speedgoat_test_SN5659__cal_impl.Decode1_P3_f speedgoat_test_SN5659__cal_impl.Decode1_P4_c speedgoat_test_SN5659__cal_impl.Decode1_P5_fb speedgoat_test_SN5659__cal_impl.Decode1_P6_b speedgoat_test_SN5659__cal_impl.Decode1_P7_m speedgoat_test_SN5659__cal_impl.Decode1_P8_e speedgoat_test_SN5659__cal_impl.Decode1_P9_b speedgoat_test_SN5659__cal_impl.Decode2_P10_c speedgoat_test_SN5659__cal_impl.Decode2_P11_f speedgoat_test_SN5659__cal_impl.Decode2_P12_f speedgoat_test_SN5659__cal_impl.Decode2_P13_k speedgoat_test_SN5659__cal_impl.Decode2_P14_m speedgoat_test_SN5659__cal_impl.Decode2_P15_c speedgoat_test_SN5659__cal_impl.Decode2_P16_m speedgoat_test_SN5659__cal_impl.Decode2_P1_g speedgoat_test_SN5659__cal_impl.Decode2_P2_e speedgoat_test_SN5659__cal_impl.Decode2_P3_e speedgoat_test_SN5659__cal_impl.Decode2_P4_l speedgoat_test_SN5659__cal_impl.Decode2_P5_f speedgoat_test_SN5659__cal_impl.Decode2_P6_o speedgoat_test_SN5659__cal_impl.Decode2_P7_m speedgoat_test_SN5659__cal_impl.Decode2_P8_f speedgoat_test_SN5659__cal_impl.Decode2_P9_p speedgoat_test_SN5659__cal_impl.Decode3_P10_f speedgoat_test_SN5659__cal_impl.Decode3_P11_h speedgoat_test_SN5659__cal_impl.Decode3_P12_k speedgoat_test_SN5659__cal_impl.Decode3_P13_m speedgoat_test_SN5659__cal_impl.Decode3_P14_l speedgoat_test_SN5659__cal_impl.Decode3_P15_l speedgoat_test_SN5659__cal_impl.Decode3_P16_h speedgoat_test_SN5659__cal_impl.Decode3_P1_k speedgoat_test_SN5659__cal_impl.Decode3_P2_o speedgoat_test_SN5659__cal_impl.Decode3_P3_c speedgoat_test_SN5659__cal_impl.Decode3_P4_i speedgoat_test_SN5659__cal_impl.Decode3_P5_a speedgoat_test_SN5659__cal_impl.Decode3_P6_i speedgoat_test_SN5659__cal_impl.Decode3_P7_c speedgoat_test_SN5659__cal_impl.Decode3_P8_g0 speedgoat_test_SN5659__cal_impl.Decode3_P9_d speedgoat_test_SN5659__cal_impl.Decode4_P10_m speedgoat_test_SN5659__cal_impl.Decode4_P11_d speedgoat_test_SN5659__cal_impl.Decode4_P12_k speedgoat_test_SN5659__cal_impl.Decode4_P13_f speedgoat_test_SN5659__cal_impl.Decode4_P14_d speedgoat_test_SN5659__cal_impl.Decode4_P15_f speedgoat_test_SN5659__cal_impl.Decode4_P16_e speedgoat_test_SN5659__cal_impl.Decode4_P1_c speedgoat_test_SN5659__cal_impl.Decode4_P2_l speedgoat_test_SN5659__cal_impl.Decode4_P3_e speedgoat_test_SN5659__cal_impl.Decode4_P4_i speedgoat_test_SN5659__cal_impl.Decode4_P5_e speedgoat_test_SN5659__cal_impl.Decode4_P6_p speedgoat_test_SN5659__cal_impl.Decode4_P7_o speedgoat_test_SN5659__cal_impl.Decode4_P8_e speedgoat_test_SN5659__cal_impl.Decode4_P9_ay /end REF_CHARACTERISTIC
 /begin REF_MEASUREMENT speedgoat_test_SN5659_R2021b_IO682_B.Decode1_f speedgoat_test_SN5659_R2021b_IO682_B.Decode2_j speedgoat_test_SN5659_R2021b_IO682_B.Decode3_k speedgoat_test_SN5659_R2021b_IO682_B.Decode4_c speedgoat_test_SN5659_R2021b_IO682_B.Receivev210 /end REF_MEASUREMENT
/end GROUP
/begin GROUP speedgoat_test_SN5659_R2021b_IO682_IO682_Decode_Channel_12 "speedgoat_test_SN5659_R2021b_IO682/IO682/Decode Channel 12"
 /begin REF_CHARACTERISTIC speedgoat_test_SN5659__cal_impl.Decode1_P10_k1 speedgoat_test_SN5659__cal_impl.Decode1_P11_i speedgoat_test_SN5659__cal_impl.Decode1_P12_j speedgoat_test_SN5659__cal_impl.Decode1_P13_aa speedgoat_test_SN5659__cal_impl.Decode1_P14_d speedgoat_test_SN5659__cal_impl.Decode1_P15_h speedgoat_test_SN5659__cal_impl.Decode1_P16_m speedgoat_test_SN5659__cal_impl.Decode1_P1_e speedgoat_test_SN5659__cal_impl.Decode1_P2_ov speedgoat_test_SN5659__cal_impl.Decode1_P3_p speedgoat_test_SN5659__cal_impl.Decode1_P4_ls speedgoat_test_SN5659__cal_impl.Decode1_P5_m speedgoat_test_SN5659__cal_impl.Decode1_P6_n speedgoat_test_SN5659__cal_impl.Decode1_P7_d speedgoat_test_SN5659__cal_impl.Decode1_P8_p speedgoat_test_SN5659__cal_impl.Decode1_P9_g speedgoat_test_SN5659__cal_impl.Decode2_P10_j speedgoat_test_SN5659__cal_impl.Decode2_P11_m speedgoat_test_SN5659__cal_impl.Decode2_P12_k speedgoat_test_SN5659__cal_impl.Decode2_P13_j speedgoat_test_SN5659__cal_impl.Decode2_P14_o speedgoat_test_SN5659__cal_impl.Decode2_P15_g speedgoat_test_SN5659__cal_impl.Decode2_P16_cj speedgoat_test_SN5659__cal_impl.Decode2_P1_e speedgoat_test_SN5659__cal_impl.Decode2_P2_j speedgoat_test_SN5659__cal_impl.Decode2_P3_k speedgoat_test_SN5659__cal_impl.Decode2_P4_c speedgoat_test_SN5659__cal_impl.Decode2_P5_c speedgoat_test_SN5659__cal_impl.Decode2_P6_p speedgoat_test_SN5659__cal_impl.Decode2_P7_o speedgoat_test_SN5659__cal_impl.Decode2_P8_b speedgoat_test_SN5659__cal_impl.Decode2_P9_g speedgoat_test_SN5659__cal_impl.Decode3_P10_o speedgoat_test_SN5659__cal_impl.Decode3_P11_k speedgoat_test_SN5659__cal_impl.Decode3_P12_ku speedgoat_test_SN5659__cal_impl.Decode3_P13_e speedgoat_test_SN5659__cal_impl.Decode3_P14_jy speedgoat_test_SN5659__cal_impl.Decode3_P15_l0 speedgoat_test_SN5659__cal_impl.Decode3_P16_hp speedgoat_test_SN5659__cal_impl.Decode3_P1_cm speedgoat_test_SN5659__cal_impl.Decode3_P2_h speedgoat_test_SN5659__cal_impl.Decode3_P3_b speedgoat_test_SN5659__cal_impl.Decode3_P4_o speedgoat_test_SN5659__cal_impl.Decode3_P5_ae speedgoat_test_SN5659__cal_impl.Decode3_P6_d speedgoat_test_SN5659__cal_impl.Decode3_P7_e speedgoat_test_SN5659__cal_impl.Decode3_P8_i speedgoat_test_SN5659__cal_impl.Decode3_P9_o2 speedgoat_test_SN5659__cal_impl.Decode4_P10_f speedgoat_test_SN5659__cal_impl.Decode4_P11_p speedgoat_test_SN5659__cal_impl.Decode4_P12_g speedgoat_test_SN5659__cal_impl.Decode4_P13_a speedgoat_test_SN5659__cal_impl.Decode4_P14_n speedgoat_test_SN5659__cal_impl.Decode4_P15_d speedgoat_test_SN5659__cal_impl.Decode4_P16_d speedgoat_test_SN5659__cal_impl.Decode4_P1_k speedgoat_test_SN5659__cal_impl.Decode4_P2_p0 speedgoat_test_SN5659__cal_impl.Decode4_P3_cw speedgoat_test_SN5659__cal_impl.Decode4_P4_p speedgoat_test_SN5659__cal_impl.Decode4_P5_a speedgoat_test_SN5659__cal_impl.Decode4_P6_a speedgoat_test_SN5659__cal_impl.Decode4_P7_g speedgoat_test_SN5659__cal_impl.Decode4_P8_i speedgoat_test_SN5659__cal_impl.Decode4_P9_d /end REF_CHARACTERISTIC
 /begin REF_MEASUREMENT speedgoat_test_SN5659_R2021b_IO682_B.Decode1_a speedgoat_test_SN5659_R2021b_IO682_B.Decode2_j2 speedgoat_test_SN5659_R2021b_IO682_B.Decode3_m speedgoat_test_SN5659_R2021b_IO682_B.Decode4_a speedgoat_test_SN5659_R2021b_IO682_B.Receivev211 /end REF_MEASUREMENT
/end GROUP
/begin GROUP speedgoat_test_SN5659_R2021b_IO682_IO682_Decode_Channel_13 "speedgoat_test_SN5659_R2021b_IO682/IO682/Decode Channel 13"
 /begin REF_CHARACTERISTIC speedgoat_test_SN5659__cal_impl.Decode1_P10_lb speedgoat_test_SN5659__cal_impl.Decode1_P11_m speedgoat_test_SN5659__cal_impl.Decode1_P12_b speedgoat_test_SN5659__cal_impl.Decode1_P13_lz speedgoat_test_SN5659__cal_impl.Decode1_P14_k speedgoat_test_SN5659__cal_impl.Decode1_P15_h1 speedgoat_test_SN5659__cal_impl.Decode1_P16_f speedgoat_test_SN5659__cal_impl.Decode1_P1_e3 speedgoat_test_SN5659__cal_impl.Decode1_P2_e speedgoat_test_SN5659__cal_impl.Decode1_P3_j speedgoat_test_SN5659__cal_impl.Decode1_P4_i speedgoat_test_SN5659__cal_impl.Decode1_P5_o speedgoat_test_SN5659__cal_impl.Decode1_P6_p speedgoat_test_SN5659__cal_impl.Decode1_P7_dn speedgoat_test_SN5659__cal_impl.Decode1_P8_lr speedgoat_test_SN5659__cal_impl.Decode1_P9_i speedgoat_test_SN5659__cal_impl.Decode3_P10_b speedgoat_test_SN5659__cal_impl.Decode3_P11_a speedgoat_test_SN5659__cal_impl.Decode3_P12_pk speedgoat_test_SN5659__cal_impl.Decode3_P13_dz speedgoat_test_SN5659__cal_impl.Decode3_P14_f speedgoat_test_SN5659__cal_impl.Decode3_P15_e speedgoat_test_SN5659__cal_impl.Decode3_P16_e speedgoat_test_SN5659__cal_impl.Decode3_P1_a1u speedgoat_test_SN5659__cal_impl.Decode3_P2_of speedgoat_test_SN5659__cal_impl.Decode3_P3_pi speedgoat_test_SN5659__cal_impl.Decode3_P4_a speedgoat_test_SN5659__cal_impl.Decode3_P5_h speedgoat_test_SN5659__cal_impl.Decode3_P6_ot speedgoat_test_SN5659__cal_impl.Decode3_P7_f speedgoat_test_SN5659__cal_impl.Decode3_P8_e speedgoat_test_SN5659__cal_impl.Decode3_P9_m speedgoat_test_SN5659__cal_impl.Decode4_P10_bm speedgoat_test_SN5659__cal_impl.Decode4_P11_l speedgoat_test_SN5659__cal_impl.Decode4_P12_o speedgoat_test_SN5659__cal_impl.Decode4_P13_c speedgoat_test_SN5659__cal_impl.Decode4_P14_l speedgoat_test_SN5659__cal_impl.Decode4_P15_i speedgoat_test_SN5659__cal_impl.Decode4_P16_c speedgoat_test_SN5659__cal_impl.Decode4_P1_pt speedgoat_test_SN5659__cal_impl.Decode4_P2_c speedgoat_test_SN5659__cal_impl.Decode4_P3_m speedgoat_test_SN5659__cal_impl.Decode4_P4_h speedgoat_test_SN5659__cal_impl.Decode4_P5_cq speedgoat_test_SN5659__cal_impl.Decode4_P6_e speedgoat_test_SN5659__cal_impl.Decode4_P7_d speedgoat_test_SN5659__cal_impl.Decode4_P8_gh speedgoat_test_SN5659__cal_impl.Decode4_P9_n speedgoat_test_SN5659__cal_impl.Decode5_P10_k speedgoat_test_SN5659__cal_impl.Decode5_P11_c speedgoat_test_SN5659__cal_impl.Decode5_P12_e speedgoat_test_SN5659__cal_impl.Decode5_P13_o speedgoat_test_SN5659__cal_impl.Decode5_P14_g speedgoat_test_SN5659__cal_impl.Decode5_P15_o speedgoat_test_SN5659__cal_impl.Decode5_P16_m speedgoat_test_SN5659__cal_impl.Decode5_P1_m speedgoat_test_SN5659__cal_impl.Decode5_P2_f speedgoat_test_SN5659__cal_impl.Decode5_P3_d speedgoat_test_SN5659__cal_impl.Decode5_P4_j speedgoat_test_SN5659__cal_impl.Decode5_P5_n speedgoat_test_SN5659__cal_impl.Decode5_P6_b speedgoat_test_SN5659__cal_impl.Decode5_P7_j speedgoat_test_SN5659__cal_impl.Decode5_P8_d speedgoat_test_SN5659__cal_impl.Decode5_P9_i /end REF_CHARACTERISTIC
 /begin REF_MEASUREMENT speedgoat_test_SN5659_R2021b_IO682_B.Decode1_i speedgoat_test_SN5659_R2021b_IO682_B.Decode3_o speedgoat_test_SN5659_R2021b_IO682_B.Decode4_b speedgoat_test_SN5659_R2021b_IO682_B.Decode5_i speedgoat_test_SN5659_R2021b_IO682_B.Receivev212 /end REF_MEASUREMENT
/end GROUP
/begin GROUP speedgoat_test_SN5659_R2021b_IO682_IO682_Decode_Channel_14 "speedgoat_test_SN5659_R2021b_IO682/IO682/Decode Channel 14"
 /begin REF_CHARACTERISTIC speedgoat_test_SN5659__cal_impl.Decode1_P10_a speedgoat_test_SN5659__cal_impl.Decode1_P11_g speedgoat_test_SN5659__cal_impl.Decode1_P12_d speedgoat_test_SN5659__cal_impl.Decode1_P13_c speedgoat_test_SN5659__cal_impl.Decode1_P14_gc speedgoat_test_SN5659__cal_impl.Decode1_P15_j speedgoat_test_SN5659__cal_impl.Decode1_P16_jd speedgoat_test_SN5659__cal_impl.Decode1_P1_d speedgoat_test_SN5659__cal_impl.Decode1_P2_en speedgoat_test_SN5659__cal_impl.Decode1_P3_c speedgoat_test_SN5659__cal_impl.Decode1_P4_m speedgoat_test_SN5659__cal_impl.Decode1_P5_c speedgoat_test_SN5659__cal_impl.Decode1_P6_i speedgoat_test_SN5659__cal_impl.Decode1_P7_o speedgoat_test_SN5659__cal_impl.Decode1_P8_i speedgoat_test_SN5659__cal_impl.Decode1_P9_l speedgoat_test_SN5659__cal_impl.Decode2_P10_n speedgoat_test_SN5659__cal_impl.Decode2_P11_k speedgoat_test_SN5659__cal_impl.Decode2_P12_i speedgoat_test_SN5659__cal_impl.Decode2_P13_e speedgoat_test_SN5659__cal_impl.Decode2_P14_b speedgoat_test_SN5659__cal_impl.Decode2_P15_n speedgoat_test_SN5659__cal_impl.Decode2_P16_n speedgoat_test_SN5659__cal_impl.Decode2_P1_h speedgoat_test_SN5659__cal_impl.Decode2_P2_h speedgoat_test_SN5659__cal_impl.Decode2_P3_d speedgoat_test_SN5659__cal_impl.Decode2_P4_f speedgoat_test_SN5659__cal_impl.Decode2_P5_gd speedgoat_test_SN5659__cal_impl.Decode2_P6_oa speedgoat_test_SN5659__cal_impl.Decode2_P7_j speedgoat_test_SN5659__cal_impl.Decode2_P8_h speedgoat_test_SN5659__cal_impl.Decode2_P9_pb speedgoat_test_SN5659__cal_impl.Decode3_P10_c speedgoat_test_SN5659__cal_impl.Decode3_P11_d speedgoat_test_SN5659__cal_impl.Decode3_P12_b speedgoat_test_SN5659__cal_impl.Decode3_P13_i speedgoat_test_SN5659__cal_impl.Decode3_P14_k speedgoat_test_SN5659__cal_impl.Decode3_P15_jx speedgoat_test_SN5659__cal_impl.Decode3_P16_f speedgoat_test_SN5659__cal_impl.Decode3_P1_e speedgoat_test_SN5659__cal_impl.Decode3_P2_l2 speedgoat_test_SN5659__cal_impl.Decode3_P3_cq speedgoat_test_SN5659__cal_impl.Decode3_P4_j speedgoat_test_SN5659__cal_impl.Decode3_P5_n speedgoat_test_SN5659__cal_impl.Decode3_P6_e speedgoat_test_SN5659__cal_impl.Decode3_P7_b speedgoat_test_SN5659__cal_impl.Decode3_P8_p speedgoat_test_SN5659__cal_impl.Decode3_P9_hu speedgoat_test_SN5659__cal_impl.Decode4_P10_h speedgoat_test_SN5659__cal_impl.Decode4_P11_n speedgoat_test_SN5659__cal_impl.Decode4_P12_c speedgoat_test_SN5659__cal_impl.Decode4_P13_ct speedgoat_test_SN5659__cal_impl.Decode4_P14_j speedgoat_test_SN5659__cal_impl.Decode4_P15_dw speedgoat_test_SN5659__cal_impl.Decode4_P16_o speedgoat_test_SN5659__cal_impl.Decode4_P1_a speedgoat_test_SN5659__cal_impl.Decode4_P2_m speedgoat_test_SN5659__cal_impl.Decode4_P3_mr speedgoat_test_SN5659__cal_impl.Decode4_P4_f speedgoat_test_SN5659__cal_impl.Decode4_P5_cn speedgoat_test_SN5659__cal_impl.Decode4_P6_aw speedgoat_test_SN5659__cal_impl.Decode4_P7_b speedgoat_test_SN5659__cal_impl.Decode4_P8_m speedgoat_test_SN5659__cal_impl.Decode4_P9_o /end REF_CHARACTERISTIC
 /begin REF_MEASUREMENT speedgoat_test_SN5659_R2021b_IO682_B.Decode1_my speedgoat_test_SN5659_R2021b_IO682_B.Decode2_i speedgoat_test_SN5659_R2021b_IO682_B.Decode3_n speedgoat_test_SN5659_R2021b_IO682_B.Decode4_c1 speedgoat_test_SN5659_R2021b_IO682_B.Receivev213 /end REF_MEASUREMENT
/end GROUP
/begin GROUP speedgoat_test_SN5659_R2021b_IO682_IO682_Decode_Channel_15 "speedgoat_test_SN5659_R2021b_IO682/IO682/Decode Channel 15"
 /begin REF_CHARACTERISTIC speedgoat_test_SN5659__cal_impl.Decode1_P10_lbu speedgoat_test_SN5659__cal_impl.Decode1_P11_fz speedgoat_test_SN5659__cal_impl.Decode1_P12_k speedgoat_test_SN5659__cal_impl.Decode1_P13_d speedgoat_test_SN5659__cal_impl.Decode1_P14_i speedgoat_test_SN5659__cal_impl.Decode1_P15_n speedgoat_test_SN5659__cal_impl.Decode1_P16_js speedgoat_test_SN5659__cal_impl.Decode1_P1_l speedgoat_test_SN5659__cal_impl.Decode1_P2_f speedgoat_test_SN5659__cal_impl.Decode1_P3_j5 speedgoat_test_SN5659__cal_impl.Decode1_P4_cf speedgoat_test_SN5659__cal_impl.Decode1_P5_a speedgoat_test_SN5659__cal_impl.Decode1_P6_fp speedgoat_test_SN5659__cal_impl.Decode1_P7_b speedgoat_test_SN5659__cal_impl.Decode1_P8_pw speedgoat_test_SN5659__cal_impl.Decode1_P9_d speedgoat_test_SN5659__cal_impl.Decode2_P10_b speedgoat_test_SN5659__cal_impl.Decode2_P11_b speedgoat_test_SN5659__cal_impl.Decode2_P12_l speedgoat_test_SN5659__cal_impl.Decode2_P13_f speedgoat_test_SN5659__cal_impl.Decode2_P14_mb speedgoat_test_SN5659__cal_impl.Decode2_P15_j speedgoat_test_SN5659__cal_impl.Decode2_P16_j speedgoat_test_SN5659__cal_impl.Decode2_P1_o speedgoat_test_SN5659__cal_impl.Decode2_P2_ex speedgoat_test_SN5659__cal_impl.Decode2_P3_g speedgoat_test_SN5659__cal_impl.Decode2_P4_j speedgoat_test_SN5659__cal_impl.Decode2_P5_e speedgoat_test_SN5659__cal_impl.Decode2_P6_pp speedgoat_test_SN5659__cal_impl.Decode2_P7_mb speedgoat_test_SN5659__cal_impl.Decode2_P8_c speedgoat_test_SN5659__cal_impl.Decode2_P9_n speedgoat_test_SN5659__cal_impl.Decode3_P10_n speedgoat_test_SN5659__cal_impl.Decode3_P11_k1 speedgoat_test_SN5659__cal_impl.Decode3_P12_l speedgoat_test_SN5659__cal_impl.Decode3_P13_l speedgoat_test_SN5659__cal_impl.Decode3_P14_fx speedgoat_test_SN5659__cal_impl.Decode3_P15_p speedgoat_test_SN5659__cal_impl.Decode3_P16_o speedgoat_test_SN5659__cal_impl.Decode3_P1_b speedgoat_test_SN5659__cal_impl.Decode3_P2_ls speedgoat_test_SN5659__cal_impl.Decode3_P3_l speedgoat_test_SN5659__cal_impl.Decode3_P4_ja speedgoat_test_SN5659__cal_impl.Decode3_P5_f speedgoat_test_SN5659__cal_impl.Decode3_P6_d3 speedgoat_test_SN5659__cal_impl.Decode3_P7_i speedgoat_test_SN5659__cal_impl.Decode3_P8_m3 speedgoat_test_SN5659__cal_impl.Decode3_P9_h1 speedgoat_test_SN5659__cal_impl.Decode4_P10_e speedgoat_test_SN5659__cal_impl.Decode4_P11_gt speedgoat_test_SN5659__cal_impl.Decode4_P12_n speedgoat_test_SN5659__cal_impl.Decode4_P13_i speedgoat_test_SN5659__cal_impl.Decode4_P14_a speedgoat_test_SN5659__cal_impl.Decode4_P15_i0 speedgoat_test_SN5659__cal_impl.Decode4_P16_l speedgoat_test_SN5659__cal_impl.Decode4_P1_kt speedgoat_test_SN5659__cal_impl.Decode4_P2_lo speedgoat_test_SN5659__cal_impl.Decode4_P3_b speedgoat_test_SN5659__cal_impl.Decode4_P4_hz speedgoat_test_SN5659__cal_impl.Decode4_P5_l speedgoat_test_SN5659__cal_impl.Decode4_P6_f speedgoat_test_SN5659__cal_impl.Decode4_P7_fb speedgoat_test_SN5659__cal_impl.Decode4_P8_d speedgoat_test_SN5659__cal_impl.Decode4_P9_l /end REF_CHARACTERISTIC
 /begin REF_MEASUREMENT speedgoat_test_SN5659_R2021b_IO682_B.Decode1_n speedgoat_test_SN5659_R2021b_IO682_B.Decode2_b speedgoat_test_SN5659_R2021b_IO682_B.Decode3_cq speedgoat_test_SN5659_R2021b_IO682_B.Decode4_oi speedgoat_test_SN5659_R2021b_IO682_B.Receivev214 /end REF_MEASUREMENT
/end GROUP
/begin GROUP speedgoat_test_SN5659_R2021b_IO682_IO682_Decode_Channel_16 "speedgoat_test_SN5659_R2021b_IO682/IO682/Decode Channel 16"
 /begin REF_CHARACTERISTIC speedgoat_test_SN5659__cal_impl.Decode1_P10_e speedgoat_test_SN5659__cal_impl.Decode1_P11_a speedgoat_test_SN5659__cal_impl.Decode1_P12_a speedgoat_test_SN5659__cal_impl.Decode1_P13_k speedgoat_test_SN5659__cal_impl.Decode1_P14_o4 speedgoat_test_SN5659__cal_impl.Decode1_P15_be speedgoat_test_SN5659__cal_impl.Decode1_P16_ey speedgoat_test_SN5659__cal_impl.Decode1_P1_i speedgoat_test_SN5659__cal_impl.Decode1_P2_j speedgoat_test_SN5659__cal_impl.Decode1_P3_f2 speedgoat_test_SN5659__cal_impl.Decode1_P4_p speedgoat_test_SN5659__cal_impl.Decode1_P5_nq speedgoat_test_SN5659__cal_impl.Decode1_P6_ba speedgoat_test_SN5659__cal_impl.Decode1_P7_hm speedgoat_test_SN5659__cal_impl.Decode1_P8_gl speedgoat_test_SN5659__cal_impl.Decode1_P9_dd speedgoat_test_SN5659__cal_impl.Decode2_P10_js speedgoat_test_SN5659__cal_impl.Decode2_P11_jv speedgoat_test_SN5659__cal_impl.Decode2_P12_p speedgoat_test_SN5659__cal_impl.Decode2_P13_iy speedgoat_test_SN5659__cal_impl.Decode2_P14_f speedgoat_test_SN5659__cal_impl.Decode2_P15_cj speedgoat_test_SN5659__cal_impl.Decode2_P16_i speedgoat_test_SN5659__cal_impl.Decode2_P1_c speedgoat_test_SN5659__cal_impl.Decode2_P2_k speedgoat_test_SN5659__cal_impl.Decode2_P3_b speedgoat_test_SN5659__cal_impl.Decode2_P4_o speedgoat_test_SN5659__cal_impl.Decode2_P5_j speedgoat_test_SN5659__cal_impl.Decode2_P6_h speedgoat_test_SN5659__cal_impl.Decode2_P7_jq speedgoat_test_SN5659__cal_impl.Decode2_P8_j speedgoat_test_SN5659__cal_impl.Decode2_P9_c speedgoat_test_SN5659__cal_impl.Decode3_P10_m speedgoat_test_SN5659__cal_impl.Decode3_P11_bu speedgoat_test_SN5659__cal_impl.Decode3_P12_f speedgoat_test_SN5659__cal_impl.Decode3_P13_f speedgoat_test_SN5659__cal_impl.Decode3_P14_n speedgoat_test_SN5659__cal_impl.Decode3_P15_b speedgoat_test_SN5659__cal_impl.Decode3_P16_fl speedgoat_test_SN5659__cal_impl.Decode3_P1_kn speedgoat_test_SN5659__cal_impl.Decode3_P2_js speedgoat_test_SN5659__cal_impl.Decode3_P3_jq speedgoat_test_SN5659__cal_impl.Decode3_P4_o3 speedgoat_test_SN5659__cal_impl.Decode3_P5_g speedgoat_test_SN5659__cal_impl.Decode3_P6_ih speedgoat_test_SN5659__cal_impl.Decode3_P7_cp speedgoat_test_SN5659__cal_impl.Decode3_P8_l speedgoat_test_SN5659__cal_impl.Decode3_P9_hv speedgoat_test_SN5659__cal_impl.Decode4_P10_a speedgoat_test_SN5659__cal_impl.Decode4_P11_hn speedgoat_test_SN5659__cal_impl.Decode4_P12_ko speedgoat_test_SN5659__cal_impl.Decode4_P13_h speedgoat_test_SN5659__cal_impl.Decode4_P14_aq speedgoat_test_SN5659__cal_impl.Decode4_P15_ft speedgoat_test_SN5659__cal_impl.Decode4_P16_a speedgoat_test_SN5659__cal_impl.Decode4_P1_n speedgoat_test_SN5659__cal_impl.Decode4_P2_n speedgoat_test_SN5659__cal_impl.Decode4_P3_j speedgoat_test_SN5659__cal_impl.Decode4_P4_hj speedgoat_test_SN5659__cal_impl.Decode4_P5_k speedgoat_test_SN5659__cal_impl.Decode4_P6_aj speedgoat_test_SN5659__cal_impl.Decode4_P7_h speedgoat_test_SN5659__cal_impl.Decode4_P8_iy speedgoat_test_SN5659__cal_impl.Decode4_P9_bz /end REF_CHARACTERISTIC
 /begin REF_MEASUREMENT speedgoat_test_SN5659_R2021b_IO682_B.Decode1_al speedgoat_test_SN5659_R2021b_IO682_B.Decode2_l speedgoat_test_SN5659_R2021b_IO682_B.Decode3_ou speedgoat_test_SN5659_R2021b_IO682_B.Decode4_p speedgoat_test_SN5659_R2021b_IO682_B.Receivev215 /end REF_MEASUREMENT
/end GROUP
/begin GROUP speedgoat_test_SN5659_R2021b_IO682_IO682_Decode_Channel_2 "speedgoat_test_SN5659_R2021b_IO682/IO682/Decode Channel 2" /begin REF_MEASUREMENT speedgoat_test_SN5659_R2021b_IO682_B.Receivev21 /end REF_MEASUREMENT /end GROUP
/begin GROUP speedgoat_test_SN5659_R2021b_IO682_IO682_Decode_Channel_3 "speedgoat_test_SN5659_R2021b_IO682/IO682/Decode Channel 3" /begin REF_MEASUREMENT speedgoat_test_SN5659_R2021b_IO682_B.Receivev22 /end REF_MEASUREMENT /end GROUP
/begin GROUP speedgoat_test_SN5659_R2021b_IO682_IO682_Decode_Channel_4 "speedgoat_test_SN5659_R2021b_IO682/IO682/Decode Channel 4" /begin REF_MEASUREMENT speedgoat_test_SN5659_R2021b_IO682_B.Receivev23 /end REF_MEASUREMENT /end GROUP
/begin GROUP speedgoat_test_SN5659_R2021b_IO682_IO682_Decode_Channel_5 "speedgoat_test_SN5659_R2021b_IO682/IO682/Decode Channel 5" /begin REF_MEASUREMENT speedgoat_test_SN5659_R2021b_IO682_B.Receivev24 /end REF_MEASUREMENT /end GROUP
/begin GROUP speedgoat_test_SN5659_R2021b_IO682_IO682_Decode_Channel_6 "speedgoat_test_SN5659_R2021b_IO682/IO682/Decode Channel 6" /begin REF_MEASUREMENT speedgoat_test_SN5659_R2021b_IO682_B.Receivev25 /end REF_MEASUREMENT /end GROUP
/begin GROUP speedgoat_test_SN5659_R2021b_IO682_IO682_Decode_Channel_7 "speedgoat_test_SN5659_R2021b_IO682/IO682/Decode Channel 7" /begin REF_MEASUREMENT speedgoat_test_SN5659_R2021b_IO682_B.Receivev26 /end REF_MEASUREMENT /end GROUP
/begin GROUP speedgoat_test_SN5659_R2021b_IO682_IO682_Decode_Channel_8 "speedgoat_test_SN5659_R2021b_IO682/IO682/Decode Channel 8" /begin REF_MEASUREMENT speedgoat_test_SN5659_R2021b_IO682_B.Receivev27 /end REF_MEASUREMENT /end GROUP
/begin GROUP speedgoat_test_SN5659_R2021b_IO682_IO682_Decode_Channel_9 "speedgoat_test_SN5659_R2021b_IO682/IO682/Decode Channel 9" /begin REF_MEASUREMENT speedgoat_test_SN5659_R2021b_IO682_B.Receivev28 /end REF_MEASUREMENT /end GROUP
/end MODULE
/end PROJECT
