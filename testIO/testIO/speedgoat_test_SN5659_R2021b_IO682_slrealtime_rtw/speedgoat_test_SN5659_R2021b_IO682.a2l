ASAP2_VERSION 1 71
/begin PROJECT ProjectName "Project Comment Goes Here"
/begin HEADER "Header Comments go here" /end HEADER
/begin MODULE ModuleName "Module Comment Goes Here"
/begin MOD_COMMON "Mod Common Comment Here" BYTE_ORDER MSB_LAST ALIGNMENT_BYTE 1 ALIGNMENT_WORD 2 ALIGNMENT_LONG 4 ALIGNMENT_FLOAT32_IEEE 4 ALIGNMENT_FLOAT64_IEEE 8 ALIGNMENT_INT64 8 /end MOD_COMMON
/begin CHARACTERISTIC speedgoat_test_SN5659__cal_impl.Constant_Value_b2 "" VALUE 0x00840742 Scalar_UWORD 0 speedgoat_test_SN5659_R2021b_IO682_CM_uint16 0 65535 /end CHARACTERISTIC
/begin CHARACTERISTIC speedgoat_test_SN5659__cal_impl.Constant_Value_b5 "" VALUE 0x0083FDF0 Scalar_FLOAT64_IEEE 0 speedgoat_test_SN5659_R2021b_IO682_CM_double -1.7E+308 1.7E+308 /end CHARACTERISTIC
/begin CHARACTERISTIC speedgoat_test_SN5659__cal_impl.Constant_Value_bz "" VALUE 0x0083F780 Scalar_FLOAT64_IEEE 0 speedgoat_test_SN5659_R2021b_IO682_CM_double -1.7E+308 1.7E+308 /end CHARACTERISTIC
/begin CHARACTERISTIC speedgoat_test_SN5659__cal_impl.Constant_Value_ek "" VALUE 0x0083DDC0 Scalar_FLOAT64_IEEE 0 speedgoat_test_SN5659_R2021b_IO682_CM_double -1.7E+308 1.7E+308 /end CHARACTERISTIC
/begin CHARACTERISTIC speedgoat_test_SN5659__cal_impl.Constant_Value_f "" VALUE 0x0083F110 Scalar_FLOAT64_IEEE 0 speedgoat_test_SN5659_R2021b_IO682_CM_double -1.7E+308 1.7E+308 /end CHARACTERISTIC
/begin CHARACTERISTIC speedgoat_test_SN5659__cal_impl.Constant_Value_gg "" VALUE 0x0083E430 Scalar_FLOAT64_IEEE 0 speedgoat_test_SN5659_R2021b_IO682_CM_double -1.7E+308 1.7E+308 /end CHARACTERISTIC
/begin CHARACTERISTIC speedgoat_test_SN5659__cal_impl.Constant_Value_h "" VALUE 0x0083EAA0 Scalar_FLOAT64_IEEE 0 speedgoat_test_SN5659_R2021b_IO682_CM_double -1.7E+308 1.7E+308 /end CHARACTERISTIC
/begin CHARACTERISTIC speedgoat_test_SN5659__cal_impl.Constant_Value_j5 "" VALUE 0x0084071E Scalar_UWORD 0 speedgoat_test_SN5659_R2021b_IO682_CM_uint16 0 65535 /end CHARACTERISTIC
/begin CHARACTERISTIC speedgoat_test_SN5659__cal_impl.Constant_Value_le "" VALUE 0x00840460 Scalar_FLOAT64_IEEE 0 speedgoat_test_SN5659_R2021b_IO682_CM_double -1.7E+308 1.7E+308 /end CHARACTERISTIC
/begin CHARACTERISTIC speedgoat_test_SN5659__cal_impl.Constant_Value_ly "" VALUE 0x00840724 Scalar_UWORD 0 speedgoat_test_SN5659_R2021b_IO682_CM_uint16 0 65535 /end CHARACTERISTIC
/begin CHARACTERISTIC speedgoat_test_SN5659__cal_impl.Constant_Value_ng "" VALUE 0x0084072A Scalar_UWORD 0 speedgoat_test_SN5659_R2021b_IO682_CM_uint16 0 65535 /end CHARACTERISTIC
/begin CHARACTERISTIC speedgoat_test_SN5659__cal_impl.Constant_Value_oy "" VALUE 0x00840730 Scalar_UWORD 0 speedgoat_test_SN5659_R2021b_IO682_CM_uint16 0 65535 /end CHARACTERISTIC
/begin CHARACTERISTIC speedgoat_test_SN5659__cal_impl.Constant_Value_pl "" VALUE 0x00840736 Scalar_UWORD 0 speedgoat_test_SN5659_R2021b_IO682_CM_uint16 0 65535 /end CHARACTERISTIC
/begin CHARACTERISTIC speedgoat_test_SN5659__cal_impl.Constant_Value_pv "" VALUE 0x0084073C Scalar_UWORD 0 speedgoat_test_SN5659_R2021b_IO682_CM_uint16 0 65535 /end CHARACTERISTIC
/begin CHARACTERISTIC speedgoat_test_SN5659__cal_impl.CounterLimited_uplimit_a "" VALUE 0x0083307A Scalar_UWORD 0 speedgoat_test_SN5659_R2021b_IO682_CM_uint16 0 65535 /end CHARACTERISTIC
/begin CHARACTERISTIC speedgoat_test_SN5659__cal_impl.CounterLimited_uplimit_b "" VALUE 0x00833078 Scalar_UWORD 0 speedgoat_test_SN5659_R2021b_IO682_CM_uint16 0 65535 /end CHARACTERISTIC
/begin CHARACTERISTIC speedgoat_test_SN5659__cal_impl.CounterLimited_uplimit_ck "" VALUE 0x00833072 Scalar_UWORD 0 speedgoat_test_SN5659_R2021b_IO682_CM_uint16 0 65535 /end CHARACTERISTIC
/begin CHARACTERISTIC speedgoat_test_SN5659__cal_impl.CounterLimited_uplimit_du "" VALUE 0x00833076 Scalar_UWORD 0 speedgoat_test_SN5659_R2021b_IO682_CM_uint16 0 65535 /end CHARACTERISTIC
/begin CHARACTERISTIC speedgoat_test_SN5659__cal_impl.CounterLimited_uplimit_e "" VALUE 0x0083306E Scalar_UWORD 0 speedgoat_test_SN5659_R2021b_IO682_CM_uint16 0 65535 /end CHARACTERISTIC
/begin CHARACTERISTIC speedgoat_test_SN5659__cal_impl.CounterLimited_uplimit_l "" VALUE 0x00833074 Scalar_UWORD 0 speedgoat_test_SN5659_R2021b_IO682_CM_uint16 0 65535 /end CHARACTERISTIC
/begin CHARACTERISTIC speedgoat_test_SN5659__cal_impl.CounterLimited_uplimit_p "" VALUE 0x00833070 Scalar_UWORD 0 speedgoat_test_SN5659_R2021b_IO682_CM_uint16 0 65535 /end CHARACTERISTIC
/begin CHARACTERISTIC speedgoat_test_SN5659__cal_impl.Encode1_P10_d "" VALUE 0x008400C0 Scalar_FLOAT64_IEEE 0 speedgoat_test_SN5659_R2021b_IO682_CM_double -1.7E+308 1.7E+308 /end CHARACTERISTIC
/begin CHARACTERISTIC speedgoat_test_SN5659__cal_impl.Encode1_P10_g "" VALUE 0x0083E700 Scalar_FLOAT64_IEEE 0 speedgoat_test_SN5659_R2021b_IO682_CM_double -1.7E+308 1.7E+308 /end CHARACTERISTIC
/begin CHARACTERISTIC speedgoat_test_SN5659__cal_impl.Encode1_P10_i0 "" VALUE 0x0083ED70 Scalar_FLOAT64_IEEE 0 speedgoat_test_SN5659_R2021b_IO682_CM_double -1.7E+308 1.7E+308 /end CHARACTERISTIC
/begin CHARACTERISTIC speedgoat_test_SN5659__cal_impl.Encode1_P10_i5 "" VALUE 0x0083F3E0 Scalar_FLOAT64_IEEE 0 speedgoat_test_SN5659_R2021b_IO682_CM_double -1.7E+308 1.7E+308 /end CHARACTERISTIC
/begin CHARACTERISTIC speedgoat_test_SN5659__cal_impl.Encode1_P10_j "" VALUE 0x0083E090 Scalar_FLOAT64_IEEE 0 speedgoat_test_SN5659_R2021b_IO682_CM_double -1.7E+308 1.7E+308 /end CHARACTERISTIC
/begin CHARACTERISTIC speedgoat_test_SN5659__cal_impl.Encode1_P10_l0 "" VALUE 0x0083DA20 Scalar_FLOAT64_IEEE 0 speedgoat_test_SN5659_R2021b_IO682_CM_double -1.7E+308 1.7E+308 /end CHARACTERISTIC
/begin CHARACTERISTIC speedgoat_test_SN5659__cal_impl.Encode1_P10_pr "" VALUE 0x0083FA50 Scalar_FLOAT64_IEEE 0 speedgoat_test_SN5659_R2021b_IO682_CM_double -1.7E+308 1.7E+308 /end CHARACTERISTIC
/begin CHARACTERISTIC speedgoat_test_SN5659__cal_impl.Encode1_P11_am "" VAL_BLK 0x0083F3F8 Scalar_FLOAT64_IEEE 0 speedgoat_test_SN5659_R2021b_IO682_CM_double -1.7E+308 1.7E+308 MATRIX_DIM 2 1 /end CHARACTERISTIC
/begin CHARACTERISTIC speedgoat_test_SN5659__cal_impl.Encode1_P11_c "" VAL_BLK 0x0083ED88 Scalar_FLOAT64_IEEE 0 speedgoat_test_SN5659_R2021b_IO682_CM_double -1.7E+308 1.7E+308 MATRIX_DIM 2 1 /end CHARACTERISTIC
/begin CHARACTERISTIC speedgoat_test_SN5659__cal_impl.Encode1_P11_d "" VAL_BLK 0x0083FA68 Scalar_FLOAT64_IEEE 0 speedgoat_test_SN5659_R2021b_IO682_CM_double -1.7E+308 1.7E+308 MATRIX_DIM 2 1 /end CHARACTERISTIC
/begin CHARACTERISTIC speedgoat_test_SN5659__cal_impl.Encode1_P11_f "" VAL_BLK 0x0083DA38 Scalar_FLOAT64_IEEE 0 speedgoat_test_SN5659_R2021b_IO682_CM_double -1.7E+308 1.7E+308 MATRIX_DIM 2 1 /end CHARACTERISTIC
/begin CHARACTERISTIC speedgoat_test_SN5659__cal_impl.Encode1_P11_fp "" VAL_BLK 0x0083E0A8 Scalar_FLOAT64_IEEE 0 speedgoat_test_SN5659_R2021b_IO682_CM_double -1.7E+308 1.7E+308 MATRIX_DIM 2 1 /end CHARACTERISTIC
/begin CHARACTERISTIC speedgoat_test_SN5659__cal_impl.Encode1_P11_gb "" VAL_BLK 0x0083E718 Scalar_FLOAT64_IEEE 0 speedgoat_test_SN5659_R2021b_IO682_CM_double -1.7E+308 1.7E+308 MATRIX_DIM 2 1 /end CHARACTERISTIC
/begin CHARACTERISTIC speedgoat_test_SN5659__cal_impl.Encode1_P11_i "" VAL_BLK 0x008400D8 Scalar_FLOAT64_IEEE 0 speedgoat_test_SN5659_R2021b_IO682_CM_double -1.7E+308 1.7E+308 MATRIX_DIM 2 1 /end CHARACTERISTIC
/begin CHARACTERISTIC speedgoat_test_SN5659__cal_impl.Encode1_P12_a "" VALUE 0x0083DA58 Scalar_FLOAT64_IEEE 0 speedgoat_test_SN5659_R2021b_IO682_CM_double -1.7E+308 1.7E+308 /end CHARACTERISTIC
/begin CHARACTERISTIC speedgoat_test_SN5659__cal_impl.Encode1_P12_a2 "" VALUE 0x0083FA88 Scalar_FLOAT64_IEEE 0 speedgoat_test_SN5659_R2021b_IO682_CM_double -1.7E+308 1.7E+308 /end CHARACTERISTIC
/begin CHARACTERISTIC speedgoat_test_SN5659__cal_impl.Encode1_P12_as "" VALUE 0x0083EDA8 Scalar_FLOAT64_IEEE 0 speedgoat_test_SN5659_R2021b_IO682_CM_double -1.7E+308 1.7E+308 /end CHARACTERISTIC
/begin CHARACTERISTIC speedgoat_test_SN5659__cal_impl.Encode1_P12_i "" VALUE 0x0083E738 Scalar_FLOAT64_IEEE 0 speedgoat_test_SN5659_R2021b_IO682_CM_double -1.7E+308 1.7E+308 /end CHARACTERISTIC
/begin CHARACTERISTIC speedgoat_test_SN5659__cal_impl.Encode1_P12_jx "" VALUE 0x008400F8 Scalar_FLOAT64_IEEE 0 speedgoat_test_SN5659_R2021b_IO682_CM_double -1.7E+308 1.7E+308 /end CHARACTERISTIC
/begin CHARACTERISTIC speedgoat_test_SN5659__cal_impl.Encode1_P12_kd "" VALUE 0x0083E0C8 Scalar_FLOAT64_IEEE 0 speedgoat_test_SN5659_R2021b_IO682_CM_double -1.7E+308 1.7E+308 /end CHARACTERISTIC
/begin CHARACTERISTIC speedgoat_test_SN5659__cal_impl.Encode1_P12_mt "" VALUE 0x0083F418 Scalar_FLOAT64_IEEE 0 speedgoat_test_SN5659_R2021b_IO682_CM_double -1.7E+308 1.7E+308 /end CHARACTERISTIC
/begin CHARACTERISTIC speedgoat_test_SN5659__cal_impl.Encode1_P13_b "" VALUE 0x0083EDC0 Scalar_FLOAT64_IEEE 0 speedgoat_test_SN5659_R2021b_IO682_CM_double -1.7E+308 1.7E+308 /end CHARACTERISTIC
/begin CHARACTERISTIC speedgoat_test_SN5659__cal_impl.Encode1_P13_g "" VALUE 0x0083FAA0 Scalar_FLOAT64_IEEE 0 speedgoat_test_SN5659_R2021b_IO682_CM_double -1.7E+308 1.7E+308 /end CHARACTERISTIC
/begin CHARACTERISTIC speedgoat_test_SN5659__cal_impl.Encode1_P13_gu "" VALUE 0x00840110 Scalar_FLOAT64_IEEE 0 speedgoat_test_SN5659_R2021b_IO682_CM_double -1.7E+308 1.7E+308 /end CHARACTERISTIC
/begin CHARACTERISTIC speedgoat_test_SN5659__cal_impl.Encode1_P13_h "" VALUE 0x0083E0E0 Scalar_FLOAT64_IEEE 0 speedgoat_test_SN5659_R2021b_IO682_CM_double -1.7E+308 1.7E+308 /end CHARACTERISTIC
/begin CHARACTERISTIC speedgoat_test_SN5659__cal_impl.Encode1_P13_hz "" VALUE 0x0083E750 Scalar_FLOAT64_IEEE 0 speedgoat_test_SN5659_R2021b_IO682_CM_double -1.7E+308 1.7E+308 /end CHARACTERISTIC
/begin CHARACTERISTIC speedgoat_test_SN5659__cal_impl.Encode1_P13_is "" VALUE 0x0083F430 Scalar_FLOAT64_IEEE 0 speedgoat_test_SN5659_R2021b_IO682_CM_double -1.7E+308 1.7E+308 /end CHARACTERISTIC
/begin CHARACTERISTIC speedgoat_test_SN5659__cal_impl.Encode1_P13_n "" VALUE 0x0083DA70 Scalar_FLOAT64_IEEE 0 speedgoat_test_SN5659_R2021b_IO682_CM_double -1.7E+308 1.7E+308 /end CHARACTERISTIC
/begin CHARACTERISTIC speedgoat_test_SN5659__cal_impl.Encode1_P14_av "" VALUE 0x0083FAB8 Scalar_FLOAT64_IEEE 0 speedgoat_test_SN5659_R2021b_IO682_CM_double -1.7E+308 1.7E+308 /end CHARACTERISTIC
/begin CHARACTERISTIC speedgoat_test_SN5659__cal_impl.Encode1_P14_cd "" VALUE 0x0083F448 Scalar_FLOAT64_IEEE 0 speedgoat_test_SN5659_R2021b_IO682_CM_double -1.7E+308 1.7E+308 /end CHARACTERISTIC
/begin CHARACTERISTIC speedgoat_test_SN5659__cal_impl.Encode1_P14_f "" VALUE 0x0083E768 Scalar_FLOAT64_IEEE 0 speedgoat_test_SN5659_R2021b_IO682_CM_double -1.7E+308 1.7E+308 /end CHARACTERISTIC
/begin CHARACTERISTIC speedgoat_test_SN5659__cal_impl.Encode1_P14_fh "" VALUE 0x0083EDD8 Scalar_FLOAT64_IEEE 0 speedgoat_test_SN5659_R2021b_IO682_CM_double -1.7E+308 1.7E+308 /end CHARACTERISTIC
/begin CHARACTERISTIC speedgoat_test_SN5659__cal_impl.Encode1_P14_fz "" VALUE 0x00840128 Scalar_FLOAT64_IEEE 0 speedgoat_test_SN5659_R2021b_IO682_CM_double -1.7E+308 1.7E+308 /end CHARACTERISTIC
/begin CHARACTERISTIC speedgoat_test_SN5659__cal_impl.Encode1_P14_on "" VALUE 0x0083DA88 Scalar_FLOAT64_IEEE 0 speedgoat_test_SN5659_R2021b_IO682_CM_double -1.7E+308 1.7E+308 /end CHARACTERISTIC
/begin CHARACTERISTIC speedgoat_test_SN5659__cal_impl.Encode1_P14_ov "" VALUE 0x0083E0F8 Scalar_FLOAT64_IEEE 0 speedgoat_test_SN5659_R2021b_IO682_CM_double -1.7E+308 1.7E+308 /end CHARACTERISTIC
/begin CHARACTERISTIC speedgoat_test_SN5659__cal_impl.Encode1_P15_c "" VALUE 0x0083FAD0 Scalar_FLOAT64_IEEE 0 speedgoat_test_SN5659_R2021b_IO682_CM_double -1.7E+308 1.7E+308 /end CHARACTERISTIC
/begin CHARACTERISTIC speedgoat_test_SN5659__cal_impl.Encode1_P15_d "" VALUE 0x00840140 Scalar_FLOAT64_IEEE 0 speedgoat_test_SN5659_R2021b_IO682_CM_double -1.7E+308 1.7E+308 /end CHARACTERISTIC
/begin CHARACTERISTIC speedgoat_test_SN5659__cal_impl.Encode1_P15_h1 "" VALUE 0x0083EDF0 Scalar_FLOAT64_IEEE 0 speedgoat_test_SN5659_R2021b_IO682_CM_double -1.7E+308 1.7E+308 /end CHARACTERISTIC
/begin CHARACTERISTIC speedgoat_test_SN5659__cal_impl.Encode1_P15_ka "" VALUE 0x0083E110 Scalar_FLOAT64_IEEE 0 speedgoat_test_SN5659_R2021b_IO682_CM_double -1.7E+308 1.7E+308 /end CHARACTERISTIC
/begin CHARACTERISTIC speedgoat_test_SN5659__cal_impl.Encode1_P15_kak "" VALUE 0x0083F460 Scalar_FLOAT64_IEEE 0 speedgoat_test_SN5659_R2021b_IO682_CM_double -1.7E+308 1.7E+308 /end CHARACTERISTIC
/begin CHARACTERISTIC speedgoat_test_SN5659__cal_impl.Encode1_P15_n "" VALUE 0x0083E780 Scalar_FLOAT64_IEEE 0 speedgoat_test_SN5659_R2021b_IO682_CM_double -1.7E+308 1.7E+308 /end CHARACTERISTIC
/begin CHARACTERISTIC speedgoat_test_SN5659__cal_impl.Encode1_P15_pw "" VALUE 0x0083DAA0 Scalar_FLOAT64_IEEE 0 speedgoat_test_SN5659_R2021b_IO682_CM_double -1.7E+308 1.7E+308 /end CHARACTERISTIC
/begin CHARACTERISTIC speedgoat_test_SN5659__cal_impl.Encode1_P1_cy "" VALUE 0x0083F308 Scalar_FLOAT64_IEEE 0 speedgoat_test_SN5659_R2021b_IO682_CM_double -1.7E+308 1.7E+308 /end CHARACTERISTIC
/begin CHARACTERISTIC speedgoat_test_SN5659__cal_impl.Encode1_P1_d "" VALUE 0x0083F978 Scalar_FLOAT64_IEEE 0 speedgoat_test_SN5659_R2021b_IO682_CM_double -1.7E+308 1.7E+308 /end CHARACTERISTIC
/begin CHARACTERISTIC speedgoat_test_SN5659__cal_impl.Encode1_P1_gb "" VALUE 0x0083EC98 Scalar_FLOAT64_IEEE 0 speedgoat_test_SN5659_R2021b_IO682_CM_double -1.7E+308 1.7E+308 /end CHARACTERISTIC
/begin CHARACTERISTIC speedgoat_test_SN5659__cal_impl.Encode1_P1_k "" VALUE 0x0083DFB8 Scalar_FLOAT64_IEEE 0 speedgoat_test_SN5659_R2021b_IO682_CM_double -1.7E+308 1.7E+308 /end CHARACTERISTIC
/begin CHARACTERISTIC speedgoat_test_SN5659__cal_impl.Encode1_P1_kw "" VALUE 0x0083FFE8 Scalar_FLOAT64_IEEE 0 speedgoat_test_SN5659_R2021b_IO682_CM_double -1.7E+308 1.7E+308 /end CHARACTERISTIC
/begin CHARACTERISTIC speedgoat_test_SN5659__cal_impl.Encode1_P1_m "" VALUE 0x0083D948 Scalar_FLOAT64_IEEE 0 speedgoat_test_SN5659_R2021b_IO682_CM_double -1.7E+308 1.7E+308 /end CHARACTERISTIC
/begin CHARACTERISTIC speedgoat_test_SN5659__cal_impl.Encode1_P1_n "" VALUE 0x0083E628 Scalar_FLOAT64_IEEE 0 speedgoat_test_SN5659_R2021b_IO682_CM_double -1.7E+308 1.7E+308 /end CHARACTERISTIC
/begin CHARACTERISTIC speedgoat_test_SN5659__cal_impl.Encode1_P2_a "" VALUE 0x0083F320 Scalar_FLOAT64_IEEE 0 speedgoat_test_SN5659_R2021b_IO682_CM_double -1.7E+308 1.7E+308 /end CHARACTERISTIC
/begin CHARACTERISTIC speedgoat_test_SN5659__cal_impl.Encode1_P2_c "" VALUE 0x0083DFD0 Scalar_FLOAT64_IEEE 0 speedgoat_test_SN5659_R2021b_IO682_CM_double -1.7E+308 1.7E+308 /end CHARACTERISTIC
/begin CHARACTERISTIC speedgoat_test_SN5659__cal_impl.Encode1_P2_cw "" VALUE 0x0083F990 Scalar_FLOAT64_IEEE 0 speedgoat_test_SN5659_R2021b_IO682_CM_double -1.7E+308 1.7E+308 /end CHARACTERISTIC
/begin CHARACTERISTIC speedgoat_test_SN5659__cal_impl.Encode1_P2_d "" VALUE 0x0083E640 Scalar_FLOAT64_IEEE 0 speedgoat_test_SN5659_R2021b_IO682_CM_double -1.7E+308 1.7E+308 /end CHARACTERISTIC
/begin CHARACTERISTIC speedgoat_test_SN5659__cal_impl.Encode1_P2_es "" VALUE 0x0083ECB0 Scalar_FLOAT64_IEEE 0 speedgoat_test_SN5659_R2021b_IO682_CM_double -1.7E+308 1.7E+308 /end CHARACTERISTIC
/begin CHARACTERISTIC speedgoat_test_SN5659__cal_impl.Encode1_P2_ho "" VALUE 0x00840000 Scalar_FLOAT64_IEEE 0 speedgoat_test_SN5659_R2021b_IO682_CM_double -1.7E+308 1.7E+308 /end CHARACTERISTIC
/begin CHARACTERISTIC speedgoat_test_SN5659__cal_impl.Encode1_P2_i "" VALUE 0x0083D960 Scalar_FLOAT64_IEEE 0 speedgoat_test_SN5659_R2021b_IO682_CM_double -1.7E+308 1.7E+308 /end CHARACTERISTIC
/begin CHARACTERISTIC speedgoat_test_SN5659__cal_impl.Encode1_P3_e "" VALUE 0x0083D978 Scalar_FLOAT64_IEEE 0 speedgoat_test_SN5659_R2021b_IO682_CM_double -1.7E+308 1.7E+308 /end CHARACTERISTIC
/begin CHARACTERISTIC speedgoat_test_SN5659__cal_impl.Encode1_P3_eh "" VALUE 0x0083ECC8 Scalar_FLOAT64_IEEE 0 speedgoat_test_SN5659_R2021b_IO682_CM_double -1.7E+308 1.7E+308 /end CHARACTERISTIC
/begin CHARACTERISTIC speedgoat_test_SN5659__cal_impl.Encode1_P3_em "" VALUE 0x0083F338 Scalar_FLOAT64_IEEE 0 speedgoat_test_SN5659_R2021b_IO682_CM_double -1.7E+308 1.7E+308 /end CHARACTERISTIC
/begin CHARACTERISTIC speedgoat_test_SN5659__cal_impl.Encode1_P3_g "" VALUE 0x0083DFE8 Scalar_FLOAT64_IEEE 0 speedgoat_test_SN5659_R2021b_IO682_CM_double -1.7E+308 1.7E+308 /end CHARACTERISTIC
/begin CHARACTERISTIC speedgoat_test_SN5659__cal_impl.Encode1_P3_hc "" VALUE 0x0083F9A8 Scalar_FLOAT64_IEEE 0 speedgoat_test_SN5659_R2021b_IO682_CM_double -1.7E+308 1.7E+308 /end CHARACTERISTIC
/begin CHARACTERISTIC speedgoat_test_SN5659__cal_impl.Encode1_P3_lm "" VALUE 0x00840018 Scalar_FLOAT64_IEEE 0 speedgoat_test_SN5659_R2021b_IO682_CM_double -1.7E+308 1.7E+308 /end CHARACTERISTIC
/begin CHARACTERISTIC speedgoat_test_SN5659__cal_impl.Encode1_P3_n "" VALUE 0x0083E658 Scalar_FLOAT64_IEEE 0 speedgoat_test_SN5659_R2021b_IO682_CM_double -1.7E+308 1.7E+308 /end CHARACTERISTIC
/begin CHARACTERISTIC speedgoat_test_SN5659__cal_impl.Encode1_P4_b "" VALUE 0x0083E670 Scalar_FLOAT64_IEEE 0 speedgoat_test_SN5659_R2021b_IO682_CM_double -1.7E+308 1.7E+308 /end CHARACTERISTIC
/begin CHARACTERISTIC speedgoat_test_SN5659__cal_impl.Encode1_P4_cs "" VALUE 0x00840030 Scalar_FLOAT64_IEEE 0 speedgoat_test_SN5659_R2021b_IO682_CM_double -1.7E+308 1.7E+308 /end CHARACTERISTIC
/begin CHARACTERISTIC speedgoat_test_SN5659__cal_impl.Encode1_P4_d2 "" VALUE 0x0083D990 Scalar_FLOAT64_IEEE 0 speedgoat_test_SN5659_R2021b_IO682_CM_double -1.7E+308 1.7E+308 /end CHARACTERISTIC
/begin CHARACTERISTIC speedgoat_test_SN5659__cal_impl.Encode1_P4_eq "" VALUE 0x0083E000 Scalar_FLOAT64_IEEE 0 speedgoat_test_SN5659_R2021b_IO682_CM_double -1.7E+308 1.7E+308 /end CHARACTERISTIC
/begin CHARACTERISTIC speedgoat_test_SN5659__cal_impl.Encode1_P4_f "" VALUE 0x0083F9C0 Scalar_FLOAT64_IEEE 0 speedgoat_test_SN5659_R2021b_IO682_CM_double -1.7E+308 1.7E+308 /end CHARACTERISTIC
/begin CHARACTERISTIC speedgoat_test_SN5659__cal_impl.Encode1_P4_h "" VALUE 0x0083ECE0 Scalar_FLOAT64_IEEE 0 speedgoat_test_SN5659_R2021b_IO682_CM_double -1.7E+308 1.7E+308 /end CHARACTERISTIC
/begin CHARACTERISTIC speedgoat_test_SN5659__cal_impl.Encode1_P4_m "" VALUE 0x0083F350 Scalar_FLOAT64_IEEE 0 speedgoat_test_SN5659_R2021b_IO682_CM_double -1.7E+308 1.7E+308 /end CHARACTERISTIC
/begin CHARACTERISTIC speedgoat_test_SN5659__cal_impl.Encode1_P5_d "" VALUE 0x0083ECF8 Scalar_FLOAT64_IEEE 0 speedgoat_test_SN5659_R2021b_IO682_CM_double -1.7E+308 1.7E+308 /end CHARACTERISTIC
/begin CHARACTERISTIC speedgoat_test_SN5659__cal_impl.Encode1_P5_dq "" VALUE 0x0083F368 Scalar_FLOAT64_IEEE 0 speedgoat_test_SN5659_R2021b_IO682_CM_double -1.7E+308 1.7E+308 /end CHARACTERISTIC
/begin CHARACTERISTIC speedgoat_test_SN5659__cal_impl.Encode1_P5_gx "" VALUE 0x0083E688 Scalar_FLOAT64_IEEE 0 speedgoat_test_SN5659_R2021b_IO682_CM_double -1.7E+308 1.7E+308 /end CHARACTERISTIC
/begin CHARACTERISTIC speedgoat_test_SN5659__cal_impl.Encode1_P5_h "" VALUE 0x0083D9A8 Scalar_FLOAT64_IEEE 0 speedgoat_test_SN5659_R2021b_IO682_CM_double -1.7E+308 1.7E+308 /end CHARACTERISTIC
/begin CHARACTERISTIC speedgoat_test_SN5659__cal_impl.Encode1_P5_jf "" VALUE 0x0083E018 Scalar_FLOAT64_IEEE 0 speedgoat_test_SN5659_R2021b_IO682_CM_double -1.7E+308 1.7E+308 /end CHARACTERISTIC
/begin CHARACTERISTIC speedgoat_test_SN5659__cal_impl.Encode1_P5_m "" VALUE 0x00840048 Scalar_FLOAT64_IEEE 0 speedgoat_test_SN5659_R2021b_IO682_CM_double -1.7E+308 1.7E+308 /end CHARACTERISTIC
/begin CHARACTERISTIC speedgoat_test_SN5659__cal_impl.Encode1_P5_p "" VALUE 0x0083F9D8 Scalar_FLOAT64_IEEE 0 speedgoat_test_SN5659_R2021b_IO682_CM_double -1.7E+308 1.7E+308 /end CHARACTERISTIC
/begin CHARACTERISTIC speedgoat_test_SN5659__cal_impl.Encode1_P6_ad "" VALUE 0x0083F380 Scalar_FLOAT64_IEEE 0 speedgoat_test_SN5659_R2021b_IO682_CM_double -1.7E+308 1.7E+308 /end CHARACTERISTIC
/begin CHARACTERISTIC speedgoat_test_SN5659__cal_impl.Encode1_P6_am "" VALUE 0x00840060 Scalar_FLOAT64_IEEE 0 speedgoat_test_SN5659_R2021b_IO682_CM_double -1.7E+308 1.7E+308 /end CHARACTERISTIC
/begin CHARACTERISTIC speedgoat_test_SN5659__cal_impl.Encode1_P6_g "" VALUE 0x0083ED10 Scalar_FLOAT64_IEEE 0 speedgoat_test_SN5659_R2021b_IO682_CM_double -1.7E+308 1.7E+308 /end CHARACTERISTIC
/begin CHARACTERISTIC speedgoat_test_SN5659__cal_impl.Encode1_P6_gn "" VALUE 0x0083F9F0 Scalar_FLOAT64_IEEE 0 speedgoat_test_SN5659_R2021b_IO682_CM_double -1.7E+308 1.7E+308 /end CHARACTERISTIC
/begin CHARACTERISTIC speedgoat_test_SN5659__cal_impl.Encode1_P6_i "" VALUE 0x0083D9C0 Scalar_FLOAT64_IEEE 0 speedgoat_test_SN5659_R2021b_IO682_CM_double -1.7E+308 1.7E+308 /end CHARACTERISTIC
/begin CHARACTERISTIC speedgoat_test_SN5659__cal_impl.Encode1_P6_k "" VALUE 0x0083E030 Scalar_FLOAT64_IEEE 0 speedgoat_test_SN5659_R2021b_IO682_CM_double -1.7E+308 1.7E+308 /end CHARACTERISTIC
/begin CHARACTERISTIC speedgoat_test_SN5659__cal_impl.Encode1_P6_mt "" VALUE 0x0083E6A0 Scalar_FLOAT64_IEEE 0 speedgoat_test_SN5659_R2021b_IO682_CM_double -1.7E+308 1.7E+308 /end CHARACTERISTIC
/begin CHARACTERISTIC speedgoat_test_SN5659__cal_impl.Encode1_P7_b3 "" VALUE 0x00840078 Scalar_FLOAT64_IEEE 0 speedgoat_test_SN5659_R2021b_IO682_CM_double -1.7E+308 1.7E+308 /end CHARACTERISTIC
/begin CHARACTERISTIC speedgoat_test_SN5659__cal_impl.Encode1_P7_eo "" VALUE 0x0083F398 Scalar_FLOAT64_IEEE 0 speedgoat_test_SN5659_R2021b_IO682_CM_double -1.7E+308 1.7E+308 /end CHARACTERISTIC
/begin CHARACTERISTIC speedgoat_test_SN5659__cal_impl.Encode1_P7_gj "" VALUE 0x0083D9D8 Scalar_FLOAT64_IEEE 0 speedgoat_test_SN5659_R2021b_IO682_CM_double -1.7E+308 1.7E+308 /end CHARACTERISTIC
/begin CHARACTERISTIC speedgoat_test_SN5659__cal_impl.Encode1_P7_h "" VALUE 0x0083FA08 Scalar_FLOAT64_IEEE 0 speedgoat_test_SN5659_R2021b_IO682_CM_double -1.7E+308 1.7E+308 /end CHARACTERISTIC
/begin CHARACTERISTIC speedgoat_test_SN5659__cal_impl.Encode1_P7_k "" VALUE 0x0083E6B8 Scalar_FLOAT64_IEEE 0 speedgoat_test_SN5659_R2021b_IO682_CM_double -1.7E+308 1.7E+308 /end CHARACTERISTIC
/begin CHARACTERISTIC speedgoat_test_SN5659__cal_impl.Encode1_P7_n "" VALUE 0x0083ED28 Scalar_FLOAT64_IEEE 0 speedgoat_test_SN5659_R2021b_IO682_CM_double -1.7E+308 1.7E+308 /end CHARACTERISTIC
/begin CHARACTERISTIC speedgoat_test_SN5659__cal_impl.Encode1_P7_p "" VALUE 0x0083E048 Scalar_FLOAT64_IEEE 0 speedgoat_test_SN5659_R2021b_IO682_CM_double -1.7E+308 1.7E+308 /end CHARACTERISTIC
/begin CHARACTERISTIC speedgoat_test_SN5659__cal_impl.Encode1_P8_bi "" VALUE 0x0083FA20 Scalar_FLOAT64_IEEE 0 speedgoat_test_SN5659_R2021b_IO682_CM_double -1.7E+308 1.7E+308 /end CHARACTERISTIC
/begin CHARACTERISTIC speedgoat_test_SN5659__cal_impl.Encode1_P8_bu "" VALUE 0x0083E6D0 Scalar_FLOAT64_IEEE 0 speedgoat_test_SN5659_R2021b_IO682_CM_double -1.7E+308 1.7E+308 /end CHARACTERISTIC
/begin CHARACTERISTIC speedgoat_test_SN5659__cal_impl.Encode1_P8_cc "" VALUE 0x0083ED40 Scalar_FLOAT64_IEEE 0 speedgoat_test_SN5659_R2021b_IO682_CM_double -1.7E+308 1.7E+308 /end CHARACTERISTIC
/begin CHARACTERISTIC speedgoat_test_SN5659__cal_impl.Encode1_P8_ct "" VALUE 0x0083D9F0 Scalar_FLOAT64_IEEE 0 speedgoat_test_SN5659_R2021b_IO682_CM_double -1.7E+308 1.7E+308 /end CHARACTERISTIC
/begin CHARACTERISTIC speedgoat_test_SN5659__cal_impl.Encode1_P8_j "" VALUE 0x00840090 Scalar_FLOAT64_IEEE 0 speedgoat_test_SN5659_R2021b_IO682_CM_double -1.7E+308 1.7E+308 /end CHARACTERISTIC
/begin CHARACTERISTIC speedgoat_test_SN5659__cal_impl.Encode1_P8_n "" VALUE 0x0083F3B0 Scalar_FLOAT64_IEEE 0 speedgoat_test_SN5659_R2021b_IO682_CM_double -1.7E+308 1.7E+308 /end CHARACTERISTIC
/begin CHARACTERISTIC speedgoat_test_SN5659__cal_impl.Encode1_P8_o "" VALUE 0x0083E060 Scalar_FLOAT64_IEEE 0 speedgoat_test_SN5659_R2021b_IO682_CM_double -1.7E+308 1.7E+308 /end CHARACTERISTIC
/begin CHARACTERISTIC speedgoat_test_SN5659__cal_impl.Encode1_P9_a2 "" VALUE 0x0083F3C8 Scalar_FLOAT64_IEEE 0 speedgoat_test_SN5659_R2021b_IO682_CM_double -1.7E+308 1.7E+308 /end CHARACTERISTIC
/begin CHARACTERISTIC speedgoat_test_SN5659__cal_impl.Encode1_P9_f "" VALUE 0x0083ED58 Scalar_FLOAT64_IEEE 0 speedgoat_test_SN5659_R2021b_IO682_CM_double -1.7E+308 1.7E+308 /end CHARACTERISTIC
/begin CHARACTERISTIC speedgoat_test_SN5659__cal_impl.Encode1_P9_h "" VALUE 0x0083E078 Scalar_FLOAT64_IEEE 0 speedgoat_test_SN5659_R2021b_IO682_CM_double -1.7E+308 1.7E+308 /end CHARACTERISTIC
/begin CHARACTERISTIC speedgoat_test_SN5659__cal_impl.Encode1_P9_i "" VALUE 0x0083FA38 Scalar_FLOAT64_IEEE 0 speedgoat_test_SN5659_R2021b_IO682_CM_double -1.7E+308 1.7E+308 /end CHARACTERISTIC
/begin CHARACTERISTIC speedgoat_test_SN5659__cal_impl.Encode1_P9_j "" VALUE 0x0083DA08 Scalar_FLOAT64_IEEE 0 speedgoat_test_SN5659_R2021b_IO682_CM_double -1.7E+308 1.7E+308 /end CHARACTERISTIC
/begin CHARACTERISTIC speedgoat_test_SN5659__cal_impl.Encode1_P9_ju "" VALUE 0x0083E6E8 Scalar_FLOAT64_IEEE 0 speedgoat_test_SN5659_R2021b_IO682_CM_double -1.7E+308 1.7E+308 /end CHARACTERISTIC
/begin CHARACTERISTIC speedgoat_test_SN5659__cal_impl.Encode1_P9_oc "" VALUE 0x008400A8 Scalar_FLOAT64_IEEE 0 speedgoat_test_SN5659_R2021b_IO682_CM_double -1.7E+308 1.7E+308 /end CHARACTERISTIC
/begin CHARACTERISTIC speedgoat_test_SN5659__cal_impl.Encode2_P10_ab0 "" VALUE 0x0083E200 Scalar_FLOAT64_IEEE 0 speedgoat_test_SN5659_R2021b_IO682_CM_double -1.7E+308 1.7E+308 /end CHARACTERISTIC
/begin CHARACTERISTIC speedgoat_test_SN5659__cal_impl.Encode2_P10_d "" VALUE 0x0083EEE0 Scalar_FLOAT64_IEEE 0 speedgoat_test_SN5659_R2021b_IO682_CM_double -1.7E+308 1.7E+308 /end CHARACTERISTIC
/begin CHARACTERISTIC speedgoat_test_SN5659__cal_impl.Encode2_P10_dc "" VALUE 0x0083F550 Scalar_FLOAT64_IEEE 0 speedgoat_test_SN5659_R2021b_IO682_CM_double -1.7E+308 1.7E+308 /end CHARACTERISTIC
/begin CHARACTERISTIC speedgoat_test_SN5659__cal_impl.Encode2_P10_dz "" VALUE 0x00840560 Scalar_FLOAT64_IEEE 0 speedgoat_test_SN5659_R2021b_IO682_CM_double -1.7E+308 1.7E+308 /end CHARACTERISTIC
/begin CHARACTERISTIC speedgoat_test_SN5659__cal_impl.Encode2_P10_f "" VALUE 0x0083DB90 Scalar_FLOAT64_IEEE 0 speedgoat_test_SN5659_R2021b_IO682_CM_double -1.7E+308 1.7E+308 /end CHARACTERISTIC
/begin CHARACTERISTIC speedgoat_test_SN5659__cal_impl.Encode2_P10_im "" VALUE 0x0083EBA0 Scalar_FLOAT64_IEEE 0 speedgoat_test_SN5659_R2021b_IO682_CM_double -1.7E+308 1.7E+308 /end CHARACTERISTIC
/begin CHARACTERISTIC speedgoat_test_SN5659__cal_impl.Encode2_P10_og "" VALUE 0x0083FBC0 Scalar_FLOAT64_IEEE 0 speedgoat_test_SN5659_R2021b_IO682_CM_double -1.7E+308 1.7E+308 /end CHARACTERISTIC
/begin CHARACTERISTIC speedgoat_test_SN5659__cal_impl.Encode2_P11_b "" VAL_BLK 0x0083EEF8 Scalar_FLOAT64_IEEE 0 speedgoat_test_SN5659_R2021b_IO682_CM_double -1.7E+308 1.7E+308 MATRIX_DIM 2 1 /end CHARACTERISTIC
/begin CHARACTERISTIC speedgoat_test_SN5659__cal_impl.Encode2_P11_df "" VAL_BLK 0x0083FBD8 Scalar_FLOAT64_IEEE 0 speedgoat_test_SN5659_R2021b_IO682_CM_double -1.7E+308 1.7E+308 MATRIX_DIM 2 1 /end CHARACTERISTIC
/begin CHARACTERISTIC speedgoat_test_SN5659__cal_impl.Encode2_P11_dm "" VAL_BLK 0x00840578 Scalar_FLOAT64_IEEE 0 speedgoat_test_SN5659_R2021b_IO682_CM_double -1.7E+308 1.7E+308 MATRIX_DIM 2 1 /end CHARACTERISTIC
/begin CHARACTERISTIC speedgoat_test_SN5659__cal_impl.Encode2_P11_hq "" VAL_BLK 0x0083F568 Scalar_FLOAT64_IEEE 0 speedgoat_test_SN5659_R2021b_IO682_CM_double -1.7E+308 1.7E+308 MATRIX_DIM 2 1 /end CHARACTERISTIC
/begin CHARACTERISTIC speedgoat_test_SN5659__cal_impl.Encode2_P11_m "" VAL_BLK 0x0083DBA8 Scalar_FLOAT64_IEEE 0 speedgoat_test_SN5659_R2021b_IO682_CM_double -1.7E+308 1.7E+308 MATRIX_DIM 2 1 /end CHARACTERISTIC
/begin CHARACTERISTIC speedgoat_test_SN5659__cal_impl.Encode2_P11_o "" VAL_BLK 0x0083EBB8 Scalar_FLOAT64_IEEE 0 speedgoat_test_SN5659_R2021b_IO682_CM_double -1.7E+308 1.7E+308 MATRIX_DIM 2 1 /end CHARACTERISTIC
/begin CHARACTERISTIC speedgoat_test_SN5659__cal_impl.Encode2_P11_p "" VAL_BLK 0x0083E218 Scalar_FLOAT64_IEEE 0 speedgoat_test_SN5659_R2021b_IO682_CM_double -1.7E+308 1.7E+308 MATRIX_DIM 2 1 /end CHARACTERISTIC
/begin CHARACTERISTIC speedgoat_test_SN5659__cal_impl.Encode2_P12_c "" VALUE 0x0083E238 Scalar_FLOAT64_IEEE 0 speedgoat_test_SN5659_R2021b_IO682_CM_double -1.7E+308 1.7E+308 /end CHARACTERISTIC
/begin CHARACTERISTIC speedgoat_test_SN5659__cal_impl.Encode2_P12_e "" VALUE 0x0083DBC8 Scalar_FLOAT64_IEEE 0 speedgoat_test_SN5659_R2021b_IO682_CM_double -1.7E+308 1.7E+308 /end CHARACTERISTIC
/begin CHARACTERISTIC speedgoat_test_SN5659__cal_impl.Encode2_P12_ek "" VALUE 0x0083F588 Scalar_FLOAT64_IEEE 0 speedgoat_test_SN5659_R2021b_IO682_CM_double -1.7E+308 1.7E+308 /end CHARACTERISTIC
/begin CHARACTERISTIC speedgoat_test_SN5659__cal_impl.Encode2_P12_j "" VALUE 0x00840598 Scalar_FLOAT64_IEEE 0 speedgoat_test_SN5659_R2021b_IO682_CM_double -1.7E+308 1.7E+308 /end CHARACTERISTIC
/begin CHARACTERISTIC speedgoat_test_SN5659__cal_impl.Encode2_P12_k3 "" VALUE 0x0083EBD8 Scalar_FLOAT64_IEEE 0 speedgoat_test_SN5659_R2021b_IO682_CM_double -1.7E+308 1.7E+308 /end CHARACTERISTIC
/begin CHARACTERISTIC speedgoat_test_SN5659__cal_impl.Encode2_P12_l "" VALUE 0x0083FBF8 Scalar_FLOAT64_IEEE 0 speedgoat_test_SN5659_R2021b_IO682_CM_double -1.7E+308 1.7E+308 /end CHARACTERISTIC
/begin CHARACTERISTIC speedgoat_test_SN5659__cal_impl.Encode2_P12_mp "" VALUE 0x0083EF18 Scalar_FLOAT64_IEEE 0 speedgoat_test_SN5659_R2021b_IO682_CM_double -1.7E+308 1.7E+308 /end CHARACTERISTIC
/begin CHARACTERISTIC speedgoat_test_SN5659__cal_impl.Encode2_P13_a "" VALUE 0x0083E250 Scalar_FLOAT64_IEEE 0 speedgoat_test_SN5659_R2021b_IO682_CM_double -1.7E+308 1.7E+308 /end CHARACTERISTIC
/begin CHARACTERISTIC speedgoat_test_SN5659__cal_impl.Encode2_P13_b "" VALUE 0x0083EF30 Scalar_FLOAT64_IEEE 0 speedgoat_test_SN5659_R2021b_IO682_CM_double -1.7E+308 1.7E+308 /end CHARACTERISTIC
/begin CHARACTERISTIC speedgoat_test_SN5659__cal_impl.Encode2_P13_fx "" VALUE 0x0083DBE0 Scalar_FLOAT64_IEEE 0 speedgoat_test_SN5659_R2021b_IO682_CM_double -1.7E+308 1.7E+308 /end CHARACTERISTIC
/begin CHARACTERISTIC speedgoat_test_SN5659__cal_impl.Encode2_P13_g "" VALUE 0x008405B0 Scalar_FLOAT64_IEEE 0 speedgoat_test_SN5659_R2021b_IO682_CM_double -1.7E+308 1.7E+308 /end CHARACTERISTIC
/begin CHARACTERISTIC speedgoat_test_SN5659__cal_impl.Encode2_P13_m "" VALUE 0x0083EBF0 Scalar_FLOAT64_IEEE 0 speedgoat_test_SN5659_R2021b_IO682_CM_double -1.7E+308 1.7E+308 /end CHARACTERISTIC
/begin CHARACTERISTIC speedgoat_test_SN5659__cal_impl.Encode2_P13_ol "" VALUE 0x0083FC10 Scalar_FLOAT64_IEEE 0 speedgoat_test_SN5659_R2021b_IO682_CM_double -1.7E+308 1.7E+308 /end CHARACTERISTIC
/begin CHARACTERISTIC speedgoat_test_SN5659__cal_impl.Encode2_P13_oo "" VALUE 0x0083F5A0 Scalar_FLOAT64_IEEE 0 speedgoat_test_SN5659_R2021b_IO682_CM_double -1.7E+308 1.7E+308 /end CHARACTERISTIC
/begin CHARACTERISTIC speedgoat_test_SN5659__cal_impl.Encode2_P14_d "" VALUE 0x0083DBF8 Scalar_FLOAT64_IEEE 0 speedgoat_test_SN5659_R2021b_IO682_CM_double -1.7E+308 1.7E+308 /end CHARACTERISTIC
/begin CHARACTERISTIC speedgoat_test_SN5659__cal_impl.Encode2_P14_db "" VALUE 0x0083E268 Scalar_FLOAT64_IEEE 0 speedgoat_test_SN5659_R2021b_IO682_CM_double -1.7E+308 1.7E+308 /end CHARACTERISTIC
/begin CHARACTERISTIC speedgoat_test_SN5659__cal_impl.Encode2_P14_dr "" VALUE 0x0083FC28 Scalar_FLOAT64_IEEE 0 speedgoat_test_SN5659_R2021b_IO682_CM_double -1.7E+308 1.7E+308 /end CHARACTERISTIC
/begin CHARACTERISTIC speedgoat_test_SN5659__cal_impl.Encode2_P14_h "" VALUE 0x0083EF48 Scalar_FLOAT64_IEEE 0 speedgoat_test_SN5659_R2021b_IO682_CM_double -1.7E+308 1.7E+308 /end CHARACTERISTIC
/begin CHARACTERISTIC speedgoat_test_SN5659__cal_impl.Encode2_P14_hh "" VALUE 0x008405C8 Scalar_FLOAT64_IEEE 0 speedgoat_test_SN5659_R2021b_IO682_CM_double -1.7E+308 1.7E+308 /end CHARACTERISTIC
/begin CHARACTERISTIC speedgoat_test_SN5659__cal_impl.Encode2_P14_j "" VALUE 0x0083F5B8 Scalar_FLOAT64_IEEE 0 speedgoat_test_SN5659_R2021b_IO682_CM_double -1.7E+308 1.7E+308 /end CHARACTERISTIC
/begin CHARACTERISTIC speedgoat_test_SN5659__cal_impl.Encode2_P14_k "" VALUE 0x0083EC08 Scalar_FLOAT64_IEEE 0 speedgoat_test_SN5659_R2021b_IO682_CM_double -1.7E+308 1.7E+308 /end CHARACTERISTIC
/begin CHARACTERISTIC speedgoat_test_SN5659__cal_impl.Encode2_P15_a "" VALUE 0x0083E280 Scalar_FLOAT64_IEEE 0 speedgoat_test_SN5659_R2021b_IO682_CM_double -1.7E+308 1.7E+308 /end CHARACTERISTIC
/begin CHARACTERISTIC speedgoat_test_SN5659__cal_impl.Encode2_P15_ck "" VALUE 0x0083DC10 Scalar_FLOAT64_IEEE 0 speedgoat_test_SN5659_R2021b_IO682_CM_double -1.7E+308 1.7E+308 /end CHARACTERISTIC
/begin CHARACTERISTIC speedgoat_test_SN5659__cal_impl.Encode2_P15_d "" VALUE 0x0083EF60 Scalar_FLOAT64_IEEE 0 speedgoat_test_SN5659_R2021b_IO682_CM_double -1.7E+308 1.7E+308 /end CHARACTERISTIC
/begin CHARACTERISTIC speedgoat_test_SN5659__cal_impl.Encode2_P15_e1 "" VALUE 0x0083EC20 Scalar_FLOAT64_IEEE 0 speedgoat_test_SN5659_R2021b_IO682_CM_double -1.7E+308 1.7E+308 /end CHARACTERISTIC
/begin CHARACTERISTIC speedgoat_test_SN5659__cal_impl.Encode2_P15_f "" VALUE 0x0083FC40 Scalar_FLOAT64_IEEE 0 speedgoat_test_SN5659_R2021b_IO682_CM_double -1.7E+308 1.7E+308 /end CHARACTERISTIC
/begin CHARACTERISTIC speedgoat_test_SN5659__cal_impl.Encode2_P15_km "" VALUE 0x008405E0 Scalar_FLOAT64_IEEE 0 speedgoat_test_SN5659_R2021b_IO682_CM_double -1.7E+308 1.7E+308 /end CHARACTERISTIC
/begin CHARACTERISTIC speedgoat_test_SN5659__cal_impl.Encode2_P15_n "" VALUE 0x0083F5D0 Scalar_FLOAT64_IEEE 0 speedgoat_test_SN5659_R2021b_IO682_CM_double -1.7E+308 1.7E+308 /end CHARACTERISTIC
/begin CHARACTERISTIC speedgoat_test_SN5659__cal_impl.Encode2_P1_az "" VALUE 0x0083DAB8 Scalar_FLOAT64_IEEE 0 speedgoat_test_SN5659_R2021b_IO682_CM_double -1.7E+308 1.7E+308 /end CHARACTERISTIC
/begin CHARACTERISTIC speedgoat_test_SN5659__cal_impl.Encode2_P1_b "" VALUE 0x0083EAC8 Scalar_FLOAT64_IEEE 0 speedgoat_test_SN5659_R2021b_IO682_CM_double -1.7E+308 1.7E+308 /end CHARACTERISTIC
/begin CHARACTERISTIC speedgoat_test_SN5659__cal_impl.Encode2_P1_bc "" VALUE 0x00840488 Scalar_FLOAT64_IEEE 0 speedgoat_test_SN5659_R2021b_IO682_CM_double -1.7E+308 1.7E+308 /end CHARACTERISTIC
/begin CHARACTERISTIC speedgoat_test_SN5659__cal_impl.Encode2_P1_f "" VALUE 0x0083E128 Scalar_FLOAT64_IEEE 0 speedgoat_test_SN5659_R2021b_IO682_CM_double -1.7E+308 1.7E+308 /end CHARACTERISTIC
/begin CHARACTERISTIC speedgoat_test_SN5659__cal_impl.Encode2_P1_ga "" VALUE 0x0083EE08 Scalar_FLOAT64_IEEE 0 speedgoat_test_SN5659_R2021b_IO682_CM_double -1.7E+308 1.7E+308 /end CHARACTERISTIC
/begin CHARACTERISTIC speedgoat_test_SN5659__cal_impl.Encode2_P1_i "" VALUE 0x0083FAE8 Scalar_FLOAT64_IEEE 0 speedgoat_test_SN5659_R2021b_IO682_CM_double -1.7E+308 1.7E+308 /end CHARACTERISTIC
/begin CHARACTERISTIC speedgoat_test_SN5659__cal_impl.Encode2_P1_o "" VALUE 0x0083F478 Scalar_FLOAT64_IEEE 0 speedgoat_test_SN5659_R2021b_IO682_CM_double -1.7E+308 1.7E+308 /end CHARACTERISTIC
/begin CHARACTERISTIC speedgoat_test_SN5659__cal_impl.Encode2_P2_di "" VALUE 0x0083EAE0 Scalar_FLOAT64_IEEE 0 speedgoat_test_SN5659_R2021b_IO682_CM_double -1.7E+308 1.7E+308 /end CHARACTERISTIC
/begin CHARACTERISTIC speedgoat_test_SN5659__cal_impl.Encode2_P2_f0 "" VALUE 0x0083DAD0 Scalar_FLOAT64_IEEE 0 speedgoat_test_SN5659_R2021b_IO682_CM_double -1.7E+308 1.7E+308 /end CHARACTERISTIC
/begin CHARACTERISTIC speedgoat_test_SN5659__cal_impl.Encode2_P2_g "" VALUE 0x0083F490 Scalar_FLOAT64_IEEE 0 speedgoat_test_SN5659_R2021b_IO682_CM_double -1.7E+308 1.7E+308 /end CHARACTERISTIC
/begin CHARACTERISTIC speedgoat_test_SN5659__cal_impl.Encode2_P2_gi "" VALUE 0x0083FB00 Scalar_FLOAT64_IEEE 0 speedgoat_test_SN5659_R2021b_IO682_CM_double -1.7E+308 1.7E+308 /end CHARACTERISTIC
/begin CHARACTERISTIC speedgoat_test_SN5659__cal_impl.Encode2_P2_hl "" VALUE 0x008404A0 Scalar_FLOAT64_IEEE 0 speedgoat_test_SN5659_R2021b_IO682_CM_double -1.7E+308 1.7E+308 /end CHARACTERISTIC
/begin CHARACTERISTIC speedgoat_test_SN5659__cal_impl.Encode2_P2_ka "" VALUE 0x0083EE20 Scalar_FLOAT64_IEEE 0 speedgoat_test_SN5659_R2021b_IO682_CM_double -1.7E+308 1.7E+308 /end CHARACTERISTIC
/begin CHARACTERISTIC speedgoat_test_SN5659__cal_impl.Encode2_P2_kra "" VALUE 0x0083E140 Scalar_FLOAT64_IEEE 0 speedgoat_test_SN5659_R2021b_IO682_CM_double -1.7E+308 1.7E+308 /end CHARACTERISTIC
/begin CHARACTERISTIC speedgoat_test_SN5659__cal_impl.Encode2_P3_d "" VALUE 0x0083E158 Scalar_FLOAT64_IEEE 0 speedgoat_test_SN5659_R2021b_IO682_CM_double -1.7E+308 1.7E+308 /end CHARACTERISTIC
/begin CHARACTERISTIC speedgoat_test_SN5659__cal_impl.Encode2_P3_dm "" VALUE 0x008404B8 Scalar_FLOAT64_IEEE 0 speedgoat_test_SN5659_R2021b_IO682_CM_double -1.7E+308 1.7E+308 /end CHARACTERISTIC
/begin CHARACTERISTIC speedgoat_test_SN5659__cal_impl.Encode2_P3_fe "" VALUE 0x0083EE38 Scalar_FLOAT64_IEEE 0 speedgoat_test_SN5659_R2021b_IO682_CM_double -1.7E+308 1.7E+308 /end CHARACTERISTIC
/begin CHARACTERISTIC speedgoat_test_SN5659__cal_impl.Encode2_P3_kx "" VALUE 0x0083F4A8 Scalar_FLOAT64_IEEE 0 speedgoat_test_SN5659_R2021b_IO682_CM_double -1.7E+308 1.7E+308 /end CHARACTERISTIC
/begin CHARACTERISTIC speedgoat_test_SN5659__cal_impl.Encode2_P3_ln "" VALUE 0x0083EAF8 Scalar_FLOAT64_IEEE 0 speedgoat_test_SN5659_R2021b_IO682_CM_double -1.7E+308 1.7E+308 /end CHARACTERISTIC
/begin CHARACTERISTIC speedgoat_test_SN5659__cal_impl.Encode2_P3_o2 "" VALUE 0x0083DAE8 Scalar_FLOAT64_IEEE 0 speedgoat_test_SN5659_R2021b_IO682_CM_double -1.7E+308 1.7E+308 /end CHARACTERISTIC
/begin CHARACTERISTIC speedgoat_test_SN5659__cal_impl.Encode2_P3_oj "" VALUE 0x0083FB18 Scalar_FLOAT64_IEEE 0 speedgoat_test_SN5659_R2021b_IO682_CM_double -1.7E+308 1.7E+308 /end CHARACTERISTIC
/begin CHARACTERISTIC speedgoat_test_SN5659__cal_impl.Encode2_P4_a "" VALUE 0x0083F4C0 Scalar_FLOAT64_IEEE 0 speedgoat_test_SN5659_R2021b_IO682_CM_double -1.7E+308 1.7E+308 /end CHARACTERISTIC
/begin CHARACTERISTIC speedgoat_test_SN5659__cal_impl.Encode2_P4_h "" VALUE 0x0083DB00 Scalar_FLOAT64_IEEE 0 speedgoat_test_SN5659_R2021b_IO682_CM_double -1.7E+308 1.7E+308 /end CHARACTERISTIC
/begin CHARACTERISTIC speedgoat_test_SN5659__cal_impl.Encode2_P4_lk "" VALUE 0x0083EE50 Scalar_FLOAT64_IEEE 0 speedgoat_test_SN5659_R2021b_IO682_CM_double -1.7E+308 1.7E+308 /end CHARACTERISTIC
/begin CHARACTERISTIC speedgoat_test_SN5659__cal_impl.Encode2_P4_lw "" VALUE 0x0083E170 Scalar_FLOAT64_IEEE 0 speedgoat_test_SN5659_R2021b_IO682_CM_double -1.7E+308 1.7E+308 /end CHARACTERISTIC
/begin CHARACTERISTIC speedgoat_test_SN5659__cal_impl.Encode2_P4_n "" VALUE 0x0083EB10 Scalar_FLOAT64_IEEE 0 speedgoat_test_SN5659_R2021b_IO682_CM_double -1.7E+308 1.7E+308 /end CHARACTERISTIC
/begin CHARACTERISTIC speedgoat_test_SN5659__cal_impl.Encode2_P4_nt "" VALUE 0x0083FB30 Scalar_FLOAT64_IEEE 0 speedgoat_test_SN5659_R2021b_IO682_CM_double -1.7E+308 1.7E+308 /end CHARACTERISTIC
/begin CHARACTERISTIC speedgoat_test_SN5659__cal_impl.Encode2_P4_ny "" VALUE 0x008404D0 Scalar_FLOAT64_IEEE 0 speedgoat_test_SN5659_R2021b_IO682_CM_double -1.7E+308 1.7E+308 /end CHARACTERISTIC
/begin CHARACTERISTIC speedgoat_test_SN5659__cal_impl.Encode2_P5_a "" VALUE 0x0083EB28 Scalar_FLOAT64_IEEE 0 speedgoat_test_SN5659_R2021b_IO682_CM_double -1.7E+308 1.7E+308 /end CHARACTERISTIC
/begin CHARACTERISTIC speedgoat_test_SN5659__cal_impl.Encode2_P5_af "" VALUE 0x0083FB48 Scalar_FLOAT64_IEEE 0 speedgoat_test_SN5659_R2021b_IO682_CM_double -1.7E+308 1.7E+308 /end CHARACTERISTIC
/begin CHARACTERISTIC speedgoat_test_SN5659__cal_impl.Encode2_P5_i "" VALUE 0x0083DB18 Scalar_FLOAT64_IEEE 0 speedgoat_test_SN5659_R2021b_IO682_CM_double -1.7E+308 1.7E+308 /end CHARACTERISTIC
/begin CHARACTERISTIC speedgoat_test_SN5659__cal_impl.Encode2_P5_im "" VALUE 0x008404E8 Scalar_FLOAT64_IEEE 0 speedgoat_test_SN5659_R2021b_IO682_CM_double -1.7E+308 1.7E+308 /end CHARACTERISTIC
/begin CHARACTERISTIC speedgoat_test_SN5659__cal_impl.Encode2_P5_mc "" VALUE 0x0083E188 Scalar_FLOAT64_IEEE 0 speedgoat_test_SN5659_R2021b_IO682_CM_double -1.7E+308 1.7E+308 /end CHARACTERISTIC
/begin CHARACTERISTIC speedgoat_test_SN5659__cal_impl.Encode2_P5_n "" VALUE 0x0083EE68 Scalar_FLOAT64_IEEE 0 speedgoat_test_SN5659_R2021b_IO682_CM_double -1.7E+308 1.7E+308 /end CHARACTERISTIC
/begin CHARACTERISTIC speedgoat_test_SN5659__cal_impl.Encode2_P5_pz "" VALUE 0x0083F4D8 Scalar_FLOAT64_IEEE 0 speedgoat_test_SN5659_R2021b_IO682_CM_double -1.7E+308 1.7E+308 /end CHARACTERISTIC
/begin CHARACTERISTIC speedgoat_test_SN5659__cal_impl.Encode2_P6_c "" VALUE 0x0083EB40 Scalar_FLOAT64_IEEE 0 speedgoat_test_SN5659_R2021b_IO682_CM_double -1.7E+308 1.7E+308 /end CHARACTERISTIC
/begin CHARACTERISTIC speedgoat_test_SN5659__cal_impl.Encode2_P6_f "" VALUE 0x0083E1A0 Scalar_FLOAT64_IEEE 0 speedgoat_test_SN5659_R2021b_IO682_CM_double -1.7E+308 1.7E+308 /end CHARACTERISTIC
/begin CHARACTERISTIC speedgoat_test_SN5659__cal_impl.Encode2_P6_fn "" VALUE 0x0083EE80 Scalar_FLOAT64_IEEE 0 speedgoat_test_SN5659_R2021b_IO682_CM_double -1.7E+308 1.7E+308 /end CHARACTERISTIC
/begin CHARACTERISTIC speedgoat_test_SN5659__cal_impl.Encode2_P6_g "" VALUE 0x00840500 Scalar_FLOAT64_IEEE 0 speedgoat_test_SN5659_R2021b_IO682_CM_double -1.7E+308 1.7E+308 /end CHARACTERISTIC
/begin CHARACTERISTIC speedgoat_test_SN5659__cal_impl.Encode2_P6_k "" VALUE 0x0083F4F0 Scalar_FLOAT64_IEEE 0 speedgoat_test_SN5659_R2021b_IO682_CM_double -1.7E+308 1.7E+308 /end CHARACTERISTIC
/begin CHARACTERISTIC speedgoat_test_SN5659__cal_impl.Encode2_P6_ny "" VALUE 0x0083FB60 Scalar_FLOAT64_IEEE 0 speedgoat_test_SN5659_R2021b_IO682_CM_double -1.7E+308 1.7E+308 /end CHARACTERISTIC
/begin CHARACTERISTIC speedgoat_test_SN5659__cal_impl.Encode2_P6_o "" VALUE 0x0083DB30 Scalar_FLOAT64_IEEE 0 speedgoat_test_SN5659_R2021b_IO682_CM_double -1.7E+308 1.7E+308 /end CHARACTERISTIC
/begin CHARACTERISTIC speedgoat_test_SN5659__cal_impl.Encode2_P7_g "" VALUE 0x0083FB78 Scalar_FLOAT64_IEEE 0 speedgoat_test_SN5659_R2021b_IO682_CM_double -1.7E+308 1.7E+308 /end CHARACTERISTIC
/begin CHARACTERISTIC speedgoat_test_SN5659__cal_impl.Encode2_P7_iq "" VALUE 0x0083EB58 Scalar_FLOAT64_IEEE 0 speedgoat_test_SN5659_R2021b_IO682_CM_double -1.7E+308 1.7E+308 /end CHARACTERISTIC
/begin CHARACTERISTIC speedgoat_test_SN5659__cal_impl.Encode2_P7_jb "" VALUE 0x0083EE98 Scalar_FLOAT64_IEEE 0 speedgoat_test_SN5659_R2021b_IO682_CM_double -1.7E+308 1.7E+308 /end CHARACTERISTIC
/begin CHARACTERISTIC speedgoat_test_SN5659__cal_impl.Encode2_P7_k5 "" VALUE 0x00840518 Scalar_FLOAT64_IEEE 0 speedgoat_test_SN5659_R2021b_IO682_CM_double -1.7E+308 1.7E+308 /end CHARACTERISTIC
/begin CHARACTERISTIC speedgoat_test_SN5659__cal_impl.Encode2_P7_o "" VALUE 0x0083DB48 Scalar_FLOAT64_IEEE 0 speedgoat_test_SN5659_R2021b_IO682_CM_double -1.7E+308 1.7E+308 /end CHARACTERISTIC
/begin CHARACTERISTIC speedgoat_test_SN5659__cal_impl.Encode2_P7_oo "" VALUE 0x0083E1B8 Scalar_FLOAT64_IEEE 0 speedgoat_test_SN5659_R2021b_IO682_CM_double -1.7E+308 1.7E+308 /end CHARACTERISTIC
/begin CHARACTERISTIC speedgoat_test_SN5659__cal_impl.Encode2_P7_p "" VALUE 0x0083F508 Scalar_FLOAT64_IEEE 0 speedgoat_test_SN5659_R2021b_IO682_CM_double -1.7E+308 1.7E+308 /end CHARACTERISTIC
/begin CHARACTERISTIC speedgoat_test_SN5659__cal_impl.Encode2_P8_a "" VALUE 0x0083E1D0 Scalar_FLOAT64_IEEE 0 speedgoat_test_SN5659_R2021b_IO682_CM_double -1.7E+308 1.7E+308 /end CHARACTERISTIC
/begin CHARACTERISTIC speedgoat_test_SN5659__cal_impl.Encode2_P8_b "" VALUE 0x0083EB70 Scalar_FLOAT64_IEEE 0 speedgoat_test_SN5659_R2021b_IO682_CM_double -1.7E+308 1.7E+308 /end CHARACTERISTIC
/begin CHARACTERISTIC speedgoat_test_SN5659__cal_impl.Encode2_P8_fs "" VALUE 0x0083DB60 Scalar_FLOAT64_IEEE 0 speedgoat_test_SN5659_R2021b_IO682_CM_double -1.7E+308 1.7E+308 /end CHARACTERISTIC
/begin CHARACTERISTIC speedgoat_test_SN5659__cal_impl.Encode2_P8_hl "" VALUE 0x0083EEB0 Scalar_FLOAT64_IEEE 0 speedgoat_test_SN5659_R2021b_IO682_CM_double -1.7E+308 1.7E+308 /end CHARACTERISTIC
/begin CHARACTERISTIC speedgoat_test_SN5659__cal_impl.Encode2_P8_ig "" VALUE 0x00840530 Scalar_FLOAT64_IEEE 0 speedgoat_test_SN5659_R2021b_IO682_CM_double -1.7E+308 1.7E+308 /end CHARACTERISTIC
/begin CHARACTERISTIC speedgoat_test_SN5659__cal_impl.Encode2_P8_ip "" VALUE 0x0083F520 Scalar_FLOAT64_IEEE 0 speedgoat_test_SN5659_R2021b_IO682_CM_double -1.7E+308 1.7E+308 /end CHARACTERISTIC
/begin CHARACTERISTIC speedgoat_test_SN5659__cal_impl.Encode2_P8_m "" VALUE 0x0083FB90 Scalar_FLOAT64_IEEE 0 speedgoat_test_SN5659_R2021b_IO682_CM_double -1.7E+308 1.7E+308 /end CHARACTERISTIC
/begin CHARACTERISTIC speedgoat_test_SN5659__cal_impl.Encode2_P9_c "" VALUE 0x0083DB78 Scalar_FLOAT64_IEEE 0 speedgoat_test_SN5659_R2021b_IO682_CM_double -1.7E+308 1.7E+308 /end CHARACTERISTIC
/begin CHARACTERISTIC speedgoat_test_SN5659__cal_impl.Encode2_P9_dn "" VALUE 0x0083EEC8 Scalar_FLOAT64_IEEE 0 speedgoat_test_SN5659_R2021b_IO682_CM_double -1.7E+308 1.7E+308 /end CHARACTERISTIC
/begin CHARACTERISTIC speedgoat_test_SN5659__cal_impl.Encode2_P9_f "" VALUE 0x0083FBA8 Scalar_FLOAT64_IEEE 0 speedgoat_test_SN5659_R2021b_IO682_CM_double -1.7E+308 1.7E+308 /end CHARACTERISTIC
/begin CHARACTERISTIC speedgoat_test_SN5659__cal_impl.Encode2_P9_g "" VALUE 0x00840548 Scalar_FLOAT64_IEEE 0 speedgoat_test_SN5659_R2021b_IO682_CM_double -1.7E+308 1.7E+308 /end CHARACTERISTIC
/begin CHARACTERISTIC speedgoat_test_SN5659__cal_impl.Encode2_P9_hv "" VALUE 0x0083F538 Scalar_FLOAT64_IEEE 0 speedgoat_test_SN5659_R2021b_IO682_CM_double -1.7E+308 1.7E+308 /end CHARACTERISTIC
/begin CHARACTERISTIC speedgoat_test_SN5659__cal_impl.Encode2_P9_l "" VALUE 0x0083EB88 Scalar_FLOAT64_IEEE 0 speedgoat_test_SN5659_R2021b_IO682_CM_double -1.7E+308 1.7E+308 /end CHARACTERISTIC
/begin CHARACTERISTIC speedgoat_test_SN5659__cal_impl.Encode2_P9_ni "" VALUE 0x0083E1E8 Scalar_FLOAT64_IEEE 0 speedgoat_test_SN5659_R2021b_IO682_CM_double -1.7E+308 1.7E+308 /end CHARACTERISTIC
/begin CHARACTERISTIC speedgoat_test_SN5659__cal_impl.Encode3_P10_a "" VALUE 0x0083DD38 Scalar_FLOAT64_IEEE 0 speedgoat_test_SN5659_R2021b_IO682_CM_double -1.7E+308 1.7E+308 /end CHARACTERISTIC
/begin CHARACTERISTIC speedgoat_test_SN5659__cal_impl.Encode3_P10_f "" VALUE 0x0083EA18 Scalar_FLOAT64_IEEE 0 speedgoat_test_SN5659_R2021b_IO682_CM_double -1.7E+308 1.7E+308 /end CHARACTERISTIC
/begin CHARACTERISTIC speedgoat_test_SN5659__cal_impl.Encode3_P10_g "" VALUE 0x0083F088 Scalar_FLOAT64_IEEE 0 speedgoat_test_SN5659_R2021b_IO682_CM_double -1.7E+308 1.7E+308 /end CHARACTERISTIC
/begin CHARACTERISTIC speedgoat_test_SN5659__cal_impl.Encode3_P10_k "" VALUE 0x0083FD68 Scalar_FLOAT64_IEEE 0 speedgoat_test_SN5659_R2021b_IO682_CM_double -1.7E+308 1.7E+308 /end CHARACTERISTIC
/begin CHARACTERISTIC speedgoat_test_SN5659__cal_impl.Encode3_P10_l15 "" VALUE 0x008403D8 Scalar_FLOAT64_IEEE 0 speedgoat_test_SN5659_R2021b_IO682_CM_double -1.7E+308 1.7E+308 /end CHARACTERISTIC
/begin CHARACTERISTIC speedgoat_test_SN5659__cal_impl.Encode3_P10_od "" VALUE 0x0083E3A8 Scalar_FLOAT64_IEEE 0 speedgoat_test_SN5659_R2021b_IO682_CM_double -1.7E+308 1.7E+308 /end CHARACTERISTIC
/begin CHARACTERISTIC speedgoat_test_SN5659__cal_impl.Encode3_P10_oe "" VALUE 0x0083F6F8 Scalar_FLOAT64_IEEE 0 speedgoat_test_SN5659_R2021b_IO682_CM_double -1.7E+308 1.7E+308 /end CHARACTERISTIC
/begin CHARACTERISTIC speedgoat_test_SN5659__cal_impl.Encode3_P11_a "" VAL_BLK 0x0083F710 Scalar_FLOAT64_IEEE 0 speedgoat_test_SN5659_R2021b_IO682_CM_double -1.7E+308 1.7E+308 MATRIX_DIM 2 1 /end CHARACTERISTIC
/begin CHARACTERISTIC speedgoat_test_SN5659__cal_impl.Encode3_P11_f "" VAL_BLK 0x0083DD50 Scalar_FLOAT64_IEEE 0 speedgoat_test_SN5659_R2021b_IO682_CM_double -1.7E+308 1.7E+308 MATRIX_DIM 2 1 /end CHARACTERISTIC
/begin CHARACTERISTIC speedgoat_test_SN5659__cal_impl.Encode3_P11_ic "" VAL_BLK 0x0083EA30 Scalar_FLOAT64_IEEE 0 speedgoat_test_SN5659_R2021b_IO682_CM_double -1.7E+308 1.7E+308 MATRIX_DIM 2 1 /end CHARACTERISTIC
/begin CHARACTERISTIC speedgoat_test_SN5659__cal_impl.Encode3_P11_jg "" VAL_BLK 0x008403F0 Scalar_FLOAT64_IEEE 0 speedgoat_test_SN5659_R2021b_IO682_CM_double -1.7E+308 1.7E+308 MATRIX_DIM 2 1 /end CHARACTERISTIC
/begin CHARACTERISTIC speedgoat_test_SN5659__cal_impl.Encode3_P11_lg "" VAL_BLK 0x0083FD80 Scalar_FLOAT64_IEEE 0 speedgoat_test_SN5659_R2021b_IO682_CM_double -1.7E+308 1.7E+308 MATRIX_DIM 2 1 /end CHARACTERISTIC
/begin CHARACTERISTIC speedgoat_test_SN5659__cal_impl.Encode3_P11_o "" VAL_BLK 0x0083E3C0 Scalar_FLOAT64_IEEE 0 speedgoat_test_SN5659_R2021b_IO682_CM_double -1.7E+308 1.7E+308 MATRIX_DIM 2 1 /end CHARACTERISTIC
/begin CHARACTERISTIC speedgoat_test_SN5659__cal_impl.Encode3_P11_ox "" VAL_BLK 0x0083F0A0 Scalar_FLOAT64_IEEE 0 speedgoat_test_SN5659_R2021b_IO682_CM_double -1.7E+308 1.7E+308 MATRIX_DIM 2 1 /end CHARACTERISTIC
/begin CHARACTERISTIC speedgoat_test_SN5659__cal_impl.Encode3_P12_a "" VALUE 0x0083FDA0 Scalar_FLOAT64_IEEE 0 speedgoat_test_SN5659_R2021b_IO682_CM_double -1.7E+308 1.7E+308 /end CHARACTERISTIC
/begin CHARACTERISTIC speedgoat_test_SN5659__cal_impl.Encode3_P12_b3 "" VALUE 0x0083DD70 Scalar_FLOAT64_IEEE 0 speedgoat_test_SN5659_R2021b_IO682_CM_double -1.7E+308 1.7E+308 /end CHARACTERISTIC
/begin CHARACTERISTIC speedgoat_test_SN5659__cal_impl.Encode3_P12_d3 "" VALUE 0x0083F0C0 Scalar_FLOAT64_IEEE 0 speedgoat_test_SN5659_R2021b_IO682_CM_double -1.7E+308 1.7E+308 /end CHARACTERISTIC
/begin CHARACTERISTIC speedgoat_test_SN5659__cal_impl.Encode3_P12_et "" VALUE 0x0083F730 Scalar_FLOAT64_IEEE 0 speedgoat_test_SN5659_R2021b_IO682_CM_double -1.7E+308 1.7E+308 /end CHARACTERISTIC
/begin CHARACTERISTIC speedgoat_test_SN5659__cal_impl.Encode3_P12_f "" VALUE 0x0083E3E0 Scalar_FLOAT64_IEEE 0 speedgoat_test_SN5659_R2021b_IO682_CM_double -1.7E+308 1.7E+308 /end CHARACTERISTIC
/begin CHARACTERISTIC speedgoat_test_SN5659__cal_impl.Encode3_P12_m "" VALUE 0x0083EA50 Scalar_FLOAT64_IEEE 0 speedgoat_test_SN5659_R2021b_IO682_CM_double -1.7E+308 1.7E+308 /end CHARACTERISTIC
/begin CHARACTERISTIC speedgoat_test_SN5659__cal_impl.Encode3_P12_n "" VALUE 0x00840410 Scalar_FLOAT64_IEEE 0 speedgoat_test_SN5659_R2021b_IO682_CM_double -1.7E+308 1.7E+308 /end CHARACTERISTIC
/begin CHARACTERISTIC speedgoat_test_SN5659__cal_impl.Encode3_P13_a "" VALUE 0x0083E3F8 Scalar_FLOAT64_IEEE 0 speedgoat_test_SN5659_R2021b_IO682_CM_double -1.7E+308 1.7E+308 /end CHARACTERISTIC
/begin CHARACTERISTIC speedgoat_test_SN5659__cal_impl.Encode3_P13_c "" VALUE 0x0083DD88 Scalar_FLOAT64_IEEE 0 speedgoat_test_SN5659_R2021b_IO682_CM_double -1.7E+308 1.7E+308 /end CHARACTERISTIC
/begin CHARACTERISTIC speedgoat_test_SN5659__cal_impl.Encode3_P13_d "" VALUE 0x0083F748 Scalar_FLOAT64_IEEE 0 speedgoat_test_SN5659_R2021b_IO682_CM_double -1.7E+308 1.7E+308 /end CHARACTERISTIC
/begin CHARACTERISTIC speedgoat_test_SN5659__cal_impl.Encode3_P13_f "" VALUE 0x00840428 Scalar_FLOAT64_IEEE 0 speedgoat_test_SN5659_R2021b_IO682_CM_double -1.7E+308 1.7E+308 /end CHARACTERISTIC
/begin CHARACTERISTIC speedgoat_test_SN5659__cal_impl.Encode3_P13_hi "" VALUE 0x0083EA68 Scalar_FLOAT64_IEEE 0 speedgoat_test_SN5659_R2021b_IO682_CM_double -1.7E+308 1.7E+308 /end CHARACTERISTIC
/begin CHARACTERISTIC speedgoat_test_SN5659__cal_impl.Encode3_P13_n "" VALUE 0x0083F0D8 Scalar_FLOAT64_IEEE 0 speedgoat_test_SN5659_R2021b_IO682_CM_double -1.7E+308 1.7E+308 /end CHARACTERISTIC
/begin CHARACTERISTIC speedgoat_test_SN5659__cal_impl.Encode3_P13_ov "" VALUE 0x0083FDB8 Scalar_FLOAT64_IEEE 0 speedgoat_test_SN5659_R2021b_IO682_CM_double -1.7E+308 1.7E+308 /end CHARACTERISTIC
/begin CHARACTERISTIC speedgoat_test_SN5659__cal_impl.Encode3_P14_bl "" VALUE 0x0083F0F0 Scalar_FLOAT64_IEEE 0 speedgoat_test_SN5659_R2021b_IO682_CM_double -1.7E+308 1.7E+308 /end CHARACTERISTIC
/begin CHARACTERISTIC speedgoat_test_SN5659__cal_impl.Encode3_P14_do "" VALUE 0x0083DDA0 Scalar_FLOAT64_IEEE 0 speedgoat_test_SN5659_R2021b_IO682_CM_double -1.7E+308 1.7E+308 /end CHARACTERISTIC
/begin CHARACTERISTIC speedgoat_test_SN5659__cal_impl.Encode3_P14_g "" VALUE 0x0083E410 Scalar_FLOAT64_IEEE 0 speedgoat_test_SN5659_R2021b_IO682_CM_double -1.7E+308 1.7E+308 /end CHARACTERISTIC
/begin CHARACTERISTIC speedgoat_test_SN5659__cal_impl.Encode3_P14_m5 "" VALUE 0x0083FDD0 Scalar_FLOAT64_IEEE 0 speedgoat_test_SN5659_R2021b_IO682_CM_double -1.7E+308 1.7E+308 /end CHARACTERISTIC
/begin CHARACTERISTIC speedgoat_test_SN5659__cal_impl.Encode3_P14_nc "" VALUE 0x00840440 Scalar_FLOAT64_IEEE 0 speedgoat_test_SN5659_R2021b_IO682_CM_double -1.7E+308 1.7E+308 /end CHARACTERISTIC
/begin CHARACTERISTIC speedgoat_test_SN5659__cal_impl.Encode3_P14_op "" VALUE 0x0083EA80 Scalar_FLOAT64_IEEE 0 speedgoat_test_SN5659_R2021b_IO682_CM_double -1.7E+308 1.7E+308 /end CHARACTERISTIC
/begin CHARACTERISTIC speedgoat_test_SN5659__cal_impl.Encode3_P14_p "" VALUE 0x0083F760 Scalar_FLOAT64_IEEE 0 speedgoat_test_SN5659_R2021b_IO682_CM_double -1.7E+308 1.7E+308 /end CHARACTERISTIC
/begin CHARACTERISTIC speedgoat_test_SN5659__cal_impl.Encode3_P15_a "" VALUE 0x0083E428 Scalar_FLOAT64_IEEE 0 speedgoat_test_SN5659_R2021b_IO682_CM_double -1.7E+308 1.7E+308 /end CHARACTERISTIC
/begin CHARACTERISTIC speedgoat_test_SN5659__cal_impl.Encode3_P15_f "" VALUE 0x0083EA98 Scalar_FLOAT64_IEEE 0 speedgoat_test_SN5659_R2021b_IO682_CM_double -1.7E+308 1.7E+308 /end CHARACTERISTIC
/begin CHARACTERISTIC speedgoat_test_SN5659__cal_impl.Encode3_P15_gy "" VALUE 0x0083F108 Scalar_FLOAT64_IEEE 0 speedgoat_test_SN5659_R2021b_IO682_CM_double -1.7E+308 1.7E+308 /end CHARACTERISTIC
/begin CHARACTERISTIC speedgoat_test_SN5659__cal_impl.Encode3_P15_l "" VALUE 0x0083F778 Scalar_FLOAT64_IEEE 0 speedgoat_test_SN5659_R2021b_IO682_CM_double -1.7E+308 1.7E+308 /end CHARACTERISTIC
/begin CHARACTERISTIC speedgoat_test_SN5659__cal_impl.Encode3_P15_o "" VALUE 0x00840458 Scalar_FLOAT64_IEEE 0 speedgoat_test_SN5659_R2021b_IO682_CM_double -1.7E+308 1.7E+308 /end CHARACTERISTIC
/begin CHARACTERISTIC speedgoat_test_SN5659__cal_impl.Encode3_P15_pd "" VALUE 0x0083FDE8 Scalar_FLOAT64_IEEE 0 speedgoat_test_SN5659_R2021b_IO682_CM_double -1.7E+308 1.7E+308 /end CHARACTERISTIC
/begin CHARACTERISTIC speedgoat_test_SN5659__cal_impl.Encode3_P15_pu "" VALUE 0x0083DDB8 Scalar_FLOAT64_IEEE 0 speedgoat_test_SN5659_R2021b_IO682_CM_double -1.7E+308 1.7E+308 /end CHARACTERISTIC
/begin CHARACTERISTIC speedgoat_test_SN5659__cal_impl.Encode3_P1_ad "" VALUE 0x0083E2D0 Scalar_FLOAT64_IEEE 0 speedgoat_test_SN5659_R2021b_IO682_CM_double -1.7E+308 1.7E+308 /end CHARACTERISTIC
/begin CHARACTERISTIC speedgoat_test_SN5659__cal_impl.Encode3_P1_d "" VALUE 0x0083FC90 Scalar_FLOAT64_IEEE 0 speedgoat_test_SN5659_R2021b_IO682_CM_double -1.7E+308 1.7E+308 /end CHARACTERISTIC
/begin CHARACTERISTIC speedgoat_test_SN5659__cal_impl.Encode3_P1_j "" VALUE 0x0083EFB0 Scalar_FLOAT64_IEEE 0 speedgoat_test_SN5659_R2021b_IO682_CM_double -1.7E+308 1.7E+308 /end CHARACTERISTIC
/begin CHARACTERISTIC speedgoat_test_SN5659__cal_impl.Encode3_P1_jy "" VALUE 0x0083F620 Scalar_FLOAT64_IEEE 0 speedgoat_test_SN5659_R2021b_IO682_CM_double -1.7E+308 1.7E+308 /end CHARACTERISTIC
/begin CHARACTERISTIC speedgoat_test_SN5659__cal_impl.Encode3_P1_lu "" VALUE 0x00840300 Scalar_FLOAT64_IEEE 0 speedgoat_test_SN5659_R2021b_IO682_CM_double -1.7E+308 1.7E+308 /end CHARACTERISTIC
/begin CHARACTERISTIC speedgoat_test_SN5659__cal_impl.Encode3_P1_mk "" VALUE 0x0083DC60 Scalar_FLOAT64_IEEE 0 speedgoat_test_SN5659_R2021b_IO682_CM_double -1.7E+308 1.7E+308 /end CHARACTERISTIC
/begin CHARACTERISTIC speedgoat_test_SN5659__cal_impl.Encode3_P1_o "" VALUE 0x0083E940 Scalar_FLOAT64_IEEE 0 speedgoat_test_SN5659_R2021b_IO682_CM_double -1.7E+308 1.7E+308 /end CHARACTERISTIC
/begin CHARACTERISTIC speedgoat_test_SN5659__cal_impl.Encode3_P2_b0 "" VALUE 0x0083E958 Scalar_FLOAT64_IEEE 0 speedgoat_test_SN5659_R2021b_IO682_CM_double -1.7E+308 1.7E+308 /end CHARACTERISTIC
/begin CHARACTERISTIC speedgoat_test_SN5659__cal_impl.Encode3_P2_d "" VALUE 0x0083F638 Scalar_FLOAT64_IEEE 0 speedgoat_test_SN5659_R2021b_IO682_CM_double -1.7E+308 1.7E+308 /end CHARACTERISTIC
/begin CHARACTERISTIC speedgoat_test_SN5659__cal_impl.Encode3_P2_dl "" VALUE 0x00840318 Scalar_FLOAT64_IEEE 0 speedgoat_test_SN5659_R2021b_IO682_CM_double -1.7E+308 1.7E+308 /end CHARACTERISTIC
/begin CHARACTERISTIC speedgoat_test_SN5659__cal_impl.Encode3_P2_fg "" VALUE 0x0083E2E8 Scalar_FLOAT64_IEEE 0 speedgoat_test_SN5659_R2021b_IO682_CM_double -1.7E+308 1.7E+308 /end CHARACTERISTIC
/begin CHARACTERISTIC speedgoat_test_SN5659__cal_impl.Encode3_P2_ni "" VALUE 0x0083FCA8 Scalar_FLOAT64_IEEE 0 speedgoat_test_SN5659_R2021b_IO682_CM_double -1.7E+308 1.7E+308 /end CHARACTERISTIC
/begin CHARACTERISTIC speedgoat_test_SN5659__cal_impl.Encode3_P2_o "" VALUE 0x0083DC78 Scalar_FLOAT64_IEEE 0 speedgoat_test_SN5659_R2021b_IO682_CM_double -1.7E+308 1.7E+308 /end CHARACTERISTIC
/begin CHARACTERISTIC speedgoat_test_SN5659__cal_impl.Encode3_P2_p "" VALUE 0x0083EFC8 Scalar_FLOAT64_IEEE 0 speedgoat_test_SN5659_R2021b_IO682_CM_double -1.7E+308 1.7E+308 /end CHARACTERISTIC
/begin CHARACTERISTIC speedgoat_test_SN5659__cal_impl.Encode3_P3_cs "" VALUE 0x0083DC90 Scalar_FLOAT64_IEEE 0 speedgoat_test_SN5659_R2021b_IO682_CM_double -1.7E+308 1.7E+308 /end CHARACTERISTIC
/begin CHARACTERISTIC speedgoat_test_SN5659__cal_impl.Encode3_P3_e "" VALUE 0x0083FCC0 Scalar_FLOAT64_IEEE 0 speedgoat_test_SN5659_R2021b_IO682_CM_double -1.7E+308 1.7E+308 /end CHARACTERISTIC
/begin CHARACTERISTIC speedgoat_test_SN5659__cal_impl.Encode3_P3_f "" VALUE 0x0083F650 Scalar_FLOAT64_IEEE 0 speedgoat_test_SN5659_R2021b_IO682_CM_double -1.7E+308 1.7E+308 /end CHARACTERISTIC
/begin CHARACTERISTIC speedgoat_test_SN5659__cal_impl.Encode3_P3_k "" VALUE 0x00840330 Scalar_FLOAT64_IEEE 0 speedgoat_test_SN5659_R2021b_IO682_CM_double -1.7E+308 1.7E+308 /end CHARACTERISTIC
/begin CHARACTERISTIC speedgoat_test_SN5659__cal_impl.Encode3_P3_nx "" VALUE 0x0083E300 Scalar_FLOAT64_IEEE 0 speedgoat_test_SN5659_R2021b_IO682_CM_double -1.7E+308 1.7E+308 /end CHARACTERISTIC
/begin CHARACTERISTIC speedgoat_test_SN5659__cal_impl.Encode3_P3_p "" VALUE 0x0083E970 Scalar_FLOAT64_IEEE 0 speedgoat_test_SN5659_R2021b_IO682_CM_double -1.7E+308 1.7E+308 /end CHARACTERISTIC
/begin CHARACTERISTIC speedgoat_test_SN5659__cal_impl.Encode3_P3_pb "" VALUE 0x0083EFE0 Scalar_FLOAT64_IEEE 0 speedgoat_test_SN5659_R2021b_IO682_CM_double -1.7E+308 1.7E+308 /end CHARACTERISTIC
/begin CHARACTERISTIC speedgoat_test_SN5659__cal_impl.Encode3_P4_dq "" VALUE 0x0083DCA8 Scalar_FLOAT64_IEEE 0 speedgoat_test_SN5659_R2021b_IO682_CM_double -1.7E+308 1.7E+308 /end CHARACTERISTIC
/begin CHARACTERISTIC speedgoat_test_SN5659__cal_impl.Encode3_P4_ga "" VALUE 0x00840348 Scalar_FLOAT64_IEEE 0 speedgoat_test_SN5659_R2021b_IO682_CM_double -1.7E+308 1.7E+308 /end CHARACTERISTIC
/begin CHARACTERISTIC speedgoat_test_SN5659__cal_impl.Encode3_P4_go "" VALUE 0x0083E318 Scalar_FLOAT64_IEEE 0 speedgoat_test_SN5659_R2021b_IO682_CM_double -1.7E+308 1.7E+308 /end CHARACTERISTIC
/begin CHARACTERISTIC speedgoat_test_SN5659__cal_impl.Encode3_P4_he "" VALUE 0x0083FCD8 Scalar_FLOAT64_IEEE 0 speedgoat_test_SN5659_R2021b_IO682_CM_double -1.7E+308 1.7E+308 /end CHARACTERISTIC
/begin CHARACTERISTIC speedgoat_test_SN5659__cal_impl.Encode3_P4_hs "" VALUE 0x0083E988 Scalar_FLOAT64_IEEE 0 speedgoat_test_SN5659_R2021b_IO682_CM_double -1.7E+308 1.7E+308 /end CHARACTERISTIC
/begin CHARACTERISTIC speedgoat_test_SN5659__cal_impl.Encode3_P4_hu "" VALUE 0x0083EFF8 Scalar_FLOAT64_IEEE 0 speedgoat_test_SN5659_R2021b_IO682_CM_double -1.7E+308 1.7E+308 /end CHARACTERISTIC
/begin CHARACTERISTIC speedgoat_test_SN5659__cal_impl.Encode3_P4_mc "" VALUE 0x0083F668 Scalar_FLOAT64_IEEE 0 speedgoat_test_SN5659_R2021b_IO682_CM_double -1.7E+308 1.7E+308 /end CHARACTERISTIC
/begin CHARACTERISTIC speedgoat_test_SN5659__cal_impl.Encode3_P5_d0 "" VALUE 0x0083F680 Scalar_FLOAT64_IEEE 0 speedgoat_test_SN5659_R2021b_IO682_CM_double -1.7E+308 1.7E+308 /end CHARACTERISTIC
/begin CHARACTERISTIC speedgoat_test_SN5659__cal_impl.Encode3_P5_g "" VALUE 0x0083E9A0 Scalar_FLOAT64_IEEE 0 speedgoat_test_SN5659_R2021b_IO682_CM_double -1.7E+308 1.7E+308 /end CHARACTERISTIC
/begin CHARACTERISTIC speedgoat_test_SN5659__cal_impl.Encode3_P5_i0 "" VALUE 0x0083E330 Scalar_FLOAT64_IEEE 0 speedgoat_test_SN5659_R2021b_IO682_CM_double -1.7E+308 1.7E+308 /end CHARACTERISTIC
/begin CHARACTERISTIC speedgoat_test_SN5659__cal_impl.Encode3_P5_im "" VALUE 0x0083DCC0 Scalar_FLOAT64_IEEE 0 speedgoat_test_SN5659_R2021b_IO682_CM_double -1.7E+308 1.7E+308 /end CHARACTERISTIC
/begin CHARACTERISTIC speedgoat_test_SN5659__cal_impl.Encode3_P5_j "" VALUE 0x00840360 Scalar_FLOAT64_IEEE 0 speedgoat_test_SN5659_R2021b_IO682_CM_double -1.7E+308 1.7E+308 /end CHARACTERISTIC
/begin CHARACTERISTIC speedgoat_test_SN5659__cal_impl.Encode3_P5_kk "" VALUE 0x0083F010 Scalar_FLOAT64_IEEE 0 speedgoat_test_SN5659_R2021b_IO682_CM_double -1.7E+308 1.7E+308 /end CHARACTERISTIC
/begin CHARACTERISTIC speedgoat_test_SN5659__cal_impl.Encode3_P5_l "" VALUE 0x0083FCF0 Scalar_FLOAT64_IEEE 0 speedgoat_test_SN5659_R2021b_IO682_CM_double -1.7E+308 1.7E+308 /end CHARACTERISTIC
/begin CHARACTERISTIC speedgoat_test_SN5659__cal_impl.Encode3_P6_a0 "" VALUE 0x0083E348 Scalar_FLOAT64_IEEE 0 speedgoat_test_SN5659_R2021b_IO682_CM_double -1.7E+308 1.7E+308 /end CHARACTERISTIC
/begin CHARACTERISTIC speedgoat_test_SN5659__cal_impl.Encode3_P6_d "" VALUE 0x0083DCD8 Scalar_FLOAT64_IEEE 0 speedgoat_test_SN5659_R2021b_IO682_CM_double -1.7E+308 1.7E+308 /end CHARACTERISTIC
/begin CHARACTERISTIC speedgoat_test_SN5659__cal_impl.Encode3_P6_gz "" VALUE 0x00840378 Scalar_FLOAT64_IEEE 0 speedgoat_test_SN5659_R2021b_IO682_CM_double -1.7E+308 1.7E+308 /end CHARACTERISTIC
/begin CHARACTERISTIC speedgoat_test_SN5659__cal_impl.Encode3_P6_hf "" VALUE 0x0083F698 Scalar_FLOAT64_IEEE 0 speedgoat_test_SN5659_R2021b_IO682_CM_double -1.7E+308 1.7E+308 /end CHARACTERISTIC
/begin CHARACTERISTIC speedgoat_test_SN5659__cal_impl.Encode3_P6_hi "" VALUE 0x0083E9B8 Scalar_FLOAT64_IEEE 0 speedgoat_test_SN5659_R2021b_IO682_CM_double -1.7E+308 1.7E+308 /end CHARACTERISTIC
/begin CHARACTERISTIC speedgoat_test_SN5659__cal_impl.Encode3_P6_iy "" VALUE 0x0083F028 Scalar_FLOAT64_IEEE 0 speedgoat_test_SN5659_R2021b_IO682_CM_double -1.7E+308 1.7E+308 /end CHARACTERISTIC
/begin CHARACTERISTIC speedgoat_test_SN5659__cal_impl.Encode3_P6_o "" VALUE 0x0083FD08 Scalar_FLOAT64_IEEE 0 speedgoat_test_SN5659_R2021b_IO682_CM_double -1.7E+308 1.7E+308 /end CHARACTERISTIC
/begin CHARACTERISTIC speedgoat_test_SN5659__cal_impl.Encode3_P7_bt "" VALUE 0x0083FD20 Scalar_FLOAT64_IEEE 0 speedgoat_test_SN5659_R2021b_IO682_CM_double -1.7E+308 1.7E+308 /end CHARACTERISTIC
/begin CHARACTERISTIC speedgoat_test_SN5659__cal_impl.Encode3_P7_c "" VALUE 0x0083E9D0 Scalar_FLOAT64_IEEE 0 speedgoat_test_SN5659_R2021b_IO682_CM_double -1.7E+308 1.7E+308 /end CHARACTERISTIC
/begin CHARACTERISTIC speedgoat_test_SN5659__cal_impl.Encode3_P7_dw "" VALUE 0x00840390 Scalar_FLOAT64_IEEE 0 speedgoat_test_SN5659_R2021b_IO682_CM_double -1.7E+308 1.7E+308 /end CHARACTERISTIC
/begin CHARACTERISTIC speedgoat_test_SN5659__cal_impl.Encode3_P7_g "" VALUE 0x0083F040 Scalar_FLOAT64_IEEE 0 speedgoat_test_SN5659_R2021b_IO682_CM_double -1.7E+308 1.7E+308 /end CHARACTERISTIC
/begin CHARACTERISTIC speedgoat_test_SN5659__cal_impl.Encode3_P7_k "" VALUE 0x0083F6B0 Scalar_FLOAT64_IEEE 0 speedgoat_test_SN5659_R2021b_IO682_CM_double -1.7E+308 1.7E+308 /end CHARACTERISTIC
/begin CHARACTERISTIC speedgoat_test_SN5659__cal_impl.Encode3_P7_o "" VALUE 0x0083DCF0 Scalar_FLOAT64_IEEE 0 speedgoat_test_SN5659_R2021b_IO682_CM_double -1.7E+308 1.7E+308 /end CHARACTERISTIC
/begin CHARACTERISTIC speedgoat_test_SN5659__cal_impl.Encode3_P7_p "" VALUE 0x0083E360 Scalar_FLOAT64_IEEE 0 speedgoat_test_SN5659_R2021b_IO682_CM_double -1.7E+308 1.7E+308 /end CHARACTERISTIC
/begin CHARACTERISTIC speedgoat_test_SN5659__cal_impl.Encode3_P8_a "" VALUE 0x008403A8 Scalar_FLOAT64_IEEE 0 speedgoat_test_SN5659_R2021b_IO682_CM_double -1.7E+308 1.7E+308 /end CHARACTERISTIC
/begin CHARACTERISTIC speedgoat_test_SN5659__cal_impl.Encode3_P8_c "" VALUE 0x0083F058 Scalar_FLOAT64_IEEE 0 speedgoat_test_SN5659_R2021b_IO682_CM_double -1.7E+308 1.7E+308 /end CHARACTERISTIC
/begin CHARACTERISTIC speedgoat_test_SN5659__cal_impl.Encode3_P8_en "" VALUE 0x0083DD08 Scalar_FLOAT64_IEEE 0 speedgoat_test_SN5659_R2021b_IO682_CM_double -1.7E+308 1.7E+308 /end CHARACTERISTIC
/begin CHARACTERISTIC speedgoat_test_SN5659__cal_impl.Encode3_P8_fe "" VALUE 0x0083E9E8 Scalar_FLOAT64_IEEE 0 speedgoat_test_SN5659_R2021b_IO682_CM_double -1.7E+308 1.7E+308 /end CHARACTERISTIC
/begin CHARACTERISTIC speedgoat_test_SN5659__cal_impl.Encode3_P8_j "" VALUE 0x0083E378 Scalar_FLOAT64_IEEE 0 speedgoat_test_SN5659_R2021b_IO682_CM_double -1.7E+308 1.7E+308 /end CHARACTERISTIC
/begin CHARACTERISTIC speedgoat_test_SN5659__cal_impl.Encode3_P8_n "" VALUE 0x0083FD38 Scalar_FLOAT64_IEEE 0 speedgoat_test_SN5659_R2021b_IO682_CM_double -1.7E+308 1.7E+308 /end CHARACTERISTIC
/begin CHARACTERISTIC speedgoat_test_SN5659__cal_impl.Encode3_P8_o "" VALUE 0x0083F6C8 Scalar_FLOAT64_IEEE 0 speedgoat_test_SN5659_R2021b_IO682_CM_double -1.7E+308 1.7E+308 /end CHARACTERISTIC
/begin CHARACTERISTIC speedgoat_test_SN5659__cal_impl.Encode3_P9_a "" VALUE 0x0083F070 Scalar_FLOAT64_IEEE 0 speedgoat_test_SN5659_R2021b_IO682_CM_double -1.7E+308 1.7E+308 /end CHARACTERISTIC
/begin CHARACTERISTIC speedgoat_test_SN5659__cal_impl.Encode3_P9_cw "" VALUE 0x0083F6E0 Scalar_FLOAT64_IEEE 0 speedgoat_test_SN5659_R2021b_IO682_CM_double -1.7E+308 1.7E+308 /end CHARACTERISTIC
/begin CHARACTERISTIC speedgoat_test_SN5659__cal_impl.Encode3_P9_e "" VALUE 0x0083FD50 Scalar_FLOAT64_IEEE 0 speedgoat_test_SN5659_R2021b_IO682_CM_double -1.7E+308 1.7E+308 /end CHARACTERISTIC
/begin CHARACTERISTIC speedgoat_test_SN5659__cal_impl.Encode3_P9_l "" VALUE 0x0083EA00 Scalar_FLOAT64_IEEE 0 speedgoat_test_SN5659_R2021b_IO682_CM_double -1.7E+308 1.7E+308 /end CHARACTERISTIC
/begin CHARACTERISTIC speedgoat_test_SN5659__cal_impl.Encode3_P9_lj "" VALUE 0x008403C0 Scalar_FLOAT64_IEEE 0 speedgoat_test_SN5659_R2021b_IO682_CM_double -1.7E+308 1.7E+308 /end CHARACTERISTIC
/begin CHARACTERISTIC speedgoat_test_SN5659__cal_impl.Encode3_P9_m "" VALUE 0x0083DD20 Scalar_FLOAT64_IEEE 0 speedgoat_test_SN5659_R2021b_IO682_CM_double -1.7E+308 1.7E+308 /end CHARACTERISTIC
/begin CHARACTERISTIC speedgoat_test_SN5659__cal_impl.Encode3_P9_o "" VALUE 0x0083E390 Scalar_FLOAT64_IEEE 0 speedgoat_test_SN5659_R2021b_IO682_CM_double -1.7E+308 1.7E+308 /end CHARACTERISTIC
/begin CHARACTERISTIC speedgoat_test_SN5659__cal_impl.Encode4_P10_b "" VALUE 0x0083DEC0 Scalar_FLOAT64_IEEE 0 speedgoat_test_SN5659_R2021b_IO682_CM_double -1.7E+308 1.7E+308 /end CHARACTERISTIC
/begin CHARACTERISTIC speedgoat_test_SN5659__cal_impl.Encode4_P10_h3 "" VALUE 0x0083F210 Scalar_FLOAT64_IEEE 0 speedgoat_test_SN5659_R2021b_IO682_CM_double -1.7E+308 1.7E+308 /end CHARACTERISTIC
/begin CHARACTERISTIC speedgoat_test_SN5659__cal_impl.Encode4_P10_jg "" VALUE 0x0083FEF0 Scalar_FLOAT64_IEEE 0 speedgoat_test_SN5659_R2021b_IO682_CM_double -1.7E+308 1.7E+308 /end CHARACTERISTIC
/begin CHARACTERISTIC speedgoat_test_SN5659__cal_impl.Encode4_P10_l "" VALUE 0x0083F880 Scalar_FLOAT64_IEEE 0 speedgoat_test_SN5659_R2021b_IO682_CM_double -1.7E+308 1.7E+308 /end CHARACTERISTIC
/begin CHARACTERISTIC speedgoat_test_SN5659__cal_impl.Encode4_P10_p "" VALUE 0x0083E530 Scalar_FLOAT64_IEEE 0 speedgoat_test_SN5659_R2021b_IO682_CM_double -1.7E+308 1.7E+308 /end CHARACTERISTIC
/begin CHARACTERISTIC speedgoat_test_SN5659__cal_impl.Encode4_P11_a "" VAL_BLK 0x0083E548 Scalar_FLOAT64_IEEE 0 speedgoat_test_SN5659_R2021b_IO682_CM_double -1.7E+308 1.7E+308 MATRIX_DIM 2 1 /end CHARACTERISTIC
/begin CHARACTERISTIC speedgoat_test_SN5659__cal_impl.Encode4_P11_jr "" VAL_BLK 0x0083DED8 Scalar_FLOAT64_IEEE 0 speedgoat_test_SN5659_R2021b_IO682_CM_double -1.7E+308 1.7E+308 MATRIX_DIM 2 1 /end CHARACTERISTIC
/begin CHARACTERISTIC speedgoat_test_SN5659__cal_impl.Encode4_P11_js "" VAL_BLK 0x0083FF08 Scalar_FLOAT64_IEEE 0 speedgoat_test_SN5659_R2021b_IO682_CM_double -1.7E+308 1.7E+308 MATRIX_DIM 2 1 /end CHARACTERISTIC
/begin CHARACTERISTIC speedgoat_test_SN5659__cal_impl.Encode4_P11_l "" VAL_BLK 0x0083F228 Scalar_FLOAT64_IEEE 0 speedgoat_test_SN5659_R2021b_IO682_CM_double -1.7E+308 1.7E+308 MATRIX_DIM 2 1 /end CHARACTERISTIC
/begin CHARACTERISTIC speedgoat_test_SN5659__cal_impl.Encode4_P11_pl "" VAL_BLK 0x0083F898 Scalar_FLOAT64_IEEE 0 speedgoat_test_SN5659_R2021b_IO682_CM_double -1.7E+308 1.7E+308 MATRIX_DIM 2 1 /end CHARACTERISTIC
/begin CHARACTERISTIC speedgoat_test_SN5659__cal_impl.Encode4_P12_c "" VALUE 0x0083F248 Scalar_FLOAT64_IEEE 0 speedgoat_test_SN5659_R2021b_IO682_CM_double -1.7E+308 1.7E+308 /end CHARACTERISTIC
/begin CHARACTERISTIC speedgoat_test_SN5659__cal_impl.Encode4_P12_g "" VALUE 0x0083DEF8 Scalar_FLOAT64_IEEE 0 speedgoat_test_SN5659_R2021b_IO682_CM_double -1.7E+308 1.7E+308 /end CHARACTERISTIC
/begin CHARACTERISTIC speedgoat_test_SN5659__cal_impl.Encode4_P12_k "" VALUE 0x0083F8B8 Scalar_FLOAT64_IEEE 0 speedgoat_test_SN5659_R2021b_IO682_CM_double -1.7E+308 1.7E+308 /end CHARACTERISTIC
/begin CHARACTERISTIC speedgoat_test_SN5659__cal_impl.Encode4_P12_ld "" VALUE 0x0083E568 Scalar_FLOAT64_IEEE 0 speedgoat_test_SN5659_R2021b_IO682_CM_double -1.7E+308 1.7E+308 /end CHARACTERISTIC
/begin CHARACTERISTIC speedgoat_test_SN5659__cal_impl.Encode4_P12_n "" VALUE 0x0083FF28 Scalar_FLOAT64_IEEE 0 speedgoat_test_SN5659_R2021b_IO682_CM_double -1.7E+308 1.7E+308 /end CHARACTERISTIC
/begin CHARACTERISTIC speedgoat_test_SN5659__cal_impl.Encode4_P13_d "" VALUE 0x0083DF10 Scalar_FLOAT64_IEEE 0 speedgoat_test_SN5659_R2021b_IO682_CM_double -1.7E+308 1.7E+308 /end CHARACTERISTIC
/begin CHARACTERISTIC speedgoat_test_SN5659__cal_impl.Encode4_P13_g "" VALUE 0x0083E580 Scalar_FLOAT64_IEEE 0 speedgoat_test_SN5659_R2021b_IO682_CM_double -1.7E+308 1.7E+308 /end CHARACTERISTIC
/begin CHARACTERISTIC speedgoat_test_SN5659__cal_impl.Encode4_P13_hn "" VALUE 0x0083F8D0 Scalar_FLOAT64_IEEE 0 speedgoat_test_SN5659_R2021b_IO682_CM_double -1.7E+308 1.7E+308 /end CHARACTERISTIC
/begin CHARACTERISTIC speedgoat_test_SN5659__cal_impl.Encode4_P13_k "" VALUE 0x0083FF40 Scalar_FLOAT64_IEEE 0 speedgoat_test_SN5659_R2021b_IO682_CM_double -1.7E+308 1.7E+308 /end CHARACTERISTIC
/begin CHARACTERISTIC speedgoat_test_SN5659__cal_impl.Encode4_P13_ml "" VALUE 0x0083F260 Scalar_FLOAT64_IEEE 0 speedgoat_test_SN5659_R2021b_IO682_CM_double -1.7E+308 1.7E+308 /end CHARACTERISTIC
/begin CHARACTERISTIC speedgoat_test_SN5659__cal_impl.Encode4_P14_f "" VALUE 0x0083FF58 Scalar_FLOAT64_IEEE 0 speedgoat_test_SN5659_R2021b_IO682_CM_double -1.7E+308 1.7E+308 /end CHARACTERISTIC
/begin CHARACTERISTIC speedgoat_test_SN5659__cal_impl.Encode4_P14_g "" VALUE 0x0083DF28 Scalar_FLOAT64_IEEE 0 speedgoat_test_SN5659_R2021b_IO682_CM_double -1.7E+308 1.7E+308 /end CHARACTERISTIC
/begin CHARACTERISTIC speedgoat_test_SN5659__cal_impl.Encode4_P14_k "" VALUE 0x0083F278 Scalar_FLOAT64_IEEE 0 speedgoat_test_SN5659_R2021b_IO682_CM_double -1.7E+308 1.7E+308 /end CHARACTERISTIC
/begin CHARACTERISTIC speedgoat_test_SN5659__cal_impl.Encode4_P14_ma "" VALUE 0x0083F8E8 Scalar_FLOAT64_IEEE 0 speedgoat_test_SN5659_R2021b_IO682_CM_double -1.7E+308 1.7E+308 /end CHARACTERISTIC
/begin CHARACTERISTIC speedgoat_test_SN5659__cal_impl.Encode4_P14_o "" VALUE 0x0083E598 Scalar_FLOAT64_IEEE 0 speedgoat_test_SN5659_R2021b_IO682_CM_double -1.7E+308 1.7E+308 /end CHARACTERISTIC
/begin CHARACTERISTIC speedgoat_test_SN5659__cal_impl.Encode4_P15_c "" VALUE 0x0083FF70 Scalar_FLOAT64_IEEE 0 speedgoat_test_SN5659_R2021b_IO682_CM_double -1.7E+308 1.7E+308 /end CHARACTERISTIC
/begin CHARACTERISTIC speedgoat_test_SN5659__cal_impl.Encode4_P15_h "" VALUE 0x0083DF40 Scalar_FLOAT64_IEEE 0 speedgoat_test_SN5659_R2021b_IO682_CM_double -1.7E+308 1.7E+308 /end CHARACTERISTIC
/begin CHARACTERISTIC speedgoat_test_SN5659__cal_impl.Encode4_P15_iu "" VALUE 0x0083F900 Scalar_FLOAT64_IEEE 0 speedgoat_test_SN5659_R2021b_IO682_CM_double -1.7E+308 1.7E+308 /end CHARACTERISTIC
/begin CHARACTERISTIC speedgoat_test_SN5659__cal_impl.Encode4_P15_j "" VALUE 0x0083E5B0 Scalar_FLOAT64_IEEE 0 speedgoat_test_SN5659_R2021b_IO682_CM_double -1.7E+308 1.7E+308 /end CHARACTERISTIC
/begin CHARACTERISTIC speedgoat_test_SN5659__cal_impl.Encode4_P15_o "" VALUE 0x0083F290 Scalar_FLOAT64_IEEE 0 speedgoat_test_SN5659_R2021b_IO682_CM_double -1.7E+308 1.7E+308 /end CHARACTERISTIC
/begin CHARACTERISTIC speedgoat_test_SN5659__cal_impl.Encode4_P1_af "" VALUE 0x0083F138 Scalar_FLOAT64_IEEE 0 speedgoat_test_SN5659_R2021b_IO682_CM_double -1.7E+308 1.7E+308 /end CHARACTERISTIC
/begin CHARACTERISTIC speedgoat_test_SN5659__cal_impl.Encode4_P1_h "" VALUE 0x0083E458 Scalar_FLOAT64_IEEE 0 speedgoat_test_SN5659_R2021b_IO682_CM_double -1.7E+308 1.7E+308 /end CHARACTERISTIC
/begin CHARACTERISTIC speedgoat_test_SN5659__cal_impl.Encode4_P1_hi "" VALUE 0x0083FE18 Scalar_FLOAT64_IEEE 0 speedgoat_test_SN5659_R2021b_IO682_CM_double -1.7E+308 1.7E+308 /end CHARACTERISTIC
/begin CHARACTERISTIC speedgoat_test_SN5659__cal_impl.Encode4_P1_ns "" VALUE 0x0083DDE8 Scalar_FLOAT64_IEEE 0 speedgoat_test_SN5659_R2021b_IO682_CM_double -1.7E+308 1.7E+308 /end CHARACTERISTIC
/begin CHARACTERISTIC speedgoat_test_SN5659__cal_impl.Encode4_P1_o "" VALUE 0x0083F7A8 Scalar_FLOAT64_IEEE 0 speedgoat_test_SN5659_R2021b_IO682_CM_double -1.7E+308 1.7E+308 /end CHARACTERISTIC
/begin CHARACTERISTIC speedgoat_test_SN5659__cal_impl.Encode4_P2_e "" VALUE 0x0083E470 Scalar_FLOAT64_IEEE 0 speedgoat_test_SN5659_R2021b_IO682_CM_double -1.7E+308 1.7E+308 /end CHARACTERISTIC
/begin CHARACTERISTIC speedgoat_test_SN5659__cal_impl.Encode4_P2_g "" VALUE 0x0083DE00 Scalar_FLOAT64_IEEE 0 speedgoat_test_SN5659_R2021b_IO682_CM_double -1.7E+308 1.7E+308 /end CHARACTERISTIC
/begin CHARACTERISTIC speedgoat_test_SN5659__cal_impl.Encode4_P2_j "" VALUE 0x0083F150 Scalar_FLOAT64_IEEE 0 speedgoat_test_SN5659_R2021b_IO682_CM_double -1.7E+308 1.7E+308 /end CHARACTERISTIC
/begin CHARACTERISTIC speedgoat_test_SN5659__cal_impl.Encode4_P2_k "" VALUE 0x0083FE30 Scalar_FLOAT64_IEEE 0 speedgoat_test_SN5659_R2021b_IO682_CM_double -1.7E+308 1.7E+308 /end CHARACTERISTIC
/begin CHARACTERISTIC speedgoat_test_SN5659__cal_impl.Encode4_P2_pk "" VALUE 0x0083F7C0 Scalar_FLOAT64_IEEE 0 speedgoat_test_SN5659_R2021b_IO682_CM_double -1.7E+308 1.7E+308 /end CHARACTERISTIC
/begin CHARACTERISTIC speedgoat_test_SN5659__cal_impl.Encode4_P3_h5 "" VALUE 0x0083F7D8 Scalar_FLOAT64_IEEE 0 speedgoat_test_SN5659_R2021b_IO682_CM_double -1.7E+308 1.7E+308 /end CHARACTERISTIC
/begin CHARACTERISTIC speedgoat_test_SN5659__cal_impl.Encode4_P3_j "" VALUE 0x0083E488 Scalar_FLOAT64_IEEE 0 speedgoat_test_SN5659_R2021b_IO682_CM_double -1.7E+308 1.7E+308 /end CHARACTERISTIC
/begin CHARACTERISTIC speedgoat_test_SN5659__cal_impl.Encode4_P3_k "" VALUE 0x0083FE48 Scalar_FLOAT64_IEEE 0 speedgoat_test_SN5659_R2021b_IO682_CM_double -1.7E+308 1.7E+308 /end CHARACTERISTIC
/begin CHARACTERISTIC speedgoat_test_SN5659__cal_impl.Encode4_P3_n "" VALUE 0x0083DE18 Scalar_FLOAT64_IEEE 0 speedgoat_test_SN5659_R2021b_IO682_CM_double -1.7E+308 1.7E+308 /end CHARACTERISTIC
/begin CHARACTERISTIC speedgoat_test_SN5659__cal_impl.Encode4_P3_n5 "" VALUE 0x0083F168 Scalar_FLOAT64_IEEE 0 speedgoat_test_SN5659_R2021b_IO682_CM_double -1.7E+308 1.7E+308 /end CHARACTERISTIC
/begin CHARACTERISTIC speedgoat_test_SN5659__cal_impl.Encode4_P4_j "" VALUE 0x0083FE60 Scalar_FLOAT64_IEEE 0 speedgoat_test_SN5659_R2021b_IO682_CM_double -1.7E+308 1.7E+308 /end CHARACTERISTIC
/begin CHARACTERISTIC speedgoat_test_SN5659__cal_impl.Encode4_P4_kc "" VALUE 0x0083F180 Scalar_FLOAT64_IEEE 0 speedgoat_test_SN5659_R2021b_IO682_CM_double -1.7E+308 1.7E+308 /end CHARACTERISTIC
/begin CHARACTERISTIC speedgoat_test_SN5659__cal_impl.Encode4_P4_m "" VALUE 0x0083DE30 Scalar_FLOAT64_IEEE 0 speedgoat_test_SN5659_R2021b_IO682_CM_double -1.7E+308 1.7E+308 /end CHARACTERISTIC
/begin CHARACTERISTIC speedgoat_test_SN5659__cal_impl.Encode4_P4_my "" VALUE 0x0083F7F0 Scalar_FLOAT64_IEEE 0 speedgoat_test_SN5659_R2021b_IO682_CM_double -1.7E+308 1.7E+308 /end CHARACTERISTIC
/begin CHARACTERISTIC speedgoat_test_SN5659__cal_impl.Encode4_P4_o "" VALUE 0x0083E4A0 Scalar_FLOAT64_IEEE 0 speedgoat_test_SN5659_R2021b_IO682_CM_double -1.7E+308 1.7E+308 /end CHARACTERISTIC
/begin CHARACTERISTIC speedgoat_test_SN5659__cal_impl.Encode4_P5_d "" VALUE 0x0083F198 Scalar_FLOAT64_IEEE 0 speedgoat_test_SN5659_R2021b_IO682_CM_double -1.7E+308 1.7E+308 /end CHARACTERISTIC
/begin CHARACTERISTIC speedgoat_test_SN5659__cal_impl.Encode4_P5_g "" VALUE 0x0083FE78 Scalar_FLOAT64_IEEE 0 speedgoat_test_SN5659_R2021b_IO682_CM_double -1.7E+308 1.7E+308 /end CHARACTERISTIC
/begin CHARACTERISTIC speedgoat_test_SN5659__cal_impl.Encode4_P5_k "" VALUE 0x0083DE48 Scalar_FLOAT64_IEEE 0 speedgoat_test_SN5659_R2021b_IO682_CM_double -1.7E+308 1.7E+308 /end CHARACTERISTIC
/begin CHARACTERISTIC speedgoat_test_SN5659__cal_impl.Encode4_P5_pt "" VALUE 0x0083E4B8 Scalar_FLOAT64_IEEE 0 speedgoat_test_SN5659_R2021b_IO682_CM_double -1.7E+308 1.7E+308 /end CHARACTERISTIC
/begin CHARACTERISTIC speedgoat_test_SN5659__cal_impl.Encode4_P5_pv "" VALUE 0x0083F808 Scalar_FLOAT64_IEEE 0 speedgoat_test_SN5659_R2021b_IO682_CM_double -1.7E+308 1.7E+308 /end CHARACTERISTIC
/begin CHARACTERISTIC speedgoat_test_SN5659__cal_impl.Encode4_P6_ab "" VALUE 0x0083E4D0 Scalar_FLOAT64_IEEE 0 speedgoat_test_SN5659_R2021b_IO682_CM_double -1.7E+308 1.7E+308 /end CHARACTERISTIC
/begin CHARACTERISTIC speedgoat_test_SN5659__cal_impl.Encode4_P6_abh "" VALUE 0x0083F1B0 Scalar_FLOAT64_IEEE 0 speedgoat_test_SN5659_R2021b_IO682_CM_double -1.7E+308 1.7E+308 /end CHARACTERISTIC
/begin CHARACTERISTIC speedgoat_test_SN5659__cal_impl.Encode4_P6_e "" VALUE 0x0083DE60 Scalar_FLOAT64_IEEE 0 speedgoat_test_SN5659_R2021b_IO682_CM_double -1.7E+308 1.7E+308 /end CHARACTERISTIC
/begin CHARACTERISTIC speedgoat_test_SN5659__cal_impl.Encode4_P6_ed "" VALUE 0x0083F820 Scalar_FLOAT64_IEEE 0 speedgoat_test_SN5659_R2021b_IO682_CM_double -1.7E+308 1.7E+308 /end CHARACTERISTIC
/begin CHARACTERISTIC speedgoat_test_SN5659__cal_impl.Encode4_P6_g "" VALUE 0x0083FE90 Scalar_FLOAT64_IEEE 0 speedgoat_test_SN5659_R2021b_IO682_CM_double -1.7E+308 1.7E+308 /end CHARACTERISTIC
/begin CHARACTERISTIC speedgoat_test_SN5659__cal_impl.Encode4_P7_by "" VALUE 0x0083F838 Scalar_FLOAT64_IEEE 0 speedgoat_test_SN5659_R2021b_IO682_CM_double -1.7E+308 1.7E+308 /end CHARACTERISTIC
/begin CHARACTERISTIC speedgoat_test_SN5659__cal_impl.Encode4_P7_c3 "" VALUE 0x0083FEA8 Scalar_FLOAT64_IEEE 0 speedgoat_test_SN5659_R2021b_IO682_CM_double -1.7E+308 1.7E+308 /end CHARACTERISTIC
/begin CHARACTERISTIC speedgoat_test_SN5659__cal_impl.Encode4_P7_di "" VALUE 0x0083F1C8 Scalar_FLOAT64_IEEE 0 speedgoat_test_SN5659_R2021b_IO682_CM_double -1.7E+308 1.7E+308 /end CHARACTERISTIC
/begin CHARACTERISTIC speedgoat_test_SN5659__cal_impl.Encode4_P7_i "" VALUE 0x0083E4E8 Scalar_FLOAT64_IEEE 0 speedgoat_test_SN5659_R2021b_IO682_CM_double -1.7E+308 1.7E+308 /end CHARACTERISTIC
/begin CHARACTERISTIC speedgoat_test_SN5659__cal_impl.Encode4_P7_pm "" VALUE 0x0083DE78 Scalar_FLOAT64_IEEE 0 speedgoat_test_SN5659_R2021b_IO682_CM_double -1.7E+308 1.7E+308 /end CHARACTERISTIC
/begin CHARACTERISTIC speedgoat_test_SN5659__cal_impl.Encode4_P8_a "" VALUE 0x0083F850 Scalar_FLOAT64_IEEE 0 speedgoat_test_SN5659_R2021b_IO682_CM_double -1.7E+308 1.7E+308 /end CHARACTERISTIC
/begin CHARACTERISTIC speedgoat_test_SN5659__cal_impl.Encode4_P8_c "" VALUE 0x0083FEC0 Scalar_FLOAT64_IEEE 0 speedgoat_test_SN5659_R2021b_IO682_CM_double -1.7E+308 1.7E+308 /end CHARACTERISTIC
/begin CHARACTERISTIC speedgoat_test_SN5659__cal_impl.Encode4_P8_e "" VALUE 0x0083F1E0 Scalar_FLOAT64_IEEE 0 speedgoat_test_SN5659_R2021b_IO682_CM_double -1.7E+308 1.7E+308 /end CHARACTERISTIC
/begin CHARACTERISTIC speedgoat_test_SN5659__cal_impl.Encode4_P8_f "" VALUE 0x0083DE90 Scalar_FLOAT64_IEEE 0 speedgoat_test_SN5659_R2021b_IO682_CM_double -1.7E+308 1.7E+308 /end CHARACTERISTIC
/begin CHARACTERISTIC speedgoat_test_SN5659__cal_impl.Encode4_P8_hv "" VALUE 0x0083E500 Scalar_FLOAT64_IEEE 0 speedgoat_test_SN5659_R2021b_IO682_CM_double -1.7E+308 1.7E+308 /end CHARACTERISTIC
/begin CHARACTERISTIC speedgoat_test_SN5659__cal_impl.Encode4_P9_a "" VALUE 0x0083F868 Scalar_FLOAT64_IEEE 0 speedgoat_test_SN5659_R2021b_IO682_CM_double -1.7E+308 1.7E+308 /end CHARACTERISTIC
/begin CHARACTERISTIC speedgoat_test_SN5659__cal_impl.Encode4_P9_d "" VALUE 0x0083F1F8 Scalar_FLOAT64_IEEE 0 speedgoat_test_SN5659_R2021b_IO682_CM_double -1.7E+308 1.7E+308 /end CHARACTERISTIC
/begin CHARACTERISTIC speedgoat_test_SN5659__cal_impl.Encode4_P9_f "" VALUE 0x0083DEA8 Scalar_FLOAT64_IEEE 0 speedgoat_test_SN5659_R2021b_IO682_CM_double -1.7E+308 1.7E+308 /end CHARACTERISTIC
/begin CHARACTERISTIC speedgoat_test_SN5659__cal_impl.Encode4_P9_l "" VALUE 0x0083E518 Scalar_FLOAT64_IEEE 0 speedgoat_test_SN5659_R2021b_IO682_CM_double -1.7E+308 1.7E+308 /end CHARACTERISTIC
/begin CHARACTERISTIC speedgoat_test_SN5659__cal_impl.Encode4_P9_m "" VALUE 0x0083FED8 Scalar_FLOAT64_IEEE 0 speedgoat_test_SN5659_R2021b_IO682_CM_double -1.7E+308 1.7E+308 /end CHARACTERISTIC
/begin CHARACTERISTIC speedgoat_test_SN5659__cal_impl.Encode5_P10_j "" VALUE 0x0083E870 Scalar_FLOAT64_IEEE 0 speedgoat_test_SN5659_R2021b_IO682_CM_double -1.7E+308 1.7E+308 /end CHARACTERISTIC
/begin CHARACTERISTIC speedgoat_test_SN5659__cal_impl.Encode5_P10_o "" VALUE 0x00840230 Scalar_FLOAT64_IEEE 0 speedgoat_test_SN5659_R2021b_IO682_CM_double -1.7E+308 1.7E+308 /end CHARACTERISTIC
/begin CHARACTERISTIC speedgoat_test_SN5659__cal_impl.Encode5_P11_g "" VAL_BLK 0x00840248 Scalar_FLOAT64_IEEE 0 speedgoat_test_SN5659_R2021b_IO682_CM_double -1.7E+308 1.7E+308 MATRIX_DIM 2 1 /end CHARACTERISTIC
/begin CHARACTERISTIC speedgoat_test_SN5659__cal_impl.Encode5_P11_h "" VAL_BLK 0x0083E888 Scalar_FLOAT64_IEEE 0 speedgoat_test_SN5659_R2021b_IO682_CM_double -1.7E+308 1.7E+308 MATRIX_DIM 2 1 /end CHARACTERISTIC
/begin CHARACTERISTIC speedgoat_test_SN5659__cal_impl.Encode5_P12_c "" VALUE 0x0083E8A8 Scalar_FLOAT64_IEEE 0 speedgoat_test_SN5659_R2021b_IO682_CM_double -1.7E+308 1.7E+308 /end CHARACTERISTIC
/begin CHARACTERISTIC speedgoat_test_SN5659__cal_impl.Encode5_P12_p "" VALUE 0x00840268 Scalar_FLOAT64_IEEE 0 speedgoat_test_SN5659_R2021b_IO682_CM_double -1.7E+308 1.7E+308 /end CHARACTERISTIC
/begin CHARACTERISTIC speedgoat_test_SN5659__cal_impl.Encode5_P13_c "" VALUE 0x0083E8C0 Scalar_FLOAT64_IEEE 0 speedgoat_test_SN5659_R2021b_IO682_CM_double -1.7E+308 1.7E+308 /end CHARACTERISTIC
/begin CHARACTERISTIC speedgoat_test_SN5659__cal_impl.Encode5_P13_m "" VALUE 0x00840280 Scalar_FLOAT64_IEEE 0 speedgoat_test_SN5659_R2021b_IO682_CM_double -1.7E+308 1.7E+308 /end CHARACTERISTIC
/begin CHARACTERISTIC speedgoat_test_SN5659__cal_impl.Encode5_P14_e "" VALUE 0x0083E8D8 Scalar_FLOAT64_IEEE 0 speedgoat_test_SN5659_R2021b_IO682_CM_double -1.7E+308 1.7E+308 /end CHARACTERISTIC
/begin CHARACTERISTIC speedgoat_test_SN5659__cal_impl.Encode5_P14_k "" VALUE 0x00840298 Scalar_FLOAT64_IEEE 0 speedgoat_test_SN5659_R2021b_IO682_CM_double -1.7E+308 1.7E+308 /end CHARACTERISTIC
/begin CHARACTERISTIC speedgoat_test_SN5659__cal_impl.Encode5_P15_a "" VALUE 0x008402B0 Scalar_FLOAT64_IEEE 0 speedgoat_test_SN5659_R2021b_IO682_CM_double -1.7E+308 1.7E+308 /end CHARACTERISTIC
/begin CHARACTERISTIC speedgoat_test_SN5659__cal_impl.Encode5_P15_m "" VALUE 0x0083E8F0 Scalar_FLOAT64_IEEE 0 speedgoat_test_SN5659_R2021b_IO682_CM_double -1.7E+308 1.7E+308 /end CHARACTERISTIC
/begin CHARACTERISTIC speedgoat_test_SN5659__cal_impl.Encode5_P1_a "" VALUE 0x0083E798 Scalar_FLOAT64_IEEE 0 speedgoat_test_SN5659_R2021b_IO682_CM_double -1.7E+308 1.7E+308 /end CHARACTERISTIC
/begin CHARACTERISTIC speedgoat_test_SN5659__cal_impl.Encode5_P1_i "" VALUE 0x00840158 Scalar_FLOAT64_IEEE 0 speedgoat_test_SN5659_R2021b_IO682_CM_double -1.7E+308 1.7E+308 /end CHARACTERISTIC
/begin CHARACTERISTIC speedgoat_test_SN5659__cal_impl.Encode5_P2_b "" VALUE 0x00840170 Scalar_FLOAT64_IEEE 0 speedgoat_test_SN5659_R2021b_IO682_CM_double -1.7E+308 1.7E+308 /end CHARACTERISTIC
/begin CHARACTERISTIC speedgoat_test_SN5659__cal_impl.Encode5_P2_l "" VALUE 0x0083E7B0 Scalar_FLOAT64_IEEE 0 speedgoat_test_SN5659_R2021b_IO682_CM_double -1.7E+308 1.7E+308 /end CHARACTERISTIC
/begin CHARACTERISTIC speedgoat_test_SN5659__cal_impl.Encode5_P3_c "" VALUE 0x0083E7C8 Scalar_FLOAT64_IEEE 0 speedgoat_test_SN5659_R2021b_IO682_CM_double -1.7E+308 1.7E+308 /end CHARACTERISTIC
/begin CHARACTERISTIC speedgoat_test_SN5659__cal_impl.Encode5_P3_i "" VALUE 0x00840188 Scalar_FLOAT64_IEEE 0 speedgoat_test_SN5659_R2021b_IO682_CM_double -1.7E+308 1.7E+308 /end CHARACTERISTIC
/begin CHARACTERISTIC speedgoat_test_SN5659__cal_impl.Encode5_P4_k "" VALUE 0x008401A0 Scalar_FLOAT64_IEEE 0 speedgoat_test_SN5659_R2021b_IO682_CM_double -1.7E+308 1.7E+308 /end CHARACTERISTIC
/begin CHARACTERISTIC speedgoat_test_SN5659__cal_impl.Encode5_P4_o "" VALUE 0x0083E7E0 Scalar_FLOAT64_IEEE 0 speedgoat_test_SN5659_R2021b_IO682_CM_double -1.7E+308 1.7E+308 /end CHARACTERISTIC
/begin CHARACTERISTIC speedgoat_test_SN5659__cal_impl.Encode5_P5_ih "" VALUE 0x0083E7F8 Scalar_FLOAT64_IEEE 0 speedgoat_test_SN5659_R2021b_IO682_CM_double -1.7E+308 1.7E+308 /end CHARACTERISTIC
/begin CHARACTERISTIC speedgoat_test_SN5659__cal_impl.Encode5_P5_o "" VALUE 0x008401B8 Scalar_FLOAT64_IEEE 0 speedgoat_test_SN5659_R2021b_IO682_CM_double -1.7E+308 1.7E+308 /end CHARACTERISTIC
/begin CHARACTERISTIC speedgoat_test_SN5659__cal_impl.Encode5_P6_j "" VALUE 0x008401D0 Scalar_FLOAT64_IEEE 0 speedgoat_test_SN5659_R2021b_IO682_CM_double -1.7E+308 1.7E+308 /end CHARACTERISTIC
/begin CHARACTERISTIC speedgoat_test_SN5659__cal_impl.Encode5_P6_o "" VALUE 0x0083E810 Scalar_FLOAT64_IEEE 0 speedgoat_test_SN5659_R2021b_IO682_CM_double -1.7E+308 1.7E+308 /end CHARACTERISTIC
/begin CHARACTERISTIC speedgoat_test_SN5659__cal_impl.Encode5_P7_h "" VALUE 0x008401E8 Scalar_FLOAT64_IEEE 0 speedgoat_test_SN5659_R2021b_IO682_CM_double -1.7E+308 1.7E+308 /end CHARACTERISTIC
/begin CHARACTERISTIC speedgoat_test_SN5659__cal_impl.Encode5_P7_l "" VALUE 0x0083E828 Scalar_FLOAT64_IEEE 0 speedgoat_test_SN5659_R2021b_IO682_CM_double -1.7E+308 1.7E+308 /end CHARACTERISTIC
/begin CHARACTERISTIC speedgoat_test_SN5659__cal_impl.Encode5_P8_i "" VALUE 0x00840200 Scalar_FLOAT64_IEEE 0 speedgoat_test_SN5659_R2021b_IO682_CM_double -1.7E+308 1.7E+308 /end CHARACTERISTIC
/begin CHARACTERISTIC speedgoat_test_SN5659__cal_impl.Encode5_P8_m "" VALUE 0x0083E840 Scalar_FLOAT64_IEEE 0 speedgoat_test_SN5659_R2021b_IO682_CM_double -1.7E+308 1.7E+308 /end CHARACTERISTIC
/begin CHARACTERISTIC speedgoat_test_SN5659__cal_impl.Encode5_P9_g "" VALUE 0x00840218 Scalar_FLOAT64_IEEE 0 speedgoat_test_SN5659_R2021b_IO682_CM_double -1.7E+308 1.7E+308 /end CHARACTERISTIC
/begin CHARACTERISTIC speedgoat_test_SN5659__cal_impl.Encode5_P9_o "" VALUE 0x0083E858 Scalar_FLOAT64_IEEE 0 speedgoat_test_SN5659_R2021b_IO682_CM_double -1.7E+308 1.7E+308 /end CHARACTERISTIC
/begin CHARACTERISTIC speedgoat_test_SN5659__cal_impl.FixPtConstant_Value_b "" VALUE 0x0084073A Scalar_UWORD 0 speedgoat_test_SN5659_R2021b_IO682_CM_uint16 0 65535 /end CHARACTERISTIC
/begin CHARACTERISTIC speedgoat_test_SN5659__cal_impl.FixPtConstant_Value_ie "" VALUE 0x00840734 Scalar_UWORD 0 speedgoat_test_SN5659_R2021b_IO682_CM_uint16 0 65535 /end CHARACTERISTIC
/begin CHARACTERISTIC speedgoat_test_SN5659__cal_impl.FixPtConstant_Value_jp "" VALUE 0x00840740 Scalar_UWORD 0 speedgoat_test_SN5659_R2021b_IO682_CM_uint16 0 65535 /end CHARACTERISTIC
/begin CHARACTERISTIC speedgoat_test_SN5659__cal_impl.FixPtConstant_Value_k "" VALUE 0x00840722 Scalar_UWORD 0 speedgoat_test_SN5659_R2021b_IO682_CM_uint16 0 65535 /end CHARACTERISTIC
/begin CHARACTERISTIC speedgoat_test_SN5659__cal_impl.FixPtConstant_Value_m "" VALUE 0x00840728 Scalar_UWORD 0 speedgoat_test_SN5659_R2021b_IO682_CM_uint16 0 65535 /end CHARACTERISTIC
/begin CHARACTERISTIC speedgoat_test_SN5659__cal_impl.FixPtConstant_Value_n "" VALUE 0x0084072E Scalar_UWORD 0 speedgoat_test_SN5659_R2021b_IO682_CM_uint16 0 65535 /end CHARACTERISTIC
/begin CHARACTERISTIC speedgoat_test_SN5659__cal_impl.FixPtConstant_Value_oq "" VALUE 0x0084071C Scalar_UWORD 0 speedgoat_test_SN5659_R2021b_IO682_CM_uint16 0 65535 /end CHARACTERISTIC
/begin CHARACTERISTIC speedgoat_test_SN5659__cal_impl.Label_Value_fv "" VALUE 0x008406A4 Scalar_ULONG 0 speedgoat_test_SN5659_R2021b_IO682_CM_uint32 0 2147483646 /end CHARACTERISTIC
/begin CHARACTERISTIC speedgoat_test_SN5659__cal_impl.Label_Value_jf "" VALUE 0x008406D4 Scalar_ULONG 0 speedgoat_test_SN5659_R2021b_IO682_CM_uint32 0 2147483646 /end CHARACTERISTIC
/begin CHARACTERISTIC speedgoat_test_SN5659__cal_impl.Label_Value_kg "" VALUE 0x008406EC Scalar_ULONG 0 speedgoat_test_SN5659_R2021b_IO682_CM_uint32 0 2147483646 /end CHARACTERISTIC
/begin CHARACTERISTIC speedgoat_test_SN5659__cal_impl.Label_Value_kp "" VALUE 0x008406BC Scalar_ULONG 0 speedgoat_test_SN5659_R2021b_IO682_CM_uint32 0 2147483646 /end CHARACTERISTIC
/begin CHARACTERISTIC speedgoat_test_SN5659__cal_impl.Label_Value_l "" VALUE 0x008406B0 Scalar_ULONG 0 speedgoat_test_SN5659_R2021b_IO682_CM_uint32 0 2147483646 /end CHARACTERISTIC
/begin CHARACTERISTIC speedgoat_test_SN5659__cal_impl.Label_Value_n "" VALUE 0x00840698 Scalar_ULONG 0 speedgoat_test_SN5659_R2021b_IO682_CM_uint32 0 2147483646 /end CHARACTERISTIC
/begin CHARACTERISTIC speedgoat_test_SN5659__cal_impl.Label_Value_p "" VALUE 0x008406C8 Scalar_ULONG 0 speedgoat_test_SN5659_R2021b_IO682_CM_uint32 0 2147483646 /end CHARACTERISTIC
/begin CHARACTERISTIC speedgoat_test_SN5659__cal_impl.Label_Value_pn "" VALUE 0x008406E0 Scalar_ULONG 0 speedgoat_test_SN5659_R2021b_IO682_CM_uint32 0 2147483646 /end CHARACTERISTIC
/begin CHARACTERISTIC speedgoat_test_SN5659__cal_impl.Mask_BitMask_c "" VALUE 0x0083304C Scalar_ULONG 0 speedgoat_test_SN5659_R2021b_IO682_CM_uint32 0 2147483646 /end CHARACTERISTIC
/begin CHARACTERISTIC speedgoat_test_SN5659__cal_impl.Mask_BitMask_cx "" VALUE 0x0083305C Scalar_ULONG 0 speedgoat_test_SN5659_R2021b_IO682_CM_uint32 0 2147483646 /end CHARACTERISTIC
/begin CHARACTERISTIC speedgoat_test_SN5659__cal_impl.Mask_BitMask_e3 "" VALUE 0x00833044 Scalar_ULONG 0 speedgoat_test_SN5659_R2021b_IO682_CM_uint32 0 2147483646 /end CHARACTERISTIC
/begin CHARACTERISTIC speedgoat_test_SN5659__cal_impl.Mask_BitMask_er "" VALUE 0x00833050 Scalar_ULONG 0 speedgoat_test_SN5659_R2021b_IO682_CM_uint32 0 2147483646 /end CHARACTERISTIC
/begin CHARACTERISTIC speedgoat_test_SN5659__cal_impl.Mask_BitMask_f "" VALUE 0x00833048 Scalar_ULONG 0 speedgoat_test_SN5659_R2021b_IO682_CM_uint32 0 2147483646 /end CHARACTERISTIC
/begin CHARACTERISTIC speedgoat_test_SN5659__cal_impl.Mask_BitMask_f3 "" VALUE 0x00833054 Scalar_ULONG 0 speedgoat_test_SN5659_R2021b_IO682_CM_uint32 0 2147483646 /end CHARACTERISTIC
/begin CHARACTERISTIC speedgoat_test_SN5659__cal_impl.Mask_BitMask_kz "" VALUE 0x00833058 Scalar_ULONG 0 speedgoat_test_SN5659_R2021b_IO682_CM_uint32 0 2147483646 /end CHARACTERISTIC
/begin CHARACTERISTIC speedgoat_test_SN5659__cal_impl.Mask_BitMask_l "" VALUE 0x00833040 Scalar_ULONG 0 speedgoat_test_SN5659_R2021b_IO682_CM_uint32 0 2147483646 /end CHARACTERISTIC
/begin CHARACTERISTIC speedgoat_test_SN5659__cal_impl.Output_InitialCondition_a "" VALUE 0x00840738 Scalar_UWORD 0 speedgoat_test_SN5659_R2021b_IO682_CM_uint16 0 65535 /end CHARACTERISTIC
/begin CHARACTERISTIC speedgoat_test_SN5659__cal_impl.Output_InitialCondition_aw "" VALUE 0x0084073E Scalar_UWORD 0 speedgoat_test_SN5659_R2021b_IO682_CM_uint16 0 65535 /end CHARACTERISTIC
/begin CHARACTERISTIC speedgoat_test_SN5659__cal_impl.Output_InitialCondition_d "" VALUE 0x00840720 Scalar_UWORD 0 speedgoat_test_SN5659_R2021b_IO682_CM_uint16 0 65535 /end CHARACTERISTIC
/begin CHARACTERISTIC speedgoat_test_SN5659__cal_impl.Output_InitialCondition_dr "" VALUE 0x00840732 Scalar_UWORD 0 speedgoat_test_SN5659_R2021b_IO682_CM_uint16 0 65535 /end CHARACTERISTIC
/begin CHARACTERISTIC speedgoat_test_SN5659__cal_impl.Output_InitialCondition_h "" VALUE 0x0084071A Scalar_UWORD 0 speedgoat_test_SN5659_R2021b_IO682_CM_uint16 0 65535 /end CHARACTERISTIC
/begin CHARACTERISTIC speedgoat_test_SN5659__cal_impl.Output_InitialCondition_h3 "" VALUE 0x0084072C Scalar_UWORD 0 speedgoat_test_SN5659_R2021b_IO682_CM_uint16 0 65535 /end CHARACTERISTIC
/begin CHARACTERISTIC speedgoat_test_SN5659__cal_impl.Output_InitialCondition_nb "" VALUE 0x00840726 Scalar_UWORD 0 speedgoat_test_SN5659_R2021b_IO682_CM_uint16 0 65535 /end CHARACTERISTIC
/begin CHARACTERISTIC speedgoat_test_SN5659__cal_impl.Randomnumber_Mean_c "" VALUE 0x0083E600 Scalar_FLOAT64_IEEE 0 speedgoat_test_SN5659_R2021b_IO682_CM_double -1.7E+308 1.7E+308 /end CHARACTERISTIC
/begin CHARACTERISTIC speedgoat_test_SN5659__cal_impl.Randomnumber_Mean_d "" VALUE 0x0083D920 Scalar_FLOAT64_IEEE 0 speedgoat_test_SN5659_R2021b_IO682_CM_double -1.7E+308 1.7E+308 /end CHARACTERISTIC
/begin CHARACTERISTIC speedgoat_test_SN5659__cal_impl.Randomnumber_Mean_fb "" VALUE 0x0083FFC0 Scalar_FLOAT64_IEEE 0 speedgoat_test_SN5659_R2021b_IO682_CM_double -1.7E+308 1.7E+308 /end CHARACTERISTIC
/begin CHARACTERISTIC speedgoat_test_SN5659__cal_impl.Randomnumber_Mean_l "" VALUE 0x0083EC70 Scalar_FLOAT64_IEEE 0 speedgoat_test_SN5659_R2021b_IO682_CM_double -1.7E+308 1.7E+308 /end CHARACTERISTIC
/begin CHARACTERISTIC speedgoat_test_SN5659__cal_impl.Randomnumber_Mean_p "" VALUE 0x0083DF90 Scalar_FLOAT64_IEEE 0 speedgoat_test_SN5659_R2021b_IO682_CM_double -1.7E+308 1.7E+308 /end CHARACTERISTIC
/begin CHARACTERISTIC speedgoat_test_SN5659__cal_impl.Randomnumber_Mean_pl "" VALUE 0x0083F2E0 Scalar_FLOAT64_IEEE 0 speedgoat_test_SN5659_R2021b_IO682_CM_double -1.7E+308 1.7E+308 /end CHARACTERISTIC
/begin CHARACTERISTIC speedgoat_test_SN5659__cal_impl.Randomnumber_Mean_pz "" VALUE 0x0083F950 Scalar_FLOAT64_IEEE 0 speedgoat_test_SN5659_R2021b_IO682_CM_double -1.7E+308 1.7E+308 /end CHARACTERISTIC
/begin CHARACTERISTIC speedgoat_test_SN5659__cal_impl.Randomnumber_Seed_cg "" VALUE 0x0083EC80 Scalar_FLOAT64_IEEE 0 speedgoat_test_SN5659_R2021b_IO682_CM_double -1.7E+308 1.7E+308 /end CHARACTERISTIC
/begin CHARACTERISTIC speedgoat_test_SN5659__cal_impl.Randomnumber_Seed_e "" VALUE 0x0083F2F0 Scalar_FLOAT64_IEEE 0 speedgoat_test_SN5659_R2021b_IO682_CM_double -1.7E+308 1.7E+308 /end CHARACTERISTIC
/begin CHARACTERISTIC speedgoat_test_SN5659__cal_impl.Randomnumber_Seed_fq "" VALUE 0x0083D930 Scalar_FLOAT64_IEEE 0 speedgoat_test_SN5659_R2021b_IO682_CM_double -1.7E+308 1.7E+308 /end CHARACTERISTIC
/begin CHARACTERISTIC speedgoat_test_SN5659__cal_impl.Randomnumber_Seed_i "" VALUE 0x0083DFA0 Scalar_FLOAT64_IEEE 0 speedgoat_test_SN5659_R2021b_IO682_CM_double -1.7E+308 1.7E+308 /end CHARACTERISTIC
/begin CHARACTERISTIC speedgoat_test_SN5659__cal_impl.Randomnumber_Seed_j "" VALUE 0x0083FFD0 Scalar_FLOAT64_IEEE 0 speedgoat_test_SN5659_R2021b_IO682_CM_double -1.7E+308 1.7E+308 /end CHARACTERISTIC
/begin CHARACTERISTIC speedgoat_test_SN5659__cal_impl.Randomnumber_Seed_l "" VALUE 0x0083F960 Scalar_FLOAT64_IEEE 0 speedgoat_test_SN5659_R2021b_IO682_CM_double -1.7E+308 1.7E+308 /end CHARACTERISTIC
/begin CHARACTERISTIC speedgoat_test_SN5659__cal_impl.Randomnumber_Seed_o "" VALUE 0x0083E610 Scalar_FLOAT64_IEEE 0 speedgoat_test_SN5659_R2021b_IO682_CM_double -1.7E+308 1.7E+308 /end CHARACTERISTIC
/begin CHARACTERISTIC speedgoat_test_SN5659__cal_impl.Randomnumber_StdDev_b "" VALUE 0x0083DF98 Scalar_FLOAT64_IEEE 0 speedgoat_test_SN5659_R2021b_IO682_CM_double -1.7E+308 1.7E+308 /end CHARACTERISTIC
/begin CHARACTERISTIC speedgoat_test_SN5659__cal_impl.Randomnumber_StdDev_e "" VALUE 0x0083F958 Scalar_FLOAT64_IEEE 0 speedgoat_test_SN5659_R2021b_IO682_CM_double -1.7E+308 1.7E+308 /end CHARACTERISTIC
/begin CHARACTERISTIC speedgoat_test_SN5659__cal_impl.Randomnumber_StdDev_f "" VALUE 0x0083D928 Scalar_FLOAT64_IEEE 0 speedgoat_test_SN5659_R2021b_IO682_CM_double -1.7E+308 1.7E+308 /end CHARACTERISTIC
/begin CHARACTERISTIC speedgoat_test_SN5659__cal_impl.Randomnumber_StdDev_fs "" VALUE 0x0083F2E8 Scalar_FLOAT64_IEEE 0 speedgoat_test_SN5659_R2021b_IO682_CM_double -1.7E+308 1.7E+308 /end CHARACTERISTIC
/begin CHARACTERISTIC speedgoat_test_SN5659__cal_impl.Randomnumber_StdDev_mo "" VALUE 0x0083E608 Scalar_FLOAT64_IEEE 0 speedgoat_test_SN5659_R2021b_IO682_CM_double -1.7E+308 1.7E+308 /end CHARACTERISTIC
/begin CHARACTERISTIC speedgoat_test_SN5659__cal_impl.Randomnumber_StdDev_o "" VALUE 0x0083EC78 Scalar_FLOAT64_IEEE 0 speedgoat_test_SN5659_R2021b_IO682_CM_double -1.7E+308 1.7E+308 /end CHARACTERISTIC
/begin CHARACTERISTIC speedgoat_test_SN5659__cal_impl.Randomnumber_StdDev_oa "" VALUE 0x0083FFC8 Scalar_FLOAT64_IEEE 0 speedgoat_test_SN5659_R2021b_IO682_CM_double -1.7E+308 1.7E+308 /end CHARACTERISTIC
/begin CHARACTERISTIC speedgoat_test_SN5659__cal_impl.SDI_Value_ai "" VALUE 0x008406B8 Scalar_ULONG 0 speedgoat_test_SN5659_R2021b_IO682_CM_uint32 0 2147483646 /end CHARACTERISTIC
/begin CHARACTERISTIC speedgoat_test_SN5659__cal_impl.SDI_Value_g "" VALUE 0x008406AC Scalar_ULONG 0 speedgoat_test_SN5659_R2021b_IO682_CM_uint32 0 2147483646 /end CHARACTERISTIC
/begin CHARACTERISTIC speedgoat_test_SN5659__cal_impl.SDI_Value_ig "" VALUE 0x008406C4 Scalar_ULONG 0 speedgoat_test_SN5659_R2021b_IO682_CM_uint32 0 2147483646 /end CHARACTERISTIC
/begin CHARACTERISTIC speedgoat_test_SN5659__cal_impl.SDI_Value_im "" VALUE 0x008406DC Scalar_ULONG 0 speedgoat_test_SN5659_R2021b_IO682_CM_uint32 0 2147483646 /end CHARACTERISTIC
/begin CHARACTERISTIC speedgoat_test_SN5659__cal_impl.SDI_Value_k "" VALUE 0x008406D0 Scalar_ULONG 0 speedgoat_test_SN5659_R2021b_IO682_CM_uint32 0 2147483646 /end CHARACTERISTIC
/begin CHARACTERISTIC speedgoat_test_SN5659__cal_impl.SDI_Value_l4 "" VALUE 0x00840694 Scalar_ULONG 0 speedgoat_test_SN5659_R2021b_IO682_CM_uint32 0 2147483646 /end CHARACTERISTIC
/begin CHARACTERISTIC speedgoat_test_SN5659__cal_impl.SDI_Value_mq "" VALUE 0x008406E8 Scalar_ULONG 0 speedgoat_test_SN5659_R2021b_IO682_CM_uint32 0 2147483646 /end CHARACTERISTIC
/begin CHARACTERISTIC speedgoat_test_SN5659__cal_impl.SDI_Value_p "" VALUE 0x008406A0 Scalar_ULONG 0 speedgoat_test_SN5659_R2021b_IO682_CM_uint32 0 2147483646 /end CHARACTERISTIC
/begin CHARACTERISTIC speedgoat_test_SN5659__cal_impl.SSM_Value_a "" VALUE 0x008406C0 Scalar_ULONG 0 speedgoat_test_SN5659_R2021b_IO682_CM_uint32 0 2147483646 /end CHARACTERISTIC
/begin CHARACTERISTIC speedgoat_test_SN5659__cal_impl.SSM_Value_f "" VALUE 0x008406B4 Scalar_ULONG 0 speedgoat_test_SN5659_R2021b_IO682_CM_uint32 0 2147483646 /end CHARACTERISTIC
/begin CHARACTERISTIC speedgoat_test_SN5659__cal_impl.SSM_Value_g "" VALUE 0x008406CC Scalar_ULONG 0 speedgoat_test_SN5659_R2021b_IO682_CM_uint32 0 2147483646 /end CHARACTERISTIC
/begin CHARACTERISTIC speedgoat_test_SN5659__cal_impl.SSM_Value_jt "" VALUE 0x008406E4 Scalar_ULONG 0 speedgoat_test_SN5659_R2021b_IO682_CM_uint32 0 2147483646 /end CHARACTERISTIC
/begin CHARACTERISTIC speedgoat_test_SN5659__cal_impl.SSM_Value_na "" VALUE 0x00840690 Scalar_ULONG 0 speedgoat_test_SN5659_R2021b_IO682_CM_uint32 0 2147483646 /end CHARACTERISTIC
/begin CHARACTERISTIC speedgoat_test_SN5659__cal_impl.SSM_Value_nl "" VALUE 0x008406A8 Scalar_ULONG 0 speedgoat_test_SN5659_R2021b_IO682_CM_uint32 0 2147483646 /end CHARACTERISTIC
/begin CHARACTERISTIC speedgoat_test_SN5659__cal_impl.SSM_Value_os "" VALUE 0x0084069C Scalar_ULONG 0 speedgoat_test_SN5659_R2021b_IO682_CM_uint32 0 2147483646 /end CHARACTERISTIC
/begin CHARACTERISTIC speedgoat_test_SN5659__cal_impl.SSM_Value_p "" VALUE 0x008406D8 Scalar_ULONG 0 speedgoat_test_SN5659_R2021b_IO682_CM_uint32 0 2147483646 /end CHARACTERISTIC
/begin CHARACTERISTIC speedgoat_test_SN5659__cal_impl.Scale_Value_e "" VALUE 0x0083DDC8 Scalar_FLOAT64_IEEE 0 speedgoat_test_SN5659_R2021b_IO682_CM_double -1.7E+308 1.7E+308 /end CHARACTERISTIC
/begin CHARACTERISTIC speedgoat_test_SN5659__cal_impl.Scale_Value_e3 "" VALUE 0x0083F788 Scalar_FLOAT64_IEEE 0 speedgoat_test_SN5659_R2021b_IO682_CM_double -1.7E+308 1.7E+308 /end CHARACTERISTIC
/begin CHARACTERISTIC speedgoat_test_SN5659__cal_impl.Scale_Value_g "" VALUE 0x0083EAA8 Scalar_FLOAT64_IEEE 0 speedgoat_test_SN5659_R2021b_IO682_CM_double -1.7E+308 1.7E+308 /end CHARACTERISTIC
/begin CHARACTERISTIC speedgoat_test_SN5659__cal_impl.Scale_Value_h "" VALUE 0x0083F118 Scalar_FLOAT64_IEEE 0 speedgoat_test_SN5659_R2021b_IO682_CM_double -1.7E+308 1.7E+308 /end CHARACTERISTIC
/begin CHARACTERISTIC speedgoat_test_SN5659__cal_impl.Scale_Value_k "" VALUE 0x0083D758 Scalar_FLOAT64_IEEE 0 speedgoat_test_SN5659_R2021b_IO682_CM_double -1.7E+308 1.7E+308 /end CHARACTERISTIC
/begin CHARACTERISTIC speedgoat_test_SN5659__cal_impl.Scale_Value_kb "" VALUE 0x0083FDF8 Scalar_FLOAT64_IEEE 0 speedgoat_test_SN5659_R2021b_IO682_CM_double -1.7E+308 1.7E+308 /end CHARACTERISTIC
/begin CHARACTERISTIC speedgoat_test_SN5659__cal_impl.Scale_Value_n "" VALUE 0x00840468 Scalar_FLOAT64_IEEE 0 speedgoat_test_SN5659_R2021b_IO682_CM_double -1.7E+308 1.7E+308 /end CHARACTERISTIC
/begin CHARACTERISTIC speedgoat_test_SN5659__cal_impl.Scale_Value_o "" VALUE 0x0083E438 Scalar_FLOAT64_IEEE 0 speedgoat_test_SN5659_R2021b_IO682_CM_double -1.7E+308 1.7E+308 /end CHARACTERISTIC
/begin CHARACTERISTIC speedgoat_test_SN5659__cal_impl.Sinewave_Amp_a "" VALUE 0x0083DC18 Scalar_FLOAT64_IEEE 0 speedgoat_test_SN5659_R2021b_IO682_CM_double -1.7E+308 1.7E+308 /end CHARACTERISTIC
/begin CHARACTERISTIC speedgoat_test_SN5659__cal_impl.Sinewave_Amp_ch "" VALUE 0x0083F5D8 Scalar_FLOAT64_IEEE 0 speedgoat_test_SN5659_R2021b_IO682_CM_double -1.7E+308 1.7E+308 /end CHARACTERISTIC
/begin CHARACTERISTIC speedgoat_test_SN5659__cal_impl.Sinewave_Amp_f "" VALUE 0x008402B8 Scalar_FLOAT64_IEEE 0 speedgoat_test_SN5659_R2021b_IO682_CM_double -1.7E+308 1.7E+308 /end CHARACTERISTIC
/begin CHARACTERISTIC speedgoat_test_SN5659__cal_impl.Sinewave_Amp_h5 "" VALUE 0x0083E8F8 Scalar_FLOAT64_IEEE 0 speedgoat_test_SN5659_R2021b_IO682_CM_double -1.7E+308 1.7E+308 /end CHARACTERISTIC
/begin CHARACTERISTIC speedgoat_test_SN5659__cal_impl.Sinewave_Amp_hw "" VALUE 0x0083FC48 Scalar_FLOAT64_IEEE 0 speedgoat_test_SN5659_R2021b_IO682_CM_double -1.7E+308 1.7E+308 /end CHARACTERISTIC
/begin CHARACTERISTIC speedgoat_test_SN5659__cal_impl.Sinewave_Amp_m "" VALUE 0x0083E288 Scalar_FLOAT64_IEEE 0 speedgoat_test_SN5659_R2021b_IO682_CM_double -1.7E+308 1.7E+308 /end CHARACTERISTIC
/begin CHARACTERISTIC speedgoat_test_SN5659__cal_impl.Sinewave_Amp_m2 "" VALUE 0x0083EF68 Scalar_FLOAT64_IEEE 0 speedgoat_test_SN5659_R2021b_IO682_CM_double -1.7E+308 1.7E+308 /end CHARACTERISTIC
/begin CHARACTERISTIC speedgoat_test_SN5659__cal_impl.Sinewave_Bias_a "" VALUE 0x0083E900 Scalar_FLOAT64_IEEE 0 speedgoat_test_SN5659_R2021b_IO682_CM_double -1.7E+308 1.7E+308 /end CHARACTERISTIC
/begin CHARACTERISTIC speedgoat_test_SN5659__cal_impl.Sinewave_Bias_ac "" VALUE 0x0083EF70 Scalar_FLOAT64_IEEE 0 speedgoat_test_SN5659_R2021b_IO682_CM_double -1.7E+308 1.7E+308 /end CHARACTERISTIC
/begin CHARACTERISTIC speedgoat_test_SN5659__cal_impl.Sinewave_Bias_d "" VALUE 0x0083F5E0 Scalar_FLOAT64_IEEE 0 speedgoat_test_SN5659_R2021b_IO682_CM_double -1.7E+308 1.7E+308 /end CHARACTERISTIC
/begin CHARACTERISTIC speedgoat_test_SN5659__cal_impl.Sinewave_Bias_je "" VALUE 0x008402C0 Scalar_FLOAT64_IEEE 0 speedgoat_test_SN5659_R2021b_IO682_CM_double -1.7E+308 1.7E+308 /end CHARACTERISTIC
/begin CHARACTERISTIC speedgoat_test_SN5659__cal_impl.Sinewave_Bias_mn "" VALUE 0x0083DC20 Scalar_FLOAT64_IEEE 0 speedgoat_test_SN5659_R2021b_IO682_CM_double -1.7E+308 1.7E+308 /end CHARACTERISTIC
/begin CHARACTERISTIC speedgoat_test_SN5659__cal_impl.Sinewave_Bias_o "" VALUE 0x0083E290 Scalar_FLOAT64_IEEE 0 speedgoat_test_SN5659_R2021b_IO682_CM_double -1.7E+308 1.7E+308 /end CHARACTERISTIC
/begin CHARACTERISTIC speedgoat_test_SN5659__cal_impl.Sinewave_Bias_p "" VALUE 0x0083FC50 Scalar_FLOAT64_IEEE 0 speedgoat_test_SN5659_R2021b_IO682_CM_double -1.7E+308 1.7E+308 /end CHARACTERISTIC
/begin CHARACTERISTIC speedgoat_test_SN5659__cal_impl.Sinewave_Freq_a2 "" VALUE 0x0083F5E8 Scalar_FLOAT64_IEEE 0 speedgoat_test_SN5659_R2021b_IO682_CM_double -1.7E+308 1.7E+308 /end CHARACTERISTIC
/begin CHARACTERISTIC speedgoat_test_SN5659__cal_impl.Sinewave_Freq_am "" VALUE 0x0083E908 Scalar_FLOAT64_IEEE 0 speedgoat_test_SN5659_R2021b_IO682_CM_double -1.7E+308 1.7E+308 /end CHARACTERISTIC
/begin CHARACTERISTIC speedgoat_test_SN5659__cal_impl.Sinewave_Freq_b "" VALUE 0x0083DC28 Scalar_FLOAT64_IEEE 0 speedgoat_test_SN5659_R2021b_IO682_CM_double -1.7E+308 1.7E+308 /end CHARACTERISTIC
/begin CHARACTERISTIC speedgoat_test_SN5659__cal_impl.Sinewave_Freq_cn "" VALUE 0x0083EF78 Scalar_FLOAT64_IEEE 0 speedgoat_test_SN5659_R2021b_IO682_CM_double -1.7E+308 1.7E+308 /end CHARACTERISTIC
/begin CHARACTERISTIC speedgoat_test_SN5659__cal_impl.Sinewave_Freq_j "" VALUE 0x0083FC58 Scalar_FLOAT64_IEEE 0 speedgoat_test_SN5659_R2021b_IO682_CM_double -1.7E+308 1.7E+308 /end CHARACTERISTIC
/begin CHARACTERISTIC speedgoat_test_SN5659__cal_impl.Sinewave_Freq_k "" VALUE 0x008402C8 Scalar_FLOAT64_IEEE 0 speedgoat_test_SN5659_R2021b_IO682_CM_double -1.7E+308 1.7E+308 /end CHARACTERISTIC
/begin CHARACTERISTIC speedgoat_test_SN5659__cal_impl.Sinewave_Freq_lw "" VALUE 0x0083E298 Scalar_FLOAT64_IEEE 0 speedgoat_test_SN5659_R2021b_IO682_CM_double -1.7E+308 1.7E+308 /end CHARACTERISTIC
/begin CHARACTERISTIC speedgoat_test_SN5659__cal_impl.Sinewave_HCos_bz "" VALUE 0x0083DC38 Scalar_FLOAT64_IEEE 0 speedgoat_test_SN5659_R2021b_IO682_CM_double -1.7E+308 1.7E+308 /end CHARACTERISTIC
/begin CHARACTERISTIC speedgoat_test_SN5659__cal_impl.Sinewave_HCos_e "" VALUE 0x0083E2A8 Scalar_FLOAT64_IEEE 0 speedgoat_test_SN5659_R2021b_IO682_CM_double -1.7E+308 1.7E+308 /end CHARACTERISTIC
/begin CHARACTERISTIC speedgoat_test_SN5659__cal_impl.Sinewave_HCos_h "" VALUE 0x0083F5F8 Scalar_FLOAT64_IEEE 0 speedgoat_test_SN5659_R2021b_IO682_CM_double -1.7E+308 1.7E+308 /end CHARACTERISTIC
/begin CHARACTERISTIC speedgoat_test_SN5659__cal_impl.Sinewave_HCos_h2 "" VALUE 0x0083FC68 Scalar_FLOAT64_IEEE 0 speedgoat_test_SN5659_R2021b_IO682_CM_double -1.7E+308 1.7E+308 /end CHARACTERISTIC
/begin CHARACTERISTIC speedgoat_test_SN5659__cal_impl.Sinewave_HCos_i "" VALUE 0x0083EF88 Scalar_FLOAT64_IEEE 0 speedgoat_test_SN5659_R2021b_IO682_CM_double -1.7E+308 1.7E+308 /end CHARACTERISTIC
/begin CHARACTERISTIC speedgoat_test_SN5659__cal_impl.Sinewave_HCos_n "" VALUE 0x008402D8 Scalar_FLOAT64_IEEE 0 speedgoat_test_SN5659_R2021b_IO682_CM_double -1.7E+308 1.7E+308 /end CHARACTERISTIC
/begin CHARACTERISTIC speedgoat_test_SN5659__cal_impl.Sinewave_HCos_p "" VALUE 0x0083E918 Scalar_FLOAT64_IEEE 0 speedgoat_test_SN5659_R2021b_IO682_CM_double -1.7E+308 1.7E+308 /end CHARACTERISTIC
/begin CHARACTERISTIC speedgoat_test_SN5659__cal_impl.Sinewave_Hsin_a "" VALUE 0x0083E2A0 Scalar_FLOAT64_IEEE 0 speedgoat_test_SN5659_R2021b_IO682_CM_double -1.7E+308 1.7E+308 /end CHARACTERISTIC
/begin CHARACTERISTIC speedgoat_test_SN5659__cal_impl.Sinewave_Hsin_c "" VALUE 0x0083EF80 Scalar_FLOAT64_IEEE 0 speedgoat_test_SN5659_R2021b_IO682_CM_double -1.7E+308 1.7E+308 /end CHARACTERISTIC
/begin CHARACTERISTIC speedgoat_test_SN5659__cal_impl.Sinewave_Hsin_cy "" VALUE 0x0083F5F0 Scalar_FLOAT64_IEEE 0 speedgoat_test_SN5659_R2021b_IO682_CM_double -1.7E+308 1.7E+308 /end CHARACTERISTIC
/begin CHARACTERISTIC speedgoat_test_SN5659__cal_impl.Sinewave_Hsin_h4 "" VALUE 0x0083DC30 Scalar_FLOAT64_IEEE 0 speedgoat_test_SN5659_R2021b_IO682_CM_double -1.7E+308 1.7E+308 /end CHARACTERISTIC
/begin CHARACTERISTIC speedgoat_test_SN5659__cal_impl.Sinewave_Hsin_jl "" VALUE 0x0083FC60 Scalar_FLOAT64_IEEE 0 speedgoat_test_SN5659_R2021b_IO682_CM_double -1.7E+308 1.7E+308 /end CHARACTERISTIC
/begin CHARACTERISTIC speedgoat_test_SN5659__cal_impl.Sinewave_Hsin_o2 "" VALUE 0x008402D0 Scalar_FLOAT64_IEEE 0 speedgoat_test_SN5659_R2021b_IO682_CM_double -1.7E+308 1.7E+308 /end CHARACTERISTIC
/begin CHARACTERISTIC speedgoat_test_SN5659__cal_impl.Sinewave_Hsin_p "" VALUE 0x0083E910 Scalar_FLOAT64_IEEE 0 speedgoat_test_SN5659_R2021b_IO682_CM_double -1.7E+308 1.7E+308 /end CHARACTERISTIC
/begin CHARACTERISTIC speedgoat_test_SN5659__cal_impl.Sinewave_PCos_d "" VALUE 0x0083E928 Scalar_FLOAT64_IEEE 0 speedgoat_test_SN5659_R2021b_IO682_CM_double -1.7E+308 1.7E+308 /end CHARACTERISTIC
/begin CHARACTERISTIC speedgoat_test_SN5659__cal_impl.Sinewave_PCos_e "" VALUE 0x0083EF98 Scalar_FLOAT64_IEEE 0 speedgoat_test_SN5659_R2021b_IO682_CM_double -1.7E+308 1.7E+308 /end CHARACTERISTIC
/begin CHARACTERISTIC speedgoat_test_SN5659__cal_impl.Sinewave_PCos_jo "" VALUE 0x0083E2B8 Scalar_FLOAT64_IEEE 0 speedgoat_test_SN5659_R2021b_IO682_CM_double -1.7E+308 1.7E+308 /end CHARACTERISTIC
/begin CHARACTERISTIC speedgoat_test_SN5659__cal_impl.Sinewave_PCos_l "" VALUE 0x0083FC78 Scalar_FLOAT64_IEEE 0 speedgoat_test_SN5659_R2021b_IO682_CM_double -1.7E+308 1.7E+308 /end CHARACTERISTIC
/begin CHARACTERISTIC speedgoat_test_SN5659__cal_impl.Sinewave_PCos_lt "" VALUE 0x008402E8 Scalar_FLOAT64_IEEE 0 speedgoat_test_SN5659_R2021b_IO682_CM_double -1.7E+308 1.7E+308 /end CHARACTERISTIC
/begin CHARACTERISTIC speedgoat_test_SN5659__cal_impl.Sinewave_PCos_ma "" VALUE 0x0083DC48 Scalar_FLOAT64_IEEE 0 speedgoat_test_SN5659_R2021b_IO682_CM_double -1.7E+308 1.7E+308 /end CHARACTERISTIC
/begin CHARACTERISTIC speedgoat_test_SN5659__cal_impl.Sinewave_PCos_n "" VALUE 0x0083F608 Scalar_FLOAT64_IEEE 0 speedgoat_test_SN5659_R2021b_IO682_CM_double -1.7E+308 1.7E+308 /end CHARACTERISTIC
/begin CHARACTERISTIC speedgoat_test_SN5659__cal_impl.Sinewave_PSin_b "" VALUE 0x0083FC70 Scalar_FLOAT64_IEEE 0 speedgoat_test_SN5659_R2021b_IO682_CM_double -1.7E+308 1.7E+308 /end CHARACTERISTIC
/begin CHARACTERISTIC speedgoat_test_SN5659__cal_impl.Sinewave_PSin_bm "" VALUE 0x008402E0 Scalar_FLOAT64_IEEE 0 speedgoat_test_SN5659_R2021b_IO682_CM_double -1.7E+308 1.7E+308 /end CHARACTERISTIC
/begin CHARACTERISTIC speedgoat_test_SN5659__cal_impl.Sinewave_PSin_d "" VALUE 0x0083E920 Scalar_FLOAT64_IEEE 0 speedgoat_test_SN5659_R2021b_IO682_CM_double -1.7E+308 1.7E+308 /end CHARACTERISTIC
/begin CHARACTERISTIC speedgoat_test_SN5659__cal_impl.Sinewave_PSin_gt "" VALUE 0x0083DC40 Scalar_FLOAT64_IEEE 0 speedgoat_test_SN5659_R2021b_IO682_CM_double -1.7E+308 1.7E+308 /end CHARACTERISTIC
/begin CHARACTERISTIC speedgoat_test_SN5659__cal_impl.Sinewave_PSin_l "" VALUE 0x0083EF90 Scalar_FLOAT64_IEEE 0 speedgoat_test_SN5659_R2021b_IO682_CM_double -1.7E+308 1.7E+308 /end CHARACTERISTIC
/begin CHARACTERISTIC speedgoat_test_SN5659__cal_impl.Sinewave_PSin_o "" VALUE 0x0083F600 Scalar_FLOAT64_IEEE 0 speedgoat_test_SN5659_R2021b_IO682_CM_double -1.7E+308 1.7E+308 /end CHARACTERISTIC
/begin CHARACTERISTIC speedgoat_test_SN5659__cal_impl.Sinewave_PSin_px "" VALUE 0x0083E2B0 Scalar_FLOAT64_IEEE 0 speedgoat_test_SN5659_R2021b_IO682_CM_double -1.7E+308 1.7E+308 /end CHARACTERISTIC
/begin CHARACTERISTIC speedgoat_test_SN5659__cal_impl.shiftthedoublevalue27bitslef_hk "" VALUE 0x00840470 Scalar_FLOAT64_IEEE 0 speedgoat_test_SN5659_R2021b_IO682_CM_double -1.7E+308 1.7E+308 /end CHARACTERISTIC
/begin CHARACTERISTIC speedgoat_test_SN5659__cal_impl.shiftthedoublevalue27bitslef_jj "" VALUE 0x0083F790 Scalar_FLOAT64_IEEE 0 speedgoat_test_SN5659_R2021b_IO682_CM_double -1.7E+308 1.7E+308 /end CHARACTERISTIC
/begin CHARACTERISTIC speedgoat_test_SN5659__cal_impl.shiftthedoublevalue27bitslef_jt "" VALUE 0x0083E440 Scalar_FLOAT64_IEEE 0 speedgoat_test_SN5659_R2021b_IO682_CM_double -1.7E+308 1.7E+308 /end CHARACTERISTIC
/begin CHARACTERISTIC speedgoat_test_SN5659__cal_impl.shiftthedoublevalue27bitsleft_b "" VALUE 0x0083F120 Scalar_FLOAT64_IEEE 0 speedgoat_test_SN5659_R2021b_IO682_CM_double -1.7E+308 1.7E+308 /end CHARACTERISTIC
/begin CHARACTERISTIC speedgoat_test_SN5659__cal_impl.shiftthedoublevalue27bitsleft_d "" VALUE 0x0083EAB0 Scalar_FLOAT64_IEEE 0 speedgoat_test_SN5659_R2021b_IO682_CM_double -1.7E+308 1.7E+308 /end CHARACTERISTIC
/begin CHARACTERISTIC speedgoat_test_SN5659__cal_impl.shiftthedoublevalue27bitsleft_f "" VALUE 0x0083FE00 Scalar_FLOAT64_IEEE 0 speedgoat_test_SN5659_R2021b_IO682_CM_double -1.7E+308 1.7E+308 /end CHARACTERISTIC
/begin CHARACTERISTIC speedgoat_test_SN5659__cal_impl.shiftthedoublevalue27bitsleft_j "" VALUE 0x0083D760 Scalar_FLOAT64_IEEE 0 speedgoat_test_SN5659_R2021b_IO682_CM_double -1.7E+308 1.7E+308 /end CHARACTERISTIC
/begin CHARACTERISTIC speedgoat_test_SN5659__cal_impl.shiftthedoublevalue27bitsleft_n "" VALUE 0x0083DDD0 Scalar_FLOAT64_IEEE 0 speedgoat_test_SN5659_R2021b_IO682_CM_double -1.7E+308 1.7E+308 /end CHARACTERISTIC
/begin MEASUREMENT speedgoat_test_SN5659_R2021b_IO682_B.BitwiseOperator_a4 "" ULONG speedgoat_test_SN5659_R2021b_IO682_CM_uint32 0 0 0 2147483646 ECU_ADDRESS 0x00895464 /end MEASUREMENT
/begin MEASUREMENT speedgoat_test_SN5659_R2021b_IO682_B.BitwiseOperator_b "" ULONG speedgoat_test_SN5659_R2021b_IO682_CM_uint32 0 0 0 2147483646 ECU_ADDRESS 0x0089548C /end MEASUREMENT
/begin MEASUREMENT speedgoat_test_SN5659_R2021b_IO682_B.BitwiseOperator_b5 "" ULONG speedgoat_test_SN5659_R2021b_IO682_CM_uint32 0 0 0 2147483646 ECU_ADDRESS 0x008954C8 /end MEASUREMENT
/begin MEASUREMENT speedgoat_test_SN5659_R2021b_IO682_B.BitwiseOperator_eh "" ULONG speedgoat_test_SN5659_R2021b_IO682_CM_uint32 0 0 0 2147483646 ECU_ADDRESS 0x008954A0 /end MEASUREMENT
/begin MEASUREMENT speedgoat_test_SN5659_R2021b_IO682_B.BitwiseOperator_fl "" ULONG speedgoat_test_SN5659_R2021b_IO682_CM_uint32 0 0 0 2147483646 ECU_ADDRESS 0x008954DC /end MEASUREMENT
/begin MEASUREMENT speedgoat_test_SN5659_R2021b_IO682_B.BitwiseOperator_j "" ULONG speedgoat_test_SN5659_R2021b_IO682_CM_uint32 0 0 0 2147483646 ECU_ADDRESS 0x00895450 /end MEASUREMENT
/begin MEASUREMENT speedgoat_test_SN5659_R2021b_IO682_B.BitwiseOperator_n "" ULONG speedgoat_test_SN5659_R2021b_IO682_CM_uint32 0 0 0 2147483646 ECU_ADDRESS 0x008954B4 /end MEASUREMENT
/begin MEASUREMENT speedgoat_test_SN5659_R2021b_IO682_B.BitwiseOperator_pk "" ULONG speedgoat_test_SN5659_R2021b_IO682_CM_uint32 0 0 0 2147483646 ECU_ADDRESS 0x00895478 /end MEASUREMENT
/begin MEASUREMENT speedgoat_test_SN5659_R2021b_IO682_B.DataTypeConversion1_a "" FLOAT64_IEEE speedgoat_test_SN5659_R2021b_IO682_CM_double 0 0 -1.7E+308 1.7E+308 ECU_ADDRESS 0x008951B0 /end MEASUREMENT
/begin MEASUREMENT speedgoat_test_SN5659_R2021b_IO682_B.DataTypeConversion1_e "" FLOAT64_IEEE speedgoat_test_SN5659_R2021b_IO682_CM_double 0 0 -1.7E+308 1.7E+308 ECU_ADDRESS 0x00895390 /end MEASUREMENT
/begin MEASUREMENT speedgoat_test_SN5659_R2021b_IO682_B.DataTypeConversion1_f "" FLOAT64_IEEE speedgoat_test_SN5659_R2021b_IO682_CM_double 0 0 -1.7E+308 1.7E+308 ECU_ADDRESS 0x008952A0 /end MEASUREMENT
/begin MEASUREMENT speedgoat_test_SN5659_R2021b_IO682_B.DataTypeConversion1_fw "" FLOAT64_IEEE speedgoat_test_SN5659_R2021b_IO682_CM_double 0 0 -1.7E+308 1.7E+308 ECU_ADDRESS 0x008952F0 /end MEASUREMENT
/begin MEASUREMENT speedgoat_test_SN5659_R2021b_IO682_B.DataTypeConversion1_gh "" FLOAT64_IEEE speedgoat_test_SN5659_R2021b_IO682_CM_double 0 0 -1.7E+308 1.7E+308 ECU_ADDRESS 0x00895200 /end MEASUREMENT
/begin MEASUREMENT speedgoat_test_SN5659_R2021b_IO682_B.DataTypeConversion1_j "" FLOAT64_IEEE speedgoat_test_SN5659_R2021b_IO682_CM_double 0 0 -1.7E+308 1.7E+308 ECU_ADDRESS 0x00895340 /end MEASUREMENT
/begin MEASUREMENT speedgoat_test_SN5659_R2021b_IO682_B.DataTypeConversion1_nb "" FLOAT64_IEEE speedgoat_test_SN5659_R2021b_IO682_CM_double 0 0 -1.7E+308 1.7E+308 ECU_ADDRESS 0x00895250 /end MEASUREMENT
/begin MEASUREMENT speedgoat_test_SN5659_R2021b_IO682_B.DataTypeConversion_bh "" ULONG speedgoat_test_SN5659_R2021b_IO682_CM_uint32 0 0 0 2147483646 ECU_ADDRESS 0x00895440 /end MEASUREMENT
/begin MEASUREMENT speedgoat_test_SN5659_R2021b_IO682_B.DataTypeConversion_cp "" ULONG speedgoat_test_SN5659_R2021b_IO682_CM_uint32 0 0 0 2147483646 ECU_ADDRESS 0x008954A4 /end MEASUREMENT
/begin MEASUREMENT speedgoat_test_SN5659_R2021b_IO682_B.DataTypeConversion_dd "" FLOAT64_IEEE speedgoat_test_SN5659_R2021b_IO682_CM_double 0 0 -1.7E+308 1.7E+308 ECU_ADDRESS 0x00895180 /end MEASUREMENT
/begin MEASUREMENT speedgoat_test_SN5659_R2021b_IO682_B.DataTypeConversion_dn "" ULONG speedgoat_test_SN5659_R2021b_IO682_CM_uint32 0 0 0 2147483646 ECU_ADDRESS 0x0089547C /end MEASUREMENT
/begin MEASUREMENT speedgoat_test_SN5659_R2021b_IO682_B.DataTypeConversion_dw "" FLOAT64_IEEE speedgoat_test_SN5659_R2021b_IO682_CM_double 0 0 -1.7E+308 1.7E+308 ECU_ADDRESS 0x00895360 /end MEASUREMENT
/begin MEASUREMENT speedgoat_test_SN5659_R2021b_IO682_B.DataTypeConversion_f "" FLOAT64_IEEE speedgoat_test_SN5659_R2021b_IO682_CM_double 0 0 -1.7E+308 1.7E+308 ECU_ADDRESS 0x008951D0 /end MEASUREMENT
/begin MEASUREMENT speedgoat_test_SN5659_R2021b_IO682_B.DataTypeConversion_fr "" ULONG speedgoat_test_SN5659_R2021b_IO682_CM_uint32 0 0 0 2147483646 ECU_ADDRESS 0x00895468 /end MEASUREMENT
/begin MEASUREMENT speedgoat_test_SN5659_R2021b_IO682_B.DataTypeConversion_hb "" FLOAT64_IEEE speedgoat_test_SN5659_R2021b_IO682_CM_double 0 0 -1.7E+308 1.7E+308 ECU_ADDRESS 0x00895220 /end MEASUREMENT
/begin MEASUREMENT speedgoat_test_SN5659_R2021b_IO682_B.DataTypeConversion_i "" FLOAT64_IEEE speedgoat_test_SN5659_R2021b_IO682_CM_double 0 0 -1.7E+308 1.7E+308 ECU_ADDRESS 0x008952C0 /end MEASUREMENT
/begin MEASUREMENT speedgoat_test_SN5659_R2021b_IO682_B.DataTypeConversion_is "" ULONG speedgoat_test_SN5659_R2021b_IO682_CM_uint32 0 0 0 2147483646 ECU_ADDRESS 0x008954B8 /end MEASUREMENT
/begin MEASUREMENT speedgoat_test_SN5659_R2021b_IO682_B.DataTypeConversion_k "" FLOAT64_IEEE speedgoat_test_SN5659_R2021b_IO682_CM_double 0 0 -1.7E+308 1.7E+308 ECU_ADDRESS 0x00895310 /end MEASUREMENT
/begin MEASUREMENT speedgoat_test_SN5659_R2021b_IO682_B.DataTypeConversion_ku "" ULONG speedgoat_test_SN5659_R2021b_IO682_CM_uint32 0 0 0 2147483646 ECU_ADDRESS 0x008954CC /end MEASUREMENT
/begin MEASUREMENT speedgoat_test_SN5659_R2021b_IO682_B.DataTypeConversion_l "" ULONG speedgoat_test_SN5659_R2021b_IO682_CM_uint32 0 0 0 2147483646 ECU_ADDRESS 0x00895454 /end MEASUREMENT
/begin MEASUREMENT speedgoat_test_SN5659_R2021b_IO682_B.DataTypeConversion_m "" ULONG speedgoat_test_SN5659_R2021b_IO682_CM_uint32 0 0 0 2147483646 ECU_ADDRESS 0x00895490 /end MEASUREMENT
/begin MEASUREMENT speedgoat_test_SN5659_R2021b_IO682_B.DataTypeConversion_n "" FLOAT64_IEEE speedgoat_test_SN5659_R2021b_IO682_CM_double 0 0 -1.7E+308 1.7E+308 ECU_ADDRESS 0x00895270 /end MEASUREMENT
/begin MEASUREMENT speedgoat_test_SN5659_R2021b_IO682_B.Divide_c "" FLOAT64_IEEE speedgoat_test_SN5659_R2021b_IO682_CM_double 0 0 -1.7E+308 1.7E+308 ECU_ADDRESS 0x008952E0 /end MEASUREMENT
/begin MEASUREMENT speedgoat_test_SN5659_R2021b_IO682_B.Divide_g4 "" FLOAT64_IEEE speedgoat_test_SN5659_R2021b_IO682_CM_double 0 0 -1.7E+308 1.7E+308 ECU_ADDRESS 0x00895150 /end MEASUREMENT
/begin MEASUREMENT speedgoat_test_SN5659_R2021b_IO682_B.Divide_m "" FLOAT64_IEEE speedgoat_test_SN5659_R2021b_IO682_CM_double 0 0 -1.7E+308 1.7E+308 ECU_ADDRESS 0x00895240 /end MEASUREMENT
/begin MEASUREMENT speedgoat_test_SN5659_R2021b_IO682_B.Divide_n "" FLOAT64_IEEE speedgoat_test_SN5659_R2021b_IO682_CM_double 0 0 -1.7E+308 1.7E+308 ECU_ADDRESS 0x008951A0 /end MEASUREMENT
/begin MEASUREMENT speedgoat_test_SN5659_R2021b_IO682_B.Divide_o "" FLOAT64_IEEE speedgoat_test_SN5659_R2021b_IO682_CM_double 0 0 -1.7E+308 1.7E+308 ECU_ADDRESS 0x008951F0 /end MEASUREMENT
/begin MEASUREMENT speedgoat_test_SN5659_R2021b_IO682_B.Divide_oc "" FLOAT64_IEEE speedgoat_test_SN5659_R2021b_IO682_CM_double 0 0 -1.7E+308 1.7E+308 ECU_ADDRESS 0x00895330 /end MEASUREMENT
/begin MEASUREMENT speedgoat_test_SN5659_R2021b_IO682_B.Divide_os "" FLOAT64_IEEE speedgoat_test_SN5659_R2021b_IO682_CM_double 0 0 -1.7E+308 1.7E+308 ECU_ADDRESS 0x00895380 /end MEASUREMENT
/begin MEASUREMENT speedgoat_test_SN5659_R2021b_IO682_B.Divide_pl "" FLOAT64_IEEE speedgoat_test_SN5659_R2021b_IO682_CM_double 0 0 -1.7E+308 1.7E+308 ECU_ADDRESS 0x00895290 /end MEASUREMENT
/begin MEASUREMENT speedgoat_test_SN5659_R2021b_IO682_B.Encode1_c "" FLOAT64_IEEE speedgoat_test_SN5659_R2021b_IO682_CM_double 0 0 -1.7E+308 1.7E+308 ECU_ADDRESS 0x008951C8 /end MEASUREMENT
/begin MEASUREMENT speedgoat_test_SN5659_R2021b_IO682_B.Encode1_d "" FLOAT64_IEEE speedgoat_test_SN5659_R2021b_IO682_CM_double 0 0 -1.7E+308 1.7E+308 ECU_ADDRESS 0x00895268 /end MEASUREMENT
/begin MEASUREMENT speedgoat_test_SN5659_R2021b_IO682_B.Encode1_e "" FLOAT64_IEEE speedgoat_test_SN5659_R2021b_IO682_CM_double 0 0 -1.7E+308 1.7E+308 ECU_ADDRESS 0x00895218 /end MEASUREMENT
/begin MEASUREMENT speedgoat_test_SN5659_R2021b_IO682_B.Encode1_f0 "" FLOAT64_IEEE speedgoat_test_SN5659_R2021b_IO682_CM_double 0 0 -1.7E+308 1.7E+308 ECU_ADDRESS 0x00895178 /end MEASUREMENT
/begin MEASUREMENT speedgoat_test_SN5659_R2021b_IO682_B.Encode1_ff "" FLOAT64_IEEE speedgoat_test_SN5659_R2021b_IO682_CM_double 0 0 -1.7E+308 1.7E+308 ECU_ADDRESS 0x00895308 /end MEASUREMENT
/begin MEASUREMENT speedgoat_test_SN5659_R2021b_IO682_B.Encode1_i "" FLOAT64_IEEE speedgoat_test_SN5659_R2021b_IO682_CM_double 0 0 -1.7E+308 1.7E+308 ECU_ADDRESS 0x008952B8 /end MEASUREMENT
/begin MEASUREMENT speedgoat_test_SN5659_R2021b_IO682_B.Encode1_kq "" FLOAT64_IEEE speedgoat_test_SN5659_R2021b_IO682_CM_double 0 0 -1.7E+308 1.7E+308 ECU_ADDRESS 0x00895358 /end MEASUREMENT
/begin MEASUREMENT speedgoat_test_SN5659_R2021b_IO682_B.Encode2_ik "" FLOAT64_IEEE speedgoat_test_SN5659_R2021b_IO682_CM_double 0 0 -1.7E+308 1.7E+308 ECU_ADDRESS 0x008952C8 /end MEASUREMENT
/begin MEASUREMENT speedgoat_test_SN5659_R2021b_IO682_B.Encode2_iu "" FLOAT64_IEEE speedgoat_test_SN5659_R2021b_IO682_CM_double 0 0 -1.7E+308 1.7E+308 ECU_ADDRESS 0x00895188 /end MEASUREMENT
/begin MEASUREMENT speedgoat_test_SN5659_R2021b_IO682_B.Encode2_l "" FLOAT64_IEEE speedgoat_test_SN5659_R2021b_IO682_CM_double 0 0 -1.7E+308 1.7E+308 ECU_ADDRESS 0x00895258 /end MEASUREMENT
/begin MEASUREMENT speedgoat_test_SN5659_R2021b_IO682_B.Encode2_o "" FLOAT64_IEEE speedgoat_test_SN5659_R2021b_IO682_CM_double 0 0 -1.7E+308 1.7E+308 ECU_ADDRESS 0x008951D8 /end MEASUREMENT
/begin MEASUREMENT speedgoat_test_SN5659_R2021b_IO682_B.Encode2_o3 "" FLOAT64_IEEE speedgoat_test_SN5659_R2021b_IO682_CM_double 0 0 -1.7E+308 1.7E+308 ECU_ADDRESS 0x00895398 /end MEASUREMENT
/begin MEASUREMENT speedgoat_test_SN5659_R2021b_IO682_B.Encode2_o4 "" FLOAT64_IEEE speedgoat_test_SN5659_R2021b_IO682_CM_double 0 0 -1.7E+308 1.7E+308 ECU_ADDRESS 0x00895318 /end MEASUREMENT
/begin MEASUREMENT speedgoat_test_SN5659_R2021b_IO682_B.Encode2_pt "" FLOAT64_IEEE speedgoat_test_SN5659_R2021b_IO682_CM_double 0 0 -1.7E+308 1.7E+308 ECU_ADDRESS 0x00895278 /end MEASUREMENT
/begin MEASUREMENT speedgoat_test_SN5659_R2021b_IO682_B.Encode3_bv "" FLOAT64_IEEE speedgoat_test_SN5659_R2021b_IO682_CM_double 0 0 -1.7E+308 1.7E+308 ECU_ADDRESS 0x00895238 /end MEASUREMENT
/begin MEASUREMENT speedgoat_test_SN5659_R2021b_IO682_B.Encode3_dc "" FLOAT64_IEEE speedgoat_test_SN5659_R2021b_IO682_CM_double 0 0 -1.7E+308 1.7E+308 ECU_ADDRESS 0x008952D8 /end MEASUREMENT
/begin MEASUREMENT speedgoat_test_SN5659_R2021b_IO682_B.Encode3_dp "" FLOAT64_IEEE speedgoat_test_SN5659_R2021b_IO682_CM_double 0 0 -1.7E+308 1.7E+308 ECU_ADDRESS 0x00895328 /end MEASUREMENT
/begin MEASUREMENT speedgoat_test_SN5659_R2021b_IO682_B.Encode3_g "" FLOAT64_IEEE speedgoat_test_SN5659_R2021b_IO682_CM_double 0 0 -1.7E+308 1.7E+308 ECU_ADDRESS 0x008951E8 /end MEASUREMENT
/begin MEASUREMENT speedgoat_test_SN5659_R2021b_IO682_B.Encode3_h "" FLOAT64_IEEE speedgoat_test_SN5659_R2021b_IO682_CM_double 0 0 -1.7E+308 1.7E+308 ECU_ADDRESS 0x00895378 /end MEASUREMENT
/begin MEASUREMENT speedgoat_test_SN5659_R2021b_IO682_B.Encode3_ik "" FLOAT64_IEEE speedgoat_test_SN5659_R2021b_IO682_CM_double 0 0 -1.7E+308 1.7E+308 ECU_ADDRESS 0x00895198 /end MEASUREMENT
/begin MEASUREMENT speedgoat_test_SN5659_R2021b_IO682_B.Encode3_k "" FLOAT64_IEEE speedgoat_test_SN5659_R2021b_IO682_CM_double 0 0 -1.7E+308 1.7E+308 ECU_ADDRESS 0x00895288 /end MEASUREMENT
/begin MEASUREMENT speedgoat_test_SN5659_R2021b_IO682_B.Encode4_a "" FLOAT64_IEEE speedgoat_test_SN5659_R2021b_IO682_CM_double 0 0 -1.7E+308 1.7E+308 ECU_ADDRESS 0x00895348 /end MEASUREMENT
/begin MEASUREMENT speedgoat_test_SN5659_R2021b_IO682_B.Encode4_cn "" FLOAT64_IEEE speedgoat_test_SN5659_R2021b_IO682_CM_double 0 0 -1.7E+308 1.7E+308 ECU_ADDRESS 0x008952F8 /end MEASUREMENT
/begin MEASUREMENT speedgoat_test_SN5659_R2021b_IO682_B.Encode4_cp "" FLOAT64_IEEE speedgoat_test_SN5659_R2021b_IO682_CM_double 0 0 -1.7E+308 1.7E+308 ECU_ADDRESS 0x008952A8 /end MEASUREMENT
/begin MEASUREMENT speedgoat_test_SN5659_R2021b_IO682_B.Encode4_ix "" FLOAT64_IEEE speedgoat_test_SN5659_R2021b_IO682_CM_double 0 0 -1.7E+308 1.7E+308 ECU_ADDRESS 0x008951B8 /end MEASUREMENT
/begin MEASUREMENT speedgoat_test_SN5659_R2021b_IO682_B.Encode4_j "" FLOAT64_IEEE speedgoat_test_SN5659_R2021b_IO682_CM_double 0 0 -1.7E+308 1.7E+308 ECU_ADDRESS 0x00895208 /end MEASUREMENT
/begin MEASUREMENT speedgoat_test_SN5659_R2021b_IO682_B.Encode5_a "" FLOAT64_IEEE speedgoat_test_SN5659_R2021b_IO682_CM_double 0 0 -1.7E+308 1.7E+308 ECU_ADDRESS 0x00895228 /end MEASUREMENT
/begin MEASUREMENT speedgoat_test_SN5659_R2021b_IO682_B.Encode5_n "" FLOAT64_IEEE speedgoat_test_SN5659_R2021b_IO682_CM_double 0 0 -1.7E+308 1.7E+308 ECU_ADDRESS 0x00895368 /end MEASUREMENT
/begin MEASUREMENT speedgoat_test_SN5659_R2021b_IO682_B.FixPtSum1_b "" UWORD speedgoat_test_SN5659_R2021b_IO682_CM_uint16 0 0 0 65535 ECU_ADDRESS 0x00895530 /end MEASUREMENT
/begin MEASUREMENT speedgoat_test_SN5659_R2021b_IO682_B.FixPtSum1_f "" UWORD speedgoat_test_SN5659_R2021b_IO682_CM_uint16 0 0 0 65535 ECU_ADDRESS 0x00895512 /end MEASUREMENT
/begin MEASUREMENT speedgoat_test_SN5659_R2021b_IO682_B.FixPtSum1_h "" UWORD speedgoat_test_SN5659_R2021b_IO682_CM_uint16 0 0 0 65535 ECU_ADDRESS 0x0089550C /end MEASUREMENT
/begin MEASUREMENT speedgoat_test_SN5659_R2021b_IO682_B.FixPtSum1_h2 "" UWORD speedgoat_test_SN5659_R2021b_IO682_CM_uint16 0 0 0 65535 ECU_ADDRESS 0x00895518 /end MEASUREMENT
/begin MEASUREMENT speedgoat_test_SN5659_R2021b_IO682_B.FixPtSum1_he "" UWORD speedgoat_test_SN5659_R2021b_IO682_CM_uint16 0 0 0 65535 ECU_ADDRESS 0x00895524 /end MEASUREMENT
/begin MEASUREMENT speedgoat_test_SN5659_R2021b_IO682_B.FixPtSum1_m "" UWORD speedgoat_test_SN5659_R2021b_IO682_CM_uint16 0 0 0 65535 ECU_ADDRESS 0x0089551E /end MEASUREMENT
/begin MEASUREMENT speedgoat_test_SN5659_R2021b_IO682_B.FixPtSum1_p "" UWORD speedgoat_test_SN5659_R2021b_IO682_CM_uint16 0 0 0 65535 ECU_ADDRESS 0x0089552A /end MEASUREMENT
/begin MEASUREMENT speedgoat_test_SN5659_R2021b_IO682_B.FixPtSwitch_a "" UWORD speedgoat_test_SN5659_R2021b_IO682_CM_uint16 0 0 0 65535 ECU_ADDRESS 0x00895526 /end MEASUREMENT
/begin MEASUREMENT speedgoat_test_SN5659_R2021b_IO682_B.FixPtSwitch_d "" UWORD speedgoat_test_SN5659_R2021b_IO682_CM_uint16 0 0 0 65535 ECU_ADDRESS 0x0089550E /end MEASUREMENT
/begin MEASUREMENT speedgoat_test_SN5659_R2021b_IO682_B.FixPtSwitch_hh "" UWORD speedgoat_test_SN5659_R2021b_IO682_CM_uint16 0 0 0 65535 ECU_ADDRESS 0x00895520 /end MEASUREMENT
/begin MEASUREMENT speedgoat_test_SN5659_R2021b_IO682_B.FixPtSwitch_j "" UWORD speedgoat_test_SN5659_R2021b_IO682_CM_uint16 0 0 0 65535 ECU_ADDRESS 0x00895514 /end MEASUREMENT
/begin MEASUREMENT speedgoat_test_SN5659_R2021b_IO682_B.FixPtSwitch_k "" UWORD speedgoat_test_SN5659_R2021b_IO682_CM_uint16 0 0 0 65535 ECU_ADDRESS 0x0089551A /end MEASUREMENT
/begin MEASUREMENT speedgoat_test_SN5659_R2021b_IO682_B.FixPtSwitch_l0 "" UWORD speedgoat_test_SN5659_R2021b_IO682_CM_uint16 0 0 0 65535 ECU_ADDRESS 0x0089552C /end MEASUREMENT
/begin MEASUREMENT speedgoat_test_SN5659_R2021b_IO682_B.FixPtSwitch_m "" UWORD speedgoat_test_SN5659_R2021b_IO682_CM_uint16 0 0 0 65535 ECU_ADDRESS 0x00895532 /end MEASUREMENT
/begin MEASUREMENT speedgoat_test_SN5659_R2021b_IO682_B.Mask_aj "" ULONG speedgoat_test_SN5659_R2021b_IO682_CM_uint32 0 0 0 2147483646 ECU_ADDRESS 0x008954BC /end MEASUREMENT
/begin MEASUREMENT speedgoat_test_SN5659_R2021b_IO682_B.Mask_b "" ULONG speedgoat_test_SN5659_R2021b_IO682_CM_uint32 0 0 0 2147483646 ECU_ADDRESS 0x008954A8 /end MEASUREMENT
/begin MEASUREMENT speedgoat_test_SN5659_R2021b_IO682_B.Mask_cs "" ULONG speedgoat_test_SN5659_R2021b_IO682_CM_uint32 0 0 0 2147483646 ECU_ADDRESS 0x00895480 /end MEASUREMENT
/begin MEASUREMENT speedgoat_test_SN5659_R2021b_IO682_B.Mask_cy "" ULONG speedgoat_test_SN5659_R2021b_IO682_CM_uint32 0 0 0 2147483646 ECU_ADDRESS 0x008954D0 /end MEASUREMENT
/begin MEASUREMENT speedgoat_test_SN5659_R2021b_IO682_B.Mask_d "" ULONG speedgoat_test_SN5659_R2021b_IO682_CM_uint32 0 0 0 2147483646 ECU_ADDRESS 0x00895444 /end MEASUREMENT
/begin MEASUREMENT speedgoat_test_SN5659_R2021b_IO682_B.Mask_k "" ULONG speedgoat_test_SN5659_R2021b_IO682_CM_uint32 0 0 0 2147483646 ECU_ADDRESS 0x00895458 /end MEASUREMENT
/begin MEASUREMENT speedgoat_test_SN5659_R2021b_IO682_B.Mask_my "" ULONG speedgoat_test_SN5659_R2021b_IO682_CM_uint32 0 0 0 2147483646 ECU_ADDRESS 0x00895494 /end MEASUREMENT
/begin MEASUREMENT speedgoat_test_SN5659_R2021b_IO682_B.Mask_p "" ULONG speedgoat_test_SN5659_R2021b_IO682_CM_uint32 0 0 0 2147483646 ECU_ADDRESS 0x0089546C /end MEASUREMENT
/begin MEASUREMENT speedgoat_test_SN5659_R2021b_IO682_B.Multiply_b "" FLOAT64_IEEE speedgoat_test_SN5659_R2021b_IO682_CM_double 0 0 -1.7E+308 1.7E+308 ECU_ADDRESS 0x008951F8 /end MEASUREMENT
/begin MEASUREMENT speedgoat_test_SN5659_R2021b_IO682_B.Multiply_c "" FLOAT64_IEEE speedgoat_test_SN5659_R2021b_IO682_CM_double 0 0 -1.7E+308 1.7E+308 ECU_ADDRESS 0x00895388 /end MEASUREMENT
/begin MEASUREMENT speedgoat_test_SN5659_R2021b_IO682_B.Multiply_e "" FLOAT64_IEEE speedgoat_test_SN5659_R2021b_IO682_CM_double 0 0 -1.7E+308 1.7E+308 ECU_ADDRESS 0x008951A8 /end MEASUREMENT
/begin MEASUREMENT speedgoat_test_SN5659_R2021b_IO682_B.Multiply_hz "" FLOAT64_IEEE speedgoat_test_SN5659_R2021b_IO682_CM_double 0 0 -1.7E+308 1.7E+308 ECU_ADDRESS 0x008952E8 /end MEASUREMENT
/begin MEASUREMENT speedgoat_test_SN5659_R2021b_IO682_B.Multiply_il "" FLOAT64_IEEE speedgoat_test_SN5659_R2021b_IO682_CM_double 0 0 -1.7E+308 1.7E+308 ECU_ADDRESS 0x00895158 /end MEASUREMENT
/begin MEASUREMENT speedgoat_test_SN5659_R2021b_IO682_B.Multiply_k "" FLOAT64_IEEE speedgoat_test_SN5659_R2021b_IO682_CM_double 0 0 -1.7E+308 1.7E+308 ECU_ADDRESS 0x00895298 /end MEASUREMENT
/begin MEASUREMENT speedgoat_test_SN5659_R2021b_IO682_B.Multiply_kl "" FLOAT64_IEEE speedgoat_test_SN5659_R2021b_IO682_CM_double 0 0 -1.7E+308 1.7E+308 ECU_ADDRESS 0x00895338 /end MEASUREMENT
/begin MEASUREMENT speedgoat_test_SN5659_R2021b_IO682_B.Multiply_m "" FLOAT64_IEEE speedgoat_test_SN5659_R2021b_IO682_CM_double 0 0 -1.7E+308 1.7E+308 ECU_ADDRESS 0x00895248 /end MEASUREMENT
/begin MEASUREMENT speedgoat_test_SN5659_R2021b_IO682_B.Output_b2 "" UWORD speedgoat_test_SN5659_R2021b_IO682_CM_uint16 0 0 0 65535 ECU_ADDRESS 0x0089550A /end MEASUREMENT
/begin MEASUREMENT speedgoat_test_SN5659_R2021b_IO682_B.Output_bg "" UWORD speedgoat_test_SN5659_R2021b_IO682_CM_uint16 0 0 0 65535 ECU_ADDRESS 0x00895522 /end MEASUREMENT
/begin MEASUREMENT speedgoat_test_SN5659_R2021b_IO682_B.Output_d "" UWORD speedgoat_test_SN5659_R2021b_IO682_CM_uint16 0 0 0 65535 ECU_ADDRESS 0x00895510 /end MEASUREMENT
/begin MEASUREMENT speedgoat_test_SN5659_R2021b_IO682_B.Output_i "" UWORD speedgoat_test_SN5659_R2021b_IO682_CM_uint16 0 0 0 65535 ECU_ADDRESS 0x0089551C /end MEASUREMENT
/begin MEASUREMENT speedgoat_test_SN5659_R2021b_IO682_B.Output_jl "" UWORD speedgoat_test_SN5659_R2021b_IO682_CM_uint16 0 0 0 65535 ECU_ADDRESS 0x00895516 /end MEASUREMENT
/begin MEASUREMENT speedgoat_test_SN5659_R2021b_IO682_B.Output_mw "" UWORD speedgoat_test_SN5659_R2021b_IO682_CM_uint16 0 0 0 65535 ECU_ADDRESS 0x00895528 /end MEASUREMENT
/begin MEASUREMENT speedgoat_test_SN5659_R2021b_IO682_B.Output_pd "" UWORD speedgoat_test_SN5659_R2021b_IO682_CM_uint16 0 0 0 65535 ECU_ADDRESS 0x0089552E /end MEASUREMENT
/begin MEASUREMENT speedgoat_test_SN5659_R2021b_IO682_B.Randomnumber_d "" FLOAT64_IEEE speedgoat_test_SN5659_R2021b_IO682_CM_double 0 0 -1.7E+308 1.7E+308 ECU_ADDRESS 0x008952B0 /end MEASUREMENT
/begin MEASUREMENT speedgoat_test_SN5659_R2021b_IO682_B.Randomnumber_f "" FLOAT64_IEEE speedgoat_test_SN5659_R2021b_IO682_CM_double 0 0 -1.7E+308 1.7E+308 ECU_ADDRESS 0x00895170 /end MEASUREMENT
/begin MEASUREMENT speedgoat_test_SN5659_R2021b_IO682_B.Randomnumber_g "" FLOAT64_IEEE speedgoat_test_SN5659_R2021b_IO682_CM_double 0 0 -1.7E+308 1.7E+308 ECU_ADDRESS 0x008951C0 /end MEASUREMENT
/begin MEASUREMENT speedgoat_test_SN5659_R2021b_IO682_B.Randomnumber_i "" FLOAT64_IEEE speedgoat_test_SN5659_R2021b_IO682_CM_double 0 0 -1.7E+308 1.7E+308 ECU_ADDRESS 0x00895210 /end MEASUREMENT
/begin MEASUREMENT speedgoat_test_SN5659_R2021b_IO682_B.Randomnumber_i2 "" FLOAT64_IEEE speedgoat_test_SN5659_R2021b_IO682_CM_double 0 0 -1.7E+308 1.7E+308 ECU_ADDRESS 0x00895260 /end MEASUREMENT
/begin MEASUREMENT speedgoat_test_SN5659_R2021b_IO682_B.Randomnumber_j "" FLOAT64_IEEE speedgoat_test_SN5659_R2021b_IO682_CM_double 0 0 -1.7E+308 1.7E+308 ECU_ADDRESS 0x00895350 /end MEASUREMENT
/begin MEASUREMENT speedgoat_test_SN5659_R2021b_IO682_B.Randomnumber_n4 "" FLOAT64_IEEE speedgoat_test_SN5659_R2021b_IO682_CM_double 0 0 -1.7E+308 1.7E+308 ECU_ADDRESS 0x00895300 /end MEASUREMENT
/begin MEASUREMENT speedgoat_test_SN5659_R2021b_IO682_B.ShifttoSDIslot_bb "" ULONG speedgoat_test_SN5659_R2021b_IO682_CM_uint32 0 0 0 2147483646 ECU_ADDRESS 0x008954B0 /end MEASUREMENT
/begin MEASUREMENT speedgoat_test_SN5659_R2021b_IO682_B.ShifttoSDIslot_ck "" ULONG speedgoat_test_SN5659_R2021b_IO682_CM_uint32 0 0 0 2147483646 ECU_ADDRESS 0x00895474 /end MEASUREMENT
/begin MEASUREMENT speedgoat_test_SN5659_R2021b_IO682_B.ShifttoSDIslot_d "" ULONG speedgoat_test_SN5659_R2021b_IO682_CM_uint32 0 0 0 2147483646 ECU_ADDRESS 0x00895488 /end MEASUREMENT
/begin MEASUREMENT speedgoat_test_SN5659_R2021b_IO682_B.ShifttoSDIslot_f "" ULONG speedgoat_test_SN5659_R2021b_IO682_CM_uint32 0 0 0 2147483646 ECU_ADDRESS 0x008954C4 /end MEASUREMENT
/begin MEASUREMENT speedgoat_test_SN5659_R2021b_IO682_B.ShifttoSDIslot_fi "" ULONG speedgoat_test_SN5659_R2021b_IO682_CM_uint32 0 0 0 2147483646 ECU_ADDRESS 0x008954D8 /end MEASUREMENT
/begin MEASUREMENT speedgoat_test_SN5659_R2021b_IO682_B.ShifttoSDIslot_g "" ULONG speedgoat_test_SN5659_R2021b_IO682_CM_uint32 0 0 0 2147483646 ECU_ADDRESS 0x0089544C /end MEASUREMENT
/begin MEASUREMENT speedgoat_test_SN5659_R2021b_IO682_B.ShifttoSDIslot_mf "" ULONG speedgoat_test_SN5659_R2021b_IO682_CM_uint32 0 0 0 2147483646 ECU_ADDRESS 0x0089549C /end MEASUREMENT
/begin MEASUREMENT speedgoat_test_SN5659_R2021b_IO682_B.ShifttoSDIslot_n "" ULONG speedgoat_test_SN5659_R2021b_IO682_CM_uint32 0 0 0 2147483646 ECU_ADDRESS 0x00895460 /end MEASUREMENT
/begin MEASUREMENT speedgoat_test_SN5659_R2021b_IO682_B.ShifttoSSMslot_e "" ULONG speedgoat_test_SN5659_R2021b_IO682_CM_uint32 0 0 0 2147483646 ECU_ADDRESS 0x00895470 /end MEASUREMENT
/begin MEASUREMENT speedgoat_test_SN5659_R2021b_IO682_B.ShifttoSSMslot_ea "" ULONG speedgoat_test_SN5659_R2021b_IO682_CM_uint32 0 0 0 2147483646 ECU_ADDRESS 0x008954C0 /end MEASUREMENT
/begin MEASUREMENT speedgoat_test_SN5659_R2021b_IO682_B.ShifttoSSMslot_et "" ULONG speedgoat_test_SN5659_R2021b_IO682_CM_uint32 0 0 0 2147483646 ECU_ADDRESS 0x00895498 /end MEASUREMENT
/begin MEASUREMENT speedgoat_test_SN5659_R2021b_IO682_B.ShifttoSSMslot_g "" ULONG speedgoat_test_SN5659_R2021b_IO682_CM_uint32 0 0 0 2147483646 ECU_ADDRESS 0x00895448 /end MEASUREMENT
/begin MEASUREMENT speedgoat_test_SN5659_R2021b_IO682_B.ShifttoSSMslot_hy "" ULONG speedgoat_test_SN5659_R2021b_IO682_CM_uint32 0 0 0 2147483646 ECU_ADDRESS 0x008954D4 /end MEASUREMENT
/begin MEASUREMENT speedgoat_test_SN5659_R2021b_IO682_B.ShifttoSSMslot_kz "" ULONG speedgoat_test_SN5659_R2021b_IO682_CM_uint32 0 0 0 2147483646 ECU_ADDRESS 0x0089545C /end MEASUREMENT
/begin MEASUREMENT speedgoat_test_SN5659_R2021b_IO682_B.ShifttoSSMslot_n "" ULONG speedgoat_test_SN5659_R2021b_IO682_CM_uint32 0 0 0 2147483646 ECU_ADDRESS 0x00895484 /end MEASUREMENT
/begin MEASUREMENT speedgoat_test_SN5659_R2021b_IO682_B.ShifttoSSMslot_o "" ULONG speedgoat_test_SN5659_R2021b_IO682_CM_uint32 0 0 0 2147483646 ECU_ADDRESS 0x008954AC /end MEASUREMENT
/begin MEASUREMENT speedgoat_test_SN5659_R2021b_IO682_B.Sinewave_ao "" FLOAT64_IEEE speedgoat_test_SN5659_R2021b_IO682_CM_double 0 0 -1.7E+308 1.7E+308 ECU_ADDRESS 0x00895370 /end MEASUREMENT
/begin MEASUREMENT speedgoat_test_SN5659_R2021b_IO682_B.Sinewave_d "" FLOAT64_IEEE speedgoat_test_SN5659_R2021b_IO682_CM_double 0 0 -1.7E+308 1.7E+308 ECU_ADDRESS 0x00895230 /end MEASUREMENT
/begin MEASUREMENT speedgoat_test_SN5659_R2021b_IO682_B.Sinewave_fe "" FLOAT64_IEEE speedgoat_test_SN5659_R2021b_IO682_CM_double 0 0 -1.7E+308 1.7E+308 ECU_ADDRESS 0x00895280 /end MEASUREMENT
/begin MEASUREMENT speedgoat_test_SN5659_R2021b_IO682_B.Sinewave_ff "" FLOAT64_IEEE speedgoat_test_SN5659_R2021b_IO682_CM_double 0 0 -1.7E+308 1.7E+308 ECU_ADDRESS 0x008952D0 /end MEASUREMENT
/begin MEASUREMENT speedgoat_test_SN5659_R2021b_IO682_B.Sinewave_m "" FLOAT64_IEEE speedgoat_test_SN5659_R2021b_IO682_CM_double 0 0 -1.7E+308 1.7E+308 ECU_ADDRESS 0x00895320 /end MEASUREMENT
/begin MEASUREMENT speedgoat_test_SN5659_R2021b_IO682_B.Sinewave_n "" FLOAT64_IEEE speedgoat_test_SN5659_R2021b_IO682_CM_double 0 0 -1.7E+308 1.7E+308 ECU_ADDRESS 0x008951E0 /end MEASUREMENT
/begin MEASUREMENT speedgoat_test_SN5659_R2021b_IO682_B.Sinewave_oh "" FLOAT64_IEEE speedgoat_test_SN5659_R2021b_IO682_CM_double 0 0 -1.7E+308 1.7E+308 ECU_ADDRESS 0x00895190 /end MEASUREMENT
/begin MEASUREMENT speedgoat_test_SN5659_R2021b_IO682_DW.NextOutput_b "" FLOAT64_IEEE speedgoat_test_SN5659_R2021b_IO682_CM_double 0 0 -1.7E+308 1.7E+308 ECU_ADDRESS 0x008928C8 /end MEASUREMENT
/begin MEASUREMENT speedgoat_test_SN5659_R2021b_IO682_DW.NextOutput_h "" FLOAT64_IEEE speedgoat_test_SN5659_R2021b_IO682_CM_double 0 0 -1.7E+308 1.7E+308 ECU_ADDRESS 0x00892850 /end MEASUREMENT
/begin MEASUREMENT speedgoat_test_SN5659_R2021b_IO682_DW.NextOutput_hu "" FLOAT64_IEEE speedgoat_test_SN5659_R2021b_IO682_CM_double 0 0 -1.7E+308 1.7E+308 ECU_ADDRESS 0x00892880 /end MEASUREMENT
/begin MEASUREMENT speedgoat_test_SN5659_R2021b_IO682_DW.NextOutput_ir "" FLOAT64_IEEE speedgoat_test_SN5659_R2021b_IO682_CM_double 0 0 -1.7E+308 1.7E+308 ECU_ADDRESS 0x00892868 /end MEASUREMENT
/begin MEASUREMENT speedgoat_test_SN5659_R2021b_IO682_DW.NextOutput_jn "" FLOAT64_IEEE speedgoat_test_SN5659_R2021b_IO682_CM_double 0 0 -1.7E+308 1.7E+308 ECU_ADDRESS 0x008928B0 /end MEASUREMENT
/begin MEASUREMENT speedgoat_test_SN5659_R2021b_IO682_DW.NextOutput_m "" FLOAT64_IEEE speedgoat_test_SN5659_R2021b_IO682_CM_double 0 0 -1.7E+308 1.7E+308 ECU_ADDRESS 0x00892838 /end MEASUREMENT
/begin MEASUREMENT speedgoat_test_SN5659_R2021b_IO682_DW.NextOutput_p "" FLOAT64_IEEE speedgoat_test_SN5659_R2021b_IO682_CM_double 0 0 -1.7E+308 1.7E+308 ECU_ADDRESS 0x00892898 /end MEASUREMENT
/begin MEASUREMENT speedgoat_test_SN5659_R2021b_IO682_DW.Output_DSTATE_b "" UWORD speedgoat_test_SN5659_R2021b_IO682_CM_uint16 0 0 0 65535 ECU_ADDRESS 0x00893102 /end MEASUREMENT
/begin MEASUREMENT speedgoat_test_SN5659_R2021b_IO682_DW.Output_DSTATE_f "" UWORD speedgoat_test_SN5659_R2021b_IO682_CM_uint16 0 0 0 65535 ECU_ADDRESS 0x00893104 /end MEASUREMENT
/begin MEASUREMENT speedgoat_test_SN5659_R2021b_IO682_DW.Output_DSTATE_fw "" UWORD speedgoat_test_SN5659_R2021b_IO682_CM_uint16 0 0 0 65535 ECU_ADDRESS 0x0089310A /end MEASUREMENT
/begin MEASUREMENT speedgoat_test_SN5659_R2021b_IO682_DW.Output_DSTATE_g "" UWORD speedgoat_test_SN5659_R2021b_IO682_CM_uint16 0 0 0 65535 ECU_ADDRESS 0x008930FE /end MEASUREMENT
/begin MEASUREMENT speedgoat_test_SN5659_R2021b_IO682_DW.Output_DSTATE_h "" UWORD speedgoat_test_SN5659_R2021b_IO682_CM_uint16 0 0 0 65535 ECU_ADDRESS 0x00893106 /end MEASUREMENT
/begin MEASUREMENT speedgoat_test_SN5659_R2021b_IO682_DW.Output_DSTATE_m4 "" UWORD speedgoat_test_SN5659_R2021b_IO682_CM_uint16 0 0 0 65535 ECU_ADDRESS 0x00893108 /end MEASUREMENT
/begin MEASUREMENT speedgoat_test_SN5659_R2021b_IO682_DW.Output_DSTATE_p "" UWORD speedgoat_test_SN5659_R2021b_IO682_CM_uint16 0 0 0 65535 ECU_ADDRESS 0x00893100 /end MEASUREMENT
/begin MEASUREMENT speedgoat_test_SN5659_R2021b_IO682_DW.RandSeed_b "" ULONG speedgoat_test_SN5659_R2021b_IO682_CM_uint32 0 0 0 2147483646 ECU_ADDRESS 0x00892ED4 /end MEASUREMENT
/begin MEASUREMENT speedgoat_test_SN5659_R2021b_IO682_DW.RandSeed_bw "" ULONG speedgoat_test_SN5659_R2021b_IO682_CM_uint32 0 0 0 2147483646 ECU_ADDRESS 0x00892EDC /end MEASUREMENT
/begin MEASUREMENT speedgoat_test_SN5659_R2021b_IO682_DW.RandSeed_fs "" ULONG speedgoat_test_SN5659_R2021b_IO682_CM_uint32 0 0 0 2147483646 ECU_ADDRESS 0x00892EEC /end MEASUREMENT
/begin MEASUREMENT speedgoat_test_SN5659_R2021b_IO682_DW.RandSeed_hi "" ULONG speedgoat_test_SN5659_R2021b_IO682_CM_uint32 0 0 0 2147483646 ECU_ADDRESS 0x00892ED8 /end MEASUREMENT
/begin MEASUREMENT speedgoat_test_SN5659_R2021b_IO682_DW.RandSeed_j "" ULONG speedgoat_test_SN5659_R2021b_IO682_CM_uint32 0 0 0 2147483646 ECU_ADDRESS 0x00892EE0 /end MEASUREMENT
/begin MEASUREMENT speedgoat_test_SN5659_R2021b_IO682_DW.RandSeed_l "" ULONG speedgoat_test_SN5659_R2021b_IO682_CM_uint32 0 0 0 2147483646 ECU_ADDRESS 0x00892EE8 /end MEASUREMENT
/begin MEASUREMENT speedgoat_test_SN5659_R2021b_IO682_DW.RandSeed_n "" ULONG speedgoat_test_SN5659_R2021b_IO682_CM_uint32 0 0 0 2147483646 ECU_ADDRESS 0x00892EE4 /end MEASUREMENT
/begin MEASUREMENT speedgoat_test_SN5659_R2021b_IO682_DW.lastCos_b "" FLOAT64_IEEE speedgoat_test_SN5659_R2021b_IO682_CM_double 0 0 -1.7E+308 1.7E+308 ECU_ADDRESS 0x008928D8 /end MEASUREMENT
/begin MEASUREMENT speedgoat_test_SN5659_R2021b_IO682_DW.lastCos_c "" FLOAT64_IEEE speedgoat_test_SN5659_R2021b_IO682_CM_double 0 0 -1.7E+308 1.7E+308 ECU_ADDRESS 0x008928C0 /end MEASUREMENT
/begin MEASUREMENT speedgoat_test_SN5659_R2021b_IO682_DW.lastCos_g "" FLOAT64_IEEE speedgoat_test_SN5659_R2021b_IO682_CM_double 0 0 -1.7E+308 1.7E+308 ECU_ADDRESS 0x00892848 /end MEASUREMENT
/begin MEASUREMENT speedgoat_test_SN5659_R2021b_IO682_DW.lastCos_ge "" FLOAT64_IEEE speedgoat_test_SN5659_R2021b_IO682_CM_double 0 0 -1.7E+308 1.7E+308 ECU_ADDRESS 0x00892860 /end MEASUREMENT
/begin MEASUREMENT speedgoat_test_SN5659_R2021b_IO682_DW.lastCos_j "" FLOAT64_IEEE speedgoat_test_SN5659_R2021b_IO682_CM_double 0 0 -1.7E+308 1.7E+308 ECU_ADDRESS 0x008928A8 /end MEASUREMENT
/begin MEASUREMENT speedgoat_test_SN5659_R2021b_IO682_DW.lastCos_o "" FLOAT64_IEEE speedgoat_test_SN5659_R2021b_IO682_CM_double 0 0 -1.7E+308 1.7E+308 ECU_ADDRESS 0x00892878 /end MEASUREMENT
/begin MEASUREMENT speedgoat_test_SN5659_R2021b_IO682_DW.lastCos_oy "" FLOAT64_IEEE speedgoat_test_SN5659_R2021b_IO682_CM_double 0 0 -1.7E+308 1.7E+308 ECU_ADDRESS 0x00892890 /end MEASUREMENT
/begin MEASUREMENT speedgoat_test_SN5659_R2021b_IO682_DW.lastSin_a "" FLOAT64_IEEE speedgoat_test_SN5659_R2021b_IO682_CM_double 0 0 -1.7E+308 1.7E+308 ECU_ADDRESS 0x00892888 /end MEASUREMENT
/begin MEASUREMENT speedgoat_test_SN5659_R2021b_IO682_DW.lastSin_fv "" FLOAT64_IEEE speedgoat_test_SN5659_R2021b_IO682_CM_double 0 0 -1.7E+308 1.7E+308 ECU_ADDRESS 0x008928D0 /end MEASUREMENT
/begin MEASUREMENT speedgoat_test_SN5659_R2021b_IO682_DW.lastSin_i "" FLOAT64_IEEE speedgoat_test_SN5659_R2021b_IO682_CM_double 0 0 -1.7E+308 1.7E+308 ECU_ADDRESS 0x00892870 /end MEASUREMENT
/begin MEASUREMENT speedgoat_test_SN5659_R2021b_IO682_DW.lastSin_iv "" FLOAT64_IEEE speedgoat_test_SN5659_R2021b_IO682_CM_double 0 0 -1.7E+308 1.7E+308 ECU_ADDRESS 0x008928B8 /end MEASUREMENT
/begin MEASUREMENT speedgoat_test_SN5659_R2021b_IO682_DW.lastSin_l "" FLOAT64_IEEE speedgoat_test_SN5659_R2021b_IO682_CM_double 0 0 -1.7E+308 1.7E+308 ECU_ADDRESS 0x00892858 /end MEASUREMENT
/begin MEASUREMENT speedgoat_test_SN5659_R2021b_IO682_DW.lastSin_pf "" FLOAT64_IEEE speedgoat_test_SN5659_R2021b_IO682_CM_double 0 0 -1.7E+308 1.7E+308 ECU_ADDRESS 0x008928A0 /end MEASUREMENT
/begin MEASUREMENT speedgoat_test_SN5659_R2021b_IO682_DW.lastSin_pg "" FLOAT64_IEEE speedgoat_test_SN5659_R2021b_IO682_CM_double 0 0 -1.7E+308 1.7E+308 ECU_ADDRESS 0x00892840 /end MEASUREMENT
/begin MEASUREMENT speedgoat_test_SN5659_R2021b_IO682_DW.systemEnable_bx "" SLONG speedgoat_test_SN5659_R2021b_IO682_CM_int32 0 0 -2147483648 2147483647 ECU_ADDRESS 0x00892E94 /end MEASUREMENT
/begin MEASUREMENT speedgoat_test_SN5659_R2021b_IO682_DW.systemEnable_g "" SLONG speedgoat_test_SN5659_R2021b_IO682_CM_int32 0 0 -2147483648 2147483647 ECU_ADDRESS 0x00892E98 /end MEASUREMENT
/begin MEASUREMENT speedgoat_test_SN5659_R2021b_IO682_DW.systemEnable_gv "" SLONG speedgoat_test_SN5659_R2021b_IO682_CM_int32 0 0 -2147483648 2147483647 ECU_ADDRESS 0x00892EA8 /end MEASUREMENT
/begin MEASUREMENT speedgoat_test_SN5659_R2021b_IO682_DW.systemEnable_i "" SLONG speedgoat_test_SN5659_R2021b_IO682_CM_int32 0 0 -2147483648 2147483647 ECU_ADDRESS 0x00892EA0 /end MEASUREMENT
/begin MEASUREMENT speedgoat_test_SN5659_R2021b_IO682_DW.systemEnable_jy "" SLONG speedgoat_test_SN5659_R2021b_IO682_CM_int32 0 0 -2147483648 2147483647 ECU_ADDRESS 0x00892EA4 /end MEASUREMENT
/begin MEASUREMENT speedgoat_test_SN5659_R2021b_IO682_DW.systemEnable_o "" SLONG speedgoat_test_SN5659_R2021b_IO682_CM_int32 0 0 -2147483648 2147483647 ECU_ADDRESS 0x00892EAC /end MEASUREMENT
/begin MEASUREMENT speedgoat_test_SN5659_R2021b_IO682_DW.systemEnable_pe "" SLONG speedgoat_test_SN5659_R2021b_IO682_CM_int32 0 0 -2147483648 2147483647 ECU_ADDRESS 0x00892E9C /end MEASUREMENT
/begin COMPU_METHOD speedgoat_test_SN5659_R2021b_IO682_CM_double "" IDENTICAL "%15.10" "" /end COMPU_METHOD
/begin COMPU_METHOD speedgoat_test_SN5659_R2021b_IO682_CM_int32 "" IDENTICAL "%10.0" "" /end COMPU_METHOD
/begin COMPU_METHOD speedgoat_test_SN5659_R2021b_IO682_CM_uint16 "" IDENTICAL "%5.0" "" /end COMPU_METHOD
/begin COMPU_METHOD speedgoat_test_SN5659_R2021b_IO682_CM_uint32 "" IDENTICAL "%10.0" "" /end COMPU_METHOD
/begin RECORD_LAYOUT Scalar_FLOAT64_IEEE FNC_VALUES 1 FLOAT64_IEEE COLUMN_DIR DIRECT /end RECORD_LAYOUT
/begin RECORD_LAYOUT Scalar_SLONG FNC_VALUES 1 SLONG COLUMN_DIR DIRECT /end RECORD_LAYOUT
/begin RECORD_LAYOUT Scalar_ULONG FNC_VALUES 1 ULONG COLUMN_DIR DIRECT /end RECORD_LAYOUT
/begin RECORD_LAYOUT Scalar_UWORD FNC_VALUES 1 UWORD COLUMN_DIR DIRECT /end RECORD_LAYOUT
/begin GROUP speedgoat_test_SN5659_R2021b_IO682_IO682_Encode_Channel_2_Prepare_RAW_value "speedgoat_test_SN5659_R2021b_IO682/IO682/Encode Channel 2/Prepare RAW value"
 /begin REF_CHARACTERISTIC speedgoat_test_SN5659__cal_impl.Label_Value_n speedgoat_test_SN5659__cal_impl.Mask_BitMask_l speedgoat_test_SN5659__cal_impl.SDI_Value_l4 speedgoat_test_SN5659__cal_impl.SSM_Value_na speedgoat_test_SN5659__cal_impl.Scale_Value_k speedgoat_test_SN5659__cal_impl.shiftthedoublevalue27bitsleft_j /end REF_CHARACTERISTIC
 /begin REF_MEASUREMENT speedgoat_test_SN5659_R2021b_IO682_B.BitwiseOperator_j speedgoat_test_SN5659_R2021b_IO682_B.DataTypeConversion_bh speedgoat_test_SN5659_R2021b_IO682_B.Divide_g4 speedgoat_test_SN5659_R2021b_IO682_B.Mask_d speedgoat_test_SN5659_R2021b_IO682_B.Multiply_il speedgoat_test_SN5659_R2021b_IO682_B.ShifttoSDIslot_g speedgoat_test_SN5659_R2021b_IO682_B.ShifttoSSMslot_g /end REF_MEASUREMENT
/end GROUP
/begin GROUP speedgoat_test_SN5659_R2021b_IO682_IO682_Encode_Channel_3 "speedgoat_test_SN5659_R2021b_IO682/IO682/Encode Channel 3"
 /begin SUB_GROUP speedgoat_test_SN5659_R2021b_IO682_IO682_Encode_Channel_3_Counter_Limited speedgoat_test_SN5659_R2021b_IO682_IO682_Encode_Channel_3_Prepare_RAW_value /end SUB_GROUP
 /begin REF_CHARACTERISTIC speedgoat_test_SN5659__cal_impl.Constant_Value_ek speedgoat_test_SN5659__cal_impl.Encode1_P10_l0 speedgoat_test_SN5659__cal_impl.Encode1_P11_f speedgoat_test_SN5659__cal_impl.Encode1_P12_a speedgoat_test_SN5659__cal_impl.Encode1_P13_n speedgoat_test_SN5659__cal_impl.Encode1_P14_on speedgoat_test_SN5659__cal_impl.Encode1_P15_pw speedgoat_test_SN5659__cal_impl.Encode1_P1_m speedgoat_test_SN5659__cal_impl.Encode1_P2_i speedgoat_test_SN5659__cal_impl.Encode1_P3_e speedgoat_test_SN5659__cal_impl.Encode1_P4_d2 speedgoat_test_SN5659__cal_impl.Encode1_P5_h speedgoat_test_SN5659__cal_impl.Encode1_P6_i speedgoat_test_SN5659__cal_impl.Encode1_P7_gj speedgoat_test_SN5659__cal_impl.Encode1_P8_ct speedgoat_test_SN5659__cal_impl.Encode1_P9_j speedgoat_test_SN5659__cal_impl.Encode2_P10_f speedgoat_test_SN5659__cal_impl.Encode2_P11_m speedgoat_test_SN5659__cal_impl.Encode2_P12_e speedgoat_test_SN5659__cal_impl.Encode2_P13_fx speedgoat_test_SN5659__cal_impl.Encode2_P14_d speedgoat_test_SN5659__cal_impl.Encode2_P15_ck speedgoat_test_SN5659__cal_impl.Encode2_P1_az speedgoat_test_SN5659__cal_impl.Encode2_P2_f0 speedgoat_test_SN5659__cal_impl.Encode2_P3_o2 speedgoat_test_SN5659__cal_impl.Encode2_P4_h speedgoat_test_SN5659__cal_impl.Encode2_P5_i speedgoat_test_SN5659__cal_impl.Encode2_P6_o speedgoat_test_SN5659__cal_impl.Encode2_P7_o speedgoat_test_SN5659__cal_impl.Encode2_P8_fs speedgoat_test_SN5659__cal_impl.Encode2_P9_c speedgoat_test_SN5659__cal_impl.Encode3_P10_a speedgoat_test_SN5659__cal_impl.Encode3_P11_f speedgoat_test_SN5659__cal_impl.Encode3_P12_b3 speedgoat_test_SN5659__cal_impl.Encode3_P13_c speedgoat_test_SN5659__cal_impl.Encode3_P14_do speedgoat_test_SN5659__cal_impl.Encode3_P15_pu speedgoat_test_SN5659__cal_impl.Encode3_P1_mk speedgoat_test_SN5659__cal_impl.Encode3_P2_o speedgoat_test_SN5659__cal_impl.Encode3_P3_cs speedgoat_test_SN5659__cal_impl.Encode3_P4_dq speedgoat_test_SN5659__cal_impl.Encode3_P5_im speedgoat_test_SN5659__cal_impl.Encode3_P6_d speedgoat_test_SN5659__cal_impl.Encode3_P7_o speedgoat_test_SN5659__cal_impl.Encode3_P8_en speedgoat_test_SN5659__cal_impl.Encode3_P9_m speedgoat_test_SN5659__cal_impl.Encode4_P10_b speedgoat_test_SN5659__cal_impl.Encode4_P11_jr speedgoat_test_SN5659__cal_impl.Encode4_P12_g speedgoat_test_SN5659__cal_impl.Encode4_P13_d speedgoat_test_SN5659__cal_impl.Encode4_P14_g speedgoat_test_SN5659__cal_impl.Encode4_P15_h speedgoat_test_SN5659__cal_impl.Encode4_P1_ns speedgoat_test_SN5659__cal_impl.Encode4_P2_g speedgoat_test_SN5659__cal_impl.Encode4_P3_n speedgoat_test_SN5659__cal_impl.Encode4_P4_m speedgoat_test_SN5659__cal_impl.Encode4_P5_k speedgoat_test_SN5659__cal_impl.Encode4_P6_e speedgoat_test_SN5659__cal_impl.Encode4_P7_pm speedgoat_test_SN5659__cal_impl.Encode4_P8_f speedgoat_test_SN5659__cal_impl.Encode4_P9_f speedgoat_test_SN5659__cal_impl.Randomnumber_Mean_d speedgoat_test_SN5659__cal_impl.Randomnumber_Seed_fq speedgoat_test_SN5659__cal_impl.Randomnumber_StdDev_f speedgoat_test_SN5659__cal_impl.Sinewave_Amp_a speedgoat_test_SN5659__cal_impl.Sinewave_Bias_mn speedgoat_test_SN5659__cal_impl.Sinewave_Freq_b speedgoat_test_SN5659__cal_impl.Sinewave_HCos_bz speedgoat_test_SN5659__cal_impl.Sinewave_Hsin_h4 speedgoat_test_SN5659__cal_impl.Sinewave_PCos_ma speedgoat_test_SN5659__cal_impl.Sinewave_PSin_gt /end REF_CHARACTERISTIC
 /begin REF_MEASUREMENT speedgoat_test_SN5659_R2021b_IO682_B.DataTypeConversion1_a speedgoat_test_SN5659_R2021b_IO682_B.DataTypeConversion_dd speedgoat_test_SN5659_R2021b_IO682_B.Encode1_f0 speedgoat_test_SN5659_R2021b_IO682_B.Encode2_iu speedgoat_test_SN5659_R2021b_IO682_B.Encode3_ik speedgoat_test_SN5659_R2021b_IO682_B.Encode4_ix speedgoat_test_SN5659_R2021b_IO682_B.Output_b2 speedgoat_test_SN5659_R2021b_IO682_B.Randomnumber_f speedgoat_test_SN5659_R2021b_IO682_B.Sinewave_oh speedgoat_test_SN5659_R2021b_IO682_DW.NextOutput_m speedgoat_test_SN5659_R2021b_IO682_DW.RandSeed_b speedgoat_test_SN5659_R2021b_IO682_DW.lastCos_g speedgoat_test_SN5659_R2021b_IO682_DW.lastSin_pg speedgoat_test_SN5659_R2021b_IO682_DW.systemEnable_bx /end REF_MEASUREMENT
/end GROUP
/begin GROUP speedgoat_test_SN5659_R2021b_IO682_IO682_Encode_Channel_3_Counter_Limited "speedgoat_test_SN5659_R2021b_IO682/IO682/Encode Channel 3/Counter
Limited"
 /begin SUB_GROUP speedgoat_test_SN5659_R2021b_IO682_IO682_Encode_Channel_3_Counter_Limited_Increment_Real_World speedgoat_test_SN5659_R2021b_IO682_IO682_Encode_Channel_3_Counter_Limited_Wrap_To_Zero /end SUB_GROUP
 /begin REF_CHARACTERISTIC speedgoat_test_SN5659__cal_impl.Output_InitialCondition_h /end REF_CHARACTERISTIC
 /begin REF_MEASUREMENT speedgoat_test_SN5659_R2021b_IO682_B.FixPtSwitch_d speedgoat_test_SN5659_R2021b_IO682_B.Output_b2 speedgoat_test_SN5659_R2021b_IO682_DW.Output_DSTATE_g /end REF_MEASUREMENT
/end GROUP
/begin GROUP speedgoat_test_SN5659_R2021b_IO682_IO682_Encode_Channel_3_Counter_Limited_Increment_Real_World "speedgoat_test_SN5659_R2021b_IO682/IO682/Encode Channel 3/Counter
Limited/Increment
Real World" /begin REF_CHARACTERISTIC speedgoat_test_SN5659__cal_impl.FixPtConstant_Value_oq /end REF_CHARACTERISTIC
 /begin REF_MEASUREMENT speedgoat_test_SN5659_R2021b_IO682_B.FixPtSum1_h speedgoat_test_SN5659_R2021b_IO682_B.Output_b2 /end REF_MEASUREMENT
/end GROUP
/begin GROUP speedgoat_test_SN5659_R2021b_IO682_IO682_Encode_Channel_3_Counter_Limited_Wrap_To_Zero "speedgoat_test_SN5659_R2021b_IO682/IO682/Encode Channel 3/Counter
Limited/Wrap To Zero"
 /begin REF_CHARACTERISTIC speedgoat_test_SN5659__cal_impl.Constant_Value_j5 speedgoat_test_SN5659__cal_impl.CounterLimited_uplimit_e /end REF_CHARACTERISTIC
 /begin REF_MEASUREMENT speedgoat_test_SN5659_R2021b_IO682_B.FixPtSum1_h speedgoat_test_SN5659_R2021b_IO682_B.FixPtSwitch_d /end REF_MEASUREMENT
/end GROUP
/begin GROUP speedgoat_test_SN5659_R2021b_IO682_IO682_Encode_Channel_3_Prepare_RAW_value "speedgoat_test_SN5659_R2021b_IO682/IO682/Encode Channel 3/Prepare RAW value"
 /begin REF_CHARACTERISTIC speedgoat_test_SN5659__cal_impl.Label_Value_fv speedgoat_test_SN5659__cal_impl.Mask_BitMask_e3 speedgoat_test_SN5659__cal_impl.SDI_Value_p speedgoat_test_SN5659__cal_impl.SSM_Value_os speedgoat_test_SN5659__cal_impl.Scale_Value_e speedgoat_test_SN5659__cal_impl.shiftthedoublevalue27bitsleft_n /end REF_CHARACTERISTIC
 /begin REF_MEASUREMENT speedgoat_test_SN5659_R2021b_IO682_B.BitwiseOperator_a4 speedgoat_test_SN5659_R2021b_IO682_B.DataTypeConversion1_a speedgoat_test_SN5659_R2021b_IO682_B.DataTypeConversion_l speedgoat_test_SN5659_R2021b_IO682_B.Divide_n speedgoat_test_SN5659_R2021b_IO682_B.Mask_k speedgoat_test_SN5659_R2021b_IO682_B.Multiply_e speedgoat_test_SN5659_R2021b_IO682_B.ShifttoSDIslot_n speedgoat_test_SN5659_R2021b_IO682_B.ShifttoSSMslot_kz /end REF_MEASUREMENT
/end GROUP
/begin GROUP speedgoat_test_SN5659_R2021b_IO682_IO682_Encode_Channel_4 "speedgoat_test_SN5659_R2021b_IO682/IO682/Encode Channel 4"
 /begin SUB_GROUP speedgoat_test_SN5659_R2021b_IO682_IO682_Encode_Channel_4_Counter_Limited speedgoat_test_SN5659_R2021b_IO682_IO682_Encode_Channel_4_Prepare_RAW_value /end SUB_GROUP
 /begin REF_CHARACTERISTIC speedgoat_test_SN5659__cal_impl.Constant_Value_gg speedgoat_test_SN5659__cal_impl.Encode1_P10_j speedgoat_test_SN5659__cal_impl.Encode1_P11_fp speedgoat_test_SN5659__cal_impl.Encode1_P12_kd speedgoat_test_SN5659__cal_impl.Encode1_P13_h speedgoat_test_SN5659__cal_impl.Encode1_P14_ov speedgoat_test_SN5659__cal_impl.Encode1_P15_ka speedgoat_test_SN5659__cal_impl.Encode1_P1_k speedgoat_test_SN5659__cal_impl.Encode1_P2_c speedgoat_test_SN5659__cal_impl.Encode1_P3_g speedgoat_test_SN5659__cal_impl.Encode1_P4_eq speedgoat_test_SN5659__cal_impl.Encode1_P5_jf speedgoat_test_SN5659__cal_impl.Encode1_P6_k speedgoat_test_SN5659__cal_impl.Encode1_P7_p speedgoat_test_SN5659__cal_impl.Encode1_P8_o speedgoat_test_SN5659__cal_impl.Encode1_P9_h speedgoat_test_SN5659__cal_impl.Encode2_P10_ab0 speedgoat_test_SN5659__cal_impl.Encode2_P11_p speedgoat_test_SN5659__cal_impl.Encode2_P12_c speedgoat_test_SN5659__cal_impl.Encode2_P13_a speedgoat_test_SN5659__cal_impl.Encode2_P14_db speedgoat_test_SN5659__cal_impl.Encode2_P15_a speedgoat_test_SN5659__cal_impl.Encode2_P1_f speedgoat_test_SN5659__cal_impl.Encode2_P2_kra speedgoat_test_SN5659__cal_impl.Encode2_P3_d speedgoat_test_SN5659__cal_impl.Encode2_P4_lw speedgoat_test_SN5659__cal_impl.Encode2_P5_mc speedgoat_test_SN5659__cal_impl.Encode2_P6_f speedgoat_test_SN5659__cal_impl.Encode2_P7_oo speedgoat_test_SN5659__cal_impl.Encode2_P8_a speedgoat_test_SN5659__cal_impl.Encode2_P9_ni speedgoat_test_SN5659__cal_impl.Encode3_P10_od speedgoat_test_SN5659__cal_impl.Encode3_P11_o speedgoat_test_SN5659__cal_impl.Encode3_P12_f speedgoat_test_SN5659__cal_impl.Encode3_P13_a speedgoat_test_SN5659__cal_impl.Encode3_P14_g speedgoat_test_SN5659__cal_impl.Encode3_P15_a speedgoat_test_SN5659__cal_impl.Encode3_P1_ad speedgoat_test_SN5659__cal_impl.Encode3_P2_fg speedgoat_test_SN5659__cal_impl.Encode3_P3_nx speedgoat_test_SN5659__cal_impl.Encode3_P4_go speedgoat_test_SN5659__cal_impl.Encode3_P5_i0 speedgoat_test_SN5659__cal_impl.Encode3_P6_a0 speedgoat_test_SN5659__cal_impl.Encode3_P7_p speedgoat_test_SN5659__cal_impl.Encode3_P8_j speedgoat_test_SN5659__cal_impl.Encode3_P9_o speedgoat_test_SN5659__cal_impl.Encode4_P10_p speedgoat_test_SN5659__cal_impl.Encode4_P11_a speedgoat_test_SN5659__cal_impl.Encode4_P12_ld speedgoat_test_SN5659__cal_impl.Encode4_P13_g speedgoat_test_SN5659__cal_impl.Encode4_P14_o speedgoat_test_SN5659__cal_impl.Encode4_P15_j speedgoat_test_SN5659__cal_impl.Encode4_P1_h speedgoat_test_SN5659__cal_impl.Encode4_P2_e speedgoat_test_SN5659__cal_impl.Encode4_P3_j speedgoat_test_SN5659__cal_impl.Encode4_P4_o speedgoat_test_SN5659__cal_impl.Encode4_P5_pt speedgoat_test_SN5659__cal_impl.Encode4_P6_ab speedgoat_test_SN5659__cal_impl.Encode4_P7_i speedgoat_test_SN5659__cal_impl.Encode4_P8_hv speedgoat_test_SN5659__cal_impl.Encode4_P9_l speedgoat_test_SN5659__cal_impl.Randomnumber_Mean_p speedgoat_test_SN5659__cal_impl.Randomnumber_Seed_i speedgoat_test_SN5659__cal_impl.Randomnumber_StdDev_b speedgoat_test_SN5659__cal_impl.Sinewave_Amp_m speedgoat_test_SN5659__cal_impl.Sinewave_Bias_o speedgoat_test_SN5659__cal_impl.Sinewave_Freq_lw speedgoat_test_SN5659__cal_impl.Sinewave_HCos_e speedgoat_test_SN5659__cal_impl.Sinewave_Hsin_a speedgoat_test_SN5659__cal_impl.Sinewave_PCos_jo speedgoat_test_SN5659__cal_impl.Sinewave_PSin_px /end REF_CHARACTERISTIC
 /begin REF_MEASUREMENT speedgoat_test_SN5659_R2021b_IO682_B.DataTypeConversion1_gh speedgoat_test_SN5659_R2021b_IO682_B.DataTypeConversion_f speedgoat_test_SN5659_R2021b_IO682_B.Encode1_c speedgoat_test_SN5659_R2021b_IO682_B.Encode2_o speedgoat_test_SN5659_R2021b_IO682_B.Encode3_g speedgoat_test_SN5659_R2021b_IO682_B.Encode4_j speedgoat_test_SN5659_R2021b_IO682_B.Output_d speedgoat_test_SN5659_R2021b_IO682_B.Randomnumber_g speedgoat_test_SN5659_R2021b_IO682_B.Sinewave_n speedgoat_test_SN5659_R2021b_IO682_DW.NextOutput_h speedgoat_test_SN5659_R2021b_IO682_DW.RandSeed_hi speedgoat_test_SN5659_R2021b_IO682_DW.lastCos_ge speedgoat_test_SN5659_R2021b_IO682_DW.lastSin_l speedgoat_test_SN5659_R2021b_IO682_DW.systemEnable_g /end REF_MEASUREMENT
/end GROUP
/begin GROUP speedgoat_test_SN5659_R2021b_IO682_IO682_Encode_Channel_4_Counter_Limited "speedgoat_test_SN5659_R2021b_IO682/IO682/Encode Channel 4/Counter
Limited"
 /begin SUB_GROUP speedgoat_test_SN5659_R2021b_IO682_IO682_Encode_Channel_4_Counter_Limited_Increment_Real_World speedgoat_test_SN5659_R2021b_IO682_IO682_Encode_Channel_4_Counter_Limited_Wrap_To_Zero /end SUB_GROUP
 /begin REF_CHARACTERISTIC speedgoat_test_SN5659__cal_impl.Output_InitialCondition_d /end REF_CHARACTERISTIC
 /begin REF_MEASUREMENT speedgoat_test_SN5659_R2021b_IO682_B.FixPtSwitch_j speedgoat_test_SN5659_R2021b_IO682_B.Output_d speedgoat_test_SN5659_R2021b_IO682_DW.Output_DSTATE_p /end REF_MEASUREMENT
/end GROUP
/begin GROUP speedgoat_test_SN5659_R2021b_IO682_IO682_Encode_Channel_4_Counter_Limited_Increment_Real_World "speedgoat_test_SN5659_R2021b_IO682/IO682/Encode Channel 4/Counter
Limited/Increment
Real World" /begin REF_CHARACTERISTIC speedgoat_test_SN5659__cal_impl.FixPtConstant_Value_k /end REF_CHARACTERISTIC
 /begin REF_MEASUREMENT speedgoat_test_SN5659_R2021b_IO682_B.FixPtSum1_f speedgoat_test_SN5659_R2021b_IO682_B.Output_d /end REF_MEASUREMENT
/end GROUP
/begin GROUP speedgoat_test_SN5659_R2021b_IO682_IO682_Encode_Channel_4_Counter_Limited_Wrap_To_Zero "speedgoat_test_SN5659_R2021b_IO682/IO682/Encode Channel 4/Counter
Limited/Wrap To Zero"
 /begin REF_CHARACTERISTIC speedgoat_test_SN5659__cal_impl.Constant_Value_ly speedgoat_test_SN5659__cal_impl.CounterLimited_uplimit_p /end REF_CHARACTERISTIC
 /begin REF_MEASUREMENT speedgoat_test_SN5659_R2021b_IO682_B.FixPtSum1_f speedgoat_test_SN5659_R2021b_IO682_B.FixPtSwitch_j /end REF_MEASUREMENT
/end GROUP
/begin GROUP speedgoat_test_SN5659_R2021b_IO682_IO682_Encode_Channel_4_Prepare_RAW_value "speedgoat_test_SN5659_R2021b_IO682/IO682/Encode Channel 4/Prepare RAW value"
 /begin REF_CHARACTERISTIC speedgoat_test_SN5659__cal_impl.Label_Value_l speedgoat_test_SN5659__cal_impl.Mask_BitMask_f speedgoat_test_SN5659__cal_impl.SDI_Value_g speedgoat_test_SN5659__cal_impl.SSM_Value_nl speedgoat_test_SN5659__cal_impl.Scale_Value_o speedgoat_test_SN5659__cal_impl.shiftthedoublevalue27bitslef_jt /end REF_CHARACTERISTIC
 /begin REF_MEASUREMENT speedgoat_test_SN5659_R2021b_IO682_B.BitwiseOperator_pk speedgoat_test_SN5659_R2021b_IO682_B.DataTypeConversion1_gh speedgoat_test_SN5659_R2021b_IO682_B.DataTypeConversion_fr speedgoat_test_SN5659_R2021b_IO682_B.Divide_o speedgoat_test_SN5659_R2021b_IO682_B.Mask_p speedgoat_test_SN5659_R2021b_IO682_B.Multiply_b speedgoat_test_SN5659_R2021b_IO682_B.ShifttoSDIslot_ck speedgoat_test_SN5659_R2021b_IO682_B.ShifttoSSMslot_e /end REF_MEASUREMENT
/end GROUP
/begin GROUP speedgoat_test_SN5659_R2021b_IO682_IO682_Encode_Channel_5 "speedgoat_test_SN5659_R2021b_IO682/IO682/Encode Channel 5"
 /begin SUB_GROUP speedgoat_test_SN5659_R2021b_IO682_IO682_Encode_Channel_5_Counter_Limited speedgoat_test_SN5659_R2021b_IO682_IO682_Encode_Channel_5_Prepare_RAW_value /end SUB_GROUP
 /begin REF_CHARACTERISTIC speedgoat_test_SN5659__cal_impl.Constant_Value_h speedgoat_test_SN5659__cal_impl.Encode1_P10_g speedgoat_test_SN5659__cal_impl.Encode1_P11_gb speedgoat_test_SN5659__cal_impl.Encode1_P12_i speedgoat_test_SN5659__cal_impl.Encode1_P13_hz speedgoat_test_SN5659__cal_impl.Encode1_P14_f speedgoat_test_SN5659__cal_impl.Encode1_P15_n speedgoat_test_SN5659__cal_impl.Encode1_P1_n speedgoat_test_SN5659__cal_impl.Encode1_P2_d speedgoat_test_SN5659__cal_impl.Encode1_P3_n speedgoat_test_SN5659__cal_impl.Encode1_P4_b speedgoat_test_SN5659__cal_impl.Encode1_P5_gx speedgoat_test_SN5659__cal_impl.Encode1_P6_mt speedgoat_test_SN5659__cal_impl.Encode1_P7_k speedgoat_test_SN5659__cal_impl.Encode1_P8_bu speedgoat_test_SN5659__cal_impl.Encode1_P9_ju speedgoat_test_SN5659__cal_impl.Encode2_P10_im speedgoat_test_SN5659__cal_impl.Encode2_P11_o speedgoat_test_SN5659__cal_impl.Encode2_P12_k3 speedgoat_test_SN5659__cal_impl.Encode2_P13_m speedgoat_test_SN5659__cal_impl.Encode2_P14_k speedgoat_test_SN5659__cal_impl.Encode2_P15_e1 speedgoat_test_SN5659__cal_impl.Encode2_P1_b speedgoat_test_SN5659__cal_impl.Encode2_P2_di speedgoat_test_SN5659__cal_impl.Encode2_P3_ln speedgoat_test_SN5659__cal_impl.Encode2_P4_n speedgoat_test_SN5659__cal_impl.Encode2_P5_a speedgoat_test_SN5659__cal_impl.Encode2_P6_c speedgoat_test_SN5659__cal_impl.Encode2_P7_iq speedgoat_test_SN5659__cal_impl.Encode2_P8_b speedgoat_test_SN5659__cal_impl.Encode2_P9_l speedgoat_test_SN5659__cal_impl.Encode3_P10_f speedgoat_test_SN5659__cal_impl.Encode3_P11_ic speedgoat_test_SN5659__cal_impl.Encode3_P12_m speedgoat_test_SN5659__cal_impl.Encode3_P13_hi speedgoat_test_SN5659__cal_impl.Encode3_P14_op speedgoat_test_SN5659__cal_impl.Encode3_P15_f speedgoat_test_SN5659__cal_impl.Encode3_P1_o speedgoat_test_SN5659__cal_impl.Encode3_P2_b0 speedgoat_test_SN5659__cal_impl.Encode3_P3_p speedgoat_test_SN5659__cal_impl.Encode3_P4_hs speedgoat_test_SN5659__cal_impl.Encode3_P5_g speedgoat_test_SN5659__cal_impl.Encode3_P6_hi speedgoat_test_SN5659__cal_impl.Encode3_P7_c speedgoat_test_SN5659__cal_impl.Encode3_P8_fe speedgoat_test_SN5659__cal_impl.Encode3_P9_l speedgoat_test_SN5659__cal_impl.Encode5_P10_j speedgoat_test_SN5659__cal_impl.Encode5_P11_h speedgoat_test_SN5659__cal_impl.Encode5_P12_c speedgoat_test_SN5659__cal_impl.Encode5_P13_c speedgoat_test_SN5659__cal_impl.Encode5_P14_e speedgoat_test_SN5659__cal_impl.Encode5_P15_m speedgoat_test_SN5659__cal_impl.Encode5_P1_a speedgoat_test_SN5659__cal_impl.Encode5_P2_l speedgoat_test_SN5659__cal_impl.Encode5_P3_c speedgoat_test_SN5659__cal_impl.Encode5_P4_o speedgoat_test_SN5659__cal_impl.Encode5_P5_ih speedgoat_test_SN5659__cal_impl.Encode5_P6_o speedgoat_test_SN5659__cal_impl.Encode5_P7_l speedgoat_test_SN5659__cal_impl.Encode5_P8_m speedgoat_test_SN5659__cal_impl.Encode5_P9_o speedgoat_test_SN5659__cal_impl.Randomnumber_Mean_c speedgoat_test_SN5659__cal_impl.Randomnumber_Seed_o speedgoat_test_SN5659__cal_impl.Randomnumber_StdDev_mo speedgoat_test_SN5659__cal_impl.Sinewave_Amp_h5 speedgoat_test_SN5659__cal_impl.Sinewave_Bias_a speedgoat_test_SN5659__cal_impl.Sinewave_Freq_am speedgoat_test_SN5659__cal_impl.Sinewave_HCos_p speedgoat_test_SN5659__cal_impl.Sinewave_Hsin_p speedgoat_test_SN5659__cal_impl.Sinewave_PCos_d speedgoat_test_SN5659__cal_impl.Sinewave_PSin_d /end REF_CHARACTERISTIC
 /begin REF_MEASUREMENT speedgoat_test_SN5659_R2021b_IO682_B.DataTypeConversion1_nb speedgoat_test_SN5659_R2021b_IO682_B.DataTypeConversion_hb speedgoat_test_SN5659_R2021b_IO682_B.Encode1_e speedgoat_test_SN5659_R2021b_IO682_B.Encode2_l speedgoat_test_SN5659_R2021b_IO682_B.Encode3_bv speedgoat_test_SN5659_R2021b_IO682_B.Encode5_a speedgoat_test_SN5659_R2021b_IO682_B.Output_jl speedgoat_test_SN5659_R2021b_IO682_B.Randomnumber_i speedgoat_test_SN5659_R2021b_IO682_B.Sinewave_d speedgoat_test_SN5659_R2021b_IO682_DW.NextOutput_ir speedgoat_test_SN5659_R2021b_IO682_DW.RandSeed_bw speedgoat_test_SN5659_R2021b_IO682_DW.lastCos_o speedgoat_test_SN5659_R2021b_IO682_DW.lastSin_i speedgoat_test_SN5659_R2021b_IO682_DW.systemEnable_pe /end REF_MEASUREMENT
/end GROUP
/begin GROUP speedgoat_test_SN5659_R2021b_IO682_IO682_Encode_Channel_5_Counter_Limited "speedgoat_test_SN5659_R2021b_IO682/IO682/Encode Channel 5/Counter
Limited"
 /begin SUB_GROUP speedgoat_test_SN5659_R2021b_IO682_IO682_Encode_Channel_5_Counter_Limited_Increment_Real_World speedgoat_test_SN5659_R2021b_IO682_IO682_Encode_Channel_5_Counter_Limited_Wrap_To_Zero /end SUB_GROUP
 /begin REF_CHARACTERISTIC speedgoat_test_SN5659__cal_impl.Output_InitialCondition_nb /end REF_CHARACTERISTIC
 /begin REF_MEASUREMENT speedgoat_test_SN5659_R2021b_IO682_B.FixPtSwitch_k speedgoat_test_SN5659_R2021b_IO682_B.Output_jl speedgoat_test_SN5659_R2021b_IO682_DW.Output_DSTATE_b /end REF_MEASUREMENT
/end GROUP
/begin GROUP speedgoat_test_SN5659_R2021b_IO682_IO682_Encode_Channel_5_Counter_Limited_Increment_Real_World "speedgoat_test_SN5659_R2021b_IO682/IO682/Encode Channel 5/Counter
Limited/Increment
Real World" /begin REF_CHARACTERISTIC speedgoat_test_SN5659__cal_impl.FixPtConstant_Value_m /end REF_CHARACTERISTIC
 /begin REF_MEASUREMENT speedgoat_test_SN5659_R2021b_IO682_B.FixPtSum1_h2 speedgoat_test_SN5659_R2021b_IO682_B.Output_jl /end REF_MEASUREMENT
/end GROUP
/begin GROUP speedgoat_test_SN5659_R2021b_IO682_IO682_Encode_Channel_5_Counter_Limited_Wrap_To_Zero "speedgoat_test_SN5659_R2021b_IO682/IO682/Encode Channel 5/Counter
Limited/Wrap To Zero"
 /begin REF_CHARACTERISTIC speedgoat_test_SN5659__cal_impl.Constant_Value_ng speedgoat_test_SN5659__cal_impl.CounterLimited_uplimit_ck /end REF_CHARACTERISTIC
 /begin REF_MEASUREMENT speedgoat_test_SN5659_R2021b_IO682_B.FixPtSum1_h2 speedgoat_test_SN5659_R2021b_IO682_B.FixPtSwitch_k /end REF_MEASUREMENT
/end GROUP
/begin GROUP speedgoat_test_SN5659_R2021b_IO682_IO682_Encode_Channel_5_Prepare_RAW_value "speedgoat_test_SN5659_R2021b_IO682/IO682/Encode Channel 5/Prepare RAW value"
 /begin REF_CHARACTERISTIC speedgoat_test_SN5659__cal_impl.Label_Value_kp speedgoat_test_SN5659__cal_impl.Mask_BitMask_c speedgoat_test_SN5659__cal_impl.SDI_Value_ai speedgoat_test_SN5659__cal_impl.SSM_Value_f speedgoat_test_SN5659__cal_impl.Scale_Value_g speedgoat_test_SN5659__cal_impl.shiftthedoublevalue27bitsleft_d /end REF_CHARACTERISTIC
 /begin REF_MEASUREMENT speedgoat_test_SN5659_R2021b_IO682_B.BitwiseOperator_b speedgoat_test_SN5659_R2021b_IO682_B.DataTypeConversion1_nb speedgoat_test_SN5659_R2021b_IO682_B.DataTypeConversion_dn speedgoat_test_SN5659_R2021b_IO682_B.Divide_m speedgoat_test_SN5659_R2021b_IO682_B.Mask_cs speedgoat_test_SN5659_R2021b_IO682_B.Multiply_m speedgoat_test_SN5659_R2021b_IO682_B.ShifttoSDIslot_d speedgoat_test_SN5659_R2021b_IO682_B.ShifttoSSMslot_n /end REF_MEASUREMENT
/end GROUP
/begin GROUP speedgoat_test_SN5659_R2021b_IO682_IO682_Encode_Channel_6 "speedgoat_test_SN5659_R2021b_IO682/IO682/Encode Channel 6"
 /begin SUB_GROUP speedgoat_test_SN5659_R2021b_IO682_IO682_Encode_Channel_6_Counter_Limited speedgoat_test_SN5659_R2021b_IO682_IO682_Encode_Channel_6_Prepare_RAW_value /end SUB_GROUP
 /begin REF_CHARACTERISTIC speedgoat_test_SN5659__cal_impl.Constant_Value_f speedgoat_test_SN5659__cal_impl.Encode1_P10_i0 speedgoat_test_SN5659__cal_impl.Encode1_P11_c speedgoat_test_SN5659__cal_impl.Encode1_P12_as speedgoat_test_SN5659__cal_impl.Encode1_P13_b speedgoat_test_SN5659__cal_impl.Encode1_P14_fh speedgoat_test_SN5659__cal_impl.Encode1_P15_h1 speedgoat_test_SN5659__cal_impl.Encode1_P1_gb speedgoat_test_SN5659__cal_impl.Encode1_P2_es speedgoat_test_SN5659__cal_impl.Encode1_P3_eh speedgoat_test_SN5659__cal_impl.Encode1_P4_h speedgoat_test_SN5659__cal_impl.Encode1_P5_d speedgoat_test_SN5659__cal_impl.Encode1_P6_g speedgoat_test_SN5659__cal_impl.Encode1_P7_n speedgoat_test_SN5659__cal_impl.Encode1_P8_cc speedgoat_test_SN5659__cal_impl.Encode1_P9_f speedgoat_test_SN5659__cal_impl.Encode2_P10_d speedgoat_test_SN5659__cal_impl.Encode2_P11_b speedgoat_test_SN5659__cal_impl.Encode2_P12_mp speedgoat_test_SN5659__cal_impl.Encode2_P13_b speedgoat_test_SN5659__cal_impl.Encode2_P14_h speedgoat_test_SN5659__cal_impl.Encode2_P15_d speedgoat_test_SN5659__cal_impl.Encode2_P1_ga speedgoat_test_SN5659__cal_impl.Encode2_P2_ka speedgoat_test_SN5659__cal_impl.Encode2_P3_fe speedgoat_test_SN5659__cal_impl.Encode2_P4_lk speedgoat_test_SN5659__cal_impl.Encode2_P5_n speedgoat_test_SN5659__cal_impl.Encode2_P6_fn speedgoat_test_SN5659__cal_impl.Encode2_P7_jb speedgoat_test_SN5659__cal_impl.Encode2_P8_hl speedgoat_test_SN5659__cal_impl.Encode2_P9_dn speedgoat_test_SN5659__cal_impl.Encode3_P10_g speedgoat_test_SN5659__cal_impl.Encode3_P11_ox speedgoat_test_SN5659__cal_impl.Encode3_P12_d3 speedgoat_test_SN5659__cal_impl.Encode3_P13_n speedgoat_test_SN5659__cal_impl.Encode3_P14_bl speedgoat_test_SN5659__cal_impl.Encode3_P15_gy speedgoat_test_SN5659__cal_impl.Encode3_P1_j speedgoat_test_SN5659__cal_impl.Encode3_P2_p speedgoat_test_SN5659__cal_impl.Encode3_P3_pb speedgoat_test_SN5659__cal_impl.Encode3_P4_hu speedgoat_test_SN5659__cal_impl.Encode3_P5_kk speedgoat_test_SN5659__cal_impl.Encode3_P6_iy speedgoat_test_SN5659__cal_impl.Encode3_P7_g speedgoat_test_SN5659__cal_impl.Encode3_P8_c speedgoat_test_SN5659__cal_impl.Encode3_P9_a speedgoat_test_SN5659__cal_impl.Encode4_P10_h3 speedgoat_test_SN5659__cal_impl.Encode4_P11_l speedgoat_test_SN5659__cal_impl.Encode4_P12_c speedgoat_test_SN5659__cal_impl.Encode4_P13_ml speedgoat_test_SN5659__cal_impl.Encode4_P14_k speedgoat_test_SN5659__cal_impl.Encode4_P15_o speedgoat_test_SN5659__cal_impl.Encode4_P1_af speedgoat_test_SN5659__cal_impl.Encode4_P2_j speedgoat_test_SN5659__cal_impl.Encode4_P3_n5 speedgoat_test_SN5659__cal_impl.Encode4_P4_kc speedgoat_test_SN5659__cal_impl.Encode4_P5_d speedgoat_test_SN5659__cal_impl.Encode4_P6_abh speedgoat_test_SN5659__cal_impl.Encode4_P7_di speedgoat_test_SN5659__cal_impl.Encode4_P8_e speedgoat_test_SN5659__cal_impl.Encode4_P9_d speedgoat_test_SN5659__cal_impl.Randomnumber_Mean_l speedgoat_test_SN5659__cal_impl.Randomnumber_Seed_cg speedgoat_test_SN5659__cal_impl.Randomnumber_StdDev_o speedgoat_test_SN5659__cal_impl.Sinewave_Amp_m2 speedgoat_test_SN5659__cal_impl.Sinewave_Bias_ac speedgoat_test_SN5659__cal_impl.Sinewave_Freq_cn speedgoat_test_SN5659__cal_impl.Sinewave_HCos_i speedgoat_test_SN5659__cal_impl.Sinewave_Hsin_c speedgoat_test_SN5659__cal_impl.Sinewave_PCos_e speedgoat_test_SN5659__cal_impl.Sinewave_PSin_l /end REF_CHARACTERISTIC
 /begin REF_MEASUREMENT speedgoat_test_SN5659_R2021b_IO682_B.DataTypeConversion1_f speedgoat_test_SN5659_R2021b_IO682_B.DataTypeConversion_n speedgoat_test_SN5659_R2021b_IO682_B.Encode1_d speedgoat_test_SN5659_R2021b_IO682_B.Encode2_pt speedgoat_test_SN5659_R2021b_IO682_B.Encode3_k speedgoat_test_SN5659_R2021b_IO682_B.Encode4_cp speedgoat_test_SN5659_R2021b_IO682_B.Output_i speedgoat_test_SN5659_R2021b_IO682_B.Randomnumber_i2 speedgoat_test_SN5659_R2021b_IO682_B.Sinewave_fe speedgoat_test_SN5659_R2021b_IO682_DW.NextOutput_hu speedgoat_test_SN5659_R2021b_IO682_DW.RandSeed_j speedgoat_test_SN5659_R2021b_IO682_DW.lastCos_oy speedgoat_test_SN5659_R2021b_IO682_DW.lastSin_a speedgoat_test_SN5659_R2021b_IO682_DW.systemEnable_i /end REF_MEASUREMENT
/end GROUP
/begin GROUP speedgoat_test_SN5659_R2021b_IO682_IO682_Encode_Channel_6_Counter_Limited "speedgoat_test_SN5659_R2021b_IO682/IO682/Encode Channel 6/Counter
Limited"
 /begin SUB_GROUP speedgoat_test_SN5659_R2021b_IO682_IO682_Encode_Channel_6_Counter_Limited_Increment_Real_World speedgoat_test_SN5659_R2021b_IO682_IO682_Encode_Channel_6_Counter_Limited_Wrap_To_Zero /end SUB_GROUP
 /begin REF_CHARACTERISTIC speedgoat_test_SN5659__cal_impl.Output_InitialCondition_h3 /end REF_CHARACTERISTIC
 /begin REF_MEASUREMENT speedgoat_test_SN5659_R2021b_IO682_B.FixPtSwitch_hh speedgoat_test_SN5659_R2021b_IO682_B.Output_i speedgoat_test_SN5659_R2021b_IO682_DW.Output_DSTATE_f /end REF_MEASUREMENT
/end GROUP
/begin GROUP speedgoat_test_SN5659_R2021b_IO682_IO682_Encode_Channel_6_Counter_Limited_Increment_Real_World "speedgoat_test_SN5659_R2021b_IO682/IO682/Encode Channel 6/Counter
Limited/Increment
Real World" /begin REF_CHARACTERISTIC speedgoat_test_SN5659__cal_impl.FixPtConstant_Value_n /end REF_CHARACTERISTIC
 /begin REF_MEASUREMENT speedgoat_test_SN5659_R2021b_IO682_B.FixPtSum1_m speedgoat_test_SN5659_R2021b_IO682_B.Output_i /end REF_MEASUREMENT
/end GROUP
/begin GROUP speedgoat_test_SN5659_R2021b_IO682_IO682_Encode_Channel_6_Counter_Limited_Wrap_To_Zero "speedgoat_test_SN5659_R2021b_IO682/IO682/Encode Channel 6/Counter
Limited/Wrap To Zero"
 /begin REF_CHARACTERISTIC speedgoat_test_SN5659__cal_impl.Constant_Value_oy speedgoat_test_SN5659__cal_impl.CounterLimited_uplimit_l /end REF_CHARACTERISTIC
 /begin REF_MEASUREMENT speedgoat_test_SN5659_R2021b_IO682_B.FixPtSum1_m speedgoat_test_SN5659_R2021b_IO682_B.FixPtSwitch_hh /end REF_MEASUREMENT
/end GROUP
/begin GROUP speedgoat_test_SN5659_R2021b_IO682_IO682_Encode_Channel_6_Prepare_RAW_value "speedgoat_test_SN5659_R2021b_IO682/IO682/Encode Channel 6/Prepare RAW value"
 /begin REF_CHARACTERISTIC speedgoat_test_SN5659__cal_impl.Label_Value_p speedgoat_test_SN5659__cal_impl.Mask_BitMask_er speedgoat_test_SN5659__cal_impl.SDI_Value_ig speedgoat_test_SN5659__cal_impl.SSM_Value_a speedgoat_test_SN5659__cal_impl.Scale_Value_h speedgoat_test_SN5659__cal_impl.shiftthedoublevalue27bitsleft_b /end REF_CHARACTERISTIC
 /begin REF_MEASUREMENT speedgoat_test_SN5659_R2021b_IO682_B.BitwiseOperator_eh speedgoat_test_SN5659_R2021b_IO682_B.DataTypeConversion1_f speedgoat_test_SN5659_R2021b_IO682_B.DataTypeConversion_m speedgoat_test_SN5659_R2021b_IO682_B.Divide_pl speedgoat_test_SN5659_R2021b_IO682_B.Mask_my speedgoat_test_SN5659_R2021b_IO682_B.Multiply_k speedgoat_test_SN5659_R2021b_IO682_B.ShifttoSDIslot_mf speedgoat_test_SN5659_R2021b_IO682_B.ShifttoSSMslot_et /end REF_MEASUREMENT
/end GROUP
/begin GROUP speedgoat_test_SN5659_R2021b_IO682_IO682_Encode_Channel_7 "speedgoat_test_SN5659_R2021b_IO682/IO682/Encode Channel 7"
 /begin SUB_GROUP speedgoat_test_SN5659_R2021b_IO682_IO682_Encode_Channel_7_Counter_Limited speedgoat_test_SN5659_R2021b_IO682_IO682_Encode_Channel_7_Prepare_RAW_value /end SUB_GROUP
 /begin REF_CHARACTERISTIC speedgoat_test_SN5659__cal_impl.Constant_Value_bz speedgoat_test_SN5659__cal_impl.Encode1_P10_i5 speedgoat_test_SN5659__cal_impl.Encode1_P11_am speedgoat_test_SN5659__cal_impl.Encode1_P12_mt speedgoat_test_SN5659__cal_impl.Encode1_P13_is speedgoat_test_SN5659__cal_impl.Encode1_P14_cd speedgoat_test_SN5659__cal_impl.Encode1_P15_kak speedgoat_test_SN5659__cal_impl.Encode1_P1_cy speedgoat_test_SN5659__cal_impl.Encode1_P2_a speedgoat_test_SN5659__cal_impl.Encode1_P3_em speedgoat_test_SN5659__cal_impl.Encode1_P4_m speedgoat_test_SN5659__cal_impl.Encode1_P5_dq speedgoat_test_SN5659__cal_impl.Encode1_P6_ad speedgoat_test_SN5659__cal_impl.Encode1_P7_eo speedgoat_test_SN5659__cal_impl.Encode1_P8_n speedgoat_test_SN5659__cal_impl.Encode1_P9_a2 speedgoat_test_SN5659__cal_impl.Encode2_P10_dc speedgoat_test_SN5659__cal_impl.Encode2_P11_hq speedgoat_test_SN5659__cal_impl.Encode2_P12_ek speedgoat_test_SN5659__cal_impl.Encode2_P13_oo speedgoat_test_SN5659__cal_impl.Encode2_P14_j speedgoat_test_SN5659__cal_impl.Encode2_P15_n speedgoat_test_SN5659__cal_impl.Encode2_P1_o speedgoat_test_SN5659__cal_impl.Encode2_P2_g speedgoat_test_SN5659__cal_impl.Encode2_P3_kx speedgoat_test_SN5659__cal_impl.Encode2_P4_a speedgoat_test_SN5659__cal_impl.Encode2_P5_pz speedgoat_test_SN5659__cal_impl.Encode2_P6_k speedgoat_test_SN5659__cal_impl.Encode2_P7_p speedgoat_test_SN5659__cal_impl.Encode2_P8_ip speedgoat_test_SN5659__cal_impl.Encode2_P9_hv speedgoat_test_SN5659__cal_impl.Encode3_P10_oe speedgoat_test_SN5659__cal_impl.Encode3_P11_a speedgoat_test_SN5659__cal_impl.Encode3_P12_et speedgoat_test_SN5659__cal_impl.Encode3_P13_d speedgoat_test_SN5659__cal_impl.Encode3_P14_p speedgoat_test_SN5659__cal_impl.Encode3_P15_l speedgoat_test_SN5659__cal_impl.Encode3_P1_jy speedgoat_test_SN5659__cal_impl.Encode3_P2_d speedgoat_test_SN5659__cal_impl.Encode3_P3_f speedgoat_test_SN5659__cal_impl.Encode3_P4_mc speedgoat_test_SN5659__cal_impl.Encode3_P5_d0 speedgoat_test_SN5659__cal_impl.Encode3_P6_hf speedgoat_test_SN5659__cal_impl.Encode3_P7_k speedgoat_test_SN5659__cal_impl.Encode3_P8_o speedgoat_test_SN5659__cal_impl.Encode3_P9_cw speedgoat_test_SN5659__cal_impl.Encode4_P10_l speedgoat_test_SN5659__cal_impl.Encode4_P11_pl speedgoat_test_SN5659__cal_impl.Encode4_P12_k speedgoat_test_SN5659__cal_impl.Encode4_P13_hn speedgoat_test_SN5659__cal_impl.Encode4_P14_ma speedgoat_test_SN5659__cal_impl.Encode4_P15_iu speedgoat_test_SN5659__cal_impl.Encode4_P1_o speedgoat_test_SN5659__cal_impl.Encode4_P2_pk speedgoat_test_SN5659__cal_impl.Encode4_P3_h5 speedgoat_test_SN5659__cal_impl.Encode4_P4_my speedgoat_test_SN5659__cal_impl.Encode4_P5_pv speedgoat_test_SN5659__cal_impl.Encode4_P6_ed speedgoat_test_SN5659__cal_impl.Encode4_P7_by speedgoat_test_SN5659__cal_impl.Encode4_P8_a speedgoat_test_SN5659__cal_impl.Encode4_P9_a speedgoat_test_SN5659__cal_impl.Randomnumber_Mean_pl speedgoat_test_SN5659__cal_impl.Randomnumber_Seed_e speedgoat_test_SN5659__cal_impl.Randomnumber_StdDev_fs speedgoat_test_SN5659__cal_impl.Sinewave_Amp_ch speedgoat_test_SN5659__cal_impl.Sinewave_Bias_d speedgoat_test_SN5659__cal_impl.Sinewave_Freq_a2 speedgoat_test_SN5659__cal_impl.Sinewave_HCos_h speedgoat_test_SN5659__cal_impl.Sinewave_Hsin_cy speedgoat_test_SN5659__cal_impl.Sinewave_PCos_n speedgoat_test_SN5659__cal_impl.Sinewave_PSin_o /end REF_CHARACTERISTIC
 /begin REF_MEASUREMENT speedgoat_test_SN5659_R2021b_IO682_B.DataTypeConversion1_fw speedgoat_test_SN5659_R2021b_IO682_B.DataTypeConversion_i speedgoat_test_SN5659_R2021b_IO682_B.Encode1_i speedgoat_test_SN5659_R2021b_IO682_B.Encode2_ik speedgoat_test_SN5659_R2021b_IO682_B.Encode3_dc speedgoat_test_SN5659_R2021b_IO682_B.Encode4_cn speedgoat_test_SN5659_R2021b_IO682_B.Output_bg speedgoat_test_SN5659_R2021b_IO682_B.Randomnumber_d speedgoat_test_SN5659_R2021b_IO682_B.Sinewave_ff speedgoat_test_SN5659_R2021b_IO682_DW.NextOutput_p speedgoat_test_SN5659_R2021b_IO682_DW.RandSeed_n speedgoat_test_SN5659_R2021b_IO682_DW.lastCos_j speedgoat_test_SN5659_R2021b_IO682_DW.lastSin_pf speedgoat_test_SN5659_R2021b_IO682_DW.systemEnable_jy /end REF_MEASUREMENT
/end GROUP
/begin GROUP speedgoat_test_SN5659_R2021b_IO682_IO682_Encode_Channel_7_Counter_Limited "speedgoat_test_SN5659_R2021b_IO682/IO682/Encode Channel 7/Counter
Limited"
 /begin SUB_GROUP speedgoat_test_SN5659_R2021b_IO682_IO682_Encode_Channel_7_Counter_Limited_Increment_Real_World speedgoat_test_SN5659_R2021b_IO682_IO682_Encode_Channel_7_Counter_Limited_Wrap_To_Zero /end SUB_GROUP
 /begin REF_CHARACTERISTIC speedgoat_test_SN5659__cal_impl.Output_InitialCondition_dr /end REF_CHARACTERISTIC
 /begin REF_MEASUREMENT speedgoat_test_SN5659_R2021b_IO682_B.FixPtSwitch_a speedgoat_test_SN5659_R2021b_IO682_B.Output_bg speedgoat_test_SN5659_R2021b_IO682_DW.Output_DSTATE_h /end REF_MEASUREMENT
/end GROUP
/begin GROUP speedgoat_test_SN5659_R2021b_IO682_IO682_Encode_Channel_7_Counter_Limited_Increment_Real_World "speedgoat_test_SN5659_R2021b_IO682/IO682/Encode Channel 7/Counter
Limited/Increment
Real World" /begin REF_CHARACTERISTIC speedgoat_test_SN5659__cal_impl.FixPtConstant_Value_ie /end REF_CHARACTERISTIC
 /begin REF_MEASUREMENT speedgoat_test_SN5659_R2021b_IO682_B.FixPtSum1_he speedgoat_test_SN5659_R2021b_IO682_B.Output_bg /end REF_MEASUREMENT
/end GROUP
/begin GROUP speedgoat_test_SN5659_R2021b_IO682_IO682_Encode_Channel_7_Counter_Limited_Wrap_To_Zero "speedgoat_test_SN5659_R2021b_IO682/IO682/Encode Channel 7/Counter
Limited/Wrap To Zero"
 /begin REF_CHARACTERISTIC speedgoat_test_SN5659__cal_impl.Constant_Value_pl speedgoat_test_SN5659__cal_impl.CounterLimited_uplimit_du /end REF_CHARACTERISTIC
 /begin REF_MEASUREMENT speedgoat_test_SN5659_R2021b_IO682_B.FixPtSum1_he speedgoat_test_SN5659_R2021b_IO682_B.FixPtSwitch_a /end REF_MEASUREMENT
/end GROUP
/begin GROUP speedgoat_test_SN5659_R2021b_IO682_IO682_Encode_Channel_7_Prepare_RAW_value "speedgoat_test_SN5659_R2021b_IO682/IO682/Encode Channel 7/Prepare RAW value"
 /begin REF_CHARACTERISTIC speedgoat_test_SN5659__cal_impl.Label_Value_jf speedgoat_test_SN5659__cal_impl.Mask_BitMask_f3 speedgoat_test_SN5659__cal_impl.SDI_Value_k speedgoat_test_SN5659__cal_impl.SSM_Value_g speedgoat_test_SN5659__cal_impl.Scale_Value_e3 speedgoat_test_SN5659__cal_impl.shiftthedoublevalue27bitslef_jj /end REF_CHARACTERISTIC
 /begin REF_MEASUREMENT speedgoat_test_SN5659_R2021b_IO682_B.BitwiseOperator_n speedgoat_test_SN5659_R2021b_IO682_B.DataTypeConversion1_fw speedgoat_test_SN5659_R2021b_IO682_B.DataTypeConversion_cp speedgoat_test_SN5659_R2021b_IO682_B.Divide_c speedgoat_test_SN5659_R2021b_IO682_B.Mask_b speedgoat_test_SN5659_R2021b_IO682_B.Multiply_hz speedgoat_test_SN5659_R2021b_IO682_B.ShifttoSDIslot_bb speedgoat_test_SN5659_R2021b_IO682_B.ShifttoSSMslot_o /end REF_MEASUREMENT
/end GROUP
/begin GROUP speedgoat_test_SN5659_R2021b_IO682_IO682_Encode_Channel_8 "speedgoat_test_SN5659_R2021b_IO682/IO682/Encode Channel 8"
 /begin SUB_GROUP speedgoat_test_SN5659_R2021b_IO682_IO682_Encode_Channel_8_Counter_Limited speedgoat_test_SN5659_R2021b_IO682_IO682_Encode_Channel_8_Prepare_RAW_value /end SUB_GROUP
 /begin REF_CHARACTERISTIC speedgoat_test_SN5659__cal_impl.Constant_Value_b5 speedgoat_test_SN5659__cal_impl.Encode1_P10_pr speedgoat_test_SN5659__cal_impl.Encode1_P11_d speedgoat_test_SN5659__cal_impl.Encode1_P12_a2 speedgoat_test_SN5659__cal_impl.Encode1_P13_g speedgoat_test_SN5659__cal_impl.Encode1_P14_av speedgoat_test_SN5659__cal_impl.Encode1_P15_c speedgoat_test_SN5659__cal_impl.Encode1_P1_d speedgoat_test_SN5659__cal_impl.Encode1_P2_cw speedgoat_test_SN5659__cal_impl.Encode1_P3_hc speedgoat_test_SN5659__cal_impl.Encode1_P4_f speedgoat_test_SN5659__cal_impl.Encode1_P5_p speedgoat_test_SN5659__cal_impl.Encode1_P6_gn speedgoat_test_SN5659__cal_impl.Encode1_P7_h speedgoat_test_SN5659__cal_impl.Encode1_P8_bi speedgoat_test_SN5659__cal_impl.Encode1_P9_i speedgoat_test_SN5659__cal_impl.Encode2_P10_og speedgoat_test_SN5659__cal_impl.Encode2_P11_df speedgoat_test_SN5659__cal_impl.Encode2_P12_l speedgoat_test_SN5659__cal_impl.Encode2_P13_ol speedgoat_test_SN5659__cal_impl.Encode2_P14_dr speedgoat_test_SN5659__cal_impl.Encode2_P15_f speedgoat_test_SN5659__cal_impl.Encode2_P1_i speedgoat_test_SN5659__cal_impl.Encode2_P2_gi speedgoat_test_SN5659__cal_impl.Encode2_P3_oj speedgoat_test_SN5659__cal_impl.Encode2_P4_nt speedgoat_test_SN5659__cal_impl.Encode2_P5_af speedgoat_test_SN5659__cal_impl.Encode2_P6_ny speedgoat_test_SN5659__cal_impl.Encode2_P7_g speedgoat_test_SN5659__cal_impl.Encode2_P8_m speedgoat_test_SN5659__cal_impl.Encode2_P9_f speedgoat_test_SN5659__cal_impl.Encode3_P10_k speedgoat_test_SN5659__cal_impl.Encode3_P11_lg speedgoat_test_SN5659__cal_impl.Encode3_P12_a speedgoat_test_SN5659__cal_impl.Encode3_P13_ov speedgoat_test_SN5659__cal_impl.Encode3_P14_m5 speedgoat_test_SN5659__cal_impl.Encode3_P15_pd speedgoat_test_SN5659__cal_impl.Encode3_P1_d speedgoat_test_SN5659__cal_impl.Encode3_P2_ni speedgoat_test_SN5659__cal_impl.Encode3_P3_e speedgoat_test_SN5659__cal_impl.Encode3_P4_he speedgoat_test_SN5659__cal_impl.Encode3_P5_l speedgoat_test_SN5659__cal_impl.Encode3_P6_o speedgoat_test_SN5659__cal_impl.Encode3_P7_bt speedgoat_test_SN5659__cal_impl.Encode3_P8_n speedgoat_test_SN5659__cal_impl.Encode3_P9_e speedgoat_test_SN5659__cal_impl.Encode4_P10_jg speedgoat_test_SN5659__cal_impl.Encode4_P11_js speedgoat_test_SN5659__cal_impl.Encode4_P12_n speedgoat_test_SN5659__cal_impl.Encode4_P13_k speedgoat_test_SN5659__cal_impl.Encode4_P14_f speedgoat_test_SN5659__cal_impl.Encode4_P15_c speedgoat_test_SN5659__cal_impl.Encode4_P1_hi speedgoat_test_SN5659__cal_impl.Encode4_P2_k speedgoat_test_SN5659__cal_impl.Encode4_P3_k speedgoat_test_SN5659__cal_impl.Encode4_P4_j speedgoat_test_SN5659__cal_impl.Encode4_P5_g speedgoat_test_SN5659__cal_impl.Encode4_P6_g speedgoat_test_SN5659__cal_impl.Encode4_P7_c3 speedgoat_test_SN5659__cal_impl.Encode4_P8_c speedgoat_test_SN5659__cal_impl.Encode4_P9_m speedgoat_test_SN5659__cal_impl.Randomnumber_Mean_pz speedgoat_test_SN5659__cal_impl.Randomnumber_Seed_l speedgoat_test_SN5659__cal_impl.Randomnumber_StdDev_e speedgoat_test_SN5659__cal_impl.Sinewave_Amp_hw speedgoat_test_SN5659__cal_impl.Sinewave_Bias_p speedgoat_test_SN5659__cal_impl.Sinewave_Freq_j speedgoat_test_SN5659__cal_impl.Sinewave_HCos_h2 speedgoat_test_SN5659__cal_impl.Sinewave_Hsin_jl speedgoat_test_SN5659__cal_impl.Sinewave_PCos_l speedgoat_test_SN5659__cal_impl.Sinewave_PSin_b /end REF_CHARACTERISTIC
 /begin REF_MEASUREMENT speedgoat_test_SN5659_R2021b_IO682_B.DataTypeConversion1_j speedgoat_test_SN5659_R2021b_IO682_B.DataTypeConversion_k speedgoat_test_SN5659_R2021b_IO682_B.Encode1_ff speedgoat_test_SN5659_R2021b_IO682_B.Encode2_o4 speedgoat_test_SN5659_R2021b_IO682_B.Encode3_dp speedgoat_test_SN5659_R2021b_IO682_B.Encode4_a speedgoat_test_SN5659_R2021b_IO682_B.Output_mw speedgoat_test_SN5659_R2021b_IO682_B.Randomnumber_n4 speedgoat_test_SN5659_R2021b_IO682_B.Sinewave_m speedgoat_test_SN5659_R2021b_IO682_DW.NextOutput_jn speedgoat_test_SN5659_R2021b_IO682_DW.RandSeed_l speedgoat_test_SN5659_R2021b_IO682_DW.lastCos_c speedgoat_test_SN5659_R2021b_IO682_DW.lastSin_iv speedgoat_test_SN5659_R2021b_IO682_DW.systemEnable_gv /end REF_MEASUREMENT
/end GROUP
/begin GROUP speedgoat_test_SN5659_R2021b_IO682_IO682_Encode_Channel_8_Counter_Limited "speedgoat_test_SN5659_R2021b_IO682/IO682/Encode Channel 8/Counter
Limited"
 /begin SUB_GROUP speedgoat_test_SN5659_R2021b_IO682_IO682_Encode_Channel_8_Counter_Limited_Increment_Real_World speedgoat_test_SN5659_R2021b_IO682_IO682_Encode_Channel_8_Counter_Limited_Wrap_To_Zero /end SUB_GROUP
 /begin REF_CHARACTERISTIC speedgoat_test_SN5659__cal_impl.Output_InitialCondition_a /end REF_CHARACTERISTIC
 /begin REF_MEASUREMENT speedgoat_test_SN5659_R2021b_IO682_B.FixPtSwitch_l0 speedgoat_test_SN5659_R2021b_IO682_B.Output_mw speedgoat_test_SN5659_R2021b_IO682_DW.Output_DSTATE_m4 /end REF_MEASUREMENT
/end GROUP
/begin GROUP speedgoat_test_SN5659_R2021b_IO682_IO682_Encode_Channel_8_Counter_Limited_Increment_Real_World "speedgoat_test_SN5659_R2021b_IO682/IO682/Encode Channel 8/Counter
Limited/Increment
Real World" /begin REF_CHARACTERISTIC speedgoat_test_SN5659__cal_impl.FixPtConstant_Value_b /end REF_CHARACTERISTIC
 /begin REF_MEASUREMENT speedgoat_test_SN5659_R2021b_IO682_B.FixPtSum1_p speedgoat_test_SN5659_R2021b_IO682_B.Output_mw /end REF_MEASUREMENT
/end GROUP
/begin GROUP speedgoat_test_SN5659_R2021b_IO682_IO682_Encode_Channel_8_Counter_Limited_Wrap_To_Zero "speedgoat_test_SN5659_R2021b_IO682/IO682/Encode Channel 8/Counter
Limited/Wrap To Zero"
 /begin REF_CHARACTERISTIC speedgoat_test_SN5659__cal_impl.Constant_Value_pv speedgoat_test_SN5659__cal_impl.CounterLimited_uplimit_b /end REF_CHARACTERISTIC
 /begin REF_MEASUREMENT speedgoat_test_SN5659_R2021b_IO682_B.FixPtSum1_p speedgoat_test_SN5659_R2021b_IO682_B.FixPtSwitch_l0 /end REF_MEASUREMENT
/end GROUP
/begin GROUP speedgoat_test_SN5659_R2021b_IO682_IO682_Encode_Channel_8_Prepare_RAW_value "speedgoat_test_SN5659_R2021b_IO682/IO682/Encode Channel 8/Prepare RAW value"
 /begin REF_CHARACTERISTIC speedgoat_test_SN5659__cal_impl.Label_Value_pn speedgoat_test_SN5659__cal_impl.Mask_BitMask_kz speedgoat_test_SN5659__cal_impl.SDI_Value_im speedgoat_test_SN5659__cal_impl.SSM_Value_p speedgoat_test_SN5659__cal_impl.Scale_Value_kb speedgoat_test_SN5659__cal_impl.shiftthedoublevalue27bitsleft_f /end REF_CHARACTERISTIC
 /begin REF_MEASUREMENT speedgoat_test_SN5659_R2021b_IO682_B.BitwiseOperator_b5 speedgoat_test_SN5659_R2021b_IO682_B.DataTypeConversion1_j speedgoat_test_SN5659_R2021b_IO682_B.DataTypeConversion_is speedgoat_test_SN5659_R2021b_IO682_B.Divide_oc speedgoat_test_SN5659_R2021b_IO682_B.Mask_aj speedgoat_test_SN5659_R2021b_IO682_B.Multiply_kl speedgoat_test_SN5659_R2021b_IO682_B.ShifttoSDIslot_f speedgoat_test_SN5659_R2021b_IO682_B.ShifttoSSMslot_ea /end REF_MEASUREMENT
/end GROUP
/begin GROUP speedgoat_test_SN5659_R2021b_IO682_IO682_Encode_Channel_9 "speedgoat_test_SN5659_R2021b_IO682/IO682/Encode Channel 9"
 /begin SUB_GROUP speedgoat_test_SN5659_R2021b_IO682_IO682_Encode_Channel_9_Counter_Limited speedgoat_test_SN5659_R2021b_IO682_IO682_Encode_Channel_9_Prepare_RAW_value /end SUB_GROUP
 /begin REF_CHARACTERISTIC speedgoat_test_SN5659__cal_impl.Constant_Value_le speedgoat_test_SN5659__cal_impl.Encode1_P10_d speedgoat_test_SN5659__cal_impl.Encode1_P11_i speedgoat_test_SN5659__cal_impl.Encode1_P12_jx speedgoat_test_SN5659__cal_impl.Encode1_P13_gu speedgoat_test_SN5659__cal_impl.Encode1_P14_fz speedgoat_test_SN5659__cal_impl.Encode1_P15_d speedgoat_test_SN5659__cal_impl.Encode1_P1_kw speedgoat_test_SN5659__cal_impl.Encode1_P2_ho speedgoat_test_SN5659__cal_impl.Encode1_P3_lm speedgoat_test_SN5659__cal_impl.Encode1_P4_cs speedgoat_test_SN5659__cal_impl.Encode1_P5_m speedgoat_test_SN5659__cal_impl.Encode1_P6_am speedgoat_test_SN5659__cal_impl.Encode1_P7_b3 speedgoat_test_SN5659__cal_impl.Encode1_P8_j speedgoat_test_SN5659__cal_impl.Encode1_P9_oc speedgoat_test_SN5659__cal_impl.Encode2_P10_dz speedgoat_test_SN5659__cal_impl.Encode2_P11_dm speedgoat_test_SN5659__cal_impl.Encode2_P12_j speedgoat_test_SN5659__cal_impl.Encode2_P13_g speedgoat_test_SN5659__cal_impl.Encode2_P14_hh speedgoat_test_SN5659__cal_impl.Encode2_P15_km speedgoat_test_SN5659__cal_impl.Encode2_P1_bc speedgoat_test_SN5659__cal_impl.Encode2_P2_hl speedgoat_test_SN5659__cal_impl.Encode2_P3_dm speedgoat_test_SN5659__cal_impl.Encode2_P4_ny speedgoat_test_SN5659__cal_impl.Encode2_P5_im speedgoat_test_SN5659__cal_impl.Encode2_P6_g speedgoat_test_SN5659__cal_impl.Encode2_P7_k5 speedgoat_test_SN5659__cal_impl.Encode2_P8_ig speedgoat_test_SN5659__cal_impl.Encode2_P9_g speedgoat_test_SN5659__cal_impl.Encode3_P10_l15 speedgoat_test_SN5659__cal_impl.Encode3_P11_jg speedgoat_test_SN5659__cal_impl.Encode3_P12_n speedgoat_test_SN5659__cal_impl.Encode3_P13_f speedgoat_test_SN5659__cal_impl.Encode3_P14_nc speedgoat_test_SN5659__cal_impl.Encode3_P15_o speedgoat_test_SN5659__cal_impl.Encode3_P1_lu speedgoat_test_SN5659__cal_impl.Encode3_P2_dl speedgoat_test_SN5659__cal_impl.Encode3_P3_k speedgoat_test_SN5659__cal_impl.Encode3_P4_ga speedgoat_test_SN5659__cal_impl.Encode3_P5_j speedgoat_test_SN5659__cal_impl.Encode3_P6_gz speedgoat_test_SN5659__cal_impl.Encode3_P7_dw speedgoat_test_SN5659__cal_impl.Encode3_P8_a speedgoat_test_SN5659__cal_impl.Encode3_P9_lj speedgoat_test_SN5659__cal_impl.Encode5_P10_o speedgoat_test_SN5659__cal_impl.Encode5_P11_g speedgoat_test_SN5659__cal_impl.Encode5_P12_p speedgoat_test_SN5659__cal_impl.Encode5_P13_m speedgoat_test_SN5659__cal_impl.Encode5_P14_k speedgoat_test_SN5659__cal_impl.Encode5_P15_a speedgoat_test_SN5659__cal_impl.Encode5_P1_i speedgoat_test_SN5659__cal_impl.Encode5_P2_b speedgoat_test_SN5659__cal_impl.Encode5_P3_i speedgoat_test_SN5659__cal_impl.Encode5_P4_k speedgoat_test_SN5659__cal_impl.Encode5_P5_o speedgoat_test_SN5659__cal_impl.Encode5_P6_j speedgoat_test_SN5659__cal_impl.Encode5_P7_h speedgoat_test_SN5659__cal_impl.Encode5_P8_i speedgoat_test_SN5659__cal_impl.Encode5_P9_g speedgoat_test_SN5659__cal_impl.Randomnumber_Mean_fb speedgoat_test_SN5659__cal_impl.Randomnumber_Seed_j speedgoat_test_SN5659__cal_impl.Randomnumber_StdDev_oa speedgoat_test_SN5659__cal_impl.Sinewave_Amp_f speedgoat_test_SN5659__cal_impl.Sinewave_Bias_je speedgoat_test_SN5659__cal_impl.Sinewave_Freq_k speedgoat_test_SN5659__cal_impl.Sinewave_HCos_n speedgoat_test_SN5659__cal_impl.Sinewave_Hsin_o2 speedgoat_test_SN5659__cal_impl.Sinewave_PCos_lt speedgoat_test_SN5659__cal_impl.Sinewave_PSin_bm /end REF_CHARACTERISTIC
 /begin REF_MEASUREMENT speedgoat_test_SN5659_R2021b_IO682_B.DataTypeConversion1_e speedgoat_test_SN5659_R2021b_IO682_B.DataTypeConversion_dw speedgoat_test_SN5659_R2021b_IO682_B.Encode1_kq speedgoat_test_SN5659_R2021b_IO682_B.Encode2_o3 speedgoat_test_SN5659_R2021b_IO682_B.Encode3_h speedgoat_test_SN5659_R2021b_IO682_B.Encode5_n speedgoat_test_SN5659_R2021b_IO682_B.Output_pd speedgoat_test_SN5659_R2021b_IO682_B.Randomnumber_j speedgoat_test_SN5659_R2021b_IO682_B.Sinewave_ao speedgoat_test_SN5659_R2021b_IO682_DW.NextOutput_b speedgoat_test_SN5659_R2021b_IO682_DW.RandSeed_fs speedgoat_test_SN5659_R2021b_IO682_DW.lastCos_b speedgoat_test_SN5659_R2021b_IO682_DW.lastSin_fv speedgoat_test_SN5659_R2021b_IO682_DW.systemEnable_o /end REF_MEASUREMENT
/end GROUP
/begin GROUP speedgoat_test_SN5659_R2021b_IO682_IO682_Encode_Channel_9_Counter_Limited "speedgoat_test_SN5659_R2021b_IO682/IO682/Encode Channel 9/Counter
Limited"
 /begin SUB_GROUP speedgoat_test_SN5659_R2021b_IO682_IO682_Encode_Channel_9_Counter_Limited_Increment_Real_World speedgoat_test_SN5659_R2021b_IO682_IO682_Encode_Channel_9_Counter_Limited_Wrap_To_Zero /end SUB_GROUP
 /begin REF_CHARACTERISTIC speedgoat_test_SN5659__cal_impl.Output_InitialCondition_aw /end REF_CHARACTERISTIC
 /begin REF_MEASUREMENT speedgoat_test_SN5659_R2021b_IO682_B.FixPtSwitch_m speedgoat_test_SN5659_R2021b_IO682_B.Output_pd speedgoat_test_SN5659_R2021b_IO682_DW.Output_DSTATE_fw /end REF_MEASUREMENT
/end GROUP
/begin GROUP speedgoat_test_SN5659_R2021b_IO682_IO682_Encode_Channel_9_Counter_Limited_Increment_Real_World "speedgoat_test_SN5659_R2021b_IO682/IO682/Encode Channel 9/Counter
Limited/Increment
Real World" /begin REF_CHARACTERISTIC speedgoat_test_SN5659__cal_impl.FixPtConstant_Value_jp /end REF_CHARACTERISTIC
 /begin REF_MEASUREMENT speedgoat_test_SN5659_R2021b_IO682_B.FixPtSum1_b speedgoat_test_SN5659_R2021b_IO682_B.Output_pd /end REF_MEASUREMENT
/end GROUP
/begin GROUP speedgoat_test_SN5659_R2021b_IO682_IO682_Encode_Channel_9_Counter_Limited_Wrap_To_Zero "speedgoat_test_SN5659_R2021b_IO682/IO682/Encode Channel 9/Counter
Limited/Wrap To Zero"
 /begin REF_CHARACTERISTIC speedgoat_test_SN5659__cal_impl.Constant_Value_b2 speedgoat_test_SN5659__cal_impl.CounterLimited_uplimit_a /end REF_CHARACTERISTIC
 /begin REF_MEASUREMENT speedgoat_test_SN5659_R2021b_IO682_B.FixPtSum1_b speedgoat_test_SN5659_R2021b_IO682_B.FixPtSwitch_m /end REF_MEASUREMENT
/end GROUP
/begin GROUP speedgoat_test_SN5659_R2021b_IO682_IO682_Encode_Channel_9_Prepare_RAW_value "speedgoat_test_SN5659_R2021b_IO682/IO682/Encode Channel 9/Prepare RAW value"
 /begin REF_CHARACTERISTIC speedgoat_test_SN5659__cal_impl.Label_Value_kg speedgoat_test_SN5659__cal_impl.Mask_BitMask_cx speedgoat_test_SN5659__cal_impl.SDI_Value_mq speedgoat_test_SN5659__cal_impl.SSM_Value_jt speedgoat_test_SN5659__cal_impl.Scale_Value_n speedgoat_test_SN5659__cal_impl.shiftthedoublevalue27bitslef_hk /end REF_CHARACTERISTIC
 /begin REF_MEASUREMENT speedgoat_test_SN5659_R2021b_IO682_B.BitwiseOperator_fl speedgoat_test_SN5659_R2021b_IO682_B.DataTypeConversion1_e speedgoat_test_SN5659_R2021b_IO682_B.DataTypeConversion_ku speedgoat_test_SN5659_R2021b_IO682_B.Divide_os speedgoat_test_SN5659_R2021b_IO682_B.Mask_cy speedgoat_test_SN5659_R2021b_IO682_B.Multiply_c speedgoat_test_SN5659_R2021b_IO682_B.ShifttoSDIslot_fi speedgoat_test_SN5659_R2021b_IO682_B.ShifttoSSMslot_hy /end REF_MEASUREMENT
/end GROUP
/end MODULE
/end PROJECT
