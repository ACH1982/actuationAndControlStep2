/******************************************************************************
* ASAP2 file: speedgoat_test_SN5659_R2020b.a2l
* Code generation for model "speedgoat_test_SN5659_R2020b".
* Model version : 1.2
* Simulink Coder version : 10.4 R2021b
* C source code generated on : Fri Apr 08 14:37:25 2022
* Target selection: slrealtime.tlc
* Embedded hardware selection: Intel->x86-64 (Linux 64)
* Code generation objectives: Unspecified
* Validation result: Not run
* (add additional file header information here)
******************************************************************************/
ASAP2_VERSION 1 71
/begin PROJECT ProjectName "Project Comment Goes Here"
/begin HEADER "Header Comments go here" /end HEADER
/begin MODULE ModuleName "Module Comment Goes Here"
/begin IF_DATA XCP
 /begin PROTOCOL_LAYER 0x0100 0x03E8 0x00C8 0x0000 0x0000 0x0000 0x0000 0x0000 0xFC 0x0578 BYTE_ORDER_MSB_LAST ADDRESS_GRANULARITY_BYTE OPTIONAL_CMD ALLOC_ODT_ENTRY OPTIONAL_CMD ALLOC_ODT OPTIONAL_CMD ALLOC_DAQ OPTIONAL_CMD FREE_DAQ OPTIONAL_CMD GET_DAQ_RESOLUTION_INFO OPTIONAL_CMD GET_DAQ_PROCESSOR_INFO OPTIONAL_CMD START_STOP_SYNCH OPTIONAL_CMD START_STOP_DAQ_LIST OPTIONAL_CMD SET_DAQ_LIST_MODE OPTIONAL_CMD WRITE_DAQ OPTIONAL_CMD SET_DAQ_PTR OPTIONAL_CMD GET_CAL_PAGE OPTIONAL_CMD SET_CAL_PAGE OPTIONAL_CMD COPY_CAL_PAGE OPTIONAL_CMD SHORT_DOWNLOAD OPTIONAL_CMD DOWNLOAD_MAX OPTIONAL_CMD DOWNLOAD OPTIONAL_CMD SHORT_UPLOAD OPTIONAL_CMD UPLOAD OPTIONAL_CMD SET_MTA /end PROTOCOL_LAYER
 /begin DAQ DYNAMIC 0x0000 0x0080 0x00 OPTIMISATION_TYPE_DEFAULT ADDRESS_EXTENSION_FREE IDENTIFICATION_FIELD_TYPE_RELATIVE_WORD_ALIGNED GRANULARITY_ODT_ENTRY_SIZE_DAQ_BYTE 0xFF OVERLOAD_INDICATION_PID PRESCALER_SUPPORTED /begin STIM GRANULARITY_ODT_ENTRY_SIZE_STIM_BYTE 0xFF /end STIM /begin TIMESTAMP_SUPPORTED 0x0001 SIZE_DWORD UNIT_1US TIMESTAMP_FIXED /end TIMESTAMP_SUPPORTED /begin EVENT "1 ms" "1 ms" 0x0000 DAQ 0xFF 0x01 0x06 0x00 /end EVENT /begin EVENT "5 ms" "5 ms" 0x0001 DAQ 0xFF 0x05 0x06 0x00 /end EVENT /begin EVENT "10 ms" "10 ms" 0x0002 DAQ 0xFF 0x01 0x07 0x00 /end EVENT /end DAQ
 /begin XCP_ON_UDP_IP 0x0100 0x15B3 ADDRESS "192.168.7.2" /end XCP_ON_UDP_IP
/end IF_DATA
/begin MOD_PAR "MOD PAR Comment Goes Here"
 /begin MEMORY_SEGMENT speedgoat_test_SN5659__cal_impl "speedgoat_test_SN5659__cal_impl" DATA FLASH INTERN 0x008DF020 0x10CE8 -1 -1 -1 -1 -1
  /begin IF_DATA XCP
   /begin SEGMENT 0x00 0x02 0x00 0x00 0x00
    /begin PAGE 0x00 ECU_ACCESS_DONT_CARE XCP_READ_ACCESS_DONT_CARE XCP_WRITE_ACCESS_NOT_ALLOWED /end PAGE
    /begin PAGE 0x01 ECU_ACCESS_DONT_CARE XCP_READ_ACCESS_DONT_CARE XCP_WRITE_ACCESS_DONT_CARE /end PAGE
   /end SEGMENT
  /end IF_DATA
 /end MEMORY_SEGMENT
/end MOD_PAR
/begin MOD_COMMON "Mod Common Comment Here" BYTE_ORDER MSB_LAST ALIGNMENT_BYTE 1 ALIGNMENT_WORD 2 ALIGNMENT_LONG 4 ALIGNMENT_FLOAT32_IEEE 4 ALIGNMENT_FLOAT64_IEEE 8 ALIGNMENT_INT64 8 /end MOD_COMMON
/begin CHARACTERISTIC speedgoat_test_SN5659__cal_impl.ASCIIDecode1_P1 "" VAL_BLK 0x008EEFC0 Scalar_FLOAT64_IEEE 0 speedgoat_test_SN5659_R2020b_CM_double -1.7E+308 1.7E+308 MATRIX_DIM 3 1 /end CHARACTERISTIC
/begin CHARACTERISTIC speedgoat_test_SN5659__cal_impl.ASCIIDecode1_P2 "" VALUE 0x008EEFE8 Scalar_FLOAT64_IEEE 0 speedgoat_test_SN5659_R2020b_CM_double -1.7E+308 1.7E+308 /end CHARACTERISTIC
/begin CHARACTERISTIC speedgoat_test_SN5659__cal_impl.ASCIIDecode1_P3 "" VALUE 0x008EF000 Scalar_FLOAT64_IEEE 0 speedgoat_test_SN5659_R2020b_CM_double -1.7E+308 1.7E+308 /end CHARACTERISTIC
/begin CHARACTERISTIC speedgoat_test_SN5659__cal_impl.ASCIIDecode2_P1 "" VAL_BLK 0x008EF0F0 Scalar_FLOAT64_IEEE 0 speedgoat_test_SN5659_R2020b_CM_double -1.7E+308 1.7E+308 MATRIX_DIM 3 1 /end CHARACTERISTIC
/begin CHARACTERISTIC speedgoat_test_SN5659__cal_impl.ASCIIDecode2_P2 "" VALUE 0x008EF118 Scalar_FLOAT64_IEEE 0 speedgoat_test_SN5659_R2020b_CM_double -1.7E+308 1.7E+308 /end CHARACTERISTIC
/begin CHARACTERISTIC speedgoat_test_SN5659__cal_impl.ASCIIDecode2_P3 "" VALUE 0x008EF130 Scalar_FLOAT64_IEEE 0 speedgoat_test_SN5659_R2020b_CM_double -1.7E+308 1.7E+308 /end CHARACTERISTIC
/begin CHARACTERISTIC speedgoat_test_SN5659__cal_impl.ASCIIDecode3_P1 "" VAL_BLK 0x008EF220 Scalar_FLOAT64_IEEE 0 speedgoat_test_SN5659_R2020b_CM_double -1.7E+308 1.7E+308 MATRIX_DIM 3 1 /end CHARACTERISTIC
/begin CHARACTERISTIC speedgoat_test_SN5659__cal_impl.ASCIIDecode3_P2 "" VALUE 0x008EF248 Scalar_FLOAT64_IEEE 0 speedgoat_test_SN5659_R2020b_CM_double -1.7E+308 1.7E+308 /end CHARACTERISTIC
/begin CHARACTERISTIC speedgoat_test_SN5659__cal_impl.ASCIIDecode3_P3 "" VALUE 0x008EF260 Scalar_FLOAT64_IEEE 0 speedgoat_test_SN5659_R2020b_CM_double -1.7E+308 1.7E+308 /end CHARACTERISTIC
/begin CHARACTERISTIC speedgoat_test_SN5659__cal_impl.ASCIIDecode_P1 "" VAL_BLK 0x008EEE90 Scalar_FLOAT64_IEEE 0 speedgoat_test_SN5659_R2020b_CM_double -1.7E+308 1.7E+308 MATRIX_DIM 3 1 /end CHARACTERISTIC
/begin CHARACTERISTIC speedgoat_test_SN5659__cal_impl.ASCIIDecode_P2 "" VALUE 0x008EEEB8 Scalar_FLOAT64_IEEE 0 speedgoat_test_SN5659_R2020b_CM_double -1.7E+308 1.7E+308 /end CHARACTERISTIC
/begin CHARACTERISTIC speedgoat_test_SN5659__cal_impl.ASCIIDecode_P3 "" VALUE 0x008EEED0 Scalar_FLOAT64_IEEE 0 speedgoat_test_SN5659_R2020b_CM_double -1.7E+308 1.7E+308 /end CHARACTERISTIC
/begin CHARACTERISTIC speedgoat_test_SN5659__cal_impl.ASCIIEncode1_P1 "" VAL_BLK 0x008EF420 Scalar_FLOAT64_IEEE 0 speedgoat_test_SN5659_R2020b_CM_double -1.7E+308 1.7E+308 MATRIX_DIM 4 1 /end CHARACTERISTIC
/begin CHARACTERISTIC speedgoat_test_SN5659__cal_impl.ASCIIEncode1_P2 "" VALUE 0x008EF450 Scalar_FLOAT64_IEEE 0 speedgoat_test_SN5659_R2020b_CM_double -1.7E+308 1.7E+308 /end CHARACTERISTIC
/begin CHARACTERISTIC speedgoat_test_SN5659__cal_impl.ASCIIEncode1_P3 "" VALUE 0x008EF468 Scalar_FLOAT64_IEEE 0 speedgoat_test_SN5659_R2020b_CM_double -1.7E+308 1.7E+308 /end CHARACTERISTIC
/begin CHARACTERISTIC speedgoat_test_SN5659__cal_impl.ASCIIEncode1_P4 "" VALUE 0x008EF480 Scalar_FLOAT64_IEEE 0 speedgoat_test_SN5659_R2020b_CM_double -1.7E+308 1.7E+308 /end CHARACTERISTIC
/begin CHARACTERISTIC speedgoat_test_SN5659__cal_impl.ASCIIEncode2_P1 "" VAL_BLK 0x008EF590 Scalar_FLOAT64_IEEE 0 speedgoat_test_SN5659_R2020b_CM_double -1.7E+308 1.7E+308 MATRIX_DIM 4 1 /end CHARACTERISTIC
/begin CHARACTERISTIC speedgoat_test_SN5659__cal_impl.ASCIIEncode2_P2 "" VALUE 0x008EF5C0 Scalar_FLOAT64_IEEE 0 speedgoat_test_SN5659_R2020b_CM_double -1.7E+308 1.7E+308 /end CHARACTERISTIC
/begin CHARACTERISTIC speedgoat_test_SN5659__cal_impl.ASCIIEncode2_P3 "" VALUE 0x008EF5D8 Scalar_FLOAT64_IEEE 0 speedgoat_test_SN5659_R2020b_CM_double -1.7E+308 1.7E+308 /end CHARACTERISTIC
/begin CHARACTERISTIC speedgoat_test_SN5659__cal_impl.ASCIIEncode2_P4 "" VALUE 0x008EF5F0 Scalar_FLOAT64_IEEE 0 speedgoat_test_SN5659_R2020b_CM_double -1.7E+308 1.7E+308 /end CHARACTERISTIC
/begin CHARACTERISTIC speedgoat_test_SN5659__cal_impl.ASCIIEncode3_P1 "" VAL_BLK 0x008EF700 Scalar_FLOAT64_IEEE 0 speedgoat_test_SN5659_R2020b_CM_double -1.7E+308 1.7E+308 MATRIX_DIM 4 1 /end CHARACTERISTIC
/begin CHARACTERISTIC speedgoat_test_SN5659__cal_impl.ASCIIEncode3_P2 "" VALUE 0x008EF730 Scalar_FLOAT64_IEEE 0 speedgoat_test_SN5659_R2020b_CM_double -1.7E+308 1.7E+308 /end CHARACTERISTIC
/begin CHARACTERISTIC speedgoat_test_SN5659__cal_impl.ASCIIEncode3_P3 "" VALUE 0x008EF748 Scalar_FLOAT64_IEEE 0 speedgoat_test_SN5659_R2020b_CM_double -1.7E+308 1.7E+308 /end CHARACTERISTIC
/begin CHARACTERISTIC speedgoat_test_SN5659__cal_impl.ASCIIEncode3_P4 "" VALUE 0x008EF760 Scalar_FLOAT64_IEEE 0 speedgoat_test_SN5659_R2020b_CM_double -1.7E+308 1.7E+308 /end CHARACTERISTIC
/begin CHARACTERISTIC speedgoat_test_SN5659__cal_impl.ASCIIEncode_P1 "" VAL_BLK 0x008EF2B0 Scalar_FLOAT64_IEEE 0 speedgoat_test_SN5659_R2020b_CM_double -1.7E+308 1.7E+308 MATRIX_DIM 4 1 /end CHARACTERISTIC
/begin CHARACTERISTIC speedgoat_test_SN5659__cal_impl.ASCIIEncode_P2 "" VALUE 0x008EF2E0 Scalar_FLOAT64_IEEE 0 speedgoat_test_SN5659_R2020b_CM_double -1.7E+308 1.7E+308 /end CHARACTERISTIC
/begin CHARACTERISTIC speedgoat_test_SN5659__cal_impl.ASCIIEncode_P3 "" VALUE 0x008EF2F8 Scalar_FLOAT64_IEEE 0 speedgoat_test_SN5659_R2020b_CM_double -1.7E+308 1.7E+308 /end CHARACTERISTIC
/begin CHARACTERISTIC speedgoat_test_SN5659__cal_impl.ASCIIEncode_P4 "" VALUE 0x008EF310 Scalar_FLOAT64_IEEE 0 speedgoat_test_SN5659_R2020b_CM_double -1.7E+308 1.7E+308 /end CHARACTERISTIC
/begin CHARACTERISTIC speedgoat_test_SN5659__cal_impl.Analoginputv2_P1 "" VALUE 0x008DF630 Scalar_FLOAT64_IEEE 0 speedgoat_test_SN5659_R2020b_CM_double -1.7E+308 1.7E+308 /end CHARACTERISTIC
/begin CHARACTERISTIC speedgoat_test_SN5659__cal_impl.Analoginputv2_P10 "" VAL_BLK 0x008DF730 Scalar_FLOAT64_IEEE 0 speedgoat_test_SN5659_R2020b_CM_double -1.7E+308 1.7E+308 MATRIX_DIM 2 1 /end CHARACTERISTIC
/begin CHARACTERISTIC speedgoat_test_SN5659__cal_impl.Analoginputv2_P11 "" VALUE 0x008DF750 Scalar_FLOAT64_IEEE 0 speedgoat_test_SN5659_R2020b_CM_double -1.7E+308 1.7E+308 /end CHARACTERISTIC
/begin CHARACTERISTIC speedgoat_test_SN5659__cal_impl.Analoginputv2_P2 "" VALUE 0x008DF648 Scalar_FLOAT64_IEEE 0 speedgoat_test_SN5659_R2020b_CM_double -1.7E+308 1.7E+308 /end CHARACTERISTIC
/begin CHARACTERISTIC speedgoat_test_SN5659__cal_impl.Analoginputv2_P3 "" VALUE 0x008DF660 Scalar_FLOAT64_IEEE 0 speedgoat_test_SN5659_R2020b_CM_double -1.7E+308 1.7E+308 /end CHARACTERISTIC
/begin CHARACTERISTIC speedgoat_test_SN5659__cal_impl.Analoginputv2_P4 "" VALUE 0x008DF678 Scalar_FLOAT64_IEEE 0 speedgoat_test_SN5659_R2020b_CM_double -1.7E+308 1.7E+308 /end CHARACTERISTIC
/begin CHARACTERISTIC speedgoat_test_SN5659__cal_impl.Analoginputv2_P5 "" VAL_BLK 0x008DF690 Scalar_FLOAT64_IEEE 0 speedgoat_test_SN5659_R2020b_CM_double -1.7E+308 1.7E+308 MATRIX_DIM 4 1 /end CHARACTERISTIC
/begin CHARACTERISTIC speedgoat_test_SN5659__cal_impl.Analoginputv2_P6 "" VAL_BLK 0x008DF6C0 Scalar_FLOAT64_IEEE 0 speedgoat_test_SN5659_R2020b_CM_double -1.7E+308 1.7E+308 MATRIX_DIM 2 1 /end CHARACTERISTIC
/begin CHARACTERISTIC speedgoat_test_SN5659__cal_impl.Analoginputv2_P7 "" VAL_BLK 0x008DF6E0 Scalar_FLOAT64_IEEE 0 speedgoat_test_SN5659_R2020b_CM_double -1.7E+308 1.7E+308 MATRIX_DIM 2 1 /end CHARACTERISTIC
/begin CHARACTERISTIC speedgoat_test_SN5659__cal_impl.Analoginputv2_P8 "" VALUE 0x008DF700 Scalar_FLOAT64_IEEE 0 speedgoat_test_SN5659_R2020b_CM_double -1.7E+308 1.7E+308 /end CHARACTERISTIC
/begin CHARACTERISTIC speedgoat_test_SN5659__cal_impl.Analoginputv2_P9 "" VALUE 0x008DF718 Scalar_FLOAT64_IEEE 0 speedgoat_test_SN5659_R2020b_CM_double -1.7E+308 1.7E+308 /end CHARACTERISTIC
/begin CHARACTERISTIC speedgoat_test_SN5659__cal_impl.Analogoutput1_P1 "" VALUE 0x008E13D8 Scalar_FLOAT64_IEEE 0 speedgoat_test_SN5659_R2020b_CM_double -1.7E+308 1.7E+308 /end CHARACTERISTIC
/begin CHARACTERISTIC speedgoat_test_SN5659__cal_impl.Analogoutput1_P2 "" VAL_BLK 0x008E13F0 Scalar_FLOAT64_IEEE 0 speedgoat_test_SN5659_R2020b_CM_double -1.7E+308 1.7E+308 MATRIX_DIM 16 1 /end CHARACTERISTIC
/begin CHARACTERISTIC speedgoat_test_SN5659__cal_impl.Analogoutput1_P3 "" VAL_BLK 0x008E1480 Scalar_FLOAT64_IEEE 0 speedgoat_test_SN5659_R2020b_CM_double -1.7E+308 1.7E+308 MATRIX_DIM 16 1 /end CHARACTERISTIC
/begin CHARACTERISTIC speedgoat_test_SN5659__cal_impl.Analogoutput1_P4 "" VALUE 0x008E1510 Scalar_FLOAT64_IEEE 0 speedgoat_test_SN5659_R2020b_CM_double -1.7E+308 1.7E+308 /end CHARACTERISTIC
/begin CHARACTERISTIC speedgoat_test_SN5659__cal_impl.Analogoutput1_P5 "" VALUE 0x008E1528 Scalar_FLOAT64_IEEE 0 speedgoat_test_SN5659_R2020b_CM_double -1.7E+308 1.7E+308 /end CHARACTERISTIC
/begin CHARACTERISTIC speedgoat_test_SN5659__cal_impl.Analogoutput1_P6 "" VALUE 0x008E1540 Scalar_FLOAT64_IEEE 0 speedgoat_test_SN5659_R2020b_CM_double -1.7E+308 1.7E+308 /end CHARACTERISTIC
/begin CHARACTERISTIC speedgoat_test_SN5659__cal_impl.Analogoutput1_P7 "" VALUE 0x008E1558 Scalar_FLOAT64_IEEE 0 speedgoat_test_SN5659_R2020b_CM_double -1.7E+308 1.7E+308 /end CHARACTERISTIC
/begin CHARACTERISTIC speedgoat_test_SN5659__cal_impl.Analogoutput_P1 "" VALUE 0x008E1208 Scalar_FLOAT64_IEEE 0 speedgoat_test_SN5659_R2020b_CM_double -1.7E+308 1.7E+308 /end CHARACTERISTIC
/begin CHARACTERISTIC speedgoat_test_SN5659__cal_impl.Analogoutput_P2 "" VAL_BLK 0x008E1220 Scalar_FLOAT64_IEEE 0 speedgoat_test_SN5659_R2020b_CM_double -1.7E+308 1.7E+308 MATRIX_DIM 16 1 /end CHARACTERISTIC
/begin CHARACTERISTIC speedgoat_test_SN5659__cal_impl.Analogoutput_P3 "" VAL_BLK 0x008E12B0 Scalar_FLOAT64_IEEE 0 speedgoat_test_SN5659_R2020b_CM_double -1.7E+308 1.7E+308 MATRIX_DIM 16 1 /end CHARACTERISTIC
/begin CHARACTERISTIC speedgoat_test_SN5659__cal_impl.Analogoutput_P4 "" VALUE 0x008E1340 Scalar_FLOAT64_IEEE 0 speedgoat_test_SN5659_R2020b_CM_double -1.7E+308 1.7E+308 /end CHARACTERISTIC
/begin CHARACTERISTIC speedgoat_test_SN5659__cal_impl.Analogoutput_P5 "" VALUE 0x008E1358 Scalar_FLOAT64_IEEE 0 speedgoat_test_SN5659_R2020b_CM_double -1.7E+308 1.7E+308 /end CHARACTERISTIC
/begin CHARACTERISTIC speedgoat_test_SN5659__cal_impl.Analogoutput_P6 "" VALUE 0x008E1370 Scalar_FLOAT64_IEEE 0 speedgoat_test_SN5659_R2020b_CM_double -1.7E+308 1.7E+308 /end CHARACTERISTIC
/begin CHARACTERISTIC speedgoat_test_SN5659__cal_impl.Analogoutput_P7 "" VALUE 0x008E1388 Scalar_FLOAT64_IEEE 0 speedgoat_test_SN5659_R2020b_CM_double -1.7E+308 1.7E+308 /end CHARACTERISTIC
/begin CHARACTERISTIC speedgoat_test_SN5659__cal_impl.Analogoutputv2_P1 "" VALUE 0x008DF7A8 Scalar_FLOAT64_IEEE 0 speedgoat_test_SN5659_R2020b_CM_double -1.7E+308 1.7E+308 /end CHARACTERISTIC
/begin CHARACTERISTIC speedgoat_test_SN5659__cal_impl.Analogoutputv2_P10 "" VALUE 0x008DF900 Scalar_FLOAT64_IEEE 0 speedgoat_test_SN5659_R2020b_CM_double -1.7E+308 1.7E+308 /end CHARACTERISTIC
/begin CHARACTERISTIC speedgoat_test_SN5659__cal_impl.Analogoutputv2_P11 "" VAL_BLK 0x008DF918 Scalar_FLOAT64_IEEE 0 speedgoat_test_SN5659_R2020b_CM_double -1.7E+308 1.7E+308 MATRIX_DIM 2 1 /end CHARACTERISTIC
/begin CHARACTERISTIC speedgoat_test_SN5659__cal_impl.Analogoutputv2_P12 "" VALUE 0x008DF938 Scalar_FLOAT64_IEEE 0 speedgoat_test_SN5659_R2020b_CM_double -1.7E+308 1.7E+308 /end CHARACTERISTIC
/begin CHARACTERISTIC speedgoat_test_SN5659__cal_impl.Analogoutputv2_P13 "" VALUE 0x008DF950 Scalar_FLOAT64_IEEE 0 speedgoat_test_SN5659_R2020b_CM_double -1.7E+308 1.7E+308 /end CHARACTERISTIC
/begin CHARACTERISTIC speedgoat_test_SN5659__cal_impl.Analogoutputv2_P2 "" VALUE 0x008DF7C0 Scalar_FLOAT64_IEEE 0 speedgoat_test_SN5659_R2020b_CM_double -1.7E+308 1.7E+308 /end CHARACTERISTIC
/begin CHARACTERISTIC speedgoat_test_SN5659__cal_impl.Analogoutputv2_P3 "" VALUE 0x008DF7D8 Scalar_FLOAT64_IEEE 0 speedgoat_test_SN5659_R2020b_CM_double -1.7E+308 1.7E+308 /end CHARACTERISTIC
/begin CHARACTERISTIC speedgoat_test_SN5659__cal_impl.Analogoutputv2_P4 "" VALUE 0x008DF7F0 Scalar_FLOAT64_IEEE 0 speedgoat_test_SN5659_R2020b_CM_double -1.7E+308 1.7E+308 /end CHARACTERISTIC
/begin CHARACTERISTIC speedgoat_test_SN5659__cal_impl.Analogoutputv2_P5 "" VAL_BLK 0x008DF808 Scalar_FLOAT64_IEEE 0 speedgoat_test_SN5659_R2020b_CM_double -1.7E+308 1.7E+308 MATRIX_DIM 4 1 /end CHARACTERISTIC
/begin CHARACTERISTIC speedgoat_test_SN5659__cal_impl.Analogoutputv2_P6 "" VAL_BLK 0x008DF838 Scalar_FLOAT64_IEEE 0 speedgoat_test_SN5659_R2020b_CM_double -1.7E+308 1.7E+308 MATRIX_DIM 8 1 /end CHARACTERISTIC
/begin CHARACTERISTIC speedgoat_test_SN5659__cal_impl.Analogoutputv2_P7 "" VAL_BLK 0x008DF888 Scalar_FLOAT64_IEEE 0 speedgoat_test_SN5659_R2020b_CM_double -1.7E+308 1.7E+308 MATRIX_DIM 4 1 /end CHARACTERISTIC
/begin CHARACTERISTIC speedgoat_test_SN5659__cal_impl.Analogoutputv2_P8 "" VAL_BLK 0x008DF8B8 Scalar_FLOAT64_IEEE 0 speedgoat_test_SN5659_R2020b_CM_double -1.7E+308 1.7E+308 MATRIX_DIM 4 1 /end CHARACTERISTIC
/begin CHARACTERISTIC speedgoat_test_SN5659__cal_impl.Analogoutputv2_P9 "" VALUE 0x008DF8E8 Scalar_FLOAT64_IEEE 0 speedgoat_test_SN5659_R2020b_CM_double -1.7E+308 1.7E+308 /end CHARACTERISTIC
/begin CHARACTERISTIC speedgoat_test_SN5659__cal_impl.CANRead1_P1 "" VALUE 0x008DF188 Scalar_FLOAT64_IEEE 0 speedgoat_test_SN5659_R2020b_CM_double -1.7E+308 1.7E+308 /end CHARACTERISTIC
/begin CHARACTERISTIC speedgoat_test_SN5659__cal_impl.CANRead1_P2 "" VALUE 0x008DF1A0 Scalar_FLOAT64_IEEE 0 speedgoat_test_SN5659_R2020b_CM_double -1.7E+308 1.7E+308 /end CHARACTERISTIC
/begin CHARACTERISTIC speedgoat_test_SN5659__cal_impl.CANRead1_P3 "" VALUE 0x008DF1B8 Scalar_FLOAT64_IEEE 0 speedgoat_test_SN5659_R2020b_CM_double -1.7E+308 1.7E+308 /end CHARACTERISTIC
/begin CHARACTERISTIC speedgoat_test_SN5659__cal_impl.CANRead1_P4 "" VAL_BLK 0x008DF1D0 Scalar_FLOAT64_IEEE 0 speedgoat_test_SN5659_R2020b_CM_double -1.7E+308 1.7E+308 MATRIX_DIM 5 1 /end CHARACTERISTIC
/begin CHARACTERISTIC speedgoat_test_SN5659__cal_impl.CANRead1_P5 "" VALUE 0x008DF208 Scalar_FLOAT64_IEEE 0 speedgoat_test_SN5659_R2020b_CM_double -1.7E+308 1.7E+308 /end CHARACTERISTIC
/begin CHARACTERISTIC speedgoat_test_SN5659__cal_impl.CANRead1_P6 "" VALUE 0x008DF220 Scalar_FLOAT64_IEEE 0 speedgoat_test_SN5659_R2020b_CM_double -1.7E+308 1.7E+308 /end CHARACTERISTIC
/begin CHARACTERISTIC speedgoat_test_SN5659__cal_impl.CANRead1_P7 "" VALUE 0x008DF238 Scalar_FLOAT64_IEEE 0 speedgoat_test_SN5659_R2020b_CM_double -1.7E+308 1.7E+308 /end CHARACTERISTIC
/begin CHARACTERISTIC speedgoat_test_SN5659__cal_impl.CANRead_P1 "" VALUE 0x008DF0A8 Scalar_FLOAT64_IEEE 0 speedgoat_test_SN5659_R2020b_CM_double -1.7E+308 1.7E+308 /end CHARACTERISTIC
/begin CHARACTERISTIC speedgoat_test_SN5659__cal_impl.CANRead_P2 "" VALUE 0x008DF0C0 Scalar_FLOAT64_IEEE 0 speedgoat_test_SN5659_R2020b_CM_double -1.7E+308 1.7E+308 /end CHARACTERISTIC
/begin CHARACTERISTIC speedgoat_test_SN5659__cal_impl.CANRead_P3 "" VALUE 0x008DF0D8 Scalar_FLOAT64_IEEE 0 speedgoat_test_SN5659_R2020b_CM_double -1.7E+308 1.7E+308 /end CHARACTERISTIC
/begin CHARACTERISTIC speedgoat_test_SN5659__cal_impl.CANRead_P4 "" VAL_BLK 0x008DF0F0 Scalar_FLOAT64_IEEE 0 speedgoat_test_SN5659_R2020b_CM_double -1.7E+308 1.7E+308 MATRIX_DIM 5 1 /end CHARACTERISTIC
/begin CHARACTERISTIC speedgoat_test_SN5659__cal_impl.CANRead_P5 "" VALUE 0x008DF128 Scalar_FLOAT64_IEEE 0 speedgoat_test_SN5659_R2020b_CM_double -1.7E+308 1.7E+308 /end CHARACTERISTIC
/begin CHARACTERISTIC speedgoat_test_SN5659__cal_impl.CANRead_P6 "" VALUE 0x008DF140 Scalar_FLOAT64_IEEE 0 speedgoat_test_SN5659_R2020b_CM_double -1.7E+308 1.7E+308 /end CHARACTERISTIC
/begin CHARACTERISTIC speedgoat_test_SN5659__cal_impl.CANRead_P7 "" VALUE 0x008DF158 Scalar_FLOAT64_IEEE 0 speedgoat_test_SN5659_R2020b_CM_double -1.7E+308 1.7E+308 /end CHARACTERISTIC
/begin CHARACTERISTIC speedgoat_test_SN5659__cal_impl.CANSetup_P1 "" VALUE 0x008E0208 Scalar_FLOAT64_IEEE 0 speedgoat_test_SN5659_R2020b_CM_double -1.7E+308 1.7E+308 /end CHARACTERISTIC
/begin CHARACTERISTIC speedgoat_test_SN5659__cal_impl.CANSetup_P10 "" VAL_BLK 0x008E0300 Scalar_FLOAT64_IEEE 0 speedgoat_test_SN5659_R2020b_CM_double -1.7E+308 1.7E+308 MATRIX_DIM 2 1 /end CHARACTERISTIC
/begin CHARACTERISTIC speedgoat_test_SN5659__cal_impl.CANSetup_P11 "" VAL_BLK 0x008E0320 Scalar_FLOAT64_IEEE 0 speedgoat_test_SN5659_R2020b_CM_double -1.7E+308 1.7E+308 MATRIX_DIM 2 1 /end CHARACTERISTIC
/begin CHARACTERISTIC speedgoat_test_SN5659__cal_impl.CANSetup_P12 "" VALUE 0x008E0340 Scalar_FLOAT64_IEEE 0 speedgoat_test_SN5659_R2020b_CM_double -1.7E+308 1.7E+308 /end CHARACTERISTIC
/begin CHARACTERISTIC speedgoat_test_SN5659__cal_impl.CANSetup_P13 "" VAL_BLK 0x008E0358 Scalar_FLOAT64_IEEE 0 speedgoat_test_SN5659_R2020b_CM_double -1.7E+308 1.7E+308 MATRIX_DIM 4 1 /end CHARACTERISTIC
/begin CHARACTERISTIC speedgoat_test_SN5659__cal_impl.CANSetup_P14 "" VAL_BLK 0x008E0388 Scalar_FLOAT64_IEEE 0 speedgoat_test_SN5659_R2020b_CM_double -1.7E+308 1.7E+308 MATRIX_DIM 2 1 /end CHARACTERISTIC
/begin CHARACTERISTIC speedgoat_test_SN5659__cal_impl.CANSetup_P15 "" VAL_BLK 0x008E03A8 Scalar_FLOAT64_IEEE 0 speedgoat_test_SN5659_R2020b_CM_double -1.7E+308 1.7E+308 MATRIX_DIM 2 1 /end CHARACTERISTIC
/begin CHARACTERISTIC speedgoat_test_SN5659__cal_impl.CANSetup_P16 "" VALUE 0x008E03C8 Scalar_FLOAT64_IEEE 0 speedgoat_test_SN5659_R2020b_CM_double -1.7E+308 1.7E+308 /end CHARACTERISTIC
/begin CHARACTERISTIC speedgoat_test_SN5659__cal_impl.CANSetup_P17 "" VAL_BLK 0x008E03E0 Scalar_FLOAT64_IEEE 0 speedgoat_test_SN5659_R2020b_CM_double -1.7E+308 1.7E+308 MATRIX_DIM 4 1 /end CHARACTERISTIC
/begin CHARACTERISTIC speedgoat_test_SN5659__cal_impl.CANSetup_P18 "" VAL_BLK 0x008E0410 Scalar_FLOAT64_IEEE 0 speedgoat_test_SN5659_R2020b_CM_double -1.7E+308 1.7E+308 MATRIX_DIM 2 1 /end CHARACTERISTIC
/begin CHARACTERISTIC speedgoat_test_SN5659__cal_impl.CANSetup_P19 "" VAL_BLK 0x008E0430 Scalar_FLOAT64_IEEE 0 speedgoat_test_SN5659_R2020b_CM_double -1.7E+308 1.7E+308 MATRIX_DIM 2 1 /end CHARACTERISTIC
/begin CHARACTERISTIC speedgoat_test_SN5659__cal_impl.CANSetup_P2 "" VAL_BLK 0x008E0220 Scalar_FLOAT64_IEEE 0 speedgoat_test_SN5659_R2020b_CM_double -1.7E+308 1.7E+308 MATRIX_DIM 2 1 /end CHARACTERISTIC
/begin CHARACTERISTIC speedgoat_test_SN5659__cal_impl.CANSetup_P20 "" VALUE 0x008E0450 Scalar_FLOAT64_IEEE 0 speedgoat_test_SN5659_R2020b_CM_double -1.7E+308 1.7E+308 /end CHARACTERISTIC
/begin CHARACTERISTIC speedgoat_test_SN5659__cal_impl.CANSetup_P21 "" VAL_BLK 0x008E0468 Scalar_FLOAT64_IEEE 0 speedgoat_test_SN5659_R2020b_CM_double -1.7E+308 1.7E+308 MATRIX_DIM 4 1 /end CHARACTERISTIC
/begin CHARACTERISTIC speedgoat_test_SN5659__cal_impl.CANSetup_P22 "" VAL_BLK 0x008E0498 Scalar_FLOAT64_IEEE 0 speedgoat_test_SN5659_R2020b_CM_double -1.7E+308 1.7E+308 MATRIX_DIM 2 1 /end CHARACTERISTIC
/begin CHARACTERISTIC speedgoat_test_SN5659__cal_impl.CANSetup_P23 "" VAL_BLK 0x008E04B8 Scalar_FLOAT64_IEEE 0 speedgoat_test_SN5659_R2020b_CM_double -1.7E+308 1.7E+308 MATRIX_DIM 2 1 /end CHARACTERISTIC
/begin CHARACTERISTIC speedgoat_test_SN5659__cal_impl.CANSetup_P24 "" VALUE 0x008E04D8 Scalar_FLOAT64_IEEE 0 speedgoat_test_SN5659_R2020b_CM_double -1.7E+308 1.7E+308 /end CHARACTERISTIC
/begin CHARACTERISTIC speedgoat_test_SN5659__cal_impl.CANSetup_P25 "" VALUE 0x008E04F0 Scalar_FLOAT64_IEEE 0 speedgoat_test_SN5659_R2020b_CM_double -1.7E+308 1.7E+308 /end CHARACTERISTIC
/begin CHARACTERISTIC speedgoat_test_SN5659__cal_impl.CANSetup_P26 "" VAL_BLK 0x008E0508 Scalar_FLOAT64_IEEE 0 speedgoat_test_SN5659_R2020b_CM_double -1.7E+308 1.7E+308 MATRIX_DIM 5 1 /end CHARACTERISTIC
/begin CHARACTERISTIC speedgoat_test_SN5659__cal_impl.CANSetup_P27 "" VALUE 0x008E0540 Scalar_FLOAT64_IEEE 0 speedgoat_test_SN5659_R2020b_CM_double -1.7E+308 1.7E+308 /end CHARACTERISTIC
/begin CHARACTERISTIC speedgoat_test_SN5659__cal_impl.CANSetup_P28 "" VAL_BLK 0x008E0558 Scalar_FLOAT64_IEEE 0 speedgoat_test_SN5659_R2020b_CM_double -1.7E+308 1.7E+308 MATRIX_DIM 4 1 /end CHARACTERISTIC
/begin CHARACTERISTIC speedgoat_test_SN5659__cal_impl.CANSetup_P29 "" VAL_BLK 0x008E0588 Scalar_FLOAT64_IEEE 0 speedgoat_test_SN5659_R2020b_CM_double -1.7E+308 1.7E+308 MATRIX_DIM 4 1 /end CHARACTERISTIC
/begin CHARACTERISTIC speedgoat_test_SN5659__cal_impl.CANSetup_P3 "" VALUE 0x008E0240 Scalar_FLOAT64_IEEE 0 speedgoat_test_SN5659_R2020b_CM_double -1.7E+308 1.7E+308 /end CHARACTERISTIC
/begin CHARACTERISTIC speedgoat_test_SN5659__cal_impl.CANSetup_P30 "" VAL_BLK 0x008E05B8 Scalar_FLOAT64_IEEE 0 speedgoat_test_SN5659_R2020b_CM_double -1.7E+308 1.7E+308 MATRIX_DIM 4 1 /end CHARACTERISTIC
/begin CHARACTERISTIC speedgoat_test_SN5659__cal_impl.CANSetup_P31 "" VALUE 0x008E05E8 Scalar_FLOAT64_IEEE 0 speedgoat_test_SN5659_R2020b_CM_double -1.7E+308 1.7E+308 /end CHARACTERISTIC
/begin CHARACTERISTIC speedgoat_test_SN5659__cal_impl.CANSetup_P4 "" VALUE 0x008E0258 Scalar_FLOAT64_IEEE 0 speedgoat_test_SN5659_R2020b_CM_double -1.7E+308 1.7E+308 /end CHARACTERISTIC
/begin CHARACTERISTIC speedgoat_test_SN5659__cal_impl.CANSetup_P5 "" VALUE 0x008E0270 Scalar_FLOAT64_IEEE 0 speedgoat_test_SN5659_R2020b_CM_double -1.7E+308 1.7E+308 /end CHARACTERISTIC
/begin CHARACTERISTIC speedgoat_test_SN5659__cal_impl.CANSetup_P6 "" VALUE 0x008E0288 Scalar_FLOAT64_IEEE 0 speedgoat_test_SN5659_R2020b_CM_double -1.7E+308 1.7E+308 /end CHARACTERISTIC
/begin CHARACTERISTIC speedgoat_test_SN5659__cal_impl.CANSetup_P7 "" VALUE 0x008E02A0 Scalar_FLOAT64_IEEE 0 speedgoat_test_SN5659_R2020b_CM_double -1.7E+308 1.7E+308 /end CHARACTERISTIC
/begin CHARACTERISTIC speedgoat_test_SN5659__cal_impl.CANSetup_P8 "" VALUE 0x008E02B8 Scalar_FLOAT64_IEEE 0 speedgoat_test_SN5659_R2020b_CM_double -1.7E+308 1.7E+308 /end CHARACTERISTIC
/begin CHARACTERISTIC speedgoat_test_SN5659__cal_impl.CANSetup_P9 "" VAL_BLK 0x008E02D0 Scalar_FLOAT64_IEEE 0 speedgoat_test_SN5659_R2020b_CM_double -1.7E+308 1.7E+308 MATRIX_DIM 4 1 /end CHARACTERISTIC
/begin CHARACTERISTIC speedgoat_test_SN5659__cal_impl.CANWrite1_P1 "" VALUE 0x008E0980 Scalar_FLOAT64_IEEE 0 speedgoat_test_SN5659_R2020b_CM_double -1.7E+308 1.7E+308 /end CHARACTERISTIC
/begin CHARACTERISTIC speedgoat_test_SN5659__cal_impl.CANWrite1_P2 "" VALUE 0x008E0998 Scalar_FLOAT64_IEEE 0 speedgoat_test_SN5659_R2020b_CM_double -1.7E+308 1.7E+308 /end CHARACTERISTIC
/begin CHARACTERISTIC speedgoat_test_SN5659__cal_impl.CANWrite1_P3 "" VALUE 0x008E09B0 Scalar_FLOAT64_IEEE 0 speedgoat_test_SN5659_R2020b_CM_double -1.7E+308 1.7E+308 /end CHARACTERISTIC
/begin CHARACTERISTIC speedgoat_test_SN5659__cal_impl.CANWrite1_P4 "" VALUE 0x008E09C8 Scalar_FLOAT64_IEEE 0 speedgoat_test_SN5659_R2020b_CM_double -1.7E+308 1.7E+308 /end CHARACTERISTIC
/begin CHARACTERISTIC speedgoat_test_SN5659__cal_impl.CANWrite1_P5 "" VAL_BLK 0x008E09E0 Scalar_FLOAT64_IEEE 0 speedgoat_test_SN5659_R2020b_CM_double -1.7E+308 1.7E+308 MATRIX_DIM 5 1 /end CHARACTERISTIC
/begin CHARACTERISTIC speedgoat_test_SN5659__cal_impl.CANWrite1_P6 "" VALUE 0x008E0A18 Scalar_FLOAT64_IEEE 0 speedgoat_test_SN5659_R2020b_CM_double -1.7E+308 1.7E+308 /end CHARACTERISTIC
/begin CHARACTERISTIC speedgoat_test_SN5659__cal_impl.CANWrite1_P7 "" VALUE 0x008E0A30 Scalar_FLOAT64_IEEE 0 speedgoat_test_SN5659_R2020b_CM_double -1.7E+308 1.7E+308 /end CHARACTERISTIC
/begin CHARACTERISTIC speedgoat_test_SN5659__cal_impl.CANWrite1_P8 "" VALUE 0x008E0A48 Scalar_FLOAT64_IEEE 0 speedgoat_test_SN5659_R2020b_CM_double -1.7E+308 1.7E+308 /end CHARACTERISTIC
/begin CHARACTERISTIC speedgoat_test_SN5659__cal_impl.CANWrite2_P1 "" VALUE 0x008E0750 Scalar_FLOAT64_IEEE 0 speedgoat_test_SN5659_R2020b_CM_double -1.7E+308 1.7E+308 /end CHARACTERISTIC
/begin CHARACTERISTIC speedgoat_test_SN5659__cal_impl.CANWrite2_P2 "" VALUE 0x008E0768 Scalar_FLOAT64_IEEE 0 speedgoat_test_SN5659_R2020b_CM_double -1.7E+308 1.7E+308 /end CHARACTERISTIC
/begin CHARACTERISTIC speedgoat_test_SN5659__cal_impl.CANWrite2_P3 "" VALUE 0x008E0780 Scalar_FLOAT64_IEEE 0 speedgoat_test_SN5659_R2020b_CM_double -1.7E+308 1.7E+308 /end CHARACTERISTIC
/begin CHARACTERISTIC speedgoat_test_SN5659__cal_impl.CANWrite2_P4 "" VALUE 0x008E0798 Scalar_FLOAT64_IEEE 0 speedgoat_test_SN5659_R2020b_CM_double -1.7E+308 1.7E+308 /end CHARACTERISTIC
/begin CHARACTERISTIC speedgoat_test_SN5659__cal_impl.CANWrite2_P5 "" VAL_BLK 0x008E07B0 Scalar_FLOAT64_IEEE 0 speedgoat_test_SN5659_R2020b_CM_double -1.7E+308 1.7E+308 MATRIX_DIM 5 1 /end CHARACTERISTIC
/begin CHARACTERISTIC speedgoat_test_SN5659__cal_impl.CANWrite2_P6 "" VALUE 0x008E07E8 Scalar_FLOAT64_IEEE 0 speedgoat_test_SN5659_R2020b_CM_double -1.7E+308 1.7E+308 /end CHARACTERISTIC
/begin CHARACTERISTIC speedgoat_test_SN5659__cal_impl.CANWrite2_P7 "" VALUE 0x008E0800 Scalar_FLOAT64_IEEE 0 speedgoat_test_SN5659_R2020b_CM_double -1.7E+308 1.7E+308 /end CHARACTERISTIC
/begin CHARACTERISTIC speedgoat_test_SN5659__cal_impl.CANWrite2_P8 "" VALUE 0x008E0818 Scalar_FLOAT64_IEEE 0 speedgoat_test_SN5659_R2020b_CM_double -1.7E+308 1.7E+308 /end CHARACTERISTIC
/begin CHARACTERISTIC speedgoat_test_SN5659__cal_impl.CANWrite3_P1 "" VALUE 0x008E0868 Scalar_FLOAT64_IEEE 0 speedgoat_test_SN5659_R2020b_CM_double -1.7E+308 1.7E+308 /end CHARACTERISTIC
/begin CHARACTERISTIC speedgoat_test_SN5659__cal_impl.CANWrite3_P2 "" VALUE 0x008E0880 Scalar_FLOAT64_IEEE 0 speedgoat_test_SN5659_R2020b_CM_double -1.7E+308 1.7E+308 /end CHARACTERISTIC
/begin CHARACTERISTIC speedgoat_test_SN5659__cal_impl.CANWrite3_P3 "" VALUE 0x008E0898 Scalar_FLOAT64_IEEE 0 speedgoat_test_SN5659_R2020b_CM_double -1.7E+308 1.7E+308 /end CHARACTERISTIC
/begin CHARACTERISTIC speedgoat_test_SN5659__cal_impl.CANWrite3_P4 "" VALUE 0x008E08B0 Scalar_FLOAT64_IEEE 0 speedgoat_test_SN5659_R2020b_CM_double -1.7E+308 1.7E+308 /end CHARACTERISTIC
/begin CHARACTERISTIC speedgoat_test_SN5659__cal_impl.CANWrite3_P5 "" VAL_BLK 0x008E08C8 Scalar_FLOAT64_IEEE 0 speedgoat_test_SN5659_R2020b_CM_double -1.7E+308 1.7E+308 MATRIX_DIM 5 1 /end CHARACTERISTIC
/begin CHARACTERISTIC speedgoat_test_SN5659__cal_impl.CANWrite3_P6 "" VALUE 0x008E0900 Scalar_FLOAT64_IEEE 0 speedgoat_test_SN5659_R2020b_CM_double -1.7E+308 1.7E+308 /end CHARACTERISTIC
/begin CHARACTERISTIC speedgoat_test_SN5659__cal_impl.CANWrite3_P7 "" VALUE 0x008E0918 Scalar_FLOAT64_IEEE 0 speedgoat_test_SN5659_R2020b_CM_double -1.7E+308 1.7E+308 /end CHARACTERISTIC
/begin CHARACTERISTIC speedgoat_test_SN5659__cal_impl.CANWrite3_P8 "" VALUE 0x008E0930 Scalar_FLOAT64_IEEE 0 speedgoat_test_SN5659_R2020b_CM_double -1.7E+308 1.7E+308 /end CHARACTERISTIC
/begin CHARACTERISTIC speedgoat_test_SN5659__cal_impl.CANWrite4_P1 "" VALUE 0x008E0A98 Scalar_FLOAT64_IEEE 0 speedgoat_test_SN5659_R2020b_CM_double -1.7E+308 1.7E+308 /end CHARACTERISTIC
/begin CHARACTERISTIC speedgoat_test_SN5659__cal_impl.CANWrite4_P2 "" VALUE 0x008E0AB0 Scalar_FLOAT64_IEEE 0 speedgoat_test_SN5659_R2020b_CM_double -1.7E+308 1.7E+308 /end CHARACTERISTIC
/begin CHARACTERISTIC speedgoat_test_SN5659__cal_impl.CANWrite4_P3 "" VALUE 0x008E0AC8 Scalar_FLOAT64_IEEE 0 speedgoat_test_SN5659_R2020b_CM_double -1.7E+308 1.7E+308 /end CHARACTERISTIC
/begin CHARACTERISTIC speedgoat_test_SN5659__cal_impl.CANWrite4_P4 "" VALUE 0x008E0AE0 Scalar_FLOAT64_IEEE 0 speedgoat_test_SN5659_R2020b_CM_double -1.7E+308 1.7E+308 /end CHARACTERISTIC
/begin CHARACTERISTIC speedgoat_test_SN5659__cal_impl.CANWrite4_P5 "" VAL_BLK 0x008E0AF8 Scalar_FLOAT64_IEEE 0 speedgoat_test_SN5659_R2020b_CM_double -1.7E+308 1.7E+308 MATRIX_DIM 5 1 /end CHARACTERISTIC
/begin CHARACTERISTIC speedgoat_test_SN5659__cal_impl.CANWrite4_P6 "" VALUE 0x008E0B30 Scalar_FLOAT64_IEEE 0 speedgoat_test_SN5659_R2020b_CM_double -1.7E+308 1.7E+308 /end CHARACTERISTIC
/begin CHARACTERISTIC speedgoat_test_SN5659__cal_impl.CANWrite4_P7 "" VALUE 0x008E0B48 Scalar_FLOAT64_IEEE 0 speedgoat_test_SN5659_R2020b_CM_double -1.7E+308 1.7E+308 /end CHARACTERISTIC
/begin CHARACTERISTIC speedgoat_test_SN5659__cal_impl.CANWrite4_P8 "" VALUE 0x008E0B60 Scalar_FLOAT64_IEEE 0 speedgoat_test_SN5659_R2020b_CM_double -1.7E+308 1.7E+308 /end CHARACTERISTIC
/begin CHARACTERISTIC speedgoat_test_SN5659__cal_impl.CANWrite5_P1 "" VALUE 0x008E0BB0 Scalar_FLOAT64_IEEE 0 speedgoat_test_SN5659_R2020b_CM_double -1.7E+308 1.7E+308 /end CHARACTERISTIC
/begin CHARACTERISTIC speedgoat_test_SN5659__cal_impl.CANWrite5_P2 "" VALUE 0x008E0BC8 Scalar_FLOAT64_IEEE 0 speedgoat_test_SN5659_R2020b_CM_double -1.7E+308 1.7E+308 /end CHARACTERISTIC
/begin CHARACTERISTIC speedgoat_test_SN5659__cal_impl.CANWrite5_P3 "" VALUE 0x008E0BE0 Scalar_FLOAT64_IEEE 0 speedgoat_test_SN5659_R2020b_CM_double -1.7E+308 1.7E+308 /end CHARACTERISTIC
/begin CHARACTERISTIC speedgoat_test_SN5659__cal_impl.CANWrite5_P4 "" VALUE 0x008E0BF8 Scalar_FLOAT64_IEEE 0 speedgoat_test_SN5659_R2020b_CM_double -1.7E+308 1.7E+308 /end CHARACTERISTIC
/begin CHARACTERISTIC speedgoat_test_SN5659__cal_impl.CANWrite5_P5 "" VAL_BLK 0x008E0C10 Scalar_FLOAT64_IEEE 0 speedgoat_test_SN5659_R2020b_CM_double -1.7E+308 1.7E+308 MATRIX_DIM 5 1 /end CHARACTERISTIC
/begin CHARACTERISTIC speedgoat_test_SN5659__cal_impl.CANWrite5_P6 "" VALUE 0x008E0C48 Scalar_FLOAT64_IEEE 0 speedgoat_test_SN5659_R2020b_CM_double -1.7E+308 1.7E+308 /end CHARACTERISTIC
/begin CHARACTERISTIC speedgoat_test_SN5659__cal_impl.CANWrite5_P7 "" VALUE 0x008E0C60 Scalar_FLOAT64_IEEE 0 speedgoat_test_SN5659_R2020b_CM_double -1.7E+308 1.7E+308 /end CHARACTERISTIC
/begin CHARACTERISTIC speedgoat_test_SN5659__cal_impl.CANWrite5_P8 "" VALUE 0x008E0C78 Scalar_FLOAT64_IEEE 0 speedgoat_test_SN5659_R2020b_CM_double -1.7E+308 1.7E+308 /end CHARACTERISTIC
/begin CHARACTERISTIC speedgoat_test_SN5659__cal_impl.CANWrite_P1 "" VALUE 0x008E0638 Scalar_FLOAT64_IEEE 0 speedgoat_test_SN5659_R2020b_CM_double -1.7E+308 1.7E+308 /end CHARACTERISTIC
/begin CHARACTERISTIC speedgoat_test_SN5659__cal_impl.CANWrite_P2 "" VALUE 0x008E0650 Scalar_FLOAT64_IEEE 0 speedgoat_test_SN5659_R2020b_CM_double -1.7E+308 1.7E+308 /end CHARACTERISTIC
/begin CHARACTERISTIC speedgoat_test_SN5659__cal_impl.CANWrite_P3 "" VALUE 0x008E0668 Scalar_FLOAT64_IEEE 0 speedgoat_test_SN5659_R2020b_CM_double -1.7E+308 1.7E+308 /end CHARACTERISTIC
/begin CHARACTERISTIC speedgoat_test_SN5659__cal_impl.CANWrite_P4 "" VALUE 0x008E0680 Scalar_FLOAT64_IEEE 0 speedgoat_test_SN5659_R2020b_CM_double -1.7E+308 1.7E+308 /end CHARACTERISTIC
/begin CHARACTERISTIC speedgoat_test_SN5659__cal_impl.CANWrite_P5 "" VAL_BLK 0x008E0698 Scalar_FLOAT64_IEEE 0 speedgoat_test_SN5659_R2020b_CM_double -1.7E+308 1.7E+308 MATRIX_DIM 5 1 /end CHARACTERISTIC
/begin CHARACTERISTIC speedgoat_test_SN5659__cal_impl.CANWrite_P6 "" VALUE 0x008E06D0 Scalar_FLOAT64_IEEE 0 speedgoat_test_SN5659_R2020b_CM_double -1.7E+308 1.7E+308 /end CHARACTERISTIC
/begin CHARACTERISTIC speedgoat_test_SN5659__cal_impl.CANWrite_P7 "" VALUE 0x008E06E8 Scalar_FLOAT64_IEEE 0 speedgoat_test_SN5659_R2020b_CM_double -1.7E+308 1.7E+308 /end CHARACTERISTIC
/begin CHARACTERISTIC speedgoat_test_SN5659__cal_impl.CANWrite_P8 "" VALUE 0x008E0700 Scalar_FLOAT64_IEEE 0 speedgoat_test_SN5659_R2020b_CM_double -1.7E+308 1.7E+308 /end CHARACTERISTIC
/begin CHARACTERISTIC speedgoat_test_SN5659__cal_impl.Digitalinputv2_P1 "" VALUE 0x008DF968 Scalar_FLOAT64_IEEE 0 speedgoat_test_SN5659_R2020b_CM_double -1.7E+308 1.7E+308 /end CHARACTERISTIC
/begin CHARACTERISTIC speedgoat_test_SN5659__cal_impl.Digitalinputv2_P2 "" VALUE 0x008DF980 Scalar_FLOAT64_IEEE 0 speedgoat_test_SN5659_R2020b_CM_double -1.7E+308 1.7E+308 /end CHARACTERISTIC
/begin CHARACTERISTIC speedgoat_test_SN5659__cal_impl.Digitalinputv2_P3 "" VALUE 0x008DF998 Scalar_FLOAT64_IEEE 0 speedgoat_test_SN5659_R2020b_CM_double -1.7E+308 1.7E+308 /end CHARACTERISTIC
/begin CHARACTERISTIC speedgoat_test_SN5659__cal_impl.Digitalinputv2_P4 "" VALUE 0x008DF9B0 Scalar_FLOAT64_IEEE 0 speedgoat_test_SN5659_R2020b_CM_double -1.7E+308 1.7E+308 /end CHARACTERISTIC
/begin CHARACTERISTIC speedgoat_test_SN5659__cal_impl.Digitalinputv2_P5 "" VAL_BLK 0x008DF9C8 Scalar_FLOAT64_IEEE 0 speedgoat_test_SN5659_R2020b_CM_double -1.7E+308 1.7E+308 MATRIX_DIM 2 1 /end CHARACTERISTIC
/begin CHARACTERISTIC speedgoat_test_SN5659__cal_impl.Digitaloutputv2_P1 "" VALUE 0x008DFA28 Scalar_FLOAT64_IEEE 0 speedgoat_test_SN5659_R2020b_CM_double -1.7E+308 1.7E+308 /end CHARACTERISTIC
/begin CHARACTERISTIC speedgoat_test_SN5659__cal_impl.Digitaloutputv2_P2 "" VALUE 0x008DFA40 Scalar_FLOAT64_IEEE 0 speedgoat_test_SN5659_R2020b_CM_double -1.7E+308 1.7E+308 /end CHARACTERISTIC
/begin CHARACTERISTIC speedgoat_test_SN5659__cal_impl.Digitaloutputv2_P3 "" VALUE 0x008DFA58 Scalar_FLOAT64_IEEE 0 speedgoat_test_SN5659_R2020b_CM_double -1.7E+308 1.7E+308 /end CHARACTERISTIC
/begin CHARACTERISTIC speedgoat_test_SN5659__cal_impl.Digitaloutputv2_P4 "" VALUE 0x008DFA70 Scalar_FLOAT64_IEEE 0 speedgoat_test_SN5659_R2020b_CM_double -1.7E+308 1.7E+308 /end CHARACTERISTIC
/begin CHARACTERISTIC speedgoat_test_SN5659__cal_impl.Digitaloutputv2_P5 "" VAL_BLK 0x008DFA88 Scalar_FLOAT64_IEEE 0 speedgoat_test_SN5659_R2020b_CM_double -1.7E+308 1.7E+308 MATRIX_DIM 2 1 /end CHARACTERISTIC
/begin CHARACTERISTIC speedgoat_test_SN5659__cal_impl.Digitaloutputv2_P6 "" VAL_BLK 0x008DFAA8 Scalar_FLOAT64_IEEE 0 speedgoat_test_SN5659_R2020b_CM_double -1.7E+308 1.7E+308 MATRIX_DIM 2 1 /end CHARACTERISTIC
/begin CHARACTERISTIC speedgoat_test_SN5659__cal_impl.Digitaloutputv2_P7 "" VAL_BLK 0x008DFAC8 Scalar_FLOAT64_IEEE 0 speedgoat_test_SN5659_R2020b_CM_double -1.7E+308 1.7E+308 MATRIX_DIM 2 1 /end CHARACTERISTIC
/begin CHARACTERISTIC speedgoat_test_SN5659__cal_impl.Gain1_Gain "" VALUE 0x008DF780 Scalar_FLOAT64_IEEE 0 speedgoat_test_SN5659_R2020b_CM_double -1.7E+308 1.7E+308 /end CHARACTERISTIC
/begin CHARACTERISTIC speedgoat_test_SN5659__cal_impl.Gain1_Gain_o "" VALUE 0x008DFCC0 Scalar_FLOAT64_IEEE 0 speedgoat_test_SN5659_R2020b_CM_double -1.7E+308 1.7E+308 /end CHARACTERISTIC
/begin CHARACTERISTIC speedgoat_test_SN5659__cal_impl.Gain2_Gain "" VALUE 0x008DF788 Scalar_FLOAT64_IEEE 0 speedgoat_test_SN5659_R2020b_CM_double -1.7E+308 1.7E+308 /end CHARACTERISTIC
/begin CHARACTERISTIC speedgoat_test_SN5659__cal_impl.Gain2_Gain_j "" VALUE 0x008DFCC8 Scalar_FLOAT64_IEEE 0 speedgoat_test_SN5659_R2020b_CM_double -1.7E+308 1.7E+308 /end CHARACTERISTIC
/begin CHARACTERISTIC speedgoat_test_SN5659__cal_impl.Gain3_Gain "" VALUE 0x008DF790 Scalar_FLOAT64_IEEE 0 speedgoat_test_SN5659_R2020b_CM_double -1.7E+308 1.7E+308 /end CHARACTERISTIC
/begin CHARACTERISTIC speedgoat_test_SN5659__cal_impl.Gain_Gain "" VALUE 0x008DF778 Scalar_FLOAT64_IEEE 0 speedgoat_test_SN5659_R2020b_CM_double -1.7E+308 1.7E+308 /end CHARACTERISTIC
/begin CHARACTERISTIC speedgoat_test_SN5659__cal_impl.Gain_Gain_i "" VALUE 0x008DFCB8 Scalar_FLOAT64_IEEE 0 speedgoat_test_SN5659_R2020b_CM_double -1.7E+308 1.7E+308 /end CHARACTERISTIC
/begin CHARACTERISTIC speedgoat_test_SN5659__cal_impl.ID100_Signal1_Y0 "" VALUE 0x008DF080 Scalar_FLOAT64_IEEE 0 speedgoat_test_SN5659_R2020b_CM_double -1.7E+308 1.7E+308 /end CHARACTERISTIC
/begin CHARACTERISTIC speedgoat_test_SN5659__cal_impl.ID100_Signal1_Y0_j "" VALUE 0x008DF160 Scalar_FLOAT64_IEEE 0 speedgoat_test_SN5659_R2020b_CM_double -1.7E+308 1.7E+308 /end CHARACTERISTIC
/begin CHARACTERISTIC speedgoat_test_SN5659__cal_impl.ID101_Signal1_Y0 "" VALUE 0x008DF088 Scalar_FLOAT64_IEEE 0 speedgoat_test_SN5659_R2020b_CM_double -1.7E+308 1.7E+308 /end CHARACTERISTIC
/begin CHARACTERISTIC speedgoat_test_SN5659__cal_impl.ID101_Signal1_Y0_o "" VALUE 0x008DF168 Scalar_FLOAT64_IEEE 0 speedgoat_test_SN5659_R2020b_CM_double -1.7E+308 1.7E+308 /end CHARACTERISTIC
/begin CHARACTERISTIC speedgoat_test_SN5659__cal_impl.ID102_Signal1_Y0 "" VALUE 0x008DF090 Scalar_FLOAT64_IEEE 0 speedgoat_test_SN5659_R2020b_CM_double -1.7E+308 1.7E+308 /end CHARACTERISTIC
/begin CHARACTERISTIC speedgoat_test_SN5659__cal_impl.ID102_Signal1_Y0_i "" VALUE 0x008DF170 Scalar_FLOAT64_IEEE 0 speedgoat_test_SN5659_R2020b_CM_double -1.7E+308 1.7E+308 /end CHARACTERISTIC
/begin CHARACTERISTIC speedgoat_test_SN5659__cal_impl.LVDTread1_P1 "" VALUE 0x008E1C00 Scalar_FLOAT64_IEEE 0 speedgoat_test_SN5659_R2020b_CM_double -1.7E+308 1.7E+308 /end CHARACTERISTIC
/begin CHARACTERISTIC speedgoat_test_SN5659__cal_impl.LVDTread1_P2 "" VALUE 0x008E1C18 Scalar_FLOAT64_IEEE 0 speedgoat_test_SN5659_R2020b_CM_double -1.7E+308 1.7E+308 /end CHARACTERISTIC
/begin CHARACTERISTIC speedgoat_test_SN5659__cal_impl.LVDTread1_P3 "" VALUE 0x008E1C30 Scalar_FLOAT64_IEEE 0 speedgoat_test_SN5659_R2020b_CM_double -1.7E+308 1.7E+308 /end CHARACTERISTIC
/begin CHARACTERISTIC speedgoat_test_SN5659__cal_impl.LVDTread1_P4 "" VALUE 0x008E1C48 Scalar_FLOAT64_IEEE 0 speedgoat_test_SN5659_R2020b_CM_double -1.7E+308 1.7E+308 /end CHARACTERISTIC
/begin CHARACTERISTIC speedgoat_test_SN5659__cal_impl.LVDTread1_P5 "" VALUE 0x008E1C60 Scalar_FLOAT64_IEEE 0 speedgoat_test_SN5659_R2020b_CM_double -1.7E+308 1.7E+308 /end CHARACTERISTIC
/begin CHARACTERISTIC speedgoat_test_SN5659__cal_impl.LVDTread1_P6 "" VALUE 0x008E1C78 Scalar_FLOAT64_IEEE 0 speedgoat_test_SN5659_R2020b_CM_double -1.7E+308 1.7E+308 /end CHARACTERISTIC
/begin CHARACTERISTIC speedgoat_test_SN5659__cal_impl.LVDTread1_P7 "" VALUE 0x008E1C90 Scalar_FLOAT64_IEEE 0 speedgoat_test_SN5659_R2020b_CM_double -1.7E+308 1.7E+308 /end CHARACTERISTIC
/begin CHARACTERISTIC speedgoat_test_SN5659__cal_impl.LVDTread1_P8 "" VALUE 0x008E1CA8 Scalar_FLOAT64_IEEE 0 speedgoat_test_SN5659_R2020b_CM_double -1.7E+308 1.7E+308 /end CHARACTERISTIC
/begin CHARACTERISTIC speedgoat_test_SN5659__cal_impl.LVDTread_P1 "" VALUE 0x008E1B40 Scalar_FLOAT64_IEEE 0 speedgoat_test_SN5659_R2020b_CM_double -1.7E+308 1.7E+308 /end CHARACTERISTIC
/begin CHARACTERISTIC speedgoat_test_SN5659__cal_impl.LVDTread_P2 "" VALUE 0x008E1B58 Scalar_FLOAT64_IEEE 0 speedgoat_test_SN5659_R2020b_CM_double -1.7E+308 1.7E+308 /end CHARACTERISTIC
/begin CHARACTERISTIC speedgoat_test_SN5659__cal_impl.LVDTread_P3 "" VALUE 0x008E1B70 Scalar_FLOAT64_IEEE 0 speedgoat_test_SN5659_R2020b_CM_double -1.7E+308 1.7E+308 /end CHARACTERISTIC
/begin CHARACTERISTIC speedgoat_test_SN5659__cal_impl.LVDTread_P4 "" VALUE 0x008E1B88 Scalar_FLOAT64_IEEE 0 speedgoat_test_SN5659_R2020b_CM_double -1.7E+308 1.7E+308 /end CHARACTERISTIC
/begin CHARACTERISTIC speedgoat_test_SN5659__cal_impl.LVDTread_P5 "" VALUE 0x008E1BA0 Scalar_FLOAT64_IEEE 0 speedgoat_test_SN5659_R2020b_CM_double -1.7E+308 1.7E+308 /end CHARACTERISTIC
/begin CHARACTERISTIC speedgoat_test_SN5659__cal_impl.LVDTread_P6 "" VALUE 0x008E1BB8 Scalar_FLOAT64_IEEE 0 speedgoat_test_SN5659_R2020b_CM_double -1.7E+308 1.7E+308 /end CHARACTERISTIC
/begin CHARACTERISTIC speedgoat_test_SN5659__cal_impl.LVDTread_P7 "" VALUE 0x008E1BD0 Scalar_FLOAT64_IEEE 0 speedgoat_test_SN5659_R2020b_CM_double -1.7E+308 1.7E+308 /end CHARACTERISTIC
/begin CHARACTERISTIC speedgoat_test_SN5659__cal_impl.LVDTread_P8 "" VALUE 0x008E1BE8 Scalar_FLOAT64_IEEE 0 speedgoat_test_SN5659_R2020b_CM_double -1.7E+308 1.7E+308 /end CHARACTERISTIC
/begin CHARACTERISTIC speedgoat_test_SN5659__cal_impl.PulseGenerator1_Amp "" VALUE 0x008DF9F8 Scalar_FLOAT64_IEEE 0 speedgoat_test_SN5659_R2020b_CM_double -1.7E+308 1.7E+308 /end CHARACTERISTIC
/begin CHARACTERISTIC speedgoat_test_SN5659__cal_impl.PulseGenerator1_Duty "" VALUE 0x008DFA08 Scalar_FLOAT64_IEEE 0 speedgoat_test_SN5659_R2020b_CM_double -1.7E+308 1.7E+308 /end CHARACTERISTIC
/begin CHARACTERISTIC speedgoat_test_SN5659__cal_impl.PulseGenerator1_Period "" VALUE 0x008DFA00 Scalar_FLOAT64_IEEE 0 speedgoat_test_SN5659_R2020b_CM_double -1.7E+308 1.7E+308 /end CHARACTERISTIC
/begin CHARACTERISTIC speedgoat_test_SN5659__cal_impl.PulseGenerator1_PhaseDelay "" VALUE 0x008DFA10 Scalar_FLOAT64_IEEE 0 speedgoat_test_SN5659_R2020b_CM_double -1.7E+308 1.7E+308 /end CHARACTERISTIC
/begin CHARACTERISTIC speedgoat_test_SN5659__cal_impl.PulseGenerator_Amp "" VALUE 0x008DF9D8 Scalar_FLOAT64_IEEE 0 speedgoat_test_SN5659_R2020b_CM_double -1.7E+308 1.7E+308 /end CHARACTERISTIC
/begin CHARACTERISTIC speedgoat_test_SN5659__cal_impl.PulseGenerator_Amp_g "" VALUE 0x008DFD30 Scalar_FLOAT64_IEEE 0 speedgoat_test_SN5659_R2020b_CM_double -1.7E+308 1.7E+308 /end CHARACTERISTIC
/begin CHARACTERISTIC speedgoat_test_SN5659__cal_impl.PulseGenerator_Duty "" VALUE 0x008DF9E8 Scalar_FLOAT64_IEEE 0 speedgoat_test_SN5659_R2020b_CM_double -1.7E+308 1.7E+308 /end CHARACTERISTIC
/begin CHARACTERISTIC speedgoat_test_SN5659__cal_impl.PulseGenerator_Duty_i "" VALUE 0x008DFD40 Scalar_FLOAT64_IEEE 0 speedgoat_test_SN5659_R2020b_CM_double -1.7E+308 1.7E+308 /end CHARACTERISTIC
/begin CHARACTERISTIC speedgoat_test_SN5659__cal_impl.PulseGenerator_Period "" VALUE 0x008DF9E0 Scalar_FLOAT64_IEEE 0 speedgoat_test_SN5659_R2020b_CM_double -1.7E+308 1.7E+308 /end CHARACTERISTIC
/begin CHARACTERISTIC speedgoat_test_SN5659__cal_impl.PulseGenerator_Period_i "" VALUE 0x008DFD38 Scalar_FLOAT64_IEEE 0 speedgoat_test_SN5659_R2020b_CM_double -1.7E+308 1.7E+308 /end CHARACTERISTIC
/begin CHARACTERISTIC speedgoat_test_SN5659__cal_impl.PulseGenerator_PhaseDelay "" VALUE 0x008DF9F0 Scalar_FLOAT64_IEEE 0 speedgoat_test_SN5659_R2020b_CM_double -1.7E+308 1.7E+308 /end CHARACTERISTIC
/begin CHARACTERISTIC speedgoat_test_SN5659__cal_impl.PulseGenerator_PhaseDelay_l "" VALUE 0x008DFD48 Scalar_FLOAT64_IEEE 0 speedgoat_test_SN5659_R2020b_CM_double -1.7E+308 1.7E+308 /end CHARACTERISTIC
/begin CHARACTERISTIC speedgoat_test_SN5659__cal_impl.REF_P1 "" VALUE 0x008E1CC0 Scalar_FLOAT64_IEEE 0 speedgoat_test_SN5659_R2020b_CM_double -1.7E+308 1.7E+308 /end CHARACTERISTIC
/begin CHARACTERISTIC speedgoat_test_SN5659__cal_impl.REF_P2 "" VALUE 0x008E1CD8 Scalar_FLOAT64_IEEE 0 speedgoat_test_SN5659_R2020b_CM_double -1.7E+308 1.7E+308 /end CHARACTERISTIC
/begin CHARACTERISTIC speedgoat_test_SN5659__cal_impl.REF_P3 "" VALUE 0x008E1CF0 Scalar_FLOAT64_IEEE 0 speedgoat_test_SN5659_R2020b_CM_double -1.7E+308 1.7E+308 /end CHARACTERISTIC
/begin CHARACTERISTIC speedgoat_test_SN5659__cal_impl.REF_P4 "" VALUE 0x008E1D08 Scalar_FLOAT64_IEEE 0 speedgoat_test_SN5659_R2020b_CM_double -1.7E+308 1.7E+308 /end CHARACTERISTIC
/begin CHARACTERISTIC speedgoat_test_SN5659__cal_impl.REF_P5 "" VALUE 0x008E1D20 Scalar_FLOAT64_IEEE 0 speedgoat_test_SN5659_R2020b_CM_double -1.7E+308 1.7E+308 /end CHARACTERISTIC
/begin CHARACTERISTIC speedgoat_test_SN5659__cal_impl.RXSampleTime1_Value "" VALUE 0x008E0C88 Scalar_FLOAT64_IEEE 0 speedgoat_test_SN5659_R2020b_CM_double -1.7E+308 1.7E+308 /end CHARACTERISTIC
/begin CHARACTERISTIC speedgoat_test_SN5659__cal_impl.RXSampleTime_Value "" VALUE 0x008E0C80 Scalar_FLOAT64_IEEE 0 speedgoat_test_SN5659_R2020b_CM_double -1.7E+308 1.7E+308 /end CHARACTERISTIC
/begin CHARACTERISTIC speedgoat_test_SN5659__cal_impl.Read1_P1 "" VALUE 0x008EEEE8 Scalar_FLOAT64_IEEE 0 speedgoat_test_SN5659_R2020b_CM_double -1.7E+308 1.7E+308 /end CHARACTERISTIC
/begin CHARACTERISTIC speedgoat_test_SN5659__cal_impl.Read1_P2 "" VALUE 0x008EEF00 Scalar_FLOAT64_IEEE 0 speedgoat_test_SN5659_R2020b_CM_double -1.7E+308 1.7E+308 /end CHARACTERISTIC
/begin CHARACTERISTIC speedgoat_test_SN5659__cal_impl.Read1_P3 "" VALUE 0x008EEF18 Scalar_FLOAT64_IEEE 0 speedgoat_test_SN5659_R2020b_CM_double -1.7E+308 1.7E+308 /end CHARACTERISTIC
/begin CHARACTERISTIC speedgoat_test_SN5659__cal_impl.Read1_P4 "" VALUE 0x008EEF30 Scalar_FLOAT64_IEEE 0 speedgoat_test_SN5659_R2020b_CM_double -1.7E+308 1.7E+308 /end CHARACTERISTIC
/begin CHARACTERISTIC speedgoat_test_SN5659__cal_impl.Read1_P5 "" VALUE 0x008EEF48 Scalar_FLOAT64_IEEE 0 speedgoat_test_SN5659_R2020b_CM_double -1.7E+308 1.7E+308 /end CHARACTERISTIC
/begin CHARACTERISTIC speedgoat_test_SN5659__cal_impl.Read1_P6 "" VALUE 0x008EEF60 Scalar_FLOAT64_IEEE 0 speedgoat_test_SN5659_R2020b_CM_double -1.7E+308 1.7E+308 /end CHARACTERISTIC
/begin CHARACTERISTIC speedgoat_test_SN5659__cal_impl.Read1_P7 "" VALUE 0x008EEF78 Scalar_FLOAT64_IEEE 0 speedgoat_test_SN5659_R2020b_CM_double -1.7E+308 1.7E+308 /end CHARACTERISTIC
/begin CHARACTERISTIC speedgoat_test_SN5659__cal_impl.Read1_P8 "" VALUE 0x008EEF90 Scalar_FLOAT64_IEEE 0 speedgoat_test_SN5659_R2020b_CM_double -1.7E+308 1.7E+308 /end CHARACTERISTIC
/begin CHARACTERISTIC speedgoat_test_SN5659__cal_impl.Read1_P9 "" VALUE 0x008EEFA8 Scalar_FLOAT64_IEEE 0 speedgoat_test_SN5659_R2020b_CM_double -1.7E+308 1.7E+308 /end CHARACTERISTIC
/begin CHARACTERISTIC speedgoat_test_SN5659__cal_impl.Read2_P1 "" VALUE 0x008EF018 Scalar_FLOAT64_IEEE 0 speedgoat_test_SN5659_R2020b_CM_double -1.7E+308 1.7E+308 /end CHARACTERISTIC
/begin CHARACTERISTIC speedgoat_test_SN5659__cal_impl.Read2_P2 "" VALUE 0x008EF030 Scalar_FLOAT64_IEEE 0 speedgoat_test_SN5659_R2020b_CM_double -1.7E+308 1.7E+308 /end CHARACTERISTIC
/begin CHARACTERISTIC speedgoat_test_SN5659__cal_impl.Read2_P3 "" VALUE 0x008EF048 Scalar_FLOAT64_IEEE 0 speedgoat_test_SN5659_R2020b_CM_double -1.7E+308 1.7E+308 /end CHARACTERISTIC
/begin CHARACTERISTIC speedgoat_test_SN5659__cal_impl.Read2_P4 "" VALUE 0x008EF060 Scalar_FLOAT64_IEEE 0 speedgoat_test_SN5659_R2020b_CM_double -1.7E+308 1.7E+308 /end CHARACTERISTIC
/begin CHARACTERISTIC speedgoat_test_SN5659__cal_impl.Read2_P5 "" VALUE 0x008EF078 Scalar_FLOAT64_IEEE 0 speedgoat_test_SN5659_R2020b_CM_double -1.7E+308 1.7E+308 /end CHARACTERISTIC
/begin CHARACTERISTIC speedgoat_test_SN5659__cal_impl.Read2_P6 "" VALUE 0x008EF090 Scalar_FLOAT64_IEEE 0 speedgoat_test_SN5659_R2020b_CM_double -1.7E+308 1.7E+308 /end CHARACTERISTIC
/begin CHARACTERISTIC speedgoat_test_SN5659__cal_impl.Read2_P7 "" VALUE 0x008EF0A8 Scalar_FLOAT64_IEEE 0 speedgoat_test_SN5659_R2020b_CM_double -1.7E+308 1.7E+308 /end CHARACTERISTIC
/begin CHARACTERISTIC speedgoat_test_SN5659__cal_impl.Read2_P8 "" VALUE 0x008EF0C0 Scalar_FLOAT64_IEEE 0 speedgoat_test_SN5659_R2020b_CM_double -1.7E+308 1.7E+308 /end CHARACTERISTIC
/begin CHARACTERISTIC speedgoat_test_SN5659__cal_impl.Read2_P9 "" VALUE 0x008EF0D8 Scalar_FLOAT64_IEEE 0 speedgoat_test_SN5659_R2020b_CM_double -1.7E+308 1.7E+308 /end CHARACTERISTIC
/begin CHARACTERISTIC speedgoat_test_SN5659__cal_impl.Read3_P1 "" VALUE 0x008EF148 Scalar_FLOAT64_IEEE 0 speedgoat_test_SN5659_R2020b_CM_double -1.7E+308 1.7E+308 /end CHARACTERISTIC
/begin CHARACTERISTIC speedgoat_test_SN5659__cal_impl.Read3_P2 "" VALUE 0x008EF160 Scalar_FLOAT64_IEEE 0 speedgoat_test_SN5659_R2020b_CM_double -1.7E+308 1.7E+308 /end CHARACTERISTIC
/begin CHARACTERISTIC speedgoat_test_SN5659__cal_impl.Read3_P3 "" VALUE 0x008EF178 Scalar_FLOAT64_IEEE 0 speedgoat_test_SN5659_R2020b_CM_double -1.7E+308 1.7E+308 /end CHARACTERISTIC
/begin CHARACTERISTIC speedgoat_test_SN5659__cal_impl.Read3_P4 "" VALUE 0x008EF190 Scalar_FLOAT64_IEEE 0 speedgoat_test_SN5659_R2020b_CM_double -1.7E+308 1.7E+308 /end CHARACTERISTIC
/begin CHARACTERISTIC speedgoat_test_SN5659__cal_impl.Read3_P5 "" VALUE 0x008EF1A8 Scalar_FLOAT64_IEEE 0 speedgoat_test_SN5659_R2020b_CM_double -1.7E+308 1.7E+308 /end CHARACTERISTIC
/begin CHARACTERISTIC speedgoat_test_SN5659__cal_impl.Read3_P6 "" VALUE 0x008EF1C0 Scalar_FLOAT64_IEEE 0 speedgoat_test_SN5659_R2020b_CM_double -1.7E+308 1.7E+308 /end CHARACTERISTIC
/begin CHARACTERISTIC speedgoat_test_SN5659__cal_impl.Read3_P7 "" VALUE 0x008EF1D8 Scalar_FLOAT64_IEEE 0 speedgoat_test_SN5659_R2020b_CM_double -1.7E+308 1.7E+308 /end CHARACTERISTIC
/begin CHARACTERISTIC speedgoat_test_SN5659__cal_impl.Read3_P8 "" VALUE 0x008EF1F0 Scalar_FLOAT64_IEEE 0 speedgoat_test_SN5659_R2020b_CM_double -1.7E+308 1.7E+308 /end CHARACTERISTIC
/begin CHARACTERISTIC speedgoat_test_SN5659__cal_impl.Read3_P9 "" VALUE 0x008EF208 Scalar_FLOAT64_IEEE 0 speedgoat_test_SN5659_R2020b_CM_double -1.7E+308 1.7E+308 /end CHARACTERISTIC
/begin CHARACTERISTIC speedgoat_test_SN5659__cal_impl.Read_P1 "" VALUE 0x008DFC50 Scalar_FLOAT64_IEEE 0 speedgoat_test_SN5659_R2020b_CM_double -1.7E+308 1.7E+308 /end CHARACTERISTIC
/begin CHARACTERISTIC speedgoat_test_SN5659__cal_impl.Read_P1_o "" VALUE 0x008EEDB8 Scalar_FLOAT64_IEEE 0 speedgoat_test_SN5659_R2020b_CM_double -1.7E+308 1.7E+308 /end CHARACTERISTIC
/begin CHARACTERISTIC speedgoat_test_SN5659__cal_impl.Read_P2 "" VALUE 0x008DFC68 Scalar_FLOAT64_IEEE 0 speedgoat_test_SN5659_R2020b_CM_double -1.7E+308 1.7E+308 /end CHARACTERISTIC
/begin CHARACTERISTIC speedgoat_test_SN5659__cal_impl.Read_P2_b "" VALUE 0x008EEDD0 Scalar_FLOAT64_IEEE 0 speedgoat_test_SN5659_R2020b_CM_double -1.7E+308 1.7E+308 /end CHARACTERISTIC
/begin CHARACTERISTIC speedgoat_test_SN5659__cal_impl.Read_P3 "" VALUE 0x008DFC80 Scalar_FLOAT64_IEEE 0 speedgoat_test_SN5659_R2020b_CM_double -1.7E+308 1.7E+308 /end CHARACTERISTIC
/begin CHARACTERISTIC speedgoat_test_SN5659__cal_impl.Read_P3_j "" VALUE 0x008EEDE8 Scalar_FLOAT64_IEEE 0 speedgoat_test_SN5659_R2020b_CM_double -1.7E+308 1.7E+308 /end CHARACTERISTIC
/begin CHARACTERISTIC speedgoat_test_SN5659__cal_impl.Read_P4 "" VALUE 0x008DFC98 Scalar_FLOAT64_IEEE 0 speedgoat_test_SN5659_R2020b_CM_double -1.7E+308 1.7E+308 /end CHARACTERISTIC
/begin CHARACTERISTIC speedgoat_test_SN5659__cal_impl.Read_P4_k "" VALUE 0x008EEE00 Scalar_FLOAT64_IEEE 0 speedgoat_test_SN5659_R2020b_CM_double -1.7E+308 1.7E+308 /end CHARACTERISTIC
/begin CHARACTERISTIC speedgoat_test_SN5659__cal_impl.Read_P5 "" VALUE 0x008DFCB0 Scalar_FLOAT64_IEEE 0 speedgoat_test_SN5659_R2020b_CM_double -1.7E+308 1.7E+308 /end CHARACTERISTIC
/begin CHARACTERISTIC speedgoat_test_SN5659__cal_impl.Read_P5_e "" VALUE 0x008EEE18 Scalar_FLOAT64_IEEE 0 speedgoat_test_SN5659_R2020b_CM_double -1.7E+308 1.7E+308 /end CHARACTERISTIC
/begin CHARACTERISTIC speedgoat_test_SN5659__cal_impl.Read_P6 "" VALUE 0x008EEE30 Scalar_FLOAT64_IEEE 0 speedgoat_test_SN5659_R2020b_CM_double -1.7E+308 1.7E+308 /end CHARACTERISTIC
/begin CHARACTERISTIC speedgoat_test_SN5659__cal_impl.Read_P7 "" VALUE 0x008EEE48 Scalar_FLOAT64_IEEE 0 speedgoat_test_SN5659_R2020b_CM_double -1.7E+308 1.7E+308 /end CHARACTERISTIC
/begin CHARACTERISTIC speedgoat_test_SN5659__cal_impl.Read_P8 "" VALUE 0x008EEE60 Scalar_FLOAT64_IEEE 0 speedgoat_test_SN5659_R2020b_CM_double -1.7E+308 1.7E+308 /end CHARACTERISTIC
/begin CHARACTERISTIC speedgoat_test_SN5659__cal_impl.Read_P9 "" VALUE 0x008EEE78 Scalar_FLOAT64_IEEE 0 speedgoat_test_SN5659_R2020b_CM_double -1.7E+308 1.7E+308 /end CHARACTERISTIC
/begin CHARACTERISTIC speedgoat_test_SN5659__cal_impl.Setup1_P1 "" VALUE 0x008E1858 Scalar_FLOAT64_IEEE 0 speedgoat_test_SN5659_R2020b_CM_double -1.7E+308 1.7E+308 /end CHARACTERISTIC
/begin CHARACTERISTIC speedgoat_test_SN5659__cal_impl.Setup1_P10 "" VAL_BLK 0x008E1A98 Scalar_FLOAT64_IEEE 0 speedgoat_test_SN5659_R2020b_CM_double -1.7E+308 1.7E+308 MATRIX_DIM 16 1 /end CHARACTERISTIC
/begin CHARACTERISTIC speedgoat_test_SN5659__cal_impl.Setup1_P11 "" VALUE 0x008E1B28 Scalar_FLOAT64_IEEE 0 speedgoat_test_SN5659_R2020b_CM_double -1.7E+308 1.7E+308 /end CHARACTERISTIC
/begin CHARACTERISTIC speedgoat_test_SN5659__cal_impl.Setup1_P2 "" VALUE 0x008E1870 Scalar_FLOAT64_IEEE 0 speedgoat_test_SN5659_R2020b_CM_double -1.7E+308 1.7E+308 /end CHARACTERISTIC
/begin CHARACTERISTIC speedgoat_test_SN5659__cal_impl.Setup1_P3 "" VALUE 0x008E1888 Scalar_FLOAT64_IEEE 0 speedgoat_test_SN5659_R2020b_CM_double -1.7E+308 1.7E+308 /end CHARACTERISTIC
/begin CHARACTERISTIC speedgoat_test_SN5659__cal_impl.Setup1_P4 "" VALUE 0x008E18A0 Scalar_FLOAT64_IEEE 0 speedgoat_test_SN5659_R2020b_CM_double -1.7E+308 1.7E+308 /end CHARACTERISTIC
/begin CHARACTERISTIC speedgoat_test_SN5659__cal_impl.Setup1_P5 "" VALUE 0x008E18B8 Scalar_FLOAT64_IEEE 0 speedgoat_test_SN5659_R2020b_CM_double -1.7E+308 1.7E+308 /end CHARACTERISTIC
/begin CHARACTERISTIC speedgoat_test_SN5659__cal_impl.Setup1_P6 "" VALUE 0x008E18D0 Scalar_FLOAT64_IEEE 0 speedgoat_test_SN5659_R2020b_CM_double -1.7E+308 1.7E+308 /end CHARACTERISTIC
/begin CHARACTERISTIC speedgoat_test_SN5659__cal_impl.Setup1_P7 "" VAL_BLK 0x008E18E8 Scalar_FLOAT64_IEEE 0 speedgoat_test_SN5659_R2020b_CM_double -1.7E+308 1.7E+308 MATRIX_DIM 16 1 /end CHARACTERISTIC
/begin CHARACTERISTIC speedgoat_test_SN5659__cal_impl.Setup1_P8 "" VAL_BLK 0x008E1978 Scalar_FLOAT64_IEEE 0 speedgoat_test_SN5659_R2020b_CM_double -1.7E+308 1.7E+308 MATRIX_DIM 16 1 /end CHARACTERISTIC
/begin CHARACTERISTIC speedgoat_test_SN5659__cal_impl.Setup1_P9 "" VAL_BLK 0x008E1A08 Scalar_FLOAT64_IEEE 0 speedgoat_test_SN5659_R2020b_CM_double -1.7E+308 1.7E+308 MATRIX_DIM 16 1 /end CHARACTERISTIC
/begin CHARACTERISTIC speedgoat_test_SN5659__cal_impl.Setup_P1 "" VALUE 0x008DFAE8 Scalar_FLOAT64_IEEE 0 speedgoat_test_SN5659_R2020b_CM_double -1.7E+308 1.7E+308 /end CHARACTERISTIC
/begin CHARACTERISTIC speedgoat_test_SN5659__cal_impl.Setup_P10 "" VAL_BLK 0x008DFEC8 Scalar_FLOAT64_IEEE 0 speedgoat_test_SN5659_R2020b_CM_double -1.7E+308 1.7E+308 MATRIX_DIM 4 1 /end CHARACTERISTIC
/begin CHARACTERISTIC speedgoat_test_SN5659__cal_impl.Setup_P10_a "" VAL_BLK 0x008E17B0 Scalar_FLOAT64_IEEE 0 speedgoat_test_SN5659_R2020b_CM_double -1.7E+308 1.7E+308 MATRIX_DIM 16 1 /end CHARACTERISTIC
/begin CHARACTERISTIC speedgoat_test_SN5659__cal_impl.Setup_P11 "" VAL_BLK 0x008DFEF8 Scalar_FLOAT64_IEEE 0 speedgoat_test_SN5659_R2020b_CM_double -1.7E+308 1.7E+308 MATRIX_DIM 4 1 /end CHARACTERISTIC
/begin CHARACTERISTIC speedgoat_test_SN5659__cal_impl.Setup_P11_e "" VALUE 0x008E1840 Scalar_FLOAT64_IEEE 0 speedgoat_test_SN5659_R2020b_CM_double -1.7E+308 1.7E+308 /end CHARACTERISTIC
/begin CHARACTERISTIC speedgoat_test_SN5659__cal_impl.Setup_P12 "" VAL_BLK 0x008DFF28 Scalar_FLOAT64_IEEE 0 speedgoat_test_SN5659_R2020b_CM_double -1.7E+308 1.7E+308 MATRIX_DIM 4 1 /end CHARACTERISTIC
/begin CHARACTERISTIC speedgoat_test_SN5659__cal_impl.Setup_P13 "" VAL_BLK 0x008DFF58 Scalar_FLOAT64_IEEE 0 speedgoat_test_SN5659_R2020b_CM_double -1.7E+308 1.7E+308 MATRIX_DIM 4 1 /end CHARACTERISTIC
/begin CHARACTERISTIC speedgoat_test_SN5659__cal_impl.Setup_P14 "" VAL_BLK 0x008DFF88 Scalar_FLOAT64_IEEE 0 speedgoat_test_SN5659_R2020b_CM_double -1.7E+308 1.7E+308 MATRIX_DIM 4 1 /end CHARACTERISTIC
/begin CHARACTERISTIC speedgoat_test_SN5659__cal_impl.Setup_P15 "" VAL_BLK 0x008DFFB8 Scalar_FLOAT64_IEEE 0 speedgoat_test_SN5659_R2020b_CM_double -1.7E+308 1.7E+308 MATRIX_DIM 4 1 /end CHARACTERISTIC
/begin CHARACTERISTIC speedgoat_test_SN5659__cal_impl.Setup_P16 "" VAL_BLK 0x008DFFE8 Scalar_FLOAT64_IEEE 0 speedgoat_test_SN5659_R2020b_CM_double -1.7E+308 1.7E+308 MATRIX_DIM 4 1 /end CHARACTERISTIC
/begin CHARACTERISTIC speedgoat_test_SN5659__cal_impl.Setup_P17 "" VAL_BLK 0x008E0018 Scalar_FLOAT64_IEEE 0 speedgoat_test_SN5659_R2020b_CM_double -1.7E+308 1.7E+308 MATRIX_DIM 4 1 /end CHARACTERISTIC
/begin CHARACTERISTIC speedgoat_test_SN5659__cal_impl.Setup_P18 "" VAL_BLK 0x008E0048 Scalar_FLOAT64_IEEE 0 speedgoat_test_SN5659_R2020b_CM_double -1.7E+308 1.7E+308 MATRIX_DIM 4 1 /end CHARACTERISTIC
/begin CHARACTERISTIC speedgoat_test_SN5659__cal_impl.Setup_P19 "" VAL_BLK 0x008E0078 Scalar_FLOAT64_IEEE 0 speedgoat_test_SN5659_R2020b_CM_double -1.7E+308 1.7E+308 MATRIX_DIM 4 1 /end CHARACTERISTIC
/begin CHARACTERISTIC speedgoat_test_SN5659__cal_impl.Setup_P1_c "" VALUE 0x008E1570 Scalar_FLOAT64_IEEE 0 speedgoat_test_SN5659_R2020b_CM_double -1.7E+308 1.7E+308 /end CHARACTERISTIC
/begin CHARACTERISTIC speedgoat_test_SN5659__cal_impl.Setup_P1_h "" VALUE 0x008DFD60 Scalar_FLOAT64_IEEE 0 speedgoat_test_SN5659_R2020b_CM_double -1.7E+308 1.7E+308 /end CHARACTERISTIC
/begin CHARACTERISTIC speedgoat_test_SN5659__cal_impl.Setup_P2 "" VALUE 0x008DFB00 Scalar_FLOAT64_IEEE 0 speedgoat_test_SN5659_R2020b_CM_double -1.7E+308 1.7E+308 /end CHARACTERISTIC
/begin CHARACTERISTIC speedgoat_test_SN5659__cal_impl.Setup_P20 "" VAL_BLK 0x008E00A8 Scalar_FLOAT64_IEEE 0 speedgoat_test_SN5659_R2020b_CM_double -1.7E+308 1.7E+308 MATRIX_DIM 8 1 /end CHARACTERISTIC
/begin CHARACTERISTIC speedgoat_test_SN5659__cal_impl.Setup_P21 "" VAL_BLK 0x008E00F8 Scalar_FLOAT64_IEEE 0 speedgoat_test_SN5659_R2020b_CM_double -1.7E+308 1.7E+308 MATRIX_DIM 8 1 /end CHARACTERISTIC
/begin CHARACTERISTIC speedgoat_test_SN5659__cal_impl.Setup_P22 "" VAL_BLK 0x008E0148 Scalar_FLOAT64_IEEE 0 speedgoat_test_SN5659_R2020b_CM_double -1.7E+308 1.7E+308 MATRIX_DIM 4 1 /end CHARACTERISTIC
/begin CHARACTERISTIC speedgoat_test_SN5659__cal_impl.Setup_P23 "" VAL_BLK 0x008E0178 Scalar_FLOAT64_IEEE 0 speedgoat_test_SN5659_R2020b_CM_double -1.7E+308 1.7E+308 MATRIX_DIM 4 1 /end CHARACTERISTIC
/begin CHARACTERISTIC speedgoat_test_SN5659__cal_impl.Setup_P24 "" VAL_BLK 0x008E01A8 Scalar_FLOAT64_IEEE 0 speedgoat_test_SN5659_R2020b_CM_double -1.7E+308 1.7E+308 MATRIX_DIM 4 1 /end CHARACTERISTIC
/begin CHARACTERISTIC speedgoat_test_SN5659__cal_impl.Setup_P25 "" VAL_BLK 0x008E01D8 Scalar_FLOAT64_IEEE 0 speedgoat_test_SN5659_R2020b_CM_double -1.7E+308 1.7E+308 MATRIX_DIM 4 1 /end CHARACTERISTIC
/begin CHARACTERISTIC speedgoat_test_SN5659__cal_impl.Setup_P2_h "" VALUE 0x008DFD78 Scalar_FLOAT64_IEEE 0 speedgoat_test_SN5659_R2020b_CM_double -1.7E+308 1.7E+308 /end CHARACTERISTIC
/begin CHARACTERISTIC speedgoat_test_SN5659__cal_impl.Setup_P2_j "" VALUE 0x008E1588 Scalar_FLOAT64_IEEE 0 speedgoat_test_SN5659_R2020b_CM_double -1.7E+308 1.7E+308 /end CHARACTERISTIC
/begin CHARACTERISTIC speedgoat_test_SN5659__cal_impl.Setup_P3 "" VALUE 0x008DFB18 Scalar_FLOAT64_IEEE 0 speedgoat_test_SN5659_R2020b_CM_double -1.7E+308 1.7E+308 /end CHARACTERISTIC
/begin CHARACTERISTIC speedgoat_test_SN5659__cal_impl.Setup_P3_l "" VALUE 0x008DFD90 Scalar_FLOAT64_IEEE 0 speedgoat_test_SN5659_R2020b_CM_double -1.7E+308 1.7E+308 /end CHARACTERISTIC
/begin CHARACTERISTIC speedgoat_test_SN5659__cal_impl.Setup_P3_p "" VALUE 0x008E15A0 Scalar_FLOAT64_IEEE 0 speedgoat_test_SN5659_R2020b_CM_double -1.7E+308 1.7E+308 /end CHARACTERISTIC
/begin CHARACTERISTIC speedgoat_test_SN5659__cal_impl.Setup_P4 "" VAL_BLK 0x008DFB30 Scalar_FLOAT64_IEEE 0 speedgoat_test_SN5659_R2020b_CM_double -1.7E+308 1.7E+308 MATRIX_DIM 16 1 /end CHARACTERISTIC
/begin CHARACTERISTIC speedgoat_test_SN5659__cal_impl.Setup_P4_h "" VAL_BLK 0x008DFDA8 Scalar_FLOAT64_IEEE 0 speedgoat_test_SN5659_R2020b_CM_double -1.7E+308 1.7E+308 MATRIX_DIM 4 1 /end CHARACTERISTIC
/begin CHARACTERISTIC speedgoat_test_SN5659__cal_impl.Setup_P4_hb "" VALUE 0x008E15B8 Scalar_FLOAT64_IEEE 0 speedgoat_test_SN5659_R2020b_CM_double -1.7E+308 1.7E+308 /end CHARACTERISTIC
/begin CHARACTERISTIC speedgoat_test_SN5659__cal_impl.Setup_P5 "" VAL_BLK 0x008DFBC0 Scalar_FLOAT64_IEEE 0 speedgoat_test_SN5659_R2020b_CM_double -1.7E+308 1.7E+308 MATRIX_DIM 16 1 /end CHARACTERISTIC
/begin CHARACTERISTIC speedgoat_test_SN5659__cal_impl.Setup_P5_b "" VAL_BLK 0x008DFDD8 Scalar_FLOAT64_IEEE 0 speedgoat_test_SN5659_R2020b_CM_double -1.7E+308 1.7E+308 MATRIX_DIM 4 1 /end CHARACTERISTIC
/begin CHARACTERISTIC speedgoat_test_SN5659__cal_impl.Setup_P5_k "" VALUE 0x008E15D0 Scalar_FLOAT64_IEEE 0 speedgoat_test_SN5659_R2020b_CM_double -1.7E+308 1.7E+308 /end CHARACTERISTIC
/begin CHARACTERISTIC speedgoat_test_SN5659__cal_impl.Setup_P6 "" VAL_BLK 0x008DFE08 Scalar_FLOAT64_IEEE 0 speedgoat_test_SN5659_R2020b_CM_double -1.7E+308 1.7E+308 MATRIX_DIM 4 1 /end CHARACTERISTIC
/begin CHARACTERISTIC speedgoat_test_SN5659__cal_impl.Setup_P6_b "" VALUE 0x008E15E8 Scalar_FLOAT64_IEEE 0 speedgoat_test_SN5659_R2020b_CM_double -1.7E+308 1.7E+308 /end CHARACTERISTIC
/begin CHARACTERISTIC speedgoat_test_SN5659__cal_impl.Setup_P7 "" VAL_BLK 0x008DFE38 Scalar_FLOAT64_IEEE 0 speedgoat_test_SN5659_R2020b_CM_double -1.7E+308 1.7E+308 MATRIX_DIM 4 1 /end CHARACTERISTIC
/begin CHARACTERISTIC speedgoat_test_SN5659__cal_impl.Setup_P7_c "" VAL_BLK 0x008E1600 Scalar_FLOAT64_IEEE 0 speedgoat_test_SN5659_R2020b_CM_double -1.7E+308 1.7E+308 MATRIX_DIM 16 1 /end CHARACTERISTIC
/begin CHARACTERISTIC speedgoat_test_SN5659__cal_impl.Setup_P8 "" VAL_BLK 0x008DFE68 Scalar_FLOAT64_IEEE 0 speedgoat_test_SN5659_R2020b_CM_double -1.7E+308 1.7E+308 MATRIX_DIM 4 1 /end CHARACTERISTIC
/begin CHARACTERISTIC speedgoat_test_SN5659__cal_impl.Setup_P8_g "" VAL_BLK 0x008E1690 Scalar_FLOAT64_IEEE 0 speedgoat_test_SN5659_R2020b_CM_double -1.7E+308 1.7E+308 MATRIX_DIM 16 1 /end CHARACTERISTIC
/begin CHARACTERISTIC speedgoat_test_SN5659__cal_impl.Setup_P9 "" VAL_BLK 0x008DFE98 Scalar_FLOAT64_IEEE 0 speedgoat_test_SN5659_R2020b_CM_double -1.7E+308 1.7E+308 MATRIX_DIM 4 1 /end CHARACTERISTIC
/begin CHARACTERISTIC speedgoat_test_SN5659__cal_impl.Setup_P9_c "" VAL_BLK 0x008E1720 Scalar_FLOAT64_IEEE 0 speedgoat_test_SN5659_R2020b_CM_double -1.7E+308 1.7E+308 MATRIX_DIM 16 1 /end CHARACTERISTIC
/begin CHARACTERISTIC speedgoat_test_SN5659__cal_impl.Setupv2_P1 "" VALUE 0x008DF250 Scalar_FLOAT64_IEEE 0 speedgoat_test_SN5659_R2020b_CM_double -1.7E+308 1.7E+308 /end CHARACTERISTIC
/begin CHARACTERISTIC speedgoat_test_SN5659__cal_impl.Setupv2_P10 "" VALUE 0x008DF350 Scalar_FLOAT64_IEEE 0 speedgoat_test_SN5659_R2020b_CM_double -1.7E+308 1.7E+308 /end CHARACTERISTIC
/begin CHARACTERISTIC speedgoat_test_SN5659__cal_impl.Setupv2_P11 "" VAL_BLK 0x008DF368 Scalar_FLOAT64_IEEE 0 speedgoat_test_SN5659_R2020b_CM_double -1.7E+308 1.7E+308 MATRIX_DIM 2 1 /end CHARACTERISTIC
/begin CHARACTERISTIC speedgoat_test_SN5659__cal_impl.Setupv2_P12 "" VALUE 0x008DF388 Scalar_FLOAT64_IEEE 0 speedgoat_test_SN5659_R2020b_CM_double -1.7E+308 1.7E+308 /end CHARACTERISTIC
/begin CHARACTERISTIC speedgoat_test_SN5659__cal_impl.Setupv2_P13 "" VALUE 0x008DF3A0 Scalar_FLOAT64_IEEE 0 speedgoat_test_SN5659_R2020b_CM_double -1.7E+308 1.7E+308 /end CHARACTERISTIC
/begin CHARACTERISTIC speedgoat_test_SN5659__cal_impl.Setupv2_P14 "" VALUE 0x008DF3B8 Scalar_FLOAT64_IEEE 0 speedgoat_test_SN5659_R2020b_CM_double -1.7E+308 1.7E+308 /end CHARACTERISTIC
/begin CHARACTERISTIC speedgoat_test_SN5659__cal_impl.Setupv2_P15 "" VAL_BLK 0x008DF3D0 Scalar_FLOAT64_IEEE 0 speedgoat_test_SN5659_R2020b_CM_double -1.7E+308 1.7E+308 MATRIX_DIM 4 1 /end CHARACTERISTIC
/begin CHARACTERISTIC speedgoat_test_SN5659__cal_impl.Setupv2_P16 "" VAL_BLK 0x008DF400 Scalar_FLOAT64_IEEE 0 speedgoat_test_SN5659_R2020b_CM_double -1.7E+308 1.7E+308 MATRIX_DIM 8 1 /end CHARACTERISTIC
/begin CHARACTERISTIC speedgoat_test_SN5659__cal_impl.Setupv2_P17 "" VALUE 0x008DF450 Scalar_FLOAT64_IEEE 0 speedgoat_test_SN5659_R2020b_CM_double -1.7E+308 1.7E+308 /end CHARACTERISTIC
/begin CHARACTERISTIC speedgoat_test_SN5659__cal_impl.Setupv2_P18 "" VALUE 0x008DF468 Scalar_FLOAT64_IEEE 0 speedgoat_test_SN5659_R2020b_CM_double -1.7E+308 1.7E+308 /end CHARACTERISTIC
/begin CHARACTERISTIC speedgoat_test_SN5659__cal_impl.Setupv2_P19 "" VALUE 0x008DF480 Scalar_FLOAT64_IEEE 0 speedgoat_test_SN5659_R2020b_CM_double -1.7E+308 1.7E+308 /end CHARACTERISTIC
/begin CHARACTERISTIC speedgoat_test_SN5659__cal_impl.Setupv2_P2 "" VALUE 0x008DF268 Scalar_FLOAT64_IEEE 0 speedgoat_test_SN5659_R2020b_CM_double -1.7E+308 1.7E+308 /end CHARACTERISTIC
/begin CHARACTERISTIC speedgoat_test_SN5659__cal_impl.Setupv2_P20 "" VAL_BLK 0x008DF498 Scalar_FLOAT64_IEEE 0 speedgoat_test_SN5659_R2020b_CM_double -1.7E+308 1.7E+308 MATRIX_DIM 2 1 /end CHARACTERISTIC
/begin CHARACTERISTIC speedgoat_test_SN5659__cal_impl.Setupv2_P21 "" VALUE 0x008DF4B8 Scalar_FLOAT64_IEEE 0 speedgoat_test_SN5659_R2020b_CM_double -1.7E+308 1.7E+308 /end CHARACTERISTIC
/begin CHARACTERISTIC speedgoat_test_SN5659__cal_impl.Setupv2_P22 "" VALUE 0x008DF4D0 Scalar_FLOAT64_IEEE 0 speedgoat_test_SN5659_R2020b_CM_double -1.7E+308 1.7E+308 /end CHARACTERISTIC
/begin CHARACTERISTIC speedgoat_test_SN5659__cal_impl.Setupv2_P23 "" VALUE 0x008DF4E8 Scalar_FLOAT64_IEEE 0 speedgoat_test_SN5659_R2020b_CM_double -1.7E+308 1.7E+308 /end CHARACTERISTIC
/begin CHARACTERISTIC speedgoat_test_SN5659__cal_impl.Setupv2_P24 "" VALUE 0x008DF500 Scalar_FLOAT64_IEEE 0 speedgoat_test_SN5659_R2020b_CM_double -1.7E+308 1.7E+308 /end CHARACTERISTIC
/begin CHARACTERISTIC speedgoat_test_SN5659__cal_impl.Setupv2_P25 "" VALUE 0x008DF518 Scalar_FLOAT64_IEEE 0 speedgoat_test_SN5659_R2020b_CM_double -1.7E+308 1.7E+308 /end CHARACTERISTIC
/begin CHARACTERISTIC speedgoat_test_SN5659__cal_impl.Setupv2_P26 "" VALUE 0x008DF530 Scalar_FLOAT64_IEEE 0 speedgoat_test_SN5659_R2020b_CM_double -1.7E+308 1.7E+308 /end CHARACTERISTIC
/begin CHARACTERISTIC speedgoat_test_SN5659__cal_impl.Setupv2_P27 "" VALUE 0x008DF548 Scalar_FLOAT64_IEEE 0 speedgoat_test_SN5659_R2020b_CM_double -1.7E+308 1.7E+308 /end CHARACTERISTIC
/begin CHARACTERISTIC speedgoat_test_SN5659__cal_impl.Setupv2_P28 "" VALUE 0x008DF560 Scalar_FLOAT64_IEEE 0 speedgoat_test_SN5659_R2020b_CM_double -1.7E+308 1.7E+308 /end CHARACTERISTIC
/begin CHARACTERISTIC speedgoat_test_SN5659__cal_impl.Setupv2_P29 "" VALUE 0x008DF578 Scalar_FLOAT64_IEEE 0 speedgoat_test_SN5659_R2020b_CM_double -1.7E+308 1.7E+308 /end CHARACTERISTIC
/begin CHARACTERISTIC speedgoat_test_SN5659__cal_impl.Setupv2_P3 "" VALUE 0x008DF280 Scalar_FLOAT64_IEEE 0 speedgoat_test_SN5659_R2020b_CM_double -1.7E+308 1.7E+308 /end CHARACTERISTIC
/begin CHARACTERISTIC speedgoat_test_SN5659__cal_impl.Setupv2_P30 "" VALUE 0x008DF590 Scalar_FLOAT64_IEEE 0 speedgoat_test_SN5659_R2020b_CM_double -1.7E+308 1.7E+308 /end CHARACTERISTIC
/begin CHARACTERISTIC speedgoat_test_SN5659__cal_impl.Setupv2_P31 "" VAL_BLK 0x008DF5A8 Scalar_FLOAT64_IEEE 0 speedgoat_test_SN5659_R2020b_CM_double -1.7E+308 1.7E+308 MATRIX_DIM 2 1 /end CHARACTERISTIC
/begin CHARACTERISTIC speedgoat_test_SN5659__cal_impl.Setupv2_P32 "" VAL_BLK 0x008DF5C8 Scalar_FLOAT64_IEEE 0 speedgoat_test_SN5659_R2020b_CM_double -1.7E+308 1.7E+308 MATRIX_DIM 2 1 /end CHARACTERISTIC
/begin CHARACTERISTIC speedgoat_test_SN5659__cal_impl.Setupv2_P33 "" VALUE 0x008DF5E8 Scalar_FLOAT64_IEEE 0 speedgoat_test_SN5659_R2020b_CM_double -1.7E+308 1.7E+308 /end CHARACTERISTIC
/begin CHARACTERISTIC speedgoat_test_SN5659__cal_impl.Setupv2_P34 "" VALUE 0x008DF600 Scalar_FLOAT64_IEEE 0 speedgoat_test_SN5659_R2020b_CM_double -1.7E+308 1.7E+308 /end CHARACTERISTIC
/begin CHARACTERISTIC speedgoat_test_SN5659__cal_impl.Setupv2_P35 "" VALUE 0x008DF618 Scalar_FLOAT64_IEEE 0 speedgoat_test_SN5659_R2020b_CM_double -1.7E+308 1.7E+308 /end CHARACTERISTIC
/begin CHARACTERISTIC speedgoat_test_SN5659__cal_impl.Setupv2_P4 "" VALUE 0x008DF298 Scalar_FLOAT64_IEEE 0 speedgoat_test_SN5659_R2020b_CM_double -1.7E+308 1.7E+308 /end CHARACTERISTIC
/begin CHARACTERISTIC speedgoat_test_SN5659__cal_impl.Setupv2_P5 "" VAL_BLK 0x008DF2B0 Scalar_FLOAT64_IEEE 0 speedgoat_test_SN5659_R2020b_CM_double -1.7E+308 1.7E+308 MATRIX_DIM 4 1 /end CHARACTERISTIC
/begin CHARACTERISTIC speedgoat_test_SN5659__cal_impl.Setupv2_P6 "" VAL_BLK 0x008DF2E0 Scalar_FLOAT64_IEEE 0 speedgoat_test_SN5659_R2020b_CM_double -1.7E+308 1.7E+308 MATRIX_DIM 2 1 /end CHARACTERISTIC
/begin CHARACTERISTIC speedgoat_test_SN5659__cal_impl.Setupv2_P7 "" VAL_BLK 0x008DF300 Scalar_FLOAT64_IEEE 0 speedgoat_test_SN5659_R2020b_CM_double -1.7E+308 1.7E+308 MATRIX_DIM 2 1 /end CHARACTERISTIC
/begin CHARACTERISTIC speedgoat_test_SN5659__cal_impl.Setupv2_P8 "" VALUE 0x008DF320 Scalar_FLOAT64_IEEE 0 speedgoat_test_SN5659_R2020b_CM_double -1.7E+308 1.7E+308 /end CHARACTERISTIC
/begin CHARACTERISTIC speedgoat_test_SN5659__cal_impl.Setupv2_P9 "" VALUE 0x008DF338 Scalar_FLOAT64_IEEE 0 speedgoat_test_SN5659_R2020b_CM_double -1.7E+308 1.7E+308 /end CHARACTERISTIC
/begin CHARACTERISTIC speedgoat_test_SN5659__cal_impl.SineWave1_Amp "" VALUE 0x008E0708 Scalar_FLOAT64_IEEE 0 speedgoat_test_SN5659_R2020b_CM_double -1.7E+308 1.7E+308 /end CHARACTERISTIC
/begin CHARACTERISTIC speedgoat_test_SN5659__cal_impl.SineWave1_Amp_d "" VALUE 0x008E1390 Scalar_FLOAT64_IEEE 0 speedgoat_test_SN5659_R2020b_CM_double -1.7E+308 1.7E+308 /end CHARACTERISTIC
/begin CHARACTERISTIC speedgoat_test_SN5659__cal_impl.SineWave1_Amp_i "" VALUE 0x008EF268 Scalar_FLOAT64_IEEE 0 speedgoat_test_SN5659_R2020b_CM_double -1.7E+308 1.7E+308 /end CHARACTERISTIC
/begin CHARACTERISTIC speedgoat_test_SN5659__cal_impl.SineWave1_Bias "" VALUE 0x008E0710 Scalar_FLOAT64_IEEE 0 speedgoat_test_SN5659_R2020b_CM_double -1.7E+308 1.7E+308 /end CHARACTERISTIC
/begin CHARACTERISTIC speedgoat_test_SN5659__cal_impl.SineWave1_Bias_d "" VALUE 0x008E1398 Scalar_FLOAT64_IEEE 0 speedgoat_test_SN5659_R2020b_CM_double -1.7E+308 1.7E+308 /end CHARACTERISTIC
/begin CHARACTERISTIC speedgoat_test_SN5659__cal_impl.SineWave1_Bias_du "" VALUE 0x008EF270 Scalar_FLOAT64_IEEE 0 speedgoat_test_SN5659_R2020b_CM_double -1.7E+308 1.7E+308 /end CHARACTERISTIC
/begin CHARACTERISTIC speedgoat_test_SN5659__cal_impl.SineWave1_Freq "" VALUE 0x008E0718 Scalar_FLOAT64_IEEE 0 speedgoat_test_SN5659_R2020b_CM_double -1.7E+308 1.7E+308 /end CHARACTERISTIC
/begin CHARACTERISTIC speedgoat_test_SN5659__cal_impl.SineWave1_Freq_b "" VALUE 0x008EF278 Scalar_FLOAT64_IEEE 0 speedgoat_test_SN5659_R2020b_CM_double -1.7E+308 1.7E+308 /end CHARACTERISTIC
/begin CHARACTERISTIC speedgoat_test_SN5659__cal_impl.SineWave1_Freq_c "" VALUE 0x008E13A0 Scalar_FLOAT64_IEEE 0 speedgoat_test_SN5659_R2020b_CM_double -1.7E+308 1.7E+308 /end CHARACTERISTIC
/begin CHARACTERISTIC speedgoat_test_SN5659__cal_impl.SineWave1_HCos "" VALUE 0x008E0728 Scalar_FLOAT64_IEEE 0 speedgoat_test_SN5659_R2020b_CM_double -1.7E+308 1.7E+308 /end CHARACTERISTIC
/begin CHARACTERISTIC speedgoat_test_SN5659__cal_impl.SineWave1_HCos_j "" VALUE 0x008E13B0 Scalar_FLOAT64_IEEE 0 speedgoat_test_SN5659_R2020b_CM_double -1.7E+308 1.7E+308 /end CHARACTERISTIC
/begin CHARACTERISTIC speedgoat_test_SN5659__cal_impl.SineWave1_HCos_l "" VALUE 0x008EF288 Scalar_FLOAT64_IEEE 0 speedgoat_test_SN5659_R2020b_CM_double -1.7E+308 1.7E+308 /end CHARACTERISTIC
/begin CHARACTERISTIC speedgoat_test_SN5659__cal_impl.SineWave1_Hsin "" VALUE 0x008E0720 Scalar_FLOAT64_IEEE 0 speedgoat_test_SN5659_R2020b_CM_double -1.7E+308 1.7E+308 /end CHARACTERISTIC
/begin CHARACTERISTIC speedgoat_test_SN5659__cal_impl.SineWave1_Hsin_j "" VALUE 0x008EF280 Scalar_FLOAT64_IEEE 0 speedgoat_test_SN5659_R2020b_CM_double -1.7E+308 1.7E+308 /end CHARACTERISTIC
/begin CHARACTERISTIC speedgoat_test_SN5659__cal_impl.SineWave1_Hsin_m "" VALUE 0x008E13A8 Scalar_FLOAT64_IEEE 0 speedgoat_test_SN5659_R2020b_CM_double -1.7E+308 1.7E+308 /end CHARACTERISTIC
/begin CHARACTERISTIC speedgoat_test_SN5659__cal_impl.SineWave1_PCos "" VALUE 0x008E0738 Scalar_FLOAT64_IEEE 0 speedgoat_test_SN5659_R2020b_CM_double -1.7E+308 1.7E+308 /end CHARACTERISTIC
/begin CHARACTERISTIC speedgoat_test_SN5659__cal_impl.SineWave1_PCos_c "" VALUE 0x008EF298 Scalar_FLOAT64_IEEE 0 speedgoat_test_SN5659_R2020b_CM_double -1.7E+308 1.7E+308 /end CHARACTERISTIC
/begin CHARACTERISTIC speedgoat_test_SN5659__cal_impl.SineWave1_PCos_o "" VALUE 0x008E13C0 Scalar_FLOAT64_IEEE 0 speedgoat_test_SN5659_R2020b_CM_double -1.7E+308 1.7E+308 /end CHARACTERISTIC
/begin CHARACTERISTIC speedgoat_test_SN5659__cal_impl.SineWave1_PSin "" VALUE 0x008E0730 Scalar_FLOAT64_IEEE 0 speedgoat_test_SN5659_R2020b_CM_double -1.7E+308 1.7E+308 /end CHARACTERISTIC
/begin CHARACTERISTIC speedgoat_test_SN5659__cal_impl.SineWave1_PSin_e "" VALUE 0x008EF290 Scalar_FLOAT64_IEEE 0 speedgoat_test_SN5659_R2020b_CM_double -1.7E+308 1.7E+308 /end CHARACTERISTIC
/begin CHARACTERISTIC speedgoat_test_SN5659__cal_impl.SineWave1_PSin_n "" VALUE 0x008E13B8 Scalar_FLOAT64_IEEE 0 speedgoat_test_SN5659_R2020b_CM_double -1.7E+308 1.7E+308 /end CHARACTERISTIC
/begin CHARACTERISTIC speedgoat_test_SN5659__cal_impl.SineWave2_Amp "" VALUE 0x008E0820 Scalar_FLOAT64_IEEE 0 speedgoat_test_SN5659_R2020b_CM_double -1.7E+308 1.7E+308 /end CHARACTERISTIC
/begin CHARACTERISTIC speedgoat_test_SN5659__cal_impl.SineWave2_Amp_e "" VALUE 0x008EF3D8 Scalar_FLOAT64_IEEE 0 speedgoat_test_SN5659_R2020b_CM_double -1.7E+308 1.7E+308 /end CHARACTERISTIC
/begin CHARACTERISTIC speedgoat_test_SN5659__cal_impl.SineWave2_Bias "" VALUE 0x008E0828 Scalar_FLOAT64_IEEE 0 speedgoat_test_SN5659_R2020b_CM_double -1.7E+308 1.7E+308 /end CHARACTERISTIC
/begin CHARACTERISTIC speedgoat_test_SN5659__cal_impl.SineWave2_Bias_e "" VALUE 0x008EF3E0 Scalar_FLOAT64_IEEE 0 speedgoat_test_SN5659_R2020b_CM_double -1.7E+308 1.7E+308 /end CHARACTERISTIC
/begin CHARACTERISTIC speedgoat_test_SN5659__cal_impl.SineWave2_Freq "" VALUE 0x008E0830 Scalar_FLOAT64_IEEE 0 speedgoat_test_SN5659_R2020b_CM_double -1.7E+308 1.7E+308 /end CHARACTERISTIC
/begin CHARACTERISTIC speedgoat_test_SN5659__cal_impl.SineWave2_Freq_o "" VALUE 0x008EF3E8 Scalar_FLOAT64_IEEE 0 speedgoat_test_SN5659_R2020b_CM_double -1.7E+308 1.7E+308 /end CHARACTERISTIC
/begin CHARACTERISTIC speedgoat_test_SN5659__cal_impl.SineWave2_HCos "" VALUE 0x008E0840 Scalar_FLOAT64_IEEE 0 speedgoat_test_SN5659_R2020b_CM_double -1.7E+308 1.7E+308 /end CHARACTERISTIC
/begin CHARACTERISTIC speedgoat_test_SN5659__cal_impl.SineWave2_HCos_a "" VALUE 0x008EF3F8 Scalar_FLOAT64_IEEE 0 speedgoat_test_SN5659_R2020b_CM_double -1.7E+308 1.7E+308 /end CHARACTERISTIC
/begin CHARACTERISTIC speedgoat_test_SN5659__cal_impl.SineWave2_Hsin "" VALUE 0x008E0838 Scalar_FLOAT64_IEEE 0 speedgoat_test_SN5659_R2020b_CM_double -1.7E+308 1.7E+308 /end CHARACTERISTIC
/begin CHARACTERISTIC speedgoat_test_SN5659__cal_impl.SineWave2_Hsin_k "" VALUE 0x008EF3F0 Scalar_FLOAT64_IEEE 0 speedgoat_test_SN5659_R2020b_CM_double -1.7E+308 1.7E+308 /end CHARACTERISTIC
/begin CHARACTERISTIC speedgoat_test_SN5659__cal_impl.SineWave2_PCos "" VALUE 0x008E0850 Scalar_FLOAT64_IEEE 0 speedgoat_test_SN5659_R2020b_CM_double -1.7E+308 1.7E+308 /end CHARACTERISTIC
/begin CHARACTERISTIC speedgoat_test_SN5659__cal_impl.SineWave2_PCos_p "" VALUE 0x008EF408 Scalar_FLOAT64_IEEE 0 speedgoat_test_SN5659_R2020b_CM_double -1.7E+308 1.7E+308 /end CHARACTERISTIC
/begin CHARACTERISTIC speedgoat_test_SN5659__cal_impl.SineWave2_PSin "" VALUE 0x008E0848 Scalar_FLOAT64_IEEE 0 speedgoat_test_SN5659_R2020b_CM_double -1.7E+308 1.7E+308 /end CHARACTERISTIC
/begin CHARACTERISTIC speedgoat_test_SN5659__cal_impl.SineWave2_PSin_p "" VALUE 0x008EF400 Scalar_FLOAT64_IEEE 0 speedgoat_test_SN5659_R2020b_CM_double -1.7E+308 1.7E+308 /end CHARACTERISTIC
/begin CHARACTERISTIC speedgoat_test_SN5659__cal_impl.SineWave3_Amp "" VALUE 0x008E0938 Scalar_FLOAT64_IEEE 0 speedgoat_test_SN5659_R2020b_CM_double -1.7E+308 1.7E+308 /end CHARACTERISTIC
/begin CHARACTERISTIC speedgoat_test_SN5659__cal_impl.SineWave3_Amp_n "" VALUE 0x008EF548 Scalar_FLOAT64_IEEE 0 speedgoat_test_SN5659_R2020b_CM_double -1.7E+308 1.7E+308 /end CHARACTERISTIC
/begin CHARACTERISTIC speedgoat_test_SN5659__cal_impl.SineWave3_Bias "" VALUE 0x008E0940 Scalar_FLOAT64_IEEE 0 speedgoat_test_SN5659_R2020b_CM_double -1.7E+308 1.7E+308 /end CHARACTERISTIC
/begin CHARACTERISTIC speedgoat_test_SN5659__cal_impl.SineWave3_Bias_m "" VALUE 0x008EF550 Scalar_FLOAT64_IEEE 0 speedgoat_test_SN5659_R2020b_CM_double -1.7E+308 1.7E+308 /end CHARACTERISTIC
/begin CHARACTERISTIC speedgoat_test_SN5659__cal_impl.SineWave3_Freq "" VALUE 0x008E0948 Scalar_FLOAT64_IEEE 0 speedgoat_test_SN5659_R2020b_CM_double -1.7E+308 1.7E+308 /end CHARACTERISTIC
/begin CHARACTERISTIC speedgoat_test_SN5659__cal_impl.SineWave3_Freq_p "" VALUE 0x008EF558 Scalar_FLOAT64_IEEE 0 speedgoat_test_SN5659_R2020b_CM_double -1.7E+308 1.7E+308 /end CHARACTERISTIC
/begin CHARACTERISTIC speedgoat_test_SN5659__cal_impl.SineWave3_HCos "" VALUE 0x008E0958 Scalar_FLOAT64_IEEE 0 speedgoat_test_SN5659_R2020b_CM_double -1.7E+308 1.7E+308 /end CHARACTERISTIC
/begin CHARACTERISTIC speedgoat_test_SN5659__cal_impl.SineWave3_HCos_e "" VALUE 0x008EF568 Scalar_FLOAT64_IEEE 0 speedgoat_test_SN5659_R2020b_CM_double -1.7E+308 1.7E+308 /end CHARACTERISTIC
/begin CHARACTERISTIC speedgoat_test_SN5659__cal_impl.SineWave3_Hsin "" VALUE 0x008E0950 Scalar_FLOAT64_IEEE 0 speedgoat_test_SN5659_R2020b_CM_double -1.7E+308 1.7E+308 /end CHARACTERISTIC
/begin CHARACTERISTIC speedgoat_test_SN5659__cal_impl.SineWave3_Hsin_g "" VALUE 0x008EF560 Scalar_FLOAT64_IEEE 0 speedgoat_test_SN5659_R2020b_CM_double -1.7E+308 1.7E+308 /end CHARACTERISTIC
/begin CHARACTERISTIC speedgoat_test_SN5659__cal_impl.SineWave3_PCos "" VALUE 0x008E0968 Scalar_FLOAT64_IEEE 0 speedgoat_test_SN5659_R2020b_CM_double -1.7E+308 1.7E+308 /end CHARACTERISTIC
/begin CHARACTERISTIC speedgoat_test_SN5659__cal_impl.SineWave3_PCos_a "" VALUE 0x008EF578 Scalar_FLOAT64_IEEE 0 speedgoat_test_SN5659_R2020b_CM_double -1.7E+308 1.7E+308 /end CHARACTERISTIC
/begin CHARACTERISTIC speedgoat_test_SN5659__cal_impl.SineWave3_PSin "" VALUE 0x008E0960 Scalar_FLOAT64_IEEE 0 speedgoat_test_SN5659_R2020b_CM_double -1.7E+308 1.7E+308 /end CHARACTERISTIC
/begin CHARACTERISTIC speedgoat_test_SN5659__cal_impl.SineWave3_PSin_n "" VALUE 0x008EF570 Scalar_FLOAT64_IEEE 0 speedgoat_test_SN5659_R2020b_CM_double -1.7E+308 1.7E+308 /end CHARACTERISTIC
/begin CHARACTERISTIC speedgoat_test_SN5659__cal_impl.SineWave4_Amp "" VALUE 0x008E0A50 Scalar_FLOAT64_IEEE 0 speedgoat_test_SN5659_R2020b_CM_double -1.7E+308 1.7E+308 /end CHARACTERISTIC
/begin CHARACTERISTIC speedgoat_test_SN5659__cal_impl.SineWave4_Amp_b "" VALUE 0x008EF6B8 Scalar_FLOAT64_IEEE 0 speedgoat_test_SN5659_R2020b_CM_double -1.7E+308 1.7E+308 /end CHARACTERISTIC
/begin CHARACTERISTIC speedgoat_test_SN5659__cal_impl.SineWave4_Bias "" VALUE 0x008E0A58 Scalar_FLOAT64_IEEE 0 speedgoat_test_SN5659_R2020b_CM_double -1.7E+308 1.7E+308 /end CHARACTERISTIC
/begin CHARACTERISTIC speedgoat_test_SN5659__cal_impl.SineWave4_Bias_h "" VALUE 0x008EF6C0 Scalar_FLOAT64_IEEE 0 speedgoat_test_SN5659_R2020b_CM_double -1.7E+308 1.7E+308 /end CHARACTERISTIC
/begin CHARACTERISTIC speedgoat_test_SN5659__cal_impl.SineWave4_Freq "" VALUE 0x008E0A60 Scalar_FLOAT64_IEEE 0 speedgoat_test_SN5659_R2020b_CM_double -1.7E+308 1.7E+308 /end CHARACTERISTIC
/begin CHARACTERISTIC speedgoat_test_SN5659__cal_impl.SineWave4_Freq_e "" VALUE 0x008EF6C8 Scalar_FLOAT64_IEEE 0 speedgoat_test_SN5659_R2020b_CM_double -1.7E+308 1.7E+308 /end CHARACTERISTIC
/begin CHARACTERISTIC speedgoat_test_SN5659__cal_impl.SineWave4_HCos "" VALUE 0x008E0A70 Scalar_FLOAT64_IEEE 0 speedgoat_test_SN5659_R2020b_CM_double -1.7E+308 1.7E+308 /end CHARACTERISTIC
/begin CHARACTERISTIC speedgoat_test_SN5659__cal_impl.SineWave4_HCos_a "" VALUE 0x008EF6D8 Scalar_FLOAT64_IEEE 0 speedgoat_test_SN5659_R2020b_CM_double -1.7E+308 1.7E+308 /end CHARACTERISTIC
/begin CHARACTERISTIC speedgoat_test_SN5659__cal_impl.SineWave4_Hsin "" VALUE 0x008E0A68 Scalar_FLOAT64_IEEE 0 speedgoat_test_SN5659_R2020b_CM_double -1.7E+308 1.7E+308 /end CHARACTERISTIC
/begin CHARACTERISTIC speedgoat_test_SN5659__cal_impl.SineWave4_Hsin_f "" VALUE 0x008EF6D0 Scalar_FLOAT64_IEEE 0 speedgoat_test_SN5659_R2020b_CM_double -1.7E+308 1.7E+308 /end CHARACTERISTIC
/begin CHARACTERISTIC speedgoat_test_SN5659__cal_impl.SineWave4_PCos "" VALUE 0x008E0A80 Scalar_FLOAT64_IEEE 0 speedgoat_test_SN5659_R2020b_CM_double -1.7E+308 1.7E+308 /end CHARACTERISTIC
/begin CHARACTERISTIC speedgoat_test_SN5659__cal_impl.SineWave4_PCos_f "" VALUE 0x008EF6E8 Scalar_FLOAT64_IEEE 0 speedgoat_test_SN5659_R2020b_CM_double -1.7E+308 1.7E+308 /end CHARACTERISTIC
/begin CHARACTERISTIC speedgoat_test_SN5659__cal_impl.SineWave4_PSin "" VALUE 0x008E0A78 Scalar_FLOAT64_IEEE 0 speedgoat_test_SN5659_R2020b_CM_double -1.7E+308 1.7E+308 /end CHARACTERISTIC
/begin CHARACTERISTIC speedgoat_test_SN5659__cal_impl.SineWave4_PSin_l "" VALUE 0x008EF6E0 Scalar_FLOAT64_IEEE 0 speedgoat_test_SN5659_R2020b_CM_double -1.7E+308 1.7E+308 /end CHARACTERISTIC
/begin CHARACTERISTIC speedgoat_test_SN5659__cal_impl.SineWave5_Amp "" VALUE 0x008E0B68 Scalar_FLOAT64_IEEE 0 speedgoat_test_SN5659_R2020b_CM_double -1.7E+308 1.7E+308 /end CHARACTERISTIC
/begin CHARACTERISTIC speedgoat_test_SN5659__cal_impl.SineWave5_Bias "" VALUE 0x008E0B70 Scalar_FLOAT64_IEEE 0 speedgoat_test_SN5659_R2020b_CM_double -1.7E+308 1.7E+308 /end CHARACTERISTIC
/begin CHARACTERISTIC speedgoat_test_SN5659__cal_impl.SineWave5_Freq "" VALUE 0x008E0B78 Scalar_FLOAT64_IEEE 0 speedgoat_test_SN5659_R2020b_CM_double -1.7E+308 1.7E+308 /end CHARACTERISTIC
/begin CHARACTERISTIC speedgoat_test_SN5659__cal_impl.SineWave5_HCos "" VALUE 0x008E0B88 Scalar_FLOAT64_IEEE 0 speedgoat_test_SN5659_R2020b_CM_double -1.7E+308 1.7E+308 /end CHARACTERISTIC
/begin CHARACTERISTIC speedgoat_test_SN5659__cal_impl.SineWave5_Hsin "" VALUE 0x008E0B80 Scalar_FLOAT64_IEEE 0 speedgoat_test_SN5659_R2020b_CM_double -1.7E+308 1.7E+308 /end CHARACTERISTIC
/begin CHARACTERISTIC speedgoat_test_SN5659__cal_impl.SineWave5_PCos "" VALUE 0x008E0B98 Scalar_FLOAT64_IEEE 0 speedgoat_test_SN5659_R2020b_CM_double -1.7E+308 1.7E+308 /end CHARACTERISTIC
/begin CHARACTERISTIC speedgoat_test_SN5659__cal_impl.SineWave5_PSin "" VALUE 0x008E0B90 Scalar_FLOAT64_IEEE 0 speedgoat_test_SN5659_R2020b_CM_double -1.7E+308 1.7E+308 /end CHARACTERISTIC
/begin CHARACTERISTIC speedgoat_test_SN5659__cal_impl.SineWave_Amp "" VALUE 0x008DF758 Scalar_FLOAT64_IEEE 0 speedgoat_test_SN5659_R2020b_CM_double -1.7E+308 1.7E+308 /end CHARACTERISTIC
/begin CHARACTERISTIC speedgoat_test_SN5659__cal_impl.SineWave_Amp_i "" VALUE 0x008E05F0 Scalar_FLOAT64_IEEE 0 speedgoat_test_SN5659_R2020b_CM_double -1.7E+308 1.7E+308 /end CHARACTERISTIC
/begin CHARACTERISTIC speedgoat_test_SN5659__cal_impl.SineWave_Amp_l "" VALUE 0x008E11C0 Scalar_FLOAT64_IEEE 0 speedgoat_test_SN5659_R2020b_CM_double -1.7E+308 1.7E+308 /end CHARACTERISTIC
/begin CHARACTERISTIC speedgoat_test_SN5659__cal_impl.SineWave_Bias "" VALUE 0x008DF760 Scalar_FLOAT64_IEEE 0 speedgoat_test_SN5659_R2020b_CM_double -1.7E+308 1.7E+308 /end CHARACTERISTIC
/begin CHARACTERISTIC speedgoat_test_SN5659__cal_impl.SineWave_Bias_d "" VALUE 0x008E11C8 Scalar_FLOAT64_IEEE 0 speedgoat_test_SN5659_R2020b_CM_double -1.7E+308 1.7E+308 /end CHARACTERISTIC
/begin CHARACTERISTIC speedgoat_test_SN5659__cal_impl.SineWave_Bias_e "" VALUE 0x008E05F8 Scalar_FLOAT64_IEEE 0 speedgoat_test_SN5659_R2020b_CM_double -1.7E+308 1.7E+308 /end CHARACTERISTIC
/begin CHARACTERISTIC speedgoat_test_SN5659__cal_impl.SineWave_Freq "" VALUE 0x008DF768 Scalar_FLOAT64_IEEE 0 speedgoat_test_SN5659_R2020b_CM_double -1.7E+308 1.7E+308 /end CHARACTERISTIC
/begin CHARACTERISTIC speedgoat_test_SN5659__cal_impl.SineWave_Freq_f "" VALUE 0x008E11D0 Scalar_FLOAT64_IEEE 0 speedgoat_test_SN5659_R2020b_CM_double -1.7E+308 1.7E+308 /end CHARACTERISTIC
/begin CHARACTERISTIC speedgoat_test_SN5659__cal_impl.SineWave_Freq_k "" VALUE 0x008E0600 Scalar_FLOAT64_IEEE 0 speedgoat_test_SN5659_R2020b_CM_double -1.7E+308 1.7E+308 /end CHARACTERISTIC
/begin CHARACTERISTIC speedgoat_test_SN5659__cal_impl.SineWave_HCos "" VALUE 0x008E0610 Scalar_FLOAT64_IEEE 0 speedgoat_test_SN5659_R2020b_CM_double -1.7E+308 1.7E+308 /end CHARACTERISTIC
/begin CHARACTERISTIC speedgoat_test_SN5659__cal_impl.SineWave_HCos_b "" VALUE 0x008E11E0 Scalar_FLOAT64_IEEE 0 speedgoat_test_SN5659_R2020b_CM_double -1.7E+308 1.7E+308 /end CHARACTERISTIC
/begin CHARACTERISTIC speedgoat_test_SN5659__cal_impl.SineWave_Hsin "" VALUE 0x008E0608 Scalar_FLOAT64_IEEE 0 speedgoat_test_SN5659_R2020b_CM_double -1.7E+308 1.7E+308 /end CHARACTERISTIC
/begin CHARACTERISTIC speedgoat_test_SN5659__cal_impl.SineWave_Hsin_c "" VALUE 0x008E11D8 Scalar_FLOAT64_IEEE 0 speedgoat_test_SN5659_R2020b_CM_double -1.7E+308 1.7E+308 /end CHARACTERISTIC
/begin CHARACTERISTIC speedgoat_test_SN5659__cal_impl.SineWave_PCos "" VALUE 0x008E0620 Scalar_FLOAT64_IEEE 0 speedgoat_test_SN5659_R2020b_CM_double -1.7E+308 1.7E+308 /end CHARACTERISTIC
/begin CHARACTERISTIC speedgoat_test_SN5659__cal_impl.SineWave_PCos_l "" VALUE 0x008E11F0 Scalar_FLOAT64_IEEE 0 speedgoat_test_SN5659_R2020b_CM_double -1.7E+308 1.7E+308 /end CHARACTERISTIC
/begin CHARACTERISTIC speedgoat_test_SN5659__cal_impl.SineWave_PSin "" VALUE 0x008E0618 Scalar_FLOAT64_IEEE 0 speedgoat_test_SN5659_R2020b_CM_double -1.7E+308 1.7E+308 /end CHARACTERISTIC
/begin CHARACTERISTIC speedgoat_test_SN5659__cal_impl.SineWave_PSin_o "" VALUE 0x008E11E8 Scalar_FLOAT64_IEEE 0 speedgoat_test_SN5659_R2020b_CM_double -1.7E+308 1.7E+308 /end CHARACTERISTIC
/begin CHARACTERISTIC speedgoat_test_SN5659__cal_impl.SineWave_Phase "" VALUE 0x008DF770 Scalar_FLOAT64_IEEE 0 speedgoat_test_SN5659_R2020b_CM_double -1.7E+308 1.7E+308 /end CHARACTERISTIC
/begin CHARACTERISTIC speedgoat_test_SN5659__cal_impl.Write1_P1 "" VALUE 0x008EF498 Scalar_FLOAT64_IEEE 0 speedgoat_test_SN5659_R2020b_CM_double -1.7E+308 1.7E+308 /end CHARACTERISTIC
/begin CHARACTERISTIC speedgoat_test_SN5659__cal_impl.Write1_P2 "" VALUE 0x008EF4B0 Scalar_FLOAT64_IEEE 0 speedgoat_test_SN5659_R2020b_CM_double -1.7E+308 1.7E+308 /end CHARACTERISTIC
/begin CHARACTERISTIC speedgoat_test_SN5659__cal_impl.Write1_P3 "" VALUE 0x008EF4C8 Scalar_FLOAT64_IEEE 0 speedgoat_test_SN5659_R2020b_CM_double -1.7E+308 1.7E+308 /end CHARACTERISTIC
/begin CHARACTERISTIC speedgoat_test_SN5659__cal_impl.Write1_P4 "" VALUE 0x008EF4E0 Scalar_FLOAT64_IEEE 0 speedgoat_test_SN5659_R2020b_CM_double -1.7E+308 1.7E+308 /end CHARACTERISTIC
/begin CHARACTERISTIC speedgoat_test_SN5659__cal_impl.Write1_P5 "" VALUE 0x008EF4F8 Scalar_FLOAT64_IEEE 0 speedgoat_test_SN5659_R2020b_CM_double -1.7E+308 1.7E+308 /end CHARACTERISTIC
/begin CHARACTERISTIC speedgoat_test_SN5659__cal_impl.Write1_P6 "" VALUE 0x008EF510 Scalar_FLOAT64_IEEE 0 speedgoat_test_SN5659_R2020b_CM_double -1.7E+308 1.7E+308 /end CHARACTERISTIC
/begin CHARACTERISTIC speedgoat_test_SN5659__cal_impl.Write1_P7 "" VALUE 0x008EF528 Scalar_FLOAT64_IEEE 0 speedgoat_test_SN5659_R2020b_CM_double -1.7E+308 1.7E+308 /end CHARACTERISTIC
/begin CHARACTERISTIC speedgoat_test_SN5659__cal_impl.Write1_P8 "" VALUE 0x008EF540 Scalar_FLOAT64_IEEE 0 speedgoat_test_SN5659_R2020b_CM_double -1.7E+308 1.7E+308 /end CHARACTERISTIC
/begin CHARACTERISTIC speedgoat_test_SN5659__cal_impl.Write2_P1 "" VALUE 0x008EF608 Scalar_FLOAT64_IEEE 0 speedgoat_test_SN5659_R2020b_CM_double -1.7E+308 1.7E+308 /end CHARACTERISTIC
/begin CHARACTERISTIC speedgoat_test_SN5659__cal_impl.Write2_P2 "" VALUE 0x008EF620 Scalar_FLOAT64_IEEE 0 speedgoat_test_SN5659_R2020b_CM_double -1.7E+308 1.7E+308 /end CHARACTERISTIC
/begin CHARACTERISTIC speedgoat_test_SN5659__cal_impl.Write2_P3 "" VALUE 0x008EF638 Scalar_FLOAT64_IEEE 0 speedgoat_test_SN5659_R2020b_CM_double -1.7E+308 1.7E+308 /end CHARACTERISTIC
/begin CHARACTERISTIC speedgoat_test_SN5659__cal_impl.Write2_P4 "" VALUE 0x008EF650 Scalar_FLOAT64_IEEE 0 speedgoat_test_SN5659_R2020b_CM_double -1.7E+308 1.7E+308 /end CHARACTERISTIC
/begin CHARACTERISTIC speedgoat_test_SN5659__cal_impl.Write2_P5 "" VALUE 0x008EF668 Scalar_FLOAT64_IEEE 0 speedgoat_test_SN5659_R2020b_CM_double -1.7E+308 1.7E+308 /end CHARACTERISTIC
/begin CHARACTERISTIC speedgoat_test_SN5659__cal_impl.Write2_P6 "" VALUE 0x008EF680 Scalar_FLOAT64_IEEE 0 speedgoat_test_SN5659_R2020b_CM_double -1.7E+308 1.7E+308 /end CHARACTERISTIC
/begin CHARACTERISTIC speedgoat_test_SN5659__cal_impl.Write2_P7 "" VALUE 0x008EF698 Scalar_FLOAT64_IEEE 0 speedgoat_test_SN5659_R2020b_CM_double -1.7E+308 1.7E+308 /end CHARACTERISTIC
/begin CHARACTERISTIC speedgoat_test_SN5659__cal_impl.Write2_P8 "" VALUE 0x008EF6B0 Scalar_FLOAT64_IEEE 0 speedgoat_test_SN5659_R2020b_CM_double -1.7E+308 1.7E+308 /end CHARACTERISTIC
/begin CHARACTERISTIC speedgoat_test_SN5659__cal_impl.Write3_P1 "" VALUE 0x008EF778 Scalar_FLOAT64_IEEE 0 speedgoat_test_SN5659_R2020b_CM_double -1.7E+308 1.7E+308 /end CHARACTERISTIC
/begin CHARACTERISTIC speedgoat_test_SN5659__cal_impl.Write3_P2 "" VALUE 0x008EF790 Scalar_FLOAT64_IEEE 0 speedgoat_test_SN5659_R2020b_CM_double -1.7E+308 1.7E+308 /end CHARACTERISTIC
/begin CHARACTERISTIC speedgoat_test_SN5659__cal_impl.Write3_P3 "" VALUE 0x008EF7A8 Scalar_FLOAT64_IEEE 0 speedgoat_test_SN5659_R2020b_CM_double -1.7E+308 1.7E+308 /end CHARACTERISTIC
/begin CHARACTERISTIC speedgoat_test_SN5659__cal_impl.Write3_P4 "" VALUE 0x008EF7C0 Scalar_FLOAT64_IEEE 0 speedgoat_test_SN5659_R2020b_CM_double -1.7E+308 1.7E+308 /end CHARACTERISTIC
/begin CHARACTERISTIC speedgoat_test_SN5659__cal_impl.Write3_P5 "" VALUE 0x008EF7D8 Scalar_FLOAT64_IEEE 0 speedgoat_test_SN5659_R2020b_CM_double -1.7E+308 1.7E+308 /end CHARACTERISTIC
/begin CHARACTERISTIC speedgoat_test_SN5659__cal_impl.Write3_P6 "" VALUE 0x008EF7F0 Scalar_FLOAT64_IEEE 0 speedgoat_test_SN5659_R2020b_CM_double -1.7E+308 1.7E+308 /end CHARACTERISTIC
/begin CHARACTERISTIC speedgoat_test_SN5659__cal_impl.Write3_P7 "" VALUE 0x008EF808 Scalar_FLOAT64_IEEE 0 speedgoat_test_SN5659_R2020b_CM_double -1.7E+308 1.7E+308 /end CHARACTERISTIC
/begin CHARACTERISTIC speedgoat_test_SN5659__cal_impl.Write3_P8 "" VALUE 0x008EF820 Scalar_FLOAT64_IEEE 0 speedgoat_test_SN5659_R2020b_CM_double -1.7E+308 1.7E+308 /end CHARACTERISTIC
/begin CHARACTERISTIC speedgoat_test_SN5659__cal_impl.Write_P1 "" VALUE 0x008DFCE0 Scalar_FLOAT64_IEEE 0 speedgoat_test_SN5659_R2020b_CM_double -1.7E+308 1.7E+308 /end CHARACTERISTIC
/begin CHARACTERISTIC speedgoat_test_SN5659__cal_impl.Write_P1_k "" VALUE 0x008EF328 Scalar_FLOAT64_IEEE 0 speedgoat_test_SN5659_R2020b_CM_double -1.7E+308 1.7E+308 /end CHARACTERISTIC
/begin CHARACTERISTIC speedgoat_test_SN5659__cal_impl.Write_P2 "" VALUE 0x008DFCF8 Scalar_FLOAT64_IEEE 0 speedgoat_test_SN5659_R2020b_CM_double -1.7E+308 1.7E+308 /end CHARACTERISTIC
/begin CHARACTERISTIC speedgoat_test_SN5659__cal_impl.Write_P2_h "" VALUE 0x008EF340 Scalar_FLOAT64_IEEE 0 speedgoat_test_SN5659_R2020b_CM_double -1.7E+308 1.7E+308 /end CHARACTERISTIC
/begin CHARACTERISTIC speedgoat_test_SN5659__cal_impl.Write_P3 "" VALUE 0x008DFD10 Scalar_FLOAT64_IEEE 0 speedgoat_test_SN5659_R2020b_CM_double -1.7E+308 1.7E+308 /end CHARACTERISTIC
/begin CHARACTERISTIC speedgoat_test_SN5659__cal_impl.Write_P3_m "" VALUE 0x008EF358 Scalar_FLOAT64_IEEE 0 speedgoat_test_SN5659_R2020b_CM_double -1.7E+308 1.7E+308 /end CHARACTERISTIC
/begin CHARACTERISTIC speedgoat_test_SN5659__cal_impl.Write_P4 "" VALUE 0x008DFD28 Scalar_FLOAT64_IEEE 0 speedgoat_test_SN5659_R2020b_CM_double -1.7E+308 1.7E+308 /end CHARACTERISTIC
/begin CHARACTERISTIC speedgoat_test_SN5659__cal_impl.Write_P4_g "" VALUE 0x008EF370 Scalar_FLOAT64_IEEE 0 speedgoat_test_SN5659_R2020b_CM_double -1.7E+308 1.7E+308 /end CHARACTERISTIC
/begin CHARACTERISTIC speedgoat_test_SN5659__cal_impl.Write_P5 "" VALUE 0x008EF388 Scalar_FLOAT64_IEEE 0 speedgoat_test_SN5659_R2020b_CM_double -1.7E+308 1.7E+308 /end CHARACTERISTIC
/begin CHARACTERISTIC speedgoat_test_SN5659__cal_impl.Write_P6 "" VALUE 0x008EF3A0 Scalar_FLOAT64_IEEE 0 speedgoat_test_SN5659_R2020b_CM_double -1.7E+308 1.7E+308 /end CHARACTERISTIC
/begin CHARACTERISTIC speedgoat_test_SN5659__cal_impl.Write_P7 "" VALUE 0x008EF3B8 Scalar_FLOAT64_IEEE 0 speedgoat_test_SN5659_R2020b_CM_double -1.7E+308 1.7E+308 /end CHARACTERISTIC
/begin CHARACTERISTIC speedgoat_test_SN5659__cal_impl.Write_P8 "" VALUE 0x008EF3D0 Scalar_FLOAT64_IEEE 0 speedgoat_test_SN5659_R2020b_CM_double -1.7E+308 1.7E+308 /end CHARACTERISTIC
/begin MEASUREMENT speedgoat_test_SN5659_R2020b_B.ASCIIEncode "" UBYTE speedgoat_test_SN5659_R2020b_CM_uint8 0 0 0 255 LAYOUT COLUMN_DIR MATRIX_DIM 64 ECU_ADDRESS 0x0095C4FE /end MEASUREMENT
/begin MEASUREMENT speedgoat_test_SN5659_R2020b_B.ASCIIEncode1 "" UBYTE speedgoat_test_SN5659_R2020b_CM_uint8 0 0 0 255 LAYOUT COLUMN_DIR MATRIX_DIM 64 ECU_ADDRESS 0x0095C53E /end MEASUREMENT
/begin MEASUREMENT speedgoat_test_SN5659_R2020b_B.ASCIIEncode2 "" UBYTE speedgoat_test_SN5659_R2020b_CM_uint8 0 0 0 255 LAYOUT COLUMN_DIR MATRIX_DIM 64 ECU_ADDRESS 0x0095C57E /end MEASUREMENT
/begin MEASUREMENT speedgoat_test_SN5659_R2020b_B.ASCIIEncode3 "" UBYTE speedgoat_test_SN5659_R2020b_CM_uint8 0 0 0 255 LAYOUT COLUMN_DIR MATRIX_DIM 64 ECU_ADDRESS 0x0095C5BE /end MEASUREMENT
/begin MEASUREMENT speedgoat_test_SN5659_R2020b_B.CANRead1_o1 "" UBYTE speedgoat_test_SN5659_R2020b_CM_logical 0 0 0 1 ECU_ADDRESS 0x0095C607 /end MEASUREMENT
/begin MEASUREMENT speedgoat_test_SN5659_R2020b_B.CANRead_o1 "" UBYTE speedgoat_test_SN5659_R2020b_CM_logical 0 0 0 1 ECU_ADDRESS 0x0095C608 /end MEASUREMENT
/begin MEASUREMENT speedgoat_test_SN5659_R2020b_B.CANUnpack "" FLOAT64_IEEE speedgoat_test_SN5659_R2020b_CM_double 0 0 -1.7E+308 1.7E+308 ECU_ADDRESS 0x0095BE20 /end MEASUREMENT
/begin MEASUREMENT speedgoat_test_SN5659_R2020b_B.CANUnpack1 "" FLOAT64_IEEE speedgoat_test_SN5659_R2020b_CM_double 0 0 -1.7E+308 1.7E+308 ECU_ADDRESS 0x0095BE28 /end MEASUREMENT
/begin MEASUREMENT speedgoat_test_SN5659_R2020b_B.CANUnpack1_o "" FLOAT64_IEEE speedgoat_test_SN5659_R2020b_CM_double 0 0 -1.7E+308 1.7E+308 ECU_ADDRESS 0x0095BE40 /end MEASUREMENT
/begin MEASUREMENT speedgoat_test_SN5659_R2020b_B.CANUnpack2 "" FLOAT64_IEEE speedgoat_test_SN5659_R2020b_CM_double 0 0 -1.7E+308 1.7E+308 ECU_ADDRESS 0x0095BE30 /end MEASUREMENT
/begin MEASUREMENT speedgoat_test_SN5659_R2020b_B.CANUnpack2_j "" FLOAT64_IEEE speedgoat_test_SN5659_R2020b_CM_double 0 0 -1.7E+308 1.7E+308 ECU_ADDRESS 0x0095BE48 /end MEASUREMENT
/begin MEASUREMENT speedgoat_test_SN5659_R2020b_B.CANUnpack_c "" FLOAT64_IEEE speedgoat_test_SN5659_R2020b_CM_double 0 0 -1.7E+308 1.7E+308 ECU_ADDRESS 0x0095BE38 /end MEASUREMENT
/begin MEASUREMENT speedgoat_test_SN5659_R2020b_B.FIFOread "" UBYTE speedgoat_test_SN5659_R2020b_CM_uint8 0 0 0 255 LAYOUT COLUMN_DIR MATRIX_DIM 65 ECU_ADDRESS 0x0095C3FA /end MEASUREMENT
/begin MEASUREMENT speedgoat_test_SN5659_R2020b_B.FIFOread1 "" UBYTE speedgoat_test_SN5659_R2020b_CM_uint8 0 0 0 255 LAYOUT COLUMN_DIR MATRIX_DIM 65 ECU_ADDRESS 0x0095C43B /end MEASUREMENT
/begin MEASUREMENT speedgoat_test_SN5659_R2020b_B.FIFOread2 "" UBYTE speedgoat_test_SN5659_R2020b_CM_uint8 0 0 0 255 LAYOUT COLUMN_DIR MATRIX_DIM 65 ECU_ADDRESS 0x0095C47C /end MEASUREMENT
/begin MEASUREMENT speedgoat_test_SN5659_R2020b_B.FIFOread3 "" UBYTE speedgoat_test_SN5659_R2020b_CM_uint8 0 0 0 255 LAYOUT COLUMN_DIR MATRIX_DIM 65 ECU_ADDRESS 0x0095C4BD /end MEASUREMENT
/begin MEASUREMENT speedgoat_test_SN5659_R2020b_B.Gain "" FLOAT64_IEEE speedgoat_test_SN5659_R2020b_CM_double 0 0 -1.7E+308 1.7E+308 ECU_ADDRESS 0x00959A18 /end MEASUREMENT
/begin MEASUREMENT speedgoat_test_SN5659_R2020b_B.Gain1 "" FLOAT64_IEEE speedgoat_test_SN5659_R2020b_CM_double 0 0 -1.7E+308 1.7E+308 ECU_ADDRESS 0x00959A20 /end MEASUREMENT
/begin MEASUREMENT speedgoat_test_SN5659_R2020b_B.Gain2 "" FLOAT64_IEEE speedgoat_test_SN5659_R2020b_CM_double 0 0 -1.7E+308 1.7E+308 ECU_ADDRESS 0x00959A28 /end MEASUREMENT
/begin MEASUREMENT speedgoat_test_SN5659_R2020b_B.Gain3 "" FLOAT64_IEEE speedgoat_test_SN5659_R2020b_CM_double 0 0 -1.7E+308 1.7E+308 ECU_ADDRESS 0x00959A30 /end MEASUREMENT
/begin MEASUREMENT speedgoat_test_SN5659_R2020b_B.IO133_AI_CH1 "" FLOAT64_IEEE speedgoat_test_SN5659_R2020b_CM_double 0 0 -1.7E+308 1.7E+308 ECU_ADDRESS 0x009599F0 /end MEASUREMENT
/begin MEASUREMENT speedgoat_test_SN5659_R2020b_B.IO133_AI_CH2 "" FLOAT64_IEEE speedgoat_test_SN5659_R2020b_CM_double 0 0 -1.7E+308 1.7E+308 ECU_ADDRESS 0x009599F8 /end MEASUREMENT
/begin MEASUREMENT speedgoat_test_SN5659_R2020b_B.IO133_AI_CH3 "" FLOAT64_IEEE speedgoat_test_SN5659_R2020b_CM_double 0 0 -1.7E+308 1.7E+308 ECU_ADDRESS 0x00959A00 /end MEASUREMENT
/begin MEASUREMENT speedgoat_test_SN5659_R2020b_B.IO133_AI_CH4 "" FLOAT64_IEEE speedgoat_test_SN5659_R2020b_CM_double 0 0 -1.7E+308 1.7E+308 ECU_ADDRESS 0x00959A08 /end MEASUREMENT
/begin MEASUREMENT speedgoat_test_SN5659_R2020b_B.IO133_DI_CH8 "" FLOAT64_IEEE speedgoat_test_SN5659_R2020b_CM_double 0 0 -1.7E+308 1.7E+308 ECU_ADDRESS 0x00959A38 /end MEASUREMENT
/begin MEASUREMENT speedgoat_test_SN5659_R2020b_B.IO133_DI_CH9 "" FLOAT64_IEEE speedgoat_test_SN5659_R2020b_CM_double 0 0 -1.7E+308 1.7E+308 ECU_ADDRESS 0x00959A40 /end MEASUREMENT
/begin MEASUREMENT speedgoat_test_SN5659_R2020b_B.IO204_CH1 "" FLOAT64_IEEE speedgoat_test_SN5659_R2020b_CM_double 0 0 -1.7E+308 1.7E+308 ECU_ADDRESS 0x00959A58 /end MEASUREMENT
/begin MEASUREMENT speedgoat_test_SN5659_R2020b_B.IO204_CH11 "" FLOAT64_IEEE speedgoat_test_SN5659_R2020b_CM_double 0 0 -1.7E+308 1.7E+308 ECU_ADDRESS 0x00959AE0 /end MEASUREMENT
/begin MEASUREMENT speedgoat_test_SN5659_R2020b_B.IO204_CH16 "" FLOAT64_IEEE speedgoat_test_SN5659_R2020b_CM_double 0 0 -1.7E+308 1.7E+308 ECU_ADDRESS 0x00959AE8 /end MEASUREMENT
/begin MEASUREMENT speedgoat_test_SN5659_R2020b_B.IO204_CH6 "" FLOAT64_IEEE speedgoat_test_SN5659_R2020b_CM_double 0 0 -1.7E+308 1.7E+308 ECU_ADDRESS 0x00959AD8 /end MEASUREMENT
/begin MEASUREMENT speedgoat_test_SN5659_R2020b_B.IO421_LVDT_POS1 "" FLOAT64_IEEE speedgoat_test_SN5659_R2020b_CM_double 0 0 -1.7E+308 1.7E+308 ECU_ADDRESS 0x00959B48 /end MEASUREMENT
/begin MEASUREMENT speedgoat_test_SN5659_R2020b_B.IO421_LVDT_POS2 "" FLOAT64_IEEE speedgoat_test_SN5659_R2020b_CM_double 0 0 -1.7E+308 1.7E+308 ECU_ADDRESS 0x00959B50 /end MEASUREMENT
/begin MEASUREMENT speedgoat_test_SN5659_R2020b_B.IO503_SerialIN_CH1 "" FLOAT64_IEEE speedgoat_test_SN5659_R2020b_CM_double 0 0 -1.7E+308 1.7E+308 ECU_ADDRESS 0x0095BDD8 /end MEASUREMENT
/begin MEASUREMENT speedgoat_test_SN5659_R2020b_B.IO503_SerialIN_CH2 "" FLOAT64_IEEE speedgoat_test_SN5659_R2020b_CM_double 0 0 -1.7E+308 1.7E+308 ECU_ADDRESS 0x0095BDE0 /end MEASUREMENT
/begin MEASUREMENT speedgoat_test_SN5659_R2020b_B.IO503_SerialIN_CH3 "" FLOAT64_IEEE speedgoat_test_SN5659_R2020b_CM_double 0 0 -1.7E+308 1.7E+308 ECU_ADDRESS 0x0095BDE8 /end MEASUREMENT
/begin MEASUREMENT speedgoat_test_SN5659_R2020b_B.IO503_SerialIN_CH4 "" FLOAT64_IEEE speedgoat_test_SN5659_R2020b_CM_double 0 0 -1.7E+308 1.7E+308 ECU_ADDRESS 0x0095BDF0 /end MEASUREMENT
/begin MEASUREMENT speedgoat_test_SN5659_R2020b_B.PulseGenerator "" FLOAT64_IEEE speedgoat_test_SN5659_R2020b_CM_double 0 0 -1.7E+308 1.7E+308 ECU_ADDRESS 0x00959A48 /end MEASUREMENT
/begin MEASUREMENT speedgoat_test_SN5659_R2020b_B.PulseGenerator1 "" FLOAT64_IEEE speedgoat_test_SN5659_R2020b_CM_double 0 0 -1.7E+308 1.7E+308 ECU_ADDRESS 0x00959A50 /end MEASUREMENT
/begin MEASUREMENT speedgoat_test_SN5659_R2020b_B.PulseGenerator_k "" FLOAT64_IEEE speedgoat_test_SN5659_R2020b_CM_double 0 0 -1.7E+308 1.7E+308 ECU_ADDRESS 0x00959AF0 /end MEASUREMENT
/begin MEASUREMENT speedgoat_test_SN5659_R2020b_B.RXSampleTime "" FLOAT64_IEEE speedgoat_test_SN5659_R2020b_CM_double 0 0 -1.7E+308 1.7E+308 ECU_ADDRESS 0x00959B28 /end MEASUREMENT
/begin MEASUREMENT speedgoat_test_SN5659_R2020b_B.RXSampleTime1 "" FLOAT64_IEEE speedgoat_test_SN5659_R2020b_CM_double 0 0 -1.7E+308 1.7E+308 ECU_ADDRESS 0x00959B30 /end MEASUREMENT
/begin MEASUREMENT speedgoat_test_SN5659_R2020b_B.Read "" ULONG speedgoat_test_SN5659_R2020b_CM_uint32 0 0 0 2147483646 LAYOUT COLUMN_DIR MATRIX_DIM 65 ECU_ADDRESS 0x0095BF90 /end MEASUREMENT
/begin MEASUREMENT speedgoat_test_SN5659_R2020b_B.Read1 "" ULONG speedgoat_test_SN5659_R2020b_CM_uint32 0 0 0 2147483646 LAYOUT COLUMN_DIR MATRIX_DIM 65 ECU_ADDRESS 0x0095C094 /end MEASUREMENT
/begin MEASUREMENT speedgoat_test_SN5659_R2020b_B.Read2 "" ULONG speedgoat_test_SN5659_R2020b_CM_uint32 0 0 0 2147483646 LAYOUT COLUMN_DIR MATRIX_DIM 65 ECU_ADDRESS 0x0095C198 /end MEASUREMENT
/begin MEASUREMENT speedgoat_test_SN5659_R2020b_B.Read3 "" ULONG speedgoat_test_SN5659_R2020b_CM_uint32 0 0 0 2147483646 LAYOUT COLUMN_DIR MATRIX_DIM 65 ECU_ADDRESS 0x0095C29C /end MEASUREMENT
/begin MEASUREMENT speedgoat_test_SN5659_R2020b_B.Read_o11 "" FLOAT64_IEEE speedgoat_test_SN5659_R2020b_CM_double 0 0 -1.7E+308 1.7E+308 ECU_ADDRESS 0x00959AA8 /end MEASUREMENT
/begin MEASUREMENT speedgoat_test_SN5659_R2020b_B.Read_o16 "" FLOAT64_IEEE speedgoat_test_SN5659_R2020b_CM_double 0 0 -1.7E+308 1.7E+308 ECU_ADDRESS 0x00959AD0 /end MEASUREMENT
/begin MEASUREMENT speedgoat_test_SN5659_R2020b_B.Read_o6 "" FLOAT64_IEEE speedgoat_test_SN5659_R2020b_CM_double 0 0 -1.7E+308 1.7E+308 ECU_ADDRESS 0x00959A80 /end MEASUREMENT
/begin MEASUREMENT speedgoat_test_SN5659_R2020b_B.SineWave "" FLOAT64_IEEE speedgoat_test_SN5659_R2020b_CM_double 0 0 -1.7E+308 1.7E+308 ECU_ADDRESS 0x00959A10 /end MEASUREMENT
/begin MEASUREMENT speedgoat_test_SN5659_R2020b_B.SineWave1 "" FLOAT64_IEEE speedgoat_test_SN5659_R2020b_CM_double 0 0 -1.7E+308 1.7E+308 ECU_ADDRESS 0x00959B00 /end MEASUREMENT
/begin MEASUREMENT speedgoat_test_SN5659_R2020b_B.SineWave1_c "" FLOAT64_IEEE speedgoat_test_SN5659_R2020b_CM_double 0 0 -1.7E+308 1.7E+308 ECU_ADDRESS 0x00959B40 /end MEASUREMENT
/begin MEASUREMENT speedgoat_test_SN5659_R2020b_B.SineWave1_k "" FLOAT64_IEEE speedgoat_test_SN5659_R2020b_CM_double 0 0 -1.7E+308 1.7E+308 ECU_ADDRESS 0x0095BDF8 /end MEASUREMENT
/begin MEASUREMENT speedgoat_test_SN5659_R2020b_B.SineWave2 "" FLOAT64_IEEE speedgoat_test_SN5659_R2020b_CM_double 0 0 -1.7E+308 1.7E+308 ECU_ADDRESS 0x00959B08 /end MEASUREMENT
/begin MEASUREMENT speedgoat_test_SN5659_R2020b_B.SineWave2_m "" FLOAT64_IEEE speedgoat_test_SN5659_R2020b_CM_double 0 0 -1.7E+308 1.7E+308 ECU_ADDRESS 0x0095BE00 /end MEASUREMENT
/begin MEASUREMENT speedgoat_test_SN5659_R2020b_B.SineWave3 "" FLOAT64_IEEE speedgoat_test_SN5659_R2020b_CM_double 0 0 -1.7E+308 1.7E+308 ECU_ADDRESS 0x00959B10 /end MEASUREMENT
/begin MEASUREMENT speedgoat_test_SN5659_R2020b_B.SineWave3_k "" FLOAT64_IEEE speedgoat_test_SN5659_R2020b_CM_double 0 0 -1.7E+308 1.7E+308 ECU_ADDRESS 0x0095BE08 /end MEASUREMENT
/begin MEASUREMENT speedgoat_test_SN5659_R2020b_B.SineWave4 "" FLOAT64_IEEE speedgoat_test_SN5659_R2020b_CM_double 0 0 -1.7E+308 1.7E+308 ECU_ADDRESS 0x00959B18 /end MEASUREMENT
/begin MEASUREMENT speedgoat_test_SN5659_R2020b_B.SineWave4_j "" FLOAT64_IEEE speedgoat_test_SN5659_R2020b_CM_double 0 0 -1.7E+308 1.7E+308 ECU_ADDRESS 0x0095BE10 /end MEASUREMENT
/begin MEASUREMENT speedgoat_test_SN5659_R2020b_B.SineWave5 "" FLOAT64_IEEE speedgoat_test_SN5659_R2020b_CM_double 0 0 -1.7E+308 1.7E+308 ECU_ADDRESS 0x00959B20 /end MEASUREMENT
/begin MEASUREMENT speedgoat_test_SN5659_R2020b_B.SineWave_e "" FLOAT64_IEEE speedgoat_test_SN5659_R2020b_CM_double 0 0 -1.7E+308 1.7E+308 ECU_ADDRESS 0x00959AF8 /end MEASUREMENT
/begin MEASUREMENT speedgoat_test_SN5659_R2020b_B.SineWave_h "" FLOAT64_IEEE speedgoat_test_SN5659_R2020b_CM_double 0 0 -1.7E+308 1.7E+308 ECU_ADDRESS 0x00959B38 /end MEASUREMENT
/begin MEASUREMENT speedgoat_test_SN5659_R2020b_DW.CANPack1_ModeSignalID "" SLONG speedgoat_test_SN5659_R2020b_CM_int_T 0 0 -2147483648 2147483647 ECU_ADDRESS 0x00959530 /end MEASUREMENT
/begin MEASUREMENT speedgoat_test_SN5659_R2020b_DW.CANPack2_ModeSignalID "" SLONG speedgoat_test_SN5659_R2020b_CM_int_T 0 0 -2147483648 2147483647 ECU_ADDRESS 0x00959538 /end MEASUREMENT
/begin MEASUREMENT speedgoat_test_SN5659_R2020b_DW.CANPack3_ModeSignalID "" SLONG speedgoat_test_SN5659_R2020b_CM_int_T 0 0 -2147483648 2147483647 ECU_ADDRESS 0x00959540 /end MEASUREMENT
/begin MEASUREMENT speedgoat_test_SN5659_R2020b_DW.CANPack4_ModeSignalID "" SLONG speedgoat_test_SN5659_R2020b_CM_int_T 0 0 -2147483648 2147483647 ECU_ADDRESS 0x00959548 /end MEASUREMENT
/begin MEASUREMENT speedgoat_test_SN5659_R2020b_DW.CANPack5_ModeSignalID "" SLONG speedgoat_test_SN5659_R2020b_CM_int_T 0 0 -2147483648 2147483647 ECU_ADDRESS 0x00959550 /end MEASUREMENT
/begin MEASUREMENT speedgoat_test_SN5659_R2020b_DW.CANPack_ModeSignalID "" SLONG speedgoat_test_SN5659_R2020b_CM_int_T 0 0 -2147483648 2147483647 ECU_ADDRESS 0x00959528 /end MEASUREMENT
/begin MEASUREMENT speedgoat_test_SN5659_R2020b_DW.CANUnpack1_ModeSignalID "" SLONG speedgoat_test_SN5659_R2020b_CM_int_T 0 0 -2147483648 2147483647 ECU_ADDRESS 0x009598A4 /end MEASUREMENT
/begin MEASUREMENT speedgoat_test_SN5659_R2020b_DW.CANUnpack1_ModeSignalID_i "" SLONG speedgoat_test_SN5659_R2020b_CM_int_T 0 0 -2147483648 2147483647 ECU_ADDRESS 0x009598C0 /end MEASUREMENT
/begin MEASUREMENT speedgoat_test_SN5659_R2020b_DW.CANUnpack1_StatusPortID "" SLONG speedgoat_test_SN5659_R2020b_CM_int_T 0 0 -2147483648 2147483647 ECU_ADDRESS 0x009598A8 /end MEASUREMENT
/begin MEASUREMENT speedgoat_test_SN5659_R2020b_DW.CANUnpack1_StatusPortID_o "" SLONG speedgoat_test_SN5659_R2020b_CM_int_T 0 0 -2147483648 2147483647 ECU_ADDRESS 0x009598C4 /end MEASUREMENT
/begin MEASUREMENT speedgoat_test_SN5659_R2020b_DW.CANUnpack2_ModeSignalID "" SLONG speedgoat_test_SN5659_R2020b_CM_int_T 0 0 -2147483648 2147483647 ECU_ADDRESS 0x009598AC /end MEASUREMENT
/begin MEASUREMENT speedgoat_test_SN5659_R2020b_DW.CANUnpack2_ModeSignalID_g "" SLONG speedgoat_test_SN5659_R2020b_CM_int_T 0 0 -2147483648 2147483647 ECU_ADDRESS 0x009598C8 /end MEASUREMENT
/begin MEASUREMENT speedgoat_test_SN5659_R2020b_DW.CANUnpack2_StatusPortID "" SLONG speedgoat_test_SN5659_R2020b_CM_int_T 0 0 -2147483648 2147483647 ECU_ADDRESS 0x009598B0 /end MEASUREMENT
/begin MEASUREMENT speedgoat_test_SN5659_R2020b_DW.CANUnpack2_StatusPortID_m "" SLONG speedgoat_test_SN5659_R2020b_CM_int_T 0 0 -2147483648 2147483647 ECU_ADDRESS 0x009598CC /end MEASUREMENT
/begin MEASUREMENT speedgoat_test_SN5659_R2020b_DW.CANUnpack_ModeSignalID "" SLONG speedgoat_test_SN5659_R2020b_CM_int_T 0 0 -2147483648 2147483647 ECU_ADDRESS 0x0095989C /end MEASUREMENT
/begin MEASUREMENT speedgoat_test_SN5659_R2020b_DW.CANUnpack_ModeSignalID_b "" SLONG speedgoat_test_SN5659_R2020b_CM_int_T 0 0 -2147483648 2147483647 ECU_ADDRESS 0x009598B8 /end MEASUREMENT
/begin MEASUREMENT speedgoat_test_SN5659_R2020b_DW.CANUnpack_StatusPortID "" SLONG speedgoat_test_SN5659_R2020b_CM_int_T 0 0 -2147483648 2147483647 ECU_ADDRESS 0x009598A0 /end MEASUREMENT
/begin MEASUREMENT speedgoat_test_SN5659_R2020b_DW.CANUnpack_StatusPortID_g "" SLONG speedgoat_test_SN5659_R2020b_CM_int_T 0 0 -2147483648 2147483647 ECU_ADDRESS 0x009598BC /end MEASUREMENT
/begin MEASUREMENT speedgoat_test_SN5659_R2020b_DW.clockTickCounter "" SLONG speedgoat_test_SN5659_R2020b_CM_int32 0 0 -2147483648 2147483647 ECU_ADDRESS 0x00959450 /end MEASUREMENT
/begin MEASUREMENT speedgoat_test_SN5659_R2020b_DW.clockTickCounter_b "" SLONG speedgoat_test_SN5659_R2020b_CM_int32 0 0 -2147483648 2147483647 ECU_ADDRESS 0x00959458 /end MEASUREMENT
/begin MEASUREMENT speedgoat_test_SN5659_R2020b_DW.clockTickCounter_c "" SLONG speedgoat_test_SN5659_R2020b_CM_int32 0 0 -2147483648 2147483647 ECU_ADDRESS 0x00959454 /end MEASUREMENT
/begin MEASUREMENT speedgoat_test_SN5659_R2020b_DW.lastCos "" FLOAT64_IEEE speedgoat_test_SN5659_R2020b_CM_double 0 0 -1.7E+308 1.7E+308 ECU_ADDRESS 0x00958828 /end MEASUREMENT
/begin MEASUREMENT speedgoat_test_SN5659_R2020b_DW.lastCos_ab "" FLOAT64_IEEE speedgoat_test_SN5659_R2020b_CM_double 0 0 -1.7E+308 1.7E+308 ECU_ADDRESS 0x00958A58 /end MEASUREMENT
/begin MEASUREMENT speedgoat_test_SN5659_R2020b_DW.lastCos_aj "" FLOAT64_IEEE speedgoat_test_SN5659_R2020b_CM_double 0 0 -1.7E+308 1.7E+308 ECU_ADDRESS 0x00958A28 /end MEASUREMENT
/begin MEASUREMENT speedgoat_test_SN5659_R2020b_DW.lastCos_b "" FLOAT64_IEEE speedgoat_test_SN5659_R2020b_CM_double 0 0 -1.7E+308 1.7E+308 ECU_ADDRESS 0x00958858 /end MEASUREMENT
/begin MEASUREMENT speedgoat_test_SN5659_R2020b_DW.lastCos_bs "" FLOAT64_IEEE speedgoat_test_SN5659_R2020b_CM_double 0 0 -1.7E+308 1.7E+308 ECU_ADDRESS 0x00958A48 /end MEASUREMENT
/begin MEASUREMENT speedgoat_test_SN5659_R2020b_DW.lastCos_c "" FLOAT64_IEEE speedgoat_test_SN5659_R2020b_CM_double 0 0 -1.7E+308 1.7E+308 ECU_ADDRESS 0x00958878 /end MEASUREMENT
/begin MEASUREMENT speedgoat_test_SN5659_R2020b_DW.lastCos_g "" FLOAT64_IEEE speedgoat_test_SN5659_R2020b_CM_double 0 0 -1.7E+308 1.7E+308 ECU_ADDRESS 0x00958838 /end MEASUREMENT
/begin MEASUREMENT speedgoat_test_SN5659_R2020b_DW.lastCos_i "" FLOAT64_IEEE speedgoat_test_SN5659_R2020b_CM_double 0 0 -1.7E+308 1.7E+308 ECU_ADDRESS 0x00958848 /end MEASUREMENT
/begin MEASUREMENT speedgoat_test_SN5659_R2020b_DW.lastCos_i1 "" FLOAT64_IEEE speedgoat_test_SN5659_R2020b_CM_double 0 0 -1.7E+308 1.7E+308 ECU_ADDRESS 0x00958888 /end MEASUREMENT
/begin MEASUREMENT speedgoat_test_SN5659_R2020b_DW.lastCos_j "" FLOAT64_IEEE speedgoat_test_SN5659_R2020b_CM_double 0 0 -1.7E+308 1.7E+308 ECU_ADDRESS 0x00958868 /end MEASUREMENT
/begin MEASUREMENT speedgoat_test_SN5659_R2020b_DW.lastCos_o "" FLOAT64_IEEE speedgoat_test_SN5659_R2020b_CM_double 0 0 -1.7E+308 1.7E+308 ECU_ADDRESS 0x00958898 /end MEASUREMENT
/begin MEASUREMENT speedgoat_test_SN5659_R2020b_DW.lastCos_oj "" FLOAT64_IEEE speedgoat_test_SN5659_R2020b_CM_double 0 0 -1.7E+308 1.7E+308 ECU_ADDRESS 0x00958A38 /end MEASUREMENT
/begin MEASUREMENT speedgoat_test_SN5659_R2020b_DW.lastSin "" FLOAT64_IEEE speedgoat_test_SN5659_R2020b_CM_double 0 0 -1.7E+308 1.7E+308 ECU_ADDRESS 0x00958820 /end MEASUREMENT
/begin MEASUREMENT speedgoat_test_SN5659_R2020b_DW.lastSin_c "" FLOAT64_IEEE speedgoat_test_SN5659_R2020b_CM_double 0 0 -1.7E+308 1.7E+308 ECU_ADDRESS 0x00958830 /end MEASUREMENT
/begin MEASUREMENT speedgoat_test_SN5659_R2020b_DW.lastSin_cd "" FLOAT64_IEEE speedgoat_test_SN5659_R2020b_CM_double 0 0 -1.7E+308 1.7E+308 ECU_ADDRESS 0x00958870 /end MEASUREMENT
/begin MEASUREMENT speedgoat_test_SN5659_R2020b_DW.lastSin_ck "" FLOAT64_IEEE speedgoat_test_SN5659_R2020b_CM_double 0 0 -1.7E+308 1.7E+308 ECU_ADDRESS 0x00958A50 /end MEASUREMENT
/begin MEASUREMENT speedgoat_test_SN5659_R2020b_DW.lastSin_d "" FLOAT64_IEEE speedgoat_test_SN5659_R2020b_CM_double 0 0 -1.7E+308 1.7E+308 ECU_ADDRESS 0x00958850 /end MEASUREMENT
/begin MEASUREMENT speedgoat_test_SN5659_R2020b_DW.lastSin_d2 "" FLOAT64_IEEE speedgoat_test_SN5659_R2020b_CM_double 0 0 -1.7E+308 1.7E+308 ECU_ADDRESS 0x00958890 /end MEASUREMENT
/begin MEASUREMENT speedgoat_test_SN5659_R2020b_DW.lastSin_ew "" FLOAT64_IEEE speedgoat_test_SN5659_R2020b_CM_double 0 0 -1.7E+308 1.7E+308 ECU_ADDRESS 0x00958A30 /end MEASUREMENT
/begin MEASUREMENT speedgoat_test_SN5659_R2020b_DW.lastSin_h "" FLOAT64_IEEE speedgoat_test_SN5659_R2020b_CM_double 0 0 -1.7E+308 1.7E+308 ECU_ADDRESS 0x00958860 /end MEASUREMENT
/begin MEASUREMENT speedgoat_test_SN5659_R2020b_DW.lastSin_h5 "" FLOAT64_IEEE speedgoat_test_SN5659_R2020b_CM_double 0 0 -1.7E+308 1.7E+308 ECU_ADDRESS 0x00958A20 /end MEASUREMENT
/begin MEASUREMENT speedgoat_test_SN5659_R2020b_DW.lastSin_i "" FLOAT64_IEEE speedgoat_test_SN5659_R2020b_CM_double 0 0 -1.7E+308 1.7E+308 ECU_ADDRESS 0x00958840 /end MEASUREMENT
/begin MEASUREMENT speedgoat_test_SN5659_R2020b_DW.lastSin_ib "" FLOAT64_IEEE speedgoat_test_SN5659_R2020b_CM_double 0 0 -1.7E+308 1.7E+308 ECU_ADDRESS 0x00958880 /end MEASUREMENT
/begin MEASUREMENT speedgoat_test_SN5659_R2020b_DW.lastSin_ln "" FLOAT64_IEEE speedgoat_test_SN5659_R2020b_CM_double 0 0 -1.7E+308 1.7E+308 ECU_ADDRESS 0x00958A40 /end MEASUREMENT
/begin MEASUREMENT speedgoat_test_SN5659_R2020b_DW.systemEnable "" SLONG speedgoat_test_SN5659_R2020b_CM_int32 0 0 -2147483648 2147483647 ECU_ADDRESS 0x0095945C /end MEASUREMENT
/begin MEASUREMENT speedgoat_test_SN5659_R2020b_DW.systemEnable_av "" SLONG speedgoat_test_SN5659_R2020b_CM_int32 0 0 -2147483648 2147483647 ECU_ADDRESS 0x009594C4 /end MEASUREMENT
/begin MEASUREMENT speedgoat_test_SN5659_R2020b_DW.systemEnable_b "" SLONG speedgoat_test_SN5659_R2020b_CM_int32 0 0 -2147483648 2147483647 ECU_ADDRESS 0x0095946C /end MEASUREMENT
/begin MEASUREMENT speedgoat_test_SN5659_R2020b_DW.systemEnable_bc "" SLONG speedgoat_test_SN5659_R2020b_CM_int32 0 0 -2147483648 2147483647 ECU_ADDRESS 0x00959474 /end MEASUREMENT
/begin MEASUREMENT speedgoat_test_SN5659_R2020b_DW.systemEnable_gp "" SLONG speedgoat_test_SN5659_R2020b_CM_int32 0 0 -2147483648 2147483647 ECU_ADDRESS 0x009594C8 /end MEASUREMENT
/begin MEASUREMENT speedgoat_test_SN5659_R2020b_DW.systemEnable_h "" SLONG speedgoat_test_SN5659_R2020b_CM_int32 0 0 -2147483648 2147483647 ECU_ADDRESS 0x00959468 /end MEASUREMENT
/begin MEASUREMENT speedgoat_test_SN5659_R2020b_DW.systemEnable_i "" SLONG speedgoat_test_SN5659_R2020b_CM_int32 0 0 -2147483648 2147483647 ECU_ADDRESS 0x00959464 /end MEASUREMENT
/begin MEASUREMENT speedgoat_test_SN5659_R2020b_DW.systemEnable_k "" SLONG speedgoat_test_SN5659_R2020b_CM_int32 0 0 -2147483648 2147483647 ECU_ADDRESS 0x009594BC /end MEASUREMENT
/begin MEASUREMENT speedgoat_test_SN5659_R2020b_DW.systemEnable_o "" SLONG speedgoat_test_SN5659_R2020b_CM_int32 0 0 -2147483648 2147483647 ECU_ADDRESS 0x00959478 /end MEASUREMENT
/begin MEASUREMENT speedgoat_test_SN5659_R2020b_DW.systemEnable_p "" SLONG speedgoat_test_SN5659_R2020b_CM_int32 0 0 -2147483648 2147483647 ECU_ADDRESS 0x00959460 /end MEASUREMENT
/begin MEASUREMENT speedgoat_test_SN5659_R2020b_DW.systemEnable_p2 "" SLONG speedgoat_test_SN5659_R2020b_CM_int32 0 0 -2147483648 2147483647 ECU_ADDRESS 0x009594C0 /end MEASUREMENT
/begin MEASUREMENT speedgoat_test_SN5659_R2020b_DW.systemEnable_py "" SLONG speedgoat_test_SN5659_R2020b_CM_int32 0 0 -2147483648 2147483647 ECU_ADDRESS 0x00959470 /end MEASUREMENT
/begin COMPU_METHOD speedgoat_test_SN5659_R2020b_CM_double "" IDENTICAL "%15.10" "" /end COMPU_METHOD
/begin COMPU_METHOD speedgoat_test_SN5659_R2020b_CM_int32 "" IDENTICAL "%10.0" "" /end COMPU_METHOD
/begin COMPU_METHOD speedgoat_test_SN5659_R2020b_CM_int_T "" IDENTICAL "customformat" "" /end COMPU_METHOD
/begin COMPU_METHOD speedgoat_test_SN5659_R2020b_CM_logical "" IDENTICAL "%1.0" "" /end COMPU_METHOD
/begin COMPU_METHOD speedgoat_test_SN5659_R2020b_CM_uint32 "" IDENTICAL "%10.0" "" /end COMPU_METHOD
/begin COMPU_METHOD speedgoat_test_SN5659_R2020b_CM_uint8 "" IDENTICAL "%3.0" "" /end COMPU_METHOD
/begin RECORD_LAYOUT Scalar_FLOAT64_IEEE FNC_VALUES 1 FLOAT64_IEEE COLUMN_DIR DIRECT /end RECORD_LAYOUT
/begin GROUP speedgoat_test_SN5659_R2020b "speedgoat_test_SN5659_R2020b" ROOT
 /begin SUB_GROUP speedgoat_test_SN5659_R2020b_IO107__1_2_ speedgoat_test_SN5659_R2020b_IO133 speedgoat_test_SN5659_R2020b_IO204 speedgoat_test_SN5659_R2020b_IO421_1 speedgoat_test_SN5659_R2020b_IO503 speedgoat_test_SN5659_R2020b_IO612 speedgoat_test_SN5659_R2020b_IO682 speedgoat_test_SN5659_R2020b_IO941_SPDT_64 /end SUB_GROUP
/end GROUP
/begin GROUP speedgoat_test_SN5659_R2020b_IO107__1_2_ "speedgoat_test_SN5659_R2020b/IO107 (1-2)"
 /begin REF_CHARACTERISTIC speedgoat_test_SN5659__cal_impl.Analogoutput1_P1 speedgoat_test_SN5659__cal_impl.Analogoutput1_P2 speedgoat_test_SN5659__cal_impl.Analogoutput1_P3 speedgoat_test_SN5659__cal_impl.Analogoutput1_P4 speedgoat_test_SN5659__cal_impl.Analogoutput1_P5 speedgoat_test_SN5659__cal_impl.Analogoutput1_P6 speedgoat_test_SN5659__cal_impl.Analogoutput1_P7 speedgoat_test_SN5659__cal_impl.Analogoutput_P1 speedgoat_test_SN5659__cal_impl.Analogoutput_P2 speedgoat_test_SN5659__cal_impl.Analogoutput_P3 speedgoat_test_SN5659__cal_impl.Analogoutput_P4 speedgoat_test_SN5659__cal_impl.Analogoutput_P5 speedgoat_test_SN5659__cal_impl.Analogoutput_P6 speedgoat_test_SN5659__cal_impl.Analogoutput_P7 speedgoat_test_SN5659__cal_impl.Setup1_P1 speedgoat_test_SN5659__cal_impl.Setup1_P10 speedgoat_test_SN5659__cal_impl.Setup1_P11 speedgoat_test_SN5659__cal_impl.Setup1_P2 speedgoat_test_SN5659__cal_impl.Setup1_P3 speedgoat_test_SN5659__cal_impl.Setup1_P4 speedgoat_test_SN5659__cal_impl.Setup1_P5 speedgoat_test_SN5659__cal_impl.Setup1_P6 speedgoat_test_SN5659__cal_impl.Setup1_P7 speedgoat_test_SN5659__cal_impl.Setup1_P8 speedgoat_test_SN5659__cal_impl.Setup1_P9 speedgoat_test_SN5659__cal_impl.Setup_P10_a speedgoat_test_SN5659__cal_impl.Setup_P11_e speedgoat_test_SN5659__cal_impl.Setup_P1_c speedgoat_test_SN5659__cal_impl.Setup_P2_j speedgoat_test_SN5659__cal_impl.Setup_P3_p speedgoat_test_SN5659__cal_impl.Setup_P4_hb speedgoat_test_SN5659__cal_impl.Setup_P5_k speedgoat_test_SN5659__cal_impl.Setup_P6_b speedgoat_test_SN5659__cal_impl.Setup_P7_c speedgoat_test_SN5659__cal_impl.Setup_P8_g speedgoat_test_SN5659__cal_impl.Setup_P9_c speedgoat_test_SN5659__cal_impl.SineWave1_Amp_d speedgoat_test_SN5659__cal_impl.SineWave1_Bias_d speedgoat_test_SN5659__cal_impl.SineWave1_Freq_c speedgoat_test_SN5659__cal_impl.SineWave1_HCos_j speedgoat_test_SN5659__cal_impl.SineWave1_Hsin_m speedgoat_test_SN5659__cal_impl.SineWave1_PCos_o speedgoat_test_SN5659__cal_impl.SineWave1_PSin_n speedgoat_test_SN5659__cal_impl.SineWave_Amp_l speedgoat_test_SN5659__cal_impl.SineWave_Bias_d speedgoat_test_SN5659__cal_impl.SineWave_Freq_f speedgoat_test_SN5659__cal_impl.SineWave_HCos_b speedgoat_test_SN5659__cal_impl.SineWave_Hsin_c speedgoat_test_SN5659__cal_impl.SineWave_PCos_l speedgoat_test_SN5659__cal_impl.SineWave_PSin_o /end REF_CHARACTERISTIC
 /begin REF_MEASUREMENT speedgoat_test_SN5659_R2020b_B.SineWave1_c speedgoat_test_SN5659_R2020b_B.SineWave_h speedgoat_test_SN5659_R2020b_DW.Analogoutput1_PWORK speedgoat_test_SN5659_R2020b_DW.Analogoutput_PWORK speedgoat_test_SN5659_R2020b_DW.Setup1_PWORK speedgoat_test_SN5659_R2020b_DW.Setup_PWORK_d speedgoat_test_SN5659_R2020b_DW.lastCos_i1 speedgoat_test_SN5659_R2020b_DW.lastCos_o speedgoat_test_SN5659_R2020b_DW.lastSin_d2 speedgoat_test_SN5659_R2020b_DW.lastSin_ib speedgoat_test_SN5659_R2020b_DW.systemEnable_bc speedgoat_test_SN5659_R2020b_DW.systemEnable_o /end REF_MEASUREMENT
/end GROUP
/begin GROUP speedgoat_test_SN5659_R2020b_IO133 "speedgoat_test_SN5659_R2020b/IO133"
 /begin REF_CHARACTERISTIC speedgoat_test_SN5659__cal_impl.Analoginputv2_P1 speedgoat_test_SN5659__cal_impl.Analoginputv2_P10 speedgoat_test_SN5659__cal_impl.Analoginputv2_P11 speedgoat_test_SN5659__cal_impl.Analoginputv2_P2 speedgoat_test_SN5659__cal_impl.Analoginputv2_P3 speedgoat_test_SN5659__cal_impl.Analoginputv2_P4 speedgoat_test_SN5659__cal_impl.Analoginputv2_P5 speedgoat_test_SN5659__cal_impl.Analoginputv2_P6 speedgoat_test_SN5659__cal_impl.Analoginputv2_P7 speedgoat_test_SN5659__cal_impl.Analoginputv2_P8 speedgoat_test_SN5659__cal_impl.Analoginputv2_P9 speedgoat_test_SN5659__cal_impl.Analogoutputv2_P1 speedgoat_test_SN5659__cal_impl.Analogoutputv2_P10 speedgoat_test_SN5659__cal_impl.Analogoutputv2_P11 speedgoat_test_SN5659__cal_impl.Analogoutputv2_P12 speedgoat_test_SN5659__cal_impl.Analogoutputv2_P13 speedgoat_test_SN5659__cal_impl.Analogoutputv2_P2 speedgoat_test_SN5659__cal_impl.Analogoutputv2_P3 speedgoat_test_SN5659__cal_impl.Analogoutputv2_P4 speedgoat_test_SN5659__cal_impl.Analogoutputv2_P5 speedgoat_test_SN5659__cal_impl.Analogoutputv2_P6 speedgoat_test_SN5659__cal_impl.Analogoutputv2_P7 speedgoat_test_SN5659__cal_impl.Analogoutputv2_P8 speedgoat_test_SN5659__cal_impl.Analogoutputv2_P9 speedgoat_test_SN5659__cal_impl.Digitalinputv2_P1 speedgoat_test_SN5659__cal_impl.Digitalinputv2_P2 speedgoat_test_SN5659__cal_impl.Digitalinputv2_P3 speedgoat_test_SN5659__cal_impl.Digitalinputv2_P4 speedgoat_test_SN5659__cal_impl.Digitalinputv2_P5 speedgoat_test_SN5659__cal_impl.Digitaloutputv2_P1 speedgoat_test_SN5659__cal_impl.Digitaloutputv2_P2 speedgoat_test_SN5659__cal_impl.Digitaloutputv2_P3 speedgoat_test_SN5659__cal_impl.Digitaloutputv2_P4 speedgoat_test_SN5659__cal_impl.Digitaloutputv2_P5 speedgoat_test_SN5659__cal_impl.Digitaloutputv2_P6 speedgoat_test_SN5659__cal_impl.Digitaloutputv2_P7 speedgoat_test_SN5659__cal_impl.Gain1_Gain speedgoat_test_SN5659__cal_impl.Gain2_Gain speedgoat_test_SN5659__cal_impl.Gain3_Gain speedgoat_test_SN5659__cal_impl.Gain_Gain speedgoat_test_SN5659__cal_impl.PulseGenerator1_Amp speedgoat_test_SN5659__cal_impl.PulseGenerator1_Duty speedgoat_test_SN5659__cal_impl.PulseGenerator1_Period speedgoat_test_SN5659__cal_impl.PulseGenerator1_PhaseDelay speedgoat_test_SN5659__cal_impl.PulseGenerator_Amp speedgoat_test_SN5659__cal_impl.PulseGenerator_Duty speedgoat_test_SN5659__cal_impl.PulseGenerator_Period speedgoat_test_SN5659__cal_impl.PulseGenerator_PhaseDelay speedgoat_test_SN5659__cal_impl.Setupv2_P1 speedgoat_test_SN5659__cal_impl.Setupv2_P10 speedgoat_test_SN5659__cal_impl.Setupv2_P11 speedgoat_test_SN5659__cal_impl.Setupv2_P12 speedgoat_test_SN5659__cal_impl.Setupv2_P13 speedgoat_test_SN5659__cal_impl.Setupv2_P14 speedgoat_test_SN5659__cal_impl.Setupv2_P15 speedgoat_test_SN5659__cal_impl.Setupv2_P16 speedgoat_test_SN5659__cal_impl.Setupv2_P17 speedgoat_test_SN5659__cal_impl.Setupv2_P18 speedgoat_test_SN5659__cal_impl.Setupv2_P19 speedgoat_test_SN5659__cal_impl.Setupv2_P2 speedgoat_test_SN5659__cal_impl.Setupv2_P20 speedgoat_test_SN5659__cal_impl.Setupv2_P21 speedgoat_test_SN5659__cal_impl.Setupv2_P22 speedgoat_test_SN5659__cal_impl.Setupv2_P23 speedgoat_test_SN5659__cal_impl.Setupv2_P24 speedgoat_test_SN5659__cal_impl.Setupv2_P25 speedgoat_test_SN5659__cal_impl.Setupv2_P26 speedgoat_test_SN5659__cal_impl.Setupv2_P27 speedgoat_test_SN5659__cal_impl.Setupv2_P28 speedgoat_test_SN5659__cal_impl.Setupv2_P29 speedgoat_test_SN5659__cal_impl.Setupv2_P3 speedgoat_test_SN5659__cal_impl.Setupv2_P30 speedgoat_test_SN5659__cal_impl.Setupv2_P31 speedgoat_test_SN5659__cal_impl.Setupv2_P32 speedgoat_test_SN5659__cal_impl.Setupv2_P33 speedgoat_test_SN5659__cal_impl.Setupv2_P34 speedgoat_test_SN5659__cal_impl.Setupv2_P35 speedgoat_test_SN5659__cal_impl.Setupv2_P4 speedgoat_test_SN5659__cal_impl.Setupv2_P5 speedgoat_test_SN5659__cal_impl.Setupv2_P6 speedgoat_test_SN5659__cal_impl.Setupv2_P7 speedgoat_test_SN5659__cal_impl.Setupv2_P8 speedgoat_test_SN5659__cal_impl.Setupv2_P9 speedgoat_test_SN5659__cal_impl.SineWave_Amp speedgoat_test_SN5659__cal_impl.SineWave_Bias speedgoat_test_SN5659__cal_impl.SineWave_Freq speedgoat_test_SN5659__cal_impl.SineWave_Phase /end REF_CHARACTERISTIC
 /begin REF_MEASUREMENT speedgoat_test_SN5659_R2020b_B.Gain speedgoat_test_SN5659_R2020b_B.Gain1 speedgoat_test_SN5659_R2020b_B.Gain2 speedgoat_test_SN5659_R2020b_B.Gain3 speedgoat_test_SN5659_R2020b_B.IO133_AI_CH1 speedgoat_test_SN5659_R2020b_B.IO133_AI_CH2 speedgoat_test_SN5659_R2020b_B.IO133_AI_CH3 speedgoat_test_SN5659_R2020b_B.IO133_AI_CH4 speedgoat_test_SN5659_R2020b_B.IO133_DI_CH8 speedgoat_test_SN5659_R2020b_B.IO133_DI_CH9 speedgoat_test_SN5659_R2020b_B.PulseGenerator speedgoat_test_SN5659_R2020b_B.PulseGenerator1 speedgoat_test_SN5659_R2020b_B.SineWave speedgoat_test_SN5659_R2020b_DW.Analoginputv2_PWORK speedgoat_test_SN5659_R2020b_DW.Analogoutputv2_PWORK speedgoat_test_SN5659_R2020b_DW.Digitalinputv2_PWORK speedgoat_test_SN5659_R2020b_DW.Digitaloutputv2_PWORK speedgoat_test_SN5659_R2020b_DW.Scope2_PWORK speedgoat_test_SN5659_R2020b_DW.Scope4_PWORK speedgoat_test_SN5659_R2020b_DW.clockTickCounter speedgoat_test_SN5659_R2020b_DW.clockTickCounter_c /end REF_MEASUREMENT
/end GROUP
/begin GROUP speedgoat_test_SN5659_R2020b_IO204 "speedgoat_test_SN5659_R2020b/IO204"
 /begin REF_CHARACTERISTIC speedgoat_test_SN5659__cal_impl.Gain1_Gain_o speedgoat_test_SN5659__cal_impl.Gain2_Gain_j speedgoat_test_SN5659__cal_impl.Gain_Gain_i speedgoat_test_SN5659__cal_impl.PulseGenerator_Amp_g speedgoat_test_SN5659__cal_impl.PulseGenerator_Duty_i speedgoat_test_SN5659__cal_impl.PulseGenerator_Period_i speedgoat_test_SN5659__cal_impl.PulseGenerator_PhaseDelay_l speedgoat_test_SN5659__cal_impl.Read_P1 speedgoat_test_SN5659__cal_impl.Read_P2 speedgoat_test_SN5659__cal_impl.Read_P3 speedgoat_test_SN5659__cal_impl.Read_P4 speedgoat_test_SN5659__cal_impl.Read_P5 speedgoat_test_SN5659__cal_impl.Setup_P1 speedgoat_test_SN5659__cal_impl.Setup_P2 speedgoat_test_SN5659__cal_impl.Setup_P3 speedgoat_test_SN5659__cal_impl.Setup_P4 speedgoat_test_SN5659__cal_impl.Setup_P5 speedgoat_test_SN5659__cal_impl.Write_P1 speedgoat_test_SN5659__cal_impl.Write_P2 speedgoat_test_SN5659__cal_impl.Write_P3 speedgoat_test_SN5659__cal_impl.Write_P4 /end REF_CHARACTERISTIC
 /begin REF_MEASUREMENT speedgoat_test_SN5659_R2020b_B.IO204_CH1 speedgoat_test_SN5659_R2020b_B.IO204_CH11 speedgoat_test_SN5659_R2020b_B.IO204_CH16 speedgoat_test_SN5659_R2020b_B.IO204_CH6 speedgoat_test_SN5659_R2020b_B.PulseGenerator_k speedgoat_test_SN5659_R2020b_B.Read_o11 speedgoat_test_SN5659_R2020b_B.Read_o16 speedgoat_test_SN5659_R2020b_B.Read_o6 speedgoat_test_SN5659_R2020b_DW.Read_PWORK speedgoat_test_SN5659_R2020b_DW.ScopexPC_PWORK speedgoat_test_SN5659_R2020b_DW.Setup_PWORK speedgoat_test_SN5659_R2020b_DW.Write_PWORK speedgoat_test_SN5659_R2020b_DW.clockTickCounter_b /end REF_MEASUREMENT
/end GROUP
/begin GROUP speedgoat_test_SN5659_R2020b_IO421_1 "speedgoat_test_SN5659_R2020b/IO421-1"
 /begin REF_CHARACTERISTIC speedgoat_test_SN5659__cal_impl.LVDTread1_P1 speedgoat_test_SN5659__cal_impl.LVDTread1_P2 speedgoat_test_SN5659__cal_impl.LVDTread1_P3 speedgoat_test_SN5659__cal_impl.LVDTread1_P4 speedgoat_test_SN5659__cal_impl.LVDTread1_P5 speedgoat_test_SN5659__cal_impl.LVDTread1_P6 speedgoat_test_SN5659__cal_impl.LVDTread1_P7 speedgoat_test_SN5659__cal_impl.LVDTread1_P8 speedgoat_test_SN5659__cal_impl.LVDTread_P1 speedgoat_test_SN5659__cal_impl.LVDTread_P2 speedgoat_test_SN5659__cal_impl.LVDTread_P3 speedgoat_test_SN5659__cal_impl.LVDTread_P4 speedgoat_test_SN5659__cal_impl.LVDTread_P5 speedgoat_test_SN5659__cal_impl.LVDTread_P6 speedgoat_test_SN5659__cal_impl.LVDTread_P7 speedgoat_test_SN5659__cal_impl.LVDTread_P8 speedgoat_test_SN5659__cal_impl.REF_P1 speedgoat_test_SN5659__cal_impl.REF_P2 speedgoat_test_SN5659__cal_impl.REF_P3 speedgoat_test_SN5659__cal_impl.REF_P4 speedgoat_test_SN5659__cal_impl.REF_P5 /end REF_CHARACTERISTIC
 /begin REF_MEASUREMENT speedgoat_test_SN5659_R2020b_B.IO421_LVDT_POS1 speedgoat_test_SN5659_R2020b_B.IO421_LVDT_POS2 speedgoat_test_SN5659_R2020b_DW.LVDTread1_PWORK speedgoat_test_SN5659_R2020b_DW.LVDTread_PWORK speedgoat_test_SN5659_R2020b_DW.REF_PWORK speedgoat_test_SN5659_R2020b_DW.Scope1_PWORK speedgoat_test_SN5659_R2020b_DW.Scope_PWORK_p /end REF_MEASUREMENT
/end GROUP
/begin GROUP speedgoat_test_SN5659_R2020b_IO503 "speedgoat_test_SN5659_R2020b/IO503"
 /begin REF_CHARACTERISTIC speedgoat_test_SN5659__cal_impl.ASCIIDecode1_P1 speedgoat_test_SN5659__cal_impl.ASCIIDecode1_P2 speedgoat_test_SN5659__cal_impl.ASCIIDecode1_P3 speedgoat_test_SN5659__cal_impl.ASCIIDecode2_P1 speedgoat_test_SN5659__cal_impl.ASCIIDecode2_P2 speedgoat_test_SN5659__cal_impl.ASCIIDecode2_P3 speedgoat_test_SN5659__cal_impl.ASCIIDecode3_P1 speedgoat_test_SN5659__cal_impl.ASCIIDecode3_P2 speedgoat_test_SN5659__cal_impl.ASCIIDecode3_P3 speedgoat_test_SN5659__cal_impl.ASCIIDecode_P1 speedgoat_test_SN5659__cal_impl.ASCIIDecode_P2 speedgoat_test_SN5659__cal_impl.ASCIIDecode_P3 speedgoat_test_SN5659__cal_impl.ASCIIEncode1_P1 speedgoat_test_SN5659__cal_impl.ASCIIEncode1_P2 speedgoat_test_SN5659__cal_impl.ASCIIEncode1_P3 speedgoat_test_SN5659__cal_impl.ASCIIEncode1_P4 speedgoat_test_SN5659__cal_impl.ASCIIEncode2_P1 speedgoat_test_SN5659__cal_impl.ASCIIEncode2_P2 speedgoat_test_SN5659__cal_impl.ASCIIEncode2_P3 speedgoat_test_SN5659__cal_impl.ASCIIEncode2_P4 speedgoat_test_SN5659__cal_impl.ASCIIEncode3_P1 speedgoat_test_SN5659__cal_impl.ASCIIEncode3_P2 speedgoat_test_SN5659__cal_impl.ASCIIEncode3_P3 speedgoat_test_SN5659__cal_impl.ASCIIEncode3_P4 speedgoat_test_SN5659__cal_impl.ASCIIEncode_P1 speedgoat_test_SN5659__cal_impl.ASCIIEncode_P2 speedgoat_test_SN5659__cal_impl.ASCIIEncode_P3 speedgoat_test_SN5659__cal_impl.ASCIIEncode_P4 speedgoat_test_SN5659__cal_impl.Read1_P1 speedgoat_test_SN5659__cal_impl.Read1_P2 speedgoat_test_SN5659__cal_impl.Read1_P3 speedgoat_test_SN5659__cal_impl.Read1_P4 speedgoat_test_SN5659__cal_impl.Read1_P5 speedgoat_test_SN5659__cal_impl.Read1_P6 speedgoat_test_SN5659__cal_impl.Read1_P7 speedgoat_test_SN5659__cal_impl.Read1_P8 speedgoat_test_SN5659__cal_impl.Read1_P9 speedgoat_test_SN5659__cal_impl.Read2_P1 speedgoat_test_SN5659__cal_impl.Read2_P2 speedgoat_test_SN5659__cal_impl.Read2_P3 speedgoat_test_SN5659__cal_impl.Read2_P4 speedgoat_test_SN5659__cal_impl.Read2_P5 speedgoat_test_SN5659__cal_impl.Read2_P6 speedgoat_test_SN5659__cal_impl.Read2_P7 speedgoat_test_SN5659__cal_impl.Read2_P8 speedgoat_test_SN5659__cal_impl.Read2_P9 speedgoat_test_SN5659__cal_impl.Read3_P1 speedgoat_test_SN5659__cal_impl.Read3_P2 speedgoat_test_SN5659__cal_impl.Read3_P3 speedgoat_test_SN5659__cal_impl.Read3_P4 speedgoat_test_SN5659__cal_impl.Read3_P5 speedgoat_test_SN5659__cal_impl.Read3_P6 speedgoat_test_SN5659__cal_impl.Read3_P7 speedgoat_test_SN5659__cal_impl.Read3_P8 speedgoat_test_SN5659__cal_impl.Read3_P9 speedgoat_test_SN5659__cal_impl.Read_P1_o speedgoat_test_SN5659__cal_impl.Read_P2_b speedgoat_test_SN5659__cal_impl.Read_P3_j speedgoat_test_SN5659__cal_impl.Read_P4_k speedgoat_test_SN5659__cal_impl.Read_P5_e speedgoat_test_SN5659__cal_impl.Read_P6 speedgoat_test_SN5659__cal_impl.Read_P7 speedgoat_test_SN5659__cal_impl.Read_P8 speedgoat_test_SN5659__cal_impl.Read_P9 speedgoat_test_SN5659__cal_impl.Setup_P10 speedgoat_test_SN5659__cal_impl.Setup_P11 speedgoat_test_SN5659__cal_impl.Setup_P12 speedgoat_test_SN5659__cal_impl.Setup_P13 speedgoat_test_SN5659__cal_impl.Setup_P14 speedgoat_test_SN5659__cal_impl.Setup_P15 speedgoat_test_SN5659__cal_impl.Setup_P16 speedgoat_test_SN5659__cal_impl.Setup_P17 speedgoat_test_SN5659__cal_impl.Setup_P18 speedgoat_test_SN5659__cal_impl.Setup_P19 speedgoat_test_SN5659__cal_impl.Setup_P1_h speedgoat_test_SN5659__cal_impl.Setup_P20 speedgoat_test_SN5659__cal_impl.Setup_P21 speedgoat_test_SN5659__cal_impl.Setup_P22 speedgoat_test_SN5659__cal_impl.Setup_P23 speedgoat_test_SN5659__cal_impl.Setup_P24 speedgoat_test_SN5659__cal_impl.Setup_P25 speedgoat_test_SN5659__cal_impl.Setup_P2_h speedgoat_test_SN5659__cal_impl.Setup_P3_l speedgoat_test_SN5659__cal_impl.Setup_P4_h speedgoat_test_SN5659__cal_impl.Setup_P5_b speedgoat_test_SN5659__cal_impl.Setup_P6 speedgoat_test_SN5659__cal_impl.Setup_P7 speedgoat_test_SN5659__cal_impl.Setup_P8 speedgoat_test_SN5659__cal_impl.Setup_P9 speedgoat_test_SN5659__cal_impl.SineWave1_Amp_i speedgoat_test_SN5659__cal_impl.SineWave1_Bias_du speedgoat_test_SN5659__cal_impl.SineWave1_Freq_b speedgoat_test_SN5659__cal_impl.SineWave1_HCos_l speedgoat_test_SN5659__cal_impl.SineWave1_Hsin_j speedgoat_test_SN5659__cal_impl.SineWave1_PCos_c speedgoat_test_SN5659__cal_impl.SineWave1_PSin_e speedgoat_test_SN5659__cal_impl.SineWave2_Amp_e speedgoat_test_SN5659__cal_impl.SineWave2_Bias_e speedgoat_test_SN5659__cal_impl.SineWave2_Freq_o speedgoat_test_SN5659__cal_impl.SineWave2_HCos_a speedgoat_test_SN5659__cal_impl.SineWave2_Hsin_k speedgoat_test_SN5659__cal_impl.SineWave2_PCos_p speedgoat_test_SN5659__cal_impl.SineWave2_PSin_p speedgoat_test_SN5659__cal_impl.SineWave3_Amp_n speedgoat_test_SN5659__cal_impl.SineWave3_Bias_m speedgoat_test_SN5659__cal_impl.SineWave3_Freq_p speedgoat_test_SN5659__cal_impl.SineWave3_HCos_e speedgoat_test_SN5659__cal_impl.SineWave3_Hsin_g speedgoat_test_SN5659__cal_impl.SineWave3_PCos_a speedgoat_test_SN5659__cal_impl.SineWave3_PSin_n speedgoat_test_SN5659__cal_impl.SineWave4_Amp_b speedgoat_test_SN5659__cal_impl.SineWave4_Bias_h speedgoat_test_SN5659__cal_impl.SineWave4_Freq_e speedgoat_test_SN5659__cal_impl.SineWave4_HCos_a speedgoat_test_SN5659__cal_impl.SineWave4_Hsin_f speedgoat_test_SN5659__cal_impl.SineWave4_PCos_f speedgoat_test_SN5659__cal_impl.SineWave4_PSin_l speedgoat_test_SN5659__cal_impl.Write1_P1 speedgoat_test_SN5659__cal_impl.Write1_P2 speedgoat_test_SN5659__cal_impl.Write1_P3 speedgoat_test_SN5659__cal_impl.Write1_P4 speedgoat_test_SN5659__cal_impl.Write1_P5 speedgoat_test_SN5659__cal_impl.Write1_P6 speedgoat_test_SN5659__cal_impl.Write1_P7 speedgoat_test_SN5659__cal_impl.Write1_P8 speedgoat_test_SN5659__cal_impl.Write2_P1 speedgoat_test_SN5659__cal_impl.Write2_P2 speedgoat_test_SN5659__cal_impl.Write2_P3 speedgoat_test_SN5659__cal_impl.Write2_P4 speedgoat_test_SN5659__cal_impl.Write2_P5 speedgoat_test_SN5659__cal_impl.Write2_P6 speedgoat_test_SN5659__cal_impl.Write2_P7 speedgoat_test_SN5659__cal_impl.Write2_P8 speedgoat_test_SN5659__cal_impl.Write3_P1 speedgoat_test_SN5659__cal_impl.Write3_P2 speedgoat_test_SN5659__cal_impl.Write3_P3 speedgoat_test_SN5659__cal_impl.Write3_P4 speedgoat_test_SN5659__cal_impl.Write3_P5 speedgoat_test_SN5659__cal_impl.Write3_P6 speedgoat_test_SN5659__cal_impl.Write3_P7 speedgoat_test_SN5659__cal_impl.Write3_P8 speedgoat_test_SN5659__cal_impl.Write_P1_k speedgoat_test_SN5659__cal_impl.Write_P2_h speedgoat_test_SN5659__cal_impl.Write_P3_m speedgoat_test_SN5659__cal_impl.Write_P4_g speedgoat_test_SN5659__cal_impl.Write_P5 speedgoat_test_SN5659__cal_impl.Write_P6 speedgoat_test_SN5659__cal_impl.Write_P7 speedgoat_test_SN5659__cal_impl.Write_P8 /end REF_CHARACTERISTIC
 /begin REF_MEASUREMENT speedgoat_test_SN5659_R2020b_B.ASCIIEncode speedgoat_test_SN5659_R2020b_B.ASCIIEncode1 speedgoat_test_SN5659_R2020b_B.ASCIIEncode2 speedgoat_test_SN5659_R2020b_B.ASCIIEncode3 speedgoat_test_SN5659_R2020b_B.FIFOread speedgoat_test_SN5659_R2020b_B.FIFOread1 speedgoat_test_SN5659_R2020b_B.FIFOread2 speedgoat_test_SN5659_R2020b_B.FIFOread3 speedgoat_test_SN5659_R2020b_B.IO503_SerialIN_CH1 speedgoat_test_SN5659_R2020b_B.IO503_SerialIN_CH2 speedgoat_test_SN5659_R2020b_B.IO503_SerialIN_CH3 speedgoat_test_SN5659_R2020b_B.IO503_SerialIN_CH4 speedgoat_test_SN5659_R2020b_B.Read speedgoat_test_SN5659_R2020b_B.Read1 speedgoat_test_SN5659_R2020b_B.Read2 speedgoat_test_SN5659_R2020b_B.Read3 speedgoat_test_SN5659_R2020b_B.SineWave1_k speedgoat_test_SN5659_R2020b_B.SineWave2_m speedgoat_test_SN5659_R2020b_B.SineWave3_k speedgoat_test_SN5659_R2020b_B.SineWave4_j speedgoat_test_SN5659_R2020b_DW.ASCIIDecode1_PWORK speedgoat_test_SN5659_R2020b_DW.ASCIIDecode2_PWORK speedgoat_test_SN5659_R2020b_DW.ASCIIDecode3_PWORK speedgoat_test_SN5659_R2020b_DW.ASCIIDecode_PWORK speedgoat_test_SN5659_R2020b_DW.ASCIIEncode1_PWORK speedgoat_test_SN5659_R2020b_DW.ASCIIEncode2_PWORK speedgoat_test_SN5659_R2020b_DW.ASCIIEncode3_PWORK speedgoat_test_SN5659_R2020b_DW.ASCIIEncode_PWORK speedgoat_test_SN5659_R2020b_DW.FIFOread1_PWORK speedgoat_test_SN5659_R2020b_DW.FIFOread2_PWORK speedgoat_test_SN5659_R2020b_DW.FIFOread3_PWORK speedgoat_test_SN5659_R2020b_DW.FIFOread_PWORK speedgoat_test_SN5659_R2020b_DW.FIFOwrite1_PWORK speedgoat_test_SN5659_R2020b_DW.FIFOwrite2_PWORK speedgoat_test_SN5659_R2020b_DW.FIFOwrite3_PWORK speedgoat_test_SN5659_R2020b_DW.FIFOwrite_PWORK speedgoat_test_SN5659_R2020b_DW.Read1_PWORK speedgoat_test_SN5659_R2020b_DW.Read2_PWORK speedgoat_test_SN5659_R2020b_DW.Read3_PWORK speedgoat_test_SN5659_R2020b_DW.Read_PWORK_g speedgoat_test_SN5659_R2020b_DW.ScopexPC2_PWORK speedgoat_test_SN5659_R2020b_DW.Setup_PWORK_j speedgoat_test_SN5659_R2020b_DW.Write1_PWORK speedgoat_test_SN5659_R2020b_DW.Write2_PWORK speedgoat_test_SN5659_R2020b_DW.Write3_PWORK speedgoat_test_SN5659_R2020b_DW.Write_PWORK_d speedgoat_test_SN5659_R2020b_DW.lastCos_ab speedgoat_test_SN5659_R2020b_DW.lastCos_aj speedgoat_test_SN5659_R2020b_DW.lastCos_bs speedgoat_test_SN5659_R2020b_DW.lastCos_oj speedgoat_test_SN5659_R2020b_DW.lastSin_ck speedgoat_test_SN5659_R2020b_DW.lastSin_ew speedgoat_test_SN5659_R2020b_DW.lastSin_h5 speedgoat_test_SN5659_R2020b_DW.lastSin_ln speedgoat_test_SN5659_R2020b_DW.systemEnable_av speedgoat_test_SN5659_R2020b_DW.systemEnable_gp speedgoat_test_SN5659_R2020b_DW.systemEnable_k speedgoat_test_SN5659_R2020b_DW.systemEnable_p2 /end REF_MEASUREMENT
/end GROUP
/begin GROUP speedgoat_test_SN5659_R2020b_IO612 "speedgoat_test_SN5659_R2020b/IO612"
 /begin SUB_GROUP speedgoat_test_SN5659_R2020b_IO612_CAN_Read_Loop___Port_3 speedgoat_test_SN5659_R2020b_IO612_CAN_Read_Loop___Port_4 /end SUB_GROUP
 /begin REF_CHARACTERISTIC speedgoat_test_SN5659__cal_impl.CANSetup_P1 speedgoat_test_SN5659__cal_impl.CANSetup_P10 speedgoat_test_SN5659__cal_impl.CANSetup_P11 speedgoat_test_SN5659__cal_impl.CANSetup_P12 speedgoat_test_SN5659__cal_impl.CANSetup_P13 speedgoat_test_SN5659__cal_impl.CANSetup_P14 speedgoat_test_SN5659__cal_impl.CANSetup_P15 speedgoat_test_SN5659__cal_impl.CANSetup_P16 speedgoat_test_SN5659__cal_impl.CANSetup_P17 speedgoat_test_SN5659__cal_impl.CANSetup_P18 speedgoat_test_SN5659__cal_impl.CANSetup_P19 speedgoat_test_SN5659__cal_impl.CANSetup_P2 speedgoat_test_SN5659__cal_impl.CANSetup_P20 speedgoat_test_SN5659__cal_impl.CANSetup_P21 speedgoat_test_SN5659__cal_impl.CANSetup_P22 speedgoat_test_SN5659__cal_impl.CANSetup_P23 speedgoat_test_SN5659__cal_impl.CANSetup_P24 speedgoat_test_SN5659__cal_impl.CANSetup_P25 speedgoat_test_SN5659__cal_impl.CANSetup_P26 speedgoat_test_SN5659__cal_impl.CANSetup_P27 speedgoat_test_SN5659__cal_impl.CANSetup_P28 speedgoat_test_SN5659__cal_impl.CANSetup_P29 speedgoat_test_SN5659__cal_impl.CANSetup_P3 speedgoat_test_SN5659__cal_impl.CANSetup_P30 speedgoat_test_SN5659__cal_impl.CANSetup_P31 speedgoat_test_SN5659__cal_impl.CANSetup_P4 speedgoat_test_SN5659__cal_impl.CANSetup_P5 speedgoat_test_SN5659__cal_impl.CANSetup_P6 speedgoat_test_SN5659__cal_impl.CANSetup_P7 speedgoat_test_SN5659__cal_impl.CANSetup_P8 speedgoat_test_SN5659__cal_impl.CANSetup_P9 speedgoat_test_SN5659__cal_impl.CANWrite1_P1 speedgoat_test_SN5659__cal_impl.CANWrite1_P2 speedgoat_test_SN5659__cal_impl.CANWrite1_P3 speedgoat_test_SN5659__cal_impl.CANWrite1_P4 speedgoat_test_SN5659__cal_impl.CANWrite1_P5 speedgoat_test_SN5659__cal_impl.CANWrite1_P6 speedgoat_test_SN5659__cal_impl.CANWrite1_P7 speedgoat_test_SN5659__cal_impl.CANWrite1_P8 speedgoat_test_SN5659__cal_impl.CANWrite2_P1 speedgoat_test_SN5659__cal_impl.CANWrite2_P2 speedgoat_test_SN5659__cal_impl.CANWrite2_P3 speedgoat_test_SN5659__cal_impl.CANWrite2_P4 speedgoat_test_SN5659__cal_impl.CANWrite2_P5 speedgoat_test_SN5659__cal_impl.CANWrite2_P6 speedgoat_test_SN5659__cal_impl.CANWrite2_P7 speedgoat_test_SN5659__cal_impl.CANWrite2_P8 speedgoat_test_SN5659__cal_impl.CANWrite3_P1 speedgoat_test_SN5659__cal_impl.CANWrite3_P2 speedgoat_test_SN5659__cal_impl.CANWrite3_P3 speedgoat_test_SN5659__cal_impl.CANWrite3_P4 speedgoat_test_SN5659__cal_impl.CANWrite3_P5 speedgoat_test_SN5659__cal_impl.CANWrite3_P6 speedgoat_test_SN5659__cal_impl.CANWrite3_P7 speedgoat_test_SN5659__cal_impl.CANWrite3_P8 speedgoat_test_SN5659__cal_impl.CANWrite4_P1 speedgoat_test_SN5659__cal_impl.CANWrite4_P2 speedgoat_test_SN5659__cal_impl.CANWrite4_P3 speedgoat_test_SN5659__cal_impl.CANWrite4_P4 speedgoat_test_SN5659__cal_impl.CANWrite4_P5 speedgoat_test_SN5659__cal_impl.CANWrite4_P6 speedgoat_test_SN5659__cal_impl.CANWrite4_P7 speedgoat_test_SN5659__cal_impl.CANWrite4_P8 speedgoat_test_SN5659__cal_impl.CANWrite5_P1 speedgoat_test_SN5659__cal_impl.CANWrite5_P2 speedgoat_test_SN5659__cal_impl.CANWrite5_P3 speedgoat_test_SN5659__cal_impl.CANWrite5_P4 speedgoat_test_SN5659__cal_impl.CANWrite5_P5 speedgoat_test_SN5659__cal_impl.CANWrite5_P6 speedgoat_test_SN5659__cal_impl.CANWrite5_P7 speedgoat_test_SN5659__cal_impl.CANWrite5_P8 speedgoat_test_SN5659__cal_impl.CANWrite_P1 speedgoat_test_SN5659__cal_impl.CANWrite_P2 speedgoat_test_SN5659__cal_impl.CANWrite_P3 speedgoat_test_SN5659__cal_impl.CANWrite_P4 speedgoat_test_SN5659__cal_impl.CANWrite_P5 speedgoat_test_SN5659__cal_impl.CANWrite_P6 speedgoat_test_SN5659__cal_impl.CANWrite_P7 speedgoat_test_SN5659__cal_impl.CANWrite_P8 speedgoat_test_SN5659__cal_impl.RXSampleTime1_Value speedgoat_test_SN5659__cal_impl.RXSampleTime_Value speedgoat_test_SN5659__cal_impl.SineWave1_Amp speedgoat_test_SN5659__cal_impl.SineWave1_Bias speedgoat_test_SN5659__cal_impl.SineWave1_Freq speedgoat_test_SN5659__cal_impl.SineWave1_HCos speedgoat_test_SN5659__cal_impl.SineWave1_Hsin speedgoat_test_SN5659__cal_impl.SineWave1_PCos speedgoat_test_SN5659__cal_impl.SineWave1_PSin speedgoat_test_SN5659__cal_impl.SineWave2_Amp speedgoat_test_SN5659__cal_impl.SineWave2_Bias speedgoat_test_SN5659__cal_impl.SineWave2_Freq speedgoat_test_SN5659__cal_impl.SineWave2_HCos speedgoat_test_SN5659__cal_impl.SineWave2_Hsin speedgoat_test_SN5659__cal_impl.SineWave2_PCos speedgoat_test_SN5659__cal_impl.SineWave2_PSin speedgoat_test_SN5659__cal_impl.SineWave3_Amp speedgoat_test_SN5659__cal_impl.SineWave3_Bias speedgoat_test_SN5659__cal_impl.SineWave3_Freq speedgoat_test_SN5659__cal_impl.SineWave3_HCos speedgoat_test_SN5659__cal_impl.SineWave3_Hsin speedgoat_test_SN5659__cal_impl.SineWave3_PCos speedgoat_test_SN5659__cal_impl.SineWave3_PSin speedgoat_test_SN5659__cal_impl.SineWave4_Amp speedgoat_test_SN5659__cal_impl.SineWave4_Bias speedgoat_test_SN5659__cal_impl.SineWave4_Freq speedgoat_test_SN5659__cal_impl.SineWave4_HCos speedgoat_test_SN5659__cal_impl.SineWave4_Hsin speedgoat_test_SN5659__cal_impl.SineWave4_PCos speedgoat_test_SN5659__cal_impl.SineWave4_PSin speedgoat_test_SN5659__cal_impl.SineWave5_Amp speedgoat_test_SN5659__cal_impl.SineWave5_Bias speedgoat_test_SN5659__cal_impl.SineWave5_Freq speedgoat_test_SN5659__cal_impl.SineWave5_HCos speedgoat_test_SN5659__cal_impl.SineWave5_Hsin speedgoat_test_SN5659__cal_impl.SineWave5_PCos speedgoat_test_SN5659__cal_impl.SineWave5_PSin speedgoat_test_SN5659__cal_impl.SineWave_Amp_i speedgoat_test_SN5659__cal_impl.SineWave_Bias_e speedgoat_test_SN5659__cal_impl.SineWave_Freq_k speedgoat_test_SN5659__cal_impl.SineWave_HCos speedgoat_test_SN5659__cal_impl.SineWave_Hsin speedgoat_test_SN5659__cal_impl.SineWave_PCos speedgoat_test_SN5659__cal_impl.SineWave_PSin /end REF_CHARACTERISTIC
 /begin REF_MEASUREMENT speedgoat_test_SN5659_R2020b_B.CANUnpack speedgoat_test_SN5659_R2020b_B.CANUnpack1 speedgoat_test_SN5659_R2020b_B.CANUnpack1_o speedgoat_test_SN5659_R2020b_B.CANUnpack2 speedgoat_test_SN5659_R2020b_B.CANUnpack2_j speedgoat_test_SN5659_R2020b_B.CANUnpack_c speedgoat_test_SN5659_R2020b_B.RXSampleTime speedgoat_test_SN5659_R2020b_B.RXSampleTime1 speedgoat_test_SN5659_R2020b_B.SineWave1 speedgoat_test_SN5659_R2020b_B.SineWave2 speedgoat_test_SN5659_R2020b_B.SineWave3 speedgoat_test_SN5659_R2020b_B.SineWave4 speedgoat_test_SN5659_R2020b_B.SineWave5 speedgoat_test_SN5659_R2020b_B.SineWave_e speedgoat_test_SN5659_R2020b_DW.CANPack1_ModeSignalID speedgoat_test_SN5659_R2020b_DW.CANPack2_ModeSignalID speedgoat_test_SN5659_R2020b_DW.CANPack3_ModeSignalID speedgoat_test_SN5659_R2020b_DW.CANPack4_ModeSignalID speedgoat_test_SN5659_R2020b_DW.CANPack5_ModeSignalID speedgoat_test_SN5659_R2020b_DW.CANPack_ModeSignalID speedgoat_test_SN5659_R2020b_DW.CANWrite1_PWORK speedgoat_test_SN5659_R2020b_DW.CANWrite2_PWORK speedgoat_test_SN5659_R2020b_DW.CANWrite3_PWORK speedgoat_test_SN5659_R2020b_DW.CANWrite4_PWORK speedgoat_test_SN5659_R2020b_DW.CANWrite5_PWORK speedgoat_test_SN5659_R2020b_DW.CANWrite_PWORK speedgoat_test_SN5659_R2020b_DW.Scope_PWORK speedgoat_test_SN5659_R2020b_DW.lastCos speedgoat_test_SN5659_R2020b_DW.lastCos_b speedgoat_test_SN5659_R2020b_DW.lastCos_c speedgoat_test_SN5659_R2020b_DW.lastCos_g speedgoat_test_SN5659_R2020b_DW.lastCos_i speedgoat_test_SN5659_R2020b_DW.lastCos_j speedgoat_test_SN5659_R2020b_DW.lastSin speedgoat_test_SN5659_R2020b_DW.lastSin_c speedgoat_test_SN5659_R2020b_DW.lastSin_cd speedgoat_test_SN5659_R2020b_DW.lastSin_d speedgoat_test_SN5659_R2020b_DW.lastSin_h speedgoat_test_SN5659_R2020b_DW.lastSin_i speedgoat_test_SN5659_R2020b_DW.systemEnable speedgoat_test_SN5659_R2020b_DW.systemEnable_b speedgoat_test_SN5659_R2020b_DW.systemEnable_h speedgoat_test_SN5659_R2020b_DW.systemEnable_i speedgoat_test_SN5659_R2020b_DW.systemEnable_p speedgoat_test_SN5659_R2020b_DW.systemEnable_py /end REF_MEASUREMENT
/end GROUP
/begin GROUP speedgoat_test_SN5659_R2020b_IO612_CAN_Read_Loop___Port_3 "speedgoat_test_SN5659_R2020b/IO612/CAN Read Loop - Port 3"
 /begin REF_CHARACTERISTIC speedgoat_test_SN5659__cal_impl.CANRead_P1 speedgoat_test_SN5659__cal_impl.CANRead_P2 speedgoat_test_SN5659__cal_impl.CANRead_P3 speedgoat_test_SN5659__cal_impl.CANRead_P4 speedgoat_test_SN5659__cal_impl.CANRead_P5 speedgoat_test_SN5659__cal_impl.CANRead_P6 speedgoat_test_SN5659__cal_impl.CANRead_P7 speedgoat_test_SN5659__cal_impl.ID100_Signal1_Y0 speedgoat_test_SN5659__cal_impl.ID101_Signal1_Y0 speedgoat_test_SN5659__cal_impl.ID102_Signal1_Y0 /end REF_CHARACTERISTIC
 /begin REF_MEASUREMENT speedgoat_test_SN5659_R2020b_B.CANRead_o1 speedgoat_test_SN5659_R2020b_B.CANUnpack1_o speedgoat_test_SN5659_R2020b_B.CANUnpack2_j speedgoat_test_SN5659_R2020b_B.CANUnpack_c speedgoat_test_SN5659_R2020b_DW.CANUnpack1_ModeSignalID_i speedgoat_test_SN5659_R2020b_DW.CANUnpack1_StatusPortID_o speedgoat_test_SN5659_R2020b_DW.CANUnpack2_ModeSignalID_g speedgoat_test_SN5659_R2020b_DW.CANUnpack2_StatusPortID_m speedgoat_test_SN5659_R2020b_DW.CANUnpack_ModeSignalID_b speedgoat_test_SN5659_R2020b_DW.CANUnpack_StatusPortID_g /end REF_MEASUREMENT
/end GROUP
/begin GROUP speedgoat_test_SN5659_R2020b_IO612_CAN_Read_Loop___Port_4 "speedgoat_test_SN5659_R2020b/IO612/CAN Read Loop - Port 4"
 /begin REF_CHARACTERISTIC speedgoat_test_SN5659__cal_impl.CANRead1_P1 speedgoat_test_SN5659__cal_impl.CANRead1_P2 speedgoat_test_SN5659__cal_impl.CANRead1_P3 speedgoat_test_SN5659__cal_impl.CANRead1_P4 speedgoat_test_SN5659__cal_impl.CANRead1_P5 speedgoat_test_SN5659__cal_impl.CANRead1_P6 speedgoat_test_SN5659__cal_impl.CANRead1_P7 speedgoat_test_SN5659__cal_impl.ID100_Signal1_Y0_j speedgoat_test_SN5659__cal_impl.ID101_Signal1_Y0_o speedgoat_test_SN5659__cal_impl.ID102_Signal1_Y0_i /end REF_CHARACTERISTIC
 /begin REF_MEASUREMENT speedgoat_test_SN5659_R2020b_B.CANRead1_o1 speedgoat_test_SN5659_R2020b_B.CANUnpack speedgoat_test_SN5659_R2020b_B.CANUnpack1 speedgoat_test_SN5659_R2020b_B.CANUnpack2 speedgoat_test_SN5659_R2020b_DW.CANUnpack1_ModeSignalID speedgoat_test_SN5659_R2020b_DW.CANUnpack1_StatusPortID speedgoat_test_SN5659_R2020b_DW.CANUnpack2_ModeSignalID speedgoat_test_SN5659_R2020b_DW.CANUnpack2_StatusPortID speedgoat_test_SN5659_R2020b_DW.CANUnpack_ModeSignalID speedgoat_test_SN5659_R2020b_DW.CANUnpack_StatusPortID /end REF_MEASUREMENT
/end GROUP
/end MODULE
/end PROJECT
