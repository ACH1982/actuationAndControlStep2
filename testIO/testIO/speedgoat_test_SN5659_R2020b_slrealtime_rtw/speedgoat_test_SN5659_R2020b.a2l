ASAP2_VERSION 1 71
/begin PROJECT ProjectName "Project Comment Goes Here"
/begin HEADER "Header Comments go here" /end HEADER
/begin MODULE ModuleName "Module Comment Goes Here"
/begin MOD_COMMON "Mod Common Comment Here" BYTE_ORDER MSB_LAST ALIGNMENT_BYTE 1 ALIGNMENT_WORD 2 ALIGNMENT_LONG 4 ALIGNMENT_FLOAT32_IEEE 4 ALIGNMENT_FLOAT64_IEEE 8 ALIGNMENT_INT64 8 /end MOD_COMMON
/begin CHARACTERISTIC speedgoat_test_SN5659__cal_impl.Constant_Value_b2 "" VALUE 0x008EFCFA Scalar_UWORD 0 speedgoat_test_SN5659_R2020b_CM_uint16 0 65535 /end CHARACTERISTIC
/begin CHARACTERISTIC speedgoat_test_SN5659__cal_impl.Constant_Value_b5 "" VALUE 0x008EE568 Scalar_FLOAT64_IEEE 0 speedgoat_test_SN5659_R2020b_CM_double -1.7E+308 1.7E+308 /end CHARACTERISTIC
/begin CHARACTERISTIC speedgoat_test_SN5659__cal_impl.Constant_Value_bz "" VALUE 0x008EDEF8 Scalar_FLOAT64_IEEE 0 speedgoat_test_SN5659_R2020b_CM_double -1.7E+308 1.7E+308 /end CHARACTERISTIC
/begin CHARACTERISTIC speedgoat_test_SN5659__cal_impl.Constant_Value_f "" VALUE 0x008ED888 Scalar_FLOAT64_IEEE 0 speedgoat_test_SN5659_R2020b_CM_double -1.7E+308 1.7E+308 /end CHARACTERISTIC
/begin CHARACTERISTIC speedgoat_test_SN5659__cal_impl.Constant_Value_gg "" VALUE 0x008ECBA8 Scalar_FLOAT64_IEEE 0 speedgoat_test_SN5659_R2020b_CM_double -1.7E+308 1.7E+308 /end CHARACTERISTIC
/begin CHARACTERISTIC speedgoat_test_SN5659__cal_impl.Constant_Value_h "" VALUE 0x008ED218 Scalar_FLOAT64_IEEE 0 speedgoat_test_SN5659_R2020b_CM_double -1.7E+308 1.7E+308 /end CHARACTERISTIC
/begin CHARACTERISTIC speedgoat_test_SN5659__cal_impl.Constant_Value_le "" VALUE 0x008EEBD8 Scalar_FLOAT64_IEEE 0 speedgoat_test_SN5659_R2020b_CM_double -1.7E+308 1.7E+308 /end CHARACTERISTIC
/begin CHARACTERISTIC speedgoat_test_SN5659__cal_impl.Constant_Value_ly "" VALUE 0x008EFCDC Scalar_UWORD 0 speedgoat_test_SN5659_R2020b_CM_uint16 0 65535 /end CHARACTERISTIC
/begin CHARACTERISTIC speedgoat_test_SN5659__cal_impl.Constant_Value_ng "" VALUE 0x008EFCE2 Scalar_UWORD 0 speedgoat_test_SN5659_R2020b_CM_uint16 0 65535 /end CHARACTERISTIC
/begin CHARACTERISTIC speedgoat_test_SN5659__cal_impl.Constant_Value_oy "" VALUE 0x008EFCE8 Scalar_UWORD 0 speedgoat_test_SN5659_R2020b_CM_uint16 0 65535 /end CHARACTERISTIC
/begin CHARACTERISTIC speedgoat_test_SN5659__cal_impl.Constant_Value_pl "" VALUE 0x008EFCEE Scalar_UWORD 0 speedgoat_test_SN5659_R2020b_CM_uint16 0 65535 /end CHARACTERISTIC
/begin CHARACTERISTIC speedgoat_test_SN5659__cal_impl.Constant_Value_pv "" VALUE 0x008EFCF4 Scalar_UWORD 0 speedgoat_test_SN5659_R2020b_CM_uint16 0 65535 /end CHARACTERISTIC
/begin CHARACTERISTIC speedgoat_test_SN5659__cal_impl.CounterLimited_uplimit_a "" VALUE 0x008DF07A Scalar_UWORD 0 speedgoat_test_SN5659_R2020b_CM_uint16 0 65535 /end CHARACTERISTIC
/begin CHARACTERISTIC speedgoat_test_SN5659__cal_impl.CounterLimited_uplimit_b "" VALUE 0x008DF078 Scalar_UWORD 0 speedgoat_test_SN5659_R2020b_CM_uint16 0 65535 /end CHARACTERISTIC
/begin CHARACTERISTIC speedgoat_test_SN5659__cal_impl.CounterLimited_uplimit_ck "" VALUE 0x008DF072 Scalar_UWORD 0 speedgoat_test_SN5659_R2020b_CM_uint16 0 65535 /end CHARACTERISTIC
/begin CHARACTERISTIC speedgoat_test_SN5659__cal_impl.CounterLimited_uplimit_du "" VALUE 0x008DF076 Scalar_UWORD 0 speedgoat_test_SN5659_R2020b_CM_uint16 0 65535 /end CHARACTERISTIC
/begin CHARACTERISTIC speedgoat_test_SN5659__cal_impl.CounterLimited_uplimit_l "" VALUE 0x008DF074 Scalar_UWORD 0 speedgoat_test_SN5659_R2020b_CM_uint16 0 65535 /end CHARACTERISTIC
/begin CHARACTERISTIC speedgoat_test_SN5659__cal_impl.CounterLimited_uplimit_p "" VALUE 0x008DF070 Scalar_UWORD 0 speedgoat_test_SN5659_R2020b_CM_uint16 0 65535 /end CHARACTERISTIC
/begin CHARACTERISTIC speedgoat_test_SN5659__cal_impl.Encode1_P10_d "" VALUE 0x008EE838 Scalar_FLOAT64_IEEE 0 speedgoat_test_SN5659_R2020b_CM_double -1.7E+308 1.7E+308 /end CHARACTERISTIC
/begin CHARACTERISTIC speedgoat_test_SN5659__cal_impl.Encode1_P10_g "" VALUE 0x008ECE78 Scalar_FLOAT64_IEEE 0 speedgoat_test_SN5659_R2020b_CM_double -1.7E+308 1.7E+308 /end CHARACTERISTIC
/begin CHARACTERISTIC speedgoat_test_SN5659__cal_impl.Encode1_P10_i0 "" VALUE 0x008ED4E8 Scalar_FLOAT64_IEEE 0 speedgoat_test_SN5659_R2020b_CM_double -1.7E+308 1.7E+308 /end CHARACTERISTIC
/begin CHARACTERISTIC speedgoat_test_SN5659__cal_impl.Encode1_P10_i5 "" VALUE 0x008EDB58 Scalar_FLOAT64_IEEE 0 speedgoat_test_SN5659_R2020b_CM_double -1.7E+308 1.7E+308 /end CHARACTERISTIC
/begin CHARACTERISTIC speedgoat_test_SN5659__cal_impl.Encode1_P10_j "" VALUE 0x008EC808 Scalar_FLOAT64_IEEE 0 speedgoat_test_SN5659_R2020b_CM_double -1.7E+308 1.7E+308 /end CHARACTERISTIC
/begin CHARACTERISTIC speedgoat_test_SN5659__cal_impl.Encode1_P10_pr "" VALUE 0x008EE1C8 Scalar_FLOAT64_IEEE 0 speedgoat_test_SN5659_R2020b_CM_double -1.7E+308 1.7E+308 /end CHARACTERISTIC
/begin CHARACTERISTIC speedgoat_test_SN5659__cal_impl.Encode1_P11_am "" VAL_BLK 0x008EDB70 Scalar_FLOAT64_IEEE 0 speedgoat_test_SN5659_R2020b_CM_double -1.7E+308 1.7E+308 MATRIX_DIM 2 1 /end CHARACTERISTIC
/begin CHARACTERISTIC speedgoat_test_SN5659__cal_impl.Encode1_P11_c "" VAL_BLK 0x008ED500 Scalar_FLOAT64_IEEE 0 speedgoat_test_SN5659_R2020b_CM_double -1.7E+308 1.7E+308 MATRIX_DIM 2 1 /end CHARACTERISTIC
/begin CHARACTERISTIC speedgoat_test_SN5659__cal_impl.Encode1_P11_d "" VAL_BLK 0x008EE1E0 Scalar_FLOAT64_IEEE 0 speedgoat_test_SN5659_R2020b_CM_double -1.7E+308 1.7E+308 MATRIX_DIM 2 1 /end CHARACTERISTIC
/begin CHARACTERISTIC speedgoat_test_SN5659__cal_impl.Encode1_P11_fp "" VAL_BLK 0x008EC820 Scalar_FLOAT64_IEEE 0 speedgoat_test_SN5659_R2020b_CM_double -1.7E+308 1.7E+308 MATRIX_DIM 2 1 /end CHARACTERISTIC
/begin CHARACTERISTIC speedgoat_test_SN5659__cal_impl.Encode1_P11_gb "" VAL_BLK 0x008ECE90 Scalar_FLOAT64_IEEE 0 speedgoat_test_SN5659_R2020b_CM_double -1.7E+308 1.7E+308 MATRIX_DIM 2 1 /end CHARACTERISTIC
/begin CHARACTERISTIC speedgoat_test_SN5659__cal_impl.Encode1_P11_i "" VAL_BLK 0x008EE850 Scalar_FLOAT64_IEEE 0 speedgoat_test_SN5659_R2020b_CM_double -1.7E+308 1.7E+308 MATRIX_DIM 2 1 /end CHARACTERISTIC
/begin CHARACTERISTIC speedgoat_test_SN5659__cal_impl.Encode1_P12_a2 "" VALUE 0x008EE200 Scalar_FLOAT64_IEEE 0 speedgoat_test_SN5659_R2020b_CM_double -1.7E+308 1.7E+308 /end CHARACTERISTIC
/begin CHARACTERISTIC speedgoat_test_SN5659__cal_impl.Encode1_P12_as "" VALUE 0x008ED520 Scalar_FLOAT64_IEEE 0 speedgoat_test_SN5659_R2020b_CM_double -1.7E+308 1.7E+308 /end CHARACTERISTIC
/begin CHARACTERISTIC speedgoat_test_SN5659__cal_impl.Encode1_P12_i "" VALUE 0x008ECEB0 Scalar_FLOAT64_IEEE 0 speedgoat_test_SN5659_R2020b_CM_double -1.7E+308 1.7E+308 /end CHARACTERISTIC
/begin CHARACTERISTIC speedgoat_test_SN5659__cal_impl.Encode1_P12_jx "" VALUE 0x008EE870 Scalar_FLOAT64_IEEE 0 speedgoat_test_SN5659_R2020b_CM_double -1.7E+308 1.7E+308 /end CHARACTERISTIC
/begin CHARACTERISTIC speedgoat_test_SN5659__cal_impl.Encode1_P12_kd "" VALUE 0x008EC840 Scalar_FLOAT64_IEEE 0 speedgoat_test_SN5659_R2020b_CM_double -1.7E+308 1.7E+308 /end CHARACTERISTIC
/begin CHARACTERISTIC speedgoat_test_SN5659__cal_impl.Encode1_P12_mt "" VALUE 0x008EDB90 Scalar_FLOAT64_IEEE 0 speedgoat_test_SN5659_R2020b_CM_double -1.7E+308 1.7E+308 /end CHARACTERISTIC
/begin CHARACTERISTIC speedgoat_test_SN5659__cal_impl.Encode1_P13_b "" VALUE 0x008ED538 Scalar_FLOAT64_IEEE 0 speedgoat_test_SN5659_R2020b_CM_double -1.7E+308 1.7E+308 /end CHARACTERISTIC
/begin CHARACTERISTIC speedgoat_test_SN5659__cal_impl.Encode1_P13_g "" VALUE 0x008EE218 Scalar_FLOAT64_IEEE 0 speedgoat_test_SN5659_R2020b_CM_double -1.7E+308 1.7E+308 /end CHARACTERISTIC
/begin CHARACTERISTIC speedgoat_test_SN5659__cal_impl.Encode1_P13_gu "" VALUE 0x008EE888 Scalar_FLOAT64_IEEE 0 speedgoat_test_SN5659_R2020b_CM_double -1.7E+308 1.7E+308 /end CHARACTERISTIC
/begin CHARACTERISTIC speedgoat_test_SN5659__cal_impl.Encode1_P13_h "" VALUE 0x008EC858 Scalar_FLOAT64_IEEE 0 speedgoat_test_SN5659_R2020b_CM_double -1.7E+308 1.7E+308 /end CHARACTERISTIC
/begin CHARACTERISTIC speedgoat_test_SN5659__cal_impl.Encode1_P13_hz "" VALUE 0x008ECEC8 Scalar_FLOAT64_IEEE 0 speedgoat_test_SN5659_R2020b_CM_double -1.7E+308 1.7E+308 /end CHARACTERISTIC
/begin CHARACTERISTIC speedgoat_test_SN5659__cal_impl.Encode1_P13_is "" VALUE 0x008EDBA8 Scalar_FLOAT64_IEEE 0 speedgoat_test_SN5659_R2020b_CM_double -1.7E+308 1.7E+308 /end CHARACTERISTIC
/begin CHARACTERISTIC speedgoat_test_SN5659__cal_impl.Encode1_P14_av "" VALUE 0x008EE230 Scalar_FLOAT64_IEEE 0 speedgoat_test_SN5659_R2020b_CM_double -1.7E+308 1.7E+308 /end CHARACTERISTIC
/begin CHARACTERISTIC speedgoat_test_SN5659__cal_impl.Encode1_P14_cd "" VALUE 0x008EDBC0 Scalar_FLOAT64_IEEE 0 speedgoat_test_SN5659_R2020b_CM_double -1.7E+308 1.7E+308 /end CHARACTERISTIC
/begin CHARACTERISTIC speedgoat_test_SN5659__cal_impl.Encode1_P14_f "" VALUE 0x008ECEE0 Scalar_FLOAT64_IEEE 0 speedgoat_test_SN5659_R2020b_CM_double -1.7E+308 1.7E+308 /end CHARACTERISTIC
/begin CHARACTERISTIC speedgoat_test_SN5659__cal_impl.Encode1_P14_fh "" VALUE 0x008ED550 Scalar_FLOAT64_IEEE 0 speedgoat_test_SN5659_R2020b_CM_double -1.7E+308 1.7E+308 /end CHARACTERISTIC
/begin CHARACTERISTIC speedgoat_test_SN5659__cal_impl.Encode1_P14_fz "" VALUE 0x008EE8A0 Scalar_FLOAT64_IEEE 0 speedgoat_test_SN5659_R2020b_CM_double -1.7E+308 1.7E+308 /end CHARACTERISTIC
/begin CHARACTERISTIC speedgoat_test_SN5659__cal_impl.Encode1_P14_ov "" VALUE 0x008EC870 Scalar_FLOAT64_IEEE 0 speedgoat_test_SN5659_R2020b_CM_double -1.7E+308 1.7E+308 /end CHARACTERISTIC
/begin CHARACTERISTIC speedgoat_test_SN5659__cal_impl.Encode1_P15_c "" VALUE 0x008EE248 Scalar_FLOAT64_IEEE 0 speedgoat_test_SN5659_R2020b_CM_double -1.7E+308 1.7E+308 /end CHARACTERISTIC
/begin CHARACTERISTIC speedgoat_test_SN5659__cal_impl.Encode1_P15_d "" VALUE 0x008EE8B8 Scalar_FLOAT64_IEEE 0 speedgoat_test_SN5659_R2020b_CM_double -1.7E+308 1.7E+308 /end CHARACTERISTIC
/begin CHARACTERISTIC speedgoat_test_SN5659__cal_impl.Encode1_P15_h1 "" VALUE 0x008ED568 Scalar_FLOAT64_IEEE 0 speedgoat_test_SN5659_R2020b_CM_double -1.7E+308 1.7E+308 /end CHARACTERISTIC
/begin CHARACTERISTIC speedgoat_test_SN5659__cal_impl.Encode1_P15_ka "" VALUE 0x008EC888 Scalar_FLOAT64_IEEE 0 speedgoat_test_SN5659_R2020b_CM_double -1.7E+308 1.7E+308 /end CHARACTERISTIC
/begin CHARACTERISTIC speedgoat_test_SN5659__cal_impl.Encode1_P15_kak "" VALUE 0x008EDBD8 Scalar_FLOAT64_IEEE 0 speedgoat_test_SN5659_R2020b_CM_double -1.7E+308 1.7E+308 /end CHARACTERISTIC
/begin CHARACTERISTIC speedgoat_test_SN5659__cal_impl.Encode1_P15_n "" VALUE 0x008ECEF8 Scalar_FLOAT64_IEEE 0 speedgoat_test_SN5659_R2020b_CM_double -1.7E+308 1.7E+308 /end CHARACTERISTIC
/begin CHARACTERISTIC speedgoat_test_SN5659__cal_impl.Encode1_P1_cy "" VALUE 0x008EDA80 Scalar_FLOAT64_IEEE 0 speedgoat_test_SN5659_R2020b_CM_double -1.7E+308 1.7E+308 /end CHARACTERISTIC
/begin CHARACTERISTIC speedgoat_test_SN5659__cal_impl.Encode1_P1_d "" VALUE 0x008EE0F0 Scalar_FLOAT64_IEEE 0 speedgoat_test_SN5659_R2020b_CM_double -1.7E+308 1.7E+308 /end CHARACTERISTIC
/begin CHARACTERISTIC speedgoat_test_SN5659__cal_impl.Encode1_P1_gb "" VALUE 0x008ED410 Scalar_FLOAT64_IEEE 0 speedgoat_test_SN5659_R2020b_CM_double -1.7E+308 1.7E+308 /end CHARACTERISTIC
/begin CHARACTERISTIC speedgoat_test_SN5659__cal_impl.Encode1_P1_k "" VALUE 0x008EC730 Scalar_FLOAT64_IEEE 0 speedgoat_test_SN5659_R2020b_CM_double -1.7E+308 1.7E+308 /end CHARACTERISTIC
/begin CHARACTERISTIC speedgoat_test_SN5659__cal_impl.Encode1_P1_kw "" VALUE 0x008EE760 Scalar_FLOAT64_IEEE 0 speedgoat_test_SN5659_R2020b_CM_double -1.7E+308 1.7E+308 /end CHARACTERISTIC
/begin CHARACTERISTIC speedgoat_test_SN5659__cal_impl.Encode1_P1_n "" VALUE 0x008ECDA0 Scalar_FLOAT64_IEEE 0 speedgoat_test_SN5659_R2020b_CM_double -1.7E+308 1.7E+308 /end CHARACTERISTIC
/begin CHARACTERISTIC speedgoat_test_SN5659__cal_impl.Encode1_P2_a "" VALUE 0x008EDA98 Scalar_FLOAT64_IEEE 0 speedgoat_test_SN5659_R2020b_CM_double -1.7E+308 1.7E+308 /end CHARACTERISTIC
/begin CHARACTERISTIC speedgoat_test_SN5659__cal_impl.Encode1_P2_c "" VALUE 0x008EC748 Scalar_FLOAT64_IEEE 0 speedgoat_test_SN5659_R2020b_CM_double -1.7E+308 1.7E+308 /end CHARACTERISTIC
/begin CHARACTERISTIC speedgoat_test_SN5659__cal_impl.Encode1_P2_cw "" VALUE 0x008EE108 Scalar_FLOAT64_IEEE 0 speedgoat_test_SN5659_R2020b_CM_double -1.7E+308 1.7E+308 /end CHARACTERISTIC
/begin CHARACTERISTIC speedgoat_test_SN5659__cal_impl.Encode1_P2_d "" VALUE 0x008ECDB8 Scalar_FLOAT64_IEEE 0 speedgoat_test_SN5659_R2020b_CM_double -1.7E+308 1.7E+308 /end CHARACTERISTIC
/begin CHARACTERISTIC speedgoat_test_SN5659__cal_impl.Encode1_P2_es "" VALUE 0x008ED428 Scalar_FLOAT64_IEEE 0 speedgoat_test_SN5659_R2020b_CM_double -1.7E+308 1.7E+308 /end CHARACTERISTIC
/begin CHARACTERISTIC speedgoat_test_SN5659__cal_impl.Encode1_P2_ho "" VALUE 0x008EE778 Scalar_FLOAT64_IEEE 0 speedgoat_test_SN5659_R2020b_CM_double -1.7E+308 1.7E+308 /end CHARACTERISTIC
/begin CHARACTERISTIC speedgoat_test_SN5659__cal_impl.Encode1_P3_eh "" VALUE 0x008ED440 Scalar_FLOAT64_IEEE 0 speedgoat_test_SN5659_R2020b_CM_double -1.7E+308 1.7E+308 /end CHARACTERISTIC
/begin CHARACTERISTIC speedgoat_test_SN5659__cal_impl.Encode1_P3_em "" VALUE 0x008EDAB0 Scalar_FLOAT64_IEEE 0 speedgoat_test_SN5659_R2020b_CM_double -1.7E+308 1.7E+308 /end CHARACTERISTIC
/begin CHARACTERISTIC speedgoat_test_SN5659__cal_impl.Encode1_P3_g "" VALUE 0x008EC760 Scalar_FLOAT64_IEEE 0 speedgoat_test_SN5659_R2020b_CM_double -1.7E+308 1.7E+308 /end CHARACTERISTIC
/begin CHARACTERISTIC speedgoat_test_SN5659__cal_impl.Encode1_P3_hc "" VALUE 0x008EE120 Scalar_FLOAT64_IEEE 0 speedgoat_test_SN5659_R2020b_CM_double -1.7E+308 1.7E+308 /end CHARACTERISTIC
/begin CHARACTERISTIC speedgoat_test_SN5659__cal_impl.Encode1_P3_lm "" VALUE 0x008EE790 Scalar_FLOAT64_IEEE 0 speedgoat_test_SN5659_R2020b_CM_double -1.7E+308 1.7E+308 /end CHARACTERISTIC
/begin CHARACTERISTIC speedgoat_test_SN5659__cal_impl.Encode1_P3_n "" VALUE 0x008ECDD0 Scalar_FLOAT64_IEEE 0 speedgoat_test_SN5659_R2020b_CM_double -1.7E+308 1.7E+308 /end CHARACTERISTIC
/begin CHARACTERISTIC speedgoat_test_SN5659__cal_impl.Encode1_P4_b "" VALUE 0x008ECDE8 Scalar_FLOAT64_IEEE 0 speedgoat_test_SN5659_R2020b_CM_double -1.7E+308 1.7E+308 /end CHARACTERISTIC
/begin CHARACTERISTIC speedgoat_test_SN5659__cal_impl.Encode1_P4_cs "" VALUE 0x008EE7A8 Scalar_FLOAT64_IEEE 0 speedgoat_test_SN5659_R2020b_CM_double -1.7E+308 1.7E+308 /end CHARACTERISTIC
/begin CHARACTERISTIC speedgoat_test_SN5659__cal_impl.Encode1_P4_eq "" VALUE 0x008EC778 Scalar_FLOAT64_IEEE 0 speedgoat_test_SN5659_R2020b_CM_double -1.7E+308 1.7E+308 /end CHARACTERISTIC
/begin CHARACTERISTIC speedgoat_test_SN5659__cal_impl.Encode1_P4_f "" VALUE 0x008EE138 Scalar_FLOAT64_IEEE 0 speedgoat_test_SN5659_R2020b_CM_double -1.7E+308 1.7E+308 /end CHARACTERISTIC
/begin CHARACTERISTIC speedgoat_test_SN5659__cal_impl.Encode1_P4_h "" VALUE 0x008ED458 Scalar_FLOAT64_IEEE 0 speedgoat_test_SN5659_R2020b_CM_double -1.7E+308 1.7E+308 /end CHARACTERISTIC
/begin CHARACTERISTIC speedgoat_test_SN5659__cal_impl.Encode1_P4_m "" VALUE 0x008EDAC8 Scalar_FLOAT64_IEEE 0 speedgoat_test_SN5659_R2020b_CM_double -1.7E+308 1.7E+308 /end CHARACTERISTIC
/begin CHARACTERISTIC speedgoat_test_SN5659__cal_impl.Encode1_P5_d "" VALUE 0x008ED470 Scalar_FLOAT64_IEEE 0 speedgoat_test_SN5659_R2020b_CM_double -1.7E+308 1.7E+308 /end CHARACTERISTIC
/begin CHARACTERISTIC speedgoat_test_SN5659__cal_impl.Encode1_P5_dq "" VALUE 0x008EDAE0 Scalar_FLOAT64_IEEE 0 speedgoat_test_SN5659_R2020b_CM_double -1.7E+308 1.7E+308 /end CHARACTERISTIC
/begin CHARACTERISTIC speedgoat_test_SN5659__cal_impl.Encode1_P5_gx "" VALUE 0x008ECE00 Scalar_FLOAT64_IEEE 0 speedgoat_test_SN5659_R2020b_CM_double -1.7E+308 1.7E+308 /end CHARACTERISTIC
/begin CHARACTERISTIC speedgoat_test_SN5659__cal_impl.Encode1_P5_jf "" VALUE 0x008EC790 Scalar_FLOAT64_IEEE 0 speedgoat_test_SN5659_R2020b_CM_double -1.7E+308 1.7E+308 /end CHARACTERISTIC
/begin CHARACTERISTIC speedgoat_test_SN5659__cal_impl.Encode1_P5_m "" VALUE 0x008EE7C0 Scalar_FLOAT64_IEEE 0 speedgoat_test_SN5659_R2020b_CM_double -1.7E+308 1.7E+308 /end CHARACTERISTIC
/begin CHARACTERISTIC speedgoat_test_SN5659__cal_impl.Encode1_P5_p "" VALUE 0x008EE150 Scalar_FLOAT64_IEEE 0 speedgoat_test_SN5659_R2020b_CM_double -1.7E+308 1.7E+308 /end CHARACTERISTIC
/begin CHARACTERISTIC speedgoat_test_SN5659__cal_impl.Encode1_P6_ad "" VALUE 0x008EDAF8 Scalar_FLOAT64_IEEE 0 speedgoat_test_SN5659_R2020b_CM_double -1.7E+308 1.7E+308 /end CHARACTERISTIC
/begin CHARACTERISTIC speedgoat_test_SN5659__cal_impl.Encode1_P6_am "" VALUE 0x008EE7D8 Scalar_FLOAT64_IEEE 0 speedgoat_test_SN5659_R2020b_CM_double -1.7E+308 1.7E+308 /end CHARACTERISTIC
/begin CHARACTERISTIC speedgoat_test_SN5659__cal_impl.Encode1_P6_g "" VALUE 0x008ED488 Scalar_FLOAT64_IEEE 0 speedgoat_test_SN5659_R2020b_CM_double -1.7E+308 1.7E+308 /end CHARACTERISTIC
/begin CHARACTERISTIC speedgoat_test_SN5659__cal_impl.Encode1_P6_gn "" VALUE 0x008EE168 Scalar_FLOAT64_IEEE 0 speedgoat_test_SN5659_R2020b_CM_double -1.7E+308 1.7E+308 /end CHARACTERISTIC
/begin CHARACTERISTIC speedgoat_test_SN5659__cal_impl.Encode1_P6_k "" VALUE 0x008EC7A8 Scalar_FLOAT64_IEEE 0 speedgoat_test_SN5659_R2020b_CM_double -1.7E+308 1.7E+308 /end CHARACTERISTIC
/begin CHARACTERISTIC speedgoat_test_SN5659__cal_impl.Encode1_P6_mt "" VALUE 0x008ECE18 Scalar_FLOAT64_IEEE 0 speedgoat_test_SN5659_R2020b_CM_double -1.7E+308 1.7E+308 /end CHARACTERISTIC
/begin CHARACTERISTIC speedgoat_test_SN5659__cal_impl.Encode1_P7_b3 "" VALUE 0x008EE7F0 Scalar_FLOAT64_IEEE 0 speedgoat_test_SN5659_R2020b_CM_double -1.7E+308 1.7E+308 /end CHARACTERISTIC
/begin CHARACTERISTIC speedgoat_test_SN5659__cal_impl.Encode1_P7_eo "" VALUE 0x008EDB10 Scalar_FLOAT64_IEEE 0 speedgoat_test_SN5659_R2020b_CM_double -1.7E+308 1.7E+308 /end CHARACTERISTIC
/begin CHARACTERISTIC speedgoat_test_SN5659__cal_impl.Encode1_P7_h "" VALUE 0x008EE180 Scalar_FLOAT64_IEEE 0 speedgoat_test_SN5659_R2020b_CM_double -1.7E+308 1.7E+308 /end CHARACTERISTIC
/begin CHARACTERISTIC speedgoat_test_SN5659__cal_impl.Encode1_P7_k "" VALUE 0x008ECE30 Scalar_FLOAT64_IEEE 0 speedgoat_test_SN5659_R2020b_CM_double -1.7E+308 1.7E+308 /end CHARACTERISTIC
/begin CHARACTERISTIC speedgoat_test_SN5659__cal_impl.Encode1_P7_n "" VALUE 0x008ED4A0 Scalar_FLOAT64_IEEE 0 speedgoat_test_SN5659_R2020b_CM_double -1.7E+308 1.7E+308 /end CHARACTERISTIC
/begin CHARACTERISTIC speedgoat_test_SN5659__cal_impl.Encode1_P7_p "" VALUE 0x008EC7C0 Scalar_FLOAT64_IEEE 0 speedgoat_test_SN5659_R2020b_CM_double -1.7E+308 1.7E+308 /end CHARACTERISTIC
/begin CHARACTERISTIC speedgoat_test_SN5659__cal_impl.Encode1_P8_bi "" VALUE 0x008EE198 Scalar_FLOAT64_IEEE 0 speedgoat_test_SN5659_R2020b_CM_double -1.7E+308 1.7E+308 /end CHARACTERISTIC
/begin CHARACTERISTIC speedgoat_test_SN5659__cal_impl.Encode1_P8_bu "" VALUE 0x008ECE48 Scalar_FLOAT64_IEEE 0 speedgoat_test_SN5659_R2020b_CM_double -1.7E+308 1.7E+308 /end CHARACTERISTIC
/begin CHARACTERISTIC speedgoat_test_SN5659__cal_impl.Encode1_P8_cc "" VALUE 0x008ED4B8 Scalar_FLOAT64_IEEE 0 speedgoat_test_SN5659_R2020b_CM_double -1.7E+308 1.7E+308 /end CHARACTERISTIC
/begin CHARACTERISTIC speedgoat_test_SN5659__cal_impl.Encode1_P8_j "" VALUE 0x008EE808 Scalar_FLOAT64_IEEE 0 speedgoat_test_SN5659_R2020b_CM_double -1.7E+308 1.7E+308 /end CHARACTERISTIC
/begin CHARACTERISTIC speedgoat_test_SN5659__cal_impl.Encode1_P8_n "" VALUE 0x008EDB28 Scalar_FLOAT64_IEEE 0 speedgoat_test_SN5659_R2020b_CM_double -1.7E+308 1.7E+308 /end CHARACTERISTIC
/begin CHARACTERISTIC speedgoat_test_SN5659__cal_impl.Encode1_P8_o "" VALUE 0x008EC7D8 Scalar_FLOAT64_IEEE 0 speedgoat_test_SN5659_R2020b_CM_double -1.7E+308 1.7E+308 /end CHARACTERISTIC
/begin CHARACTERISTIC speedgoat_test_SN5659__cal_impl.Encode1_P9_a2 "" VALUE 0x008EDB40 Scalar_FLOAT64_IEEE 0 speedgoat_test_SN5659_R2020b_CM_double -1.7E+308 1.7E+308 /end CHARACTERISTIC
/begin CHARACTERISTIC speedgoat_test_SN5659__cal_impl.Encode1_P9_f "" VALUE 0x008ED4D0 Scalar_FLOAT64_IEEE 0 speedgoat_test_SN5659_R2020b_CM_double -1.7E+308 1.7E+308 /end CHARACTERISTIC
/begin CHARACTERISTIC speedgoat_test_SN5659__cal_impl.Encode1_P9_h "" VALUE 0x008EC7F0 Scalar_FLOAT64_IEEE 0 speedgoat_test_SN5659_R2020b_CM_double -1.7E+308 1.7E+308 /end CHARACTERISTIC
/begin CHARACTERISTIC speedgoat_test_SN5659__cal_impl.Encode1_P9_i "" VALUE 0x008EE1B0 Scalar_FLOAT64_IEEE 0 speedgoat_test_SN5659_R2020b_CM_double -1.7E+308 1.7E+308 /end CHARACTERISTIC
/begin CHARACTERISTIC speedgoat_test_SN5659__cal_impl.Encode1_P9_ju "" VALUE 0x008ECE60 Scalar_FLOAT64_IEEE 0 speedgoat_test_SN5659_R2020b_CM_double -1.7E+308 1.7E+308 /end CHARACTERISTIC
/begin CHARACTERISTIC speedgoat_test_SN5659__cal_impl.Encode1_P9_oc "" VALUE 0x008EE820 Scalar_FLOAT64_IEEE 0 speedgoat_test_SN5659_R2020b_CM_double -1.7E+308 1.7E+308 /end CHARACTERISTIC
/begin CHARACTERISTIC speedgoat_test_SN5659__cal_impl.Encode2_P10_ab0 "" VALUE 0x008EC978 Scalar_FLOAT64_IEEE 0 speedgoat_test_SN5659_R2020b_CM_double -1.7E+308 1.7E+308 /end CHARACTERISTIC
/begin CHARACTERISTIC speedgoat_test_SN5659__cal_impl.Encode2_P10_d "" VALUE 0x008ED658 Scalar_FLOAT64_IEEE 0 speedgoat_test_SN5659_R2020b_CM_double -1.7E+308 1.7E+308 /end CHARACTERISTIC
/begin CHARACTERISTIC speedgoat_test_SN5659__cal_impl.Encode2_P10_dc "" VALUE 0x008EDCC8 Scalar_FLOAT64_IEEE 0 speedgoat_test_SN5659_R2020b_CM_double -1.7E+308 1.7E+308 /end CHARACTERISTIC
/begin CHARACTERISTIC speedgoat_test_SN5659__cal_impl.Encode2_P10_dz "" VALUE 0x008EECD8 Scalar_FLOAT64_IEEE 0 speedgoat_test_SN5659_R2020b_CM_double -1.7E+308 1.7E+308 /end CHARACTERISTIC
/begin CHARACTERISTIC speedgoat_test_SN5659__cal_impl.Encode2_P10_im "" VALUE 0x008ED318 Scalar_FLOAT64_IEEE 0 speedgoat_test_SN5659_R2020b_CM_double -1.7E+308 1.7E+308 /end CHARACTERISTIC
/begin CHARACTERISTIC speedgoat_test_SN5659__cal_impl.Encode2_P10_og "" VALUE 0x008EE338 Scalar_FLOAT64_IEEE 0 speedgoat_test_SN5659_R2020b_CM_double -1.7E+308 1.7E+308 /end CHARACTERISTIC
/begin CHARACTERISTIC speedgoat_test_SN5659__cal_impl.Encode2_P11_b "" VAL_BLK 0x008ED670 Scalar_FLOAT64_IEEE 0 speedgoat_test_SN5659_R2020b_CM_double -1.7E+308 1.7E+308 MATRIX_DIM 2 1 /end CHARACTERISTIC
/begin CHARACTERISTIC speedgoat_test_SN5659__cal_impl.Encode2_P11_df "" VAL_BLK 0x008EE350 Scalar_FLOAT64_IEEE 0 speedgoat_test_SN5659_R2020b_CM_double -1.7E+308 1.7E+308 MATRIX_DIM 2 1 /end CHARACTERISTIC
/begin CHARACTERISTIC speedgoat_test_SN5659__cal_impl.Encode2_P11_dm "" VAL_BLK 0x008EECF0 Scalar_FLOAT64_IEEE 0 speedgoat_test_SN5659_R2020b_CM_double -1.7E+308 1.7E+308 MATRIX_DIM 2 1 /end CHARACTERISTIC
/begin CHARACTERISTIC speedgoat_test_SN5659__cal_impl.Encode2_P11_hq "" VAL_BLK 0x008EDCE0 Scalar_FLOAT64_IEEE 0 speedgoat_test_SN5659_R2020b_CM_double -1.7E+308 1.7E+308 MATRIX_DIM 2 1 /end CHARACTERISTIC
/begin CHARACTERISTIC speedgoat_test_SN5659__cal_impl.Encode2_P11_o "" VAL_BLK 0x008ED330 Scalar_FLOAT64_IEEE 0 speedgoat_test_SN5659_R2020b_CM_double -1.7E+308 1.7E+308 MATRIX_DIM 2 1 /end CHARACTERISTIC
/begin CHARACTERISTIC speedgoat_test_SN5659__cal_impl.Encode2_P11_p "" VAL_BLK 0x008EC990 Scalar_FLOAT64_IEEE 0 speedgoat_test_SN5659_R2020b_CM_double -1.7E+308 1.7E+308 MATRIX_DIM 2 1 /end CHARACTERISTIC
/begin CHARACTERISTIC speedgoat_test_SN5659__cal_impl.Encode2_P12_c "" VALUE 0x008EC9B0 Scalar_FLOAT64_IEEE 0 speedgoat_test_SN5659_R2020b_CM_double -1.7E+308 1.7E+308 /end CHARACTERISTIC
/begin CHARACTERISTIC speedgoat_test_SN5659__cal_impl.Encode2_P12_ek "" VALUE 0x008EDD00 Scalar_FLOAT64_IEEE 0 speedgoat_test_SN5659_R2020b_CM_double -1.7E+308 1.7E+308 /end CHARACTERISTIC
/begin CHARACTERISTIC speedgoat_test_SN5659__cal_impl.Encode2_P12_j "" VALUE 0x008EED10 Scalar_FLOAT64_IEEE 0 speedgoat_test_SN5659_R2020b_CM_double -1.7E+308 1.7E+308 /end CHARACTERISTIC
/begin CHARACTERISTIC speedgoat_test_SN5659__cal_impl.Encode2_P12_k3 "" VALUE 0x008ED350 Scalar_FLOAT64_IEEE 0 speedgoat_test_SN5659_R2020b_CM_double -1.7E+308 1.7E+308 /end CHARACTERISTIC
/begin CHARACTERISTIC speedgoat_test_SN5659__cal_impl.Encode2_P12_l "" VALUE 0x008EE370 Scalar_FLOAT64_IEEE 0 speedgoat_test_SN5659_R2020b_CM_double -1.7E+308 1.7E+308 /end CHARACTERISTIC
/begin CHARACTERISTIC speedgoat_test_SN5659__cal_impl.Encode2_P12_mp "" VALUE 0x008ED690 Scalar_FLOAT64_IEEE 0 speedgoat_test_SN5659_R2020b_CM_double -1.7E+308 1.7E+308 /end CHARACTERISTIC
/begin CHARACTERISTIC speedgoat_test_SN5659__cal_impl.Encode2_P13_a "" VALUE 0x008EC9C8 Scalar_FLOAT64_IEEE 0 speedgoat_test_SN5659_R2020b_CM_double -1.7E+308 1.7E+308 /end CHARACTERISTIC
/begin CHARACTERISTIC speedgoat_test_SN5659__cal_impl.Encode2_P13_b "" VALUE 0x008ED6A8 Scalar_FLOAT64_IEEE 0 speedgoat_test_SN5659_R2020b_CM_double -1.7E+308 1.7E+308 /end CHARACTERISTIC
/begin CHARACTERISTIC speedgoat_test_SN5659__cal_impl.Encode2_P13_g "" VALUE 0x008EED28 Scalar_FLOAT64_IEEE 0 speedgoat_test_SN5659_R2020b_CM_double -1.7E+308 1.7E+308 /end CHARACTERISTIC
/begin CHARACTERISTIC speedgoat_test_SN5659__cal_impl.Encode2_P13_m "" VALUE 0x008ED368 Scalar_FLOAT64_IEEE 0 speedgoat_test_SN5659_R2020b_CM_double -1.7E+308 1.7E+308 /end CHARACTERISTIC
/begin CHARACTERISTIC speedgoat_test_SN5659__cal_impl.Encode2_P13_ol "" VALUE 0x008EE388 Scalar_FLOAT64_IEEE 0 speedgoat_test_SN5659_R2020b_CM_double -1.7E+308 1.7E+308 /end CHARACTERISTIC
/begin CHARACTERISTIC speedgoat_test_SN5659__cal_impl.Encode2_P13_oo "" VALUE 0x008EDD18 Scalar_FLOAT64_IEEE 0 speedgoat_test_SN5659_R2020b_CM_double -1.7E+308 1.7E+308 /end CHARACTERISTIC
/begin CHARACTERISTIC speedgoat_test_SN5659__cal_impl.Encode2_P14_db "" VALUE 0x008EC9E0 Scalar_FLOAT64_IEEE 0 speedgoat_test_SN5659_R2020b_CM_double -1.7E+308 1.7E+308 /end CHARACTERISTIC
/begin CHARACTERISTIC speedgoat_test_SN5659__cal_impl.Encode2_P14_dr "" VALUE 0x008EE3A0 Scalar_FLOAT64_IEEE 0 speedgoat_test_SN5659_R2020b_CM_double -1.7E+308 1.7E+308 /end CHARACTERISTIC
/begin CHARACTERISTIC speedgoat_test_SN5659__cal_impl.Encode2_P14_h "" VALUE 0x008ED6C0 Scalar_FLOAT64_IEEE 0 speedgoat_test_SN5659_R2020b_CM_double -1.7E+308 1.7E+308 /end CHARACTERISTIC
/begin CHARACTERISTIC speedgoat_test_SN5659__cal_impl.Encode2_P14_hh "" VALUE 0x008EED40 Scalar_FLOAT64_IEEE 0 speedgoat_test_SN5659_R2020b_CM_double -1.7E+308 1.7E+308 /end CHARACTERISTIC
/begin CHARACTERISTIC speedgoat_test_SN5659__cal_impl.Encode2_P14_j "" VALUE 0x008EDD30 Scalar_FLOAT64_IEEE 0 speedgoat_test_SN5659_R2020b_CM_double -1.7E+308 1.7E+308 /end CHARACTERISTIC
/begin CHARACTERISTIC speedgoat_test_SN5659__cal_impl.Encode2_P14_k "" VALUE 0x008ED380 Scalar_FLOAT64_IEEE 0 speedgoat_test_SN5659_R2020b_CM_double -1.7E+308 1.7E+308 /end CHARACTERISTIC
/begin CHARACTERISTIC speedgoat_test_SN5659__cal_impl.Encode2_P15_a "" VALUE 0x008EC9F8 Scalar_FLOAT64_IEEE 0 speedgoat_test_SN5659_R2020b_CM_double -1.7E+308 1.7E+308 /end CHARACTERISTIC
/begin CHARACTERISTIC speedgoat_test_SN5659__cal_impl.Encode2_P15_d "" VALUE 0x008ED6D8 Scalar_FLOAT64_IEEE 0 speedgoat_test_SN5659_R2020b_CM_double -1.7E+308 1.7E+308 /end CHARACTERISTIC
/begin CHARACTERISTIC speedgoat_test_SN5659__cal_impl.Encode2_P15_e1 "" VALUE 0x008ED398 Scalar_FLOAT64_IEEE 0 speedgoat_test_SN5659_R2020b_CM_double -1.7E+308 1.7E+308 /end CHARACTERISTIC
/begin CHARACTERISTIC speedgoat_test_SN5659__cal_impl.Encode2_P15_f "" VALUE 0x008EE3B8 Scalar_FLOAT64_IEEE 0 speedgoat_test_SN5659_R2020b_CM_double -1.7E+308 1.7E+308 /end CHARACTERISTIC
/begin CHARACTERISTIC speedgoat_test_SN5659__cal_impl.Encode2_P15_km "" VALUE 0x008EED58 Scalar_FLOAT64_IEEE 0 speedgoat_test_SN5659_R2020b_CM_double -1.7E+308 1.7E+308 /end CHARACTERISTIC
/begin CHARACTERISTIC speedgoat_test_SN5659__cal_impl.Encode2_P15_n "" VALUE 0x008EDD48 Scalar_FLOAT64_IEEE 0 speedgoat_test_SN5659_R2020b_CM_double -1.7E+308 1.7E+308 /end CHARACTERISTIC
/begin CHARACTERISTIC speedgoat_test_SN5659__cal_impl.Encode2_P1_b "" VALUE 0x008ED240 Scalar_FLOAT64_IEEE 0 speedgoat_test_SN5659_R2020b_CM_double -1.7E+308 1.7E+308 /end CHARACTERISTIC
/begin CHARACTERISTIC speedgoat_test_SN5659__cal_impl.Encode2_P1_bc "" VALUE 0x008EEC00 Scalar_FLOAT64_IEEE 0 speedgoat_test_SN5659_R2020b_CM_double -1.7E+308 1.7E+308 /end CHARACTERISTIC
/begin CHARACTERISTIC speedgoat_test_SN5659__cal_impl.Encode2_P1_f "" VALUE 0x008EC8A0 Scalar_FLOAT64_IEEE 0 speedgoat_test_SN5659_R2020b_CM_double -1.7E+308 1.7E+308 /end CHARACTERISTIC
/begin CHARACTERISTIC speedgoat_test_SN5659__cal_impl.Encode2_P1_ga "" VALUE 0x008ED580 Scalar_FLOAT64_IEEE 0 speedgoat_test_SN5659_R2020b_CM_double -1.7E+308 1.7E+308 /end CHARACTERISTIC
/begin CHARACTERISTIC speedgoat_test_SN5659__cal_impl.Encode2_P1_i "" VALUE 0x008EE260 Scalar_FLOAT64_IEEE 0 speedgoat_test_SN5659_R2020b_CM_double -1.7E+308 1.7E+308 /end CHARACTERISTIC
/begin CHARACTERISTIC speedgoat_test_SN5659__cal_impl.Encode2_P1_o "" VALUE 0x008EDBF0 Scalar_FLOAT64_IEEE 0 speedgoat_test_SN5659_R2020b_CM_double -1.7E+308 1.7E+308 /end CHARACTERISTIC
/begin CHARACTERISTIC speedgoat_test_SN5659__cal_impl.Encode2_P2_di "" VALUE 0x008ED258 Scalar_FLOAT64_IEEE 0 speedgoat_test_SN5659_R2020b_CM_double -1.7E+308 1.7E+308 /end CHARACTERISTIC
/begin CHARACTERISTIC speedgoat_test_SN5659__cal_impl.Encode2_P2_g "" VALUE 0x008EDC08 Scalar_FLOAT64_IEEE 0 speedgoat_test_SN5659_R2020b_CM_double -1.7E+308 1.7E+308 /end CHARACTERISTIC
/begin CHARACTERISTIC speedgoat_test_SN5659__cal_impl.Encode2_P2_gi "" VALUE 0x008EE278 Scalar_FLOAT64_IEEE 0 speedgoat_test_SN5659_R2020b_CM_double -1.7E+308 1.7E+308 /end CHARACTERISTIC
/begin CHARACTERISTIC speedgoat_test_SN5659__cal_impl.Encode2_P2_hl "" VALUE 0x008EEC18 Scalar_FLOAT64_IEEE 0 speedgoat_test_SN5659_R2020b_CM_double -1.7E+308 1.7E+308 /end CHARACTERISTIC
/begin CHARACTERISTIC speedgoat_test_SN5659__cal_impl.Encode2_P2_ka "" VALUE 0x008ED598 Scalar_FLOAT64_IEEE 0 speedgoat_test_SN5659_R2020b_CM_double -1.7E+308 1.7E+308 /end CHARACTERISTIC
/begin CHARACTERISTIC speedgoat_test_SN5659__cal_impl.Encode2_P2_kra "" VALUE 0x008EC8B8 Scalar_FLOAT64_IEEE 0 speedgoat_test_SN5659_R2020b_CM_double -1.7E+308 1.7E+308 /end CHARACTERISTIC
/begin CHARACTERISTIC speedgoat_test_SN5659__cal_impl.Encode2_P3_d "" VALUE 0x008EC8D0 Scalar_FLOAT64_IEEE 0 speedgoat_test_SN5659_R2020b_CM_double -1.7E+308 1.7E+308 /end CHARACTERISTIC
/begin CHARACTERISTIC speedgoat_test_SN5659__cal_impl.Encode2_P3_dm "" VALUE 0x008EEC30 Scalar_FLOAT64_IEEE 0 speedgoat_test_SN5659_R2020b_CM_double -1.7E+308 1.7E+308 /end CHARACTERISTIC
/begin CHARACTERISTIC speedgoat_test_SN5659__cal_impl.Encode2_P3_fe "" VALUE 0x008ED5B0 Scalar_FLOAT64_IEEE 0 speedgoat_test_SN5659_R2020b_CM_double -1.7E+308 1.7E+308 /end CHARACTERISTIC
/begin CHARACTERISTIC speedgoat_test_SN5659__cal_impl.Encode2_P3_kx "" VALUE 0x008EDC20 Scalar_FLOAT64_IEEE 0 speedgoat_test_SN5659_R2020b_CM_double -1.7E+308 1.7E+308 /end CHARACTERISTIC
/begin CHARACTERISTIC speedgoat_test_SN5659__cal_impl.Encode2_P3_ln "" VALUE 0x008ED270 Scalar_FLOAT64_IEEE 0 speedgoat_test_SN5659_R2020b_CM_double -1.7E+308 1.7E+308 /end CHARACTERISTIC
/begin CHARACTERISTIC speedgoat_test_SN5659__cal_impl.Encode2_P3_oj "" VALUE 0x008EE290 Scalar_FLOAT64_IEEE 0 speedgoat_test_SN5659_R2020b_CM_double -1.7E+308 1.7E+308 /end CHARACTERISTIC
/begin CHARACTERISTIC speedgoat_test_SN5659__cal_impl.Encode2_P4_a "" VALUE 0x008EDC38 Scalar_FLOAT64_IEEE 0 speedgoat_test_SN5659_R2020b_CM_double -1.7E+308 1.7E+308 /end CHARACTERISTIC
/begin CHARACTERISTIC speedgoat_test_SN5659__cal_impl.Encode2_P4_lk "" VALUE 0x008ED5C8 Scalar_FLOAT64_IEEE 0 speedgoat_test_SN5659_R2020b_CM_double -1.7E+308 1.7E+308 /end CHARACTERISTIC
/begin CHARACTERISTIC speedgoat_test_SN5659__cal_impl.Encode2_P4_lw "" VALUE 0x008EC8E8 Scalar_FLOAT64_IEEE 0 speedgoat_test_SN5659_R2020b_CM_double -1.7E+308 1.7E+308 /end CHARACTERISTIC
/begin CHARACTERISTIC speedgoat_test_SN5659__cal_impl.Encode2_P4_n "" VALUE 0x008ED288 Scalar_FLOAT64_IEEE 0 speedgoat_test_SN5659_R2020b_CM_double -1.7E+308 1.7E+308 /end CHARACTERISTIC
/begin CHARACTERISTIC speedgoat_test_SN5659__cal_impl.Encode2_P4_nt "" VALUE 0x008EE2A8 Scalar_FLOAT64_IEEE 0 speedgoat_test_SN5659_R2020b_CM_double -1.7E+308 1.7E+308 /end CHARACTERISTIC
/begin CHARACTERISTIC speedgoat_test_SN5659__cal_impl.Encode2_P4_ny "" VALUE 0x008EEC48 Scalar_FLOAT64_IEEE 0 speedgoat_test_SN5659_R2020b_CM_double -1.7E+308 1.7E+308 /end CHARACTERISTIC
/begin CHARACTERISTIC speedgoat_test_SN5659__cal_impl.Encode2_P5_a "" VALUE 0x008ED2A0 Scalar_FLOAT64_IEEE 0 speedgoat_test_SN5659_R2020b_CM_double -1.7E+308 1.7E+308 /end CHARACTERISTIC
/begin CHARACTERISTIC speedgoat_test_SN5659__cal_impl.Encode2_P5_af "" VALUE 0x008EE2C0 Scalar_FLOAT64_IEEE 0 speedgoat_test_SN5659_R2020b_CM_double -1.7E+308 1.7E+308 /end CHARACTERISTIC
/begin CHARACTERISTIC speedgoat_test_SN5659__cal_impl.Encode2_P5_im "" VALUE 0x008EEC60 Scalar_FLOAT64_IEEE 0 speedgoat_test_SN5659_R2020b_CM_double -1.7E+308 1.7E+308 /end CHARACTERISTIC
/begin CHARACTERISTIC speedgoat_test_SN5659__cal_impl.Encode2_P5_mc "" VALUE 0x008EC900 Scalar_FLOAT64_IEEE 0 speedgoat_test_SN5659_R2020b_CM_double -1.7E+308 1.7E+308 /end CHARACTERISTIC
/begin CHARACTERISTIC speedgoat_test_SN5659__cal_impl.Encode2_P5_n "" VALUE 0x008ED5E0 Scalar_FLOAT64_IEEE 0 speedgoat_test_SN5659_R2020b_CM_double -1.7E+308 1.7E+308 /end CHARACTERISTIC
/begin CHARACTERISTIC speedgoat_test_SN5659__cal_impl.Encode2_P5_pz "" VALUE 0x008EDC50 Scalar_FLOAT64_IEEE 0 speedgoat_test_SN5659_R2020b_CM_double -1.7E+308 1.7E+308 /end CHARACTERISTIC
/begin CHARACTERISTIC speedgoat_test_SN5659__cal_impl.Encode2_P6_c "" VALUE 0x008ED2B8 Scalar_FLOAT64_IEEE 0 speedgoat_test_SN5659_R2020b_CM_double -1.7E+308 1.7E+308 /end CHARACTERISTIC
/begin CHARACTERISTIC speedgoat_test_SN5659__cal_impl.Encode2_P6_f "" VALUE 0x008EC918 Scalar_FLOAT64_IEEE 0 speedgoat_test_SN5659_R2020b_CM_double -1.7E+308 1.7E+308 /end CHARACTERISTIC
/begin CHARACTERISTIC speedgoat_test_SN5659__cal_impl.Encode2_P6_fn "" VALUE 0x008ED5F8 Scalar_FLOAT64_IEEE 0 speedgoat_test_SN5659_R2020b_CM_double -1.7E+308 1.7E+308 /end CHARACTERISTIC
/begin CHARACTERISTIC speedgoat_test_SN5659__cal_impl.Encode2_P6_g "" VALUE 0x008EEC78 Scalar_FLOAT64_IEEE 0 speedgoat_test_SN5659_R2020b_CM_double -1.7E+308 1.7E+308 /end CHARACTERISTIC
/begin CHARACTERISTIC speedgoat_test_SN5659__cal_impl.Encode2_P6_k "" VALUE 0x008EDC68 Scalar_FLOAT64_IEEE 0 speedgoat_test_SN5659_R2020b_CM_double -1.7E+308 1.7E+308 /end CHARACTERISTIC
/begin CHARACTERISTIC speedgoat_test_SN5659__cal_impl.Encode2_P6_ny "" VALUE 0x008EE2D8 Scalar_FLOAT64_IEEE 0 speedgoat_test_SN5659_R2020b_CM_double -1.7E+308 1.7E+308 /end CHARACTERISTIC
/begin CHARACTERISTIC speedgoat_test_SN5659__cal_impl.Encode2_P7_g "" VALUE 0x008EE2F0 Scalar_FLOAT64_IEEE 0 speedgoat_test_SN5659_R2020b_CM_double -1.7E+308 1.7E+308 /end CHARACTERISTIC
/begin CHARACTERISTIC speedgoat_test_SN5659__cal_impl.Encode2_P7_iq "" VALUE 0x008ED2D0 Scalar_FLOAT64_IEEE 0 speedgoat_test_SN5659_R2020b_CM_double -1.7E+308 1.7E+308 /end CHARACTERISTIC
/begin CHARACTERISTIC speedgoat_test_SN5659__cal_impl.Encode2_P7_jb "" VALUE 0x008ED610 Scalar_FLOAT64_IEEE 0 speedgoat_test_SN5659_R2020b_CM_double -1.7E+308 1.7E+308 /end CHARACTERISTIC
/begin CHARACTERISTIC speedgoat_test_SN5659__cal_impl.Encode2_P7_k5 "" VALUE 0x008EEC90 Scalar_FLOAT64_IEEE 0 speedgoat_test_SN5659_R2020b_CM_double -1.7E+308 1.7E+308 /end CHARACTERISTIC
/begin CHARACTERISTIC speedgoat_test_SN5659__cal_impl.Encode2_P7_oo "" VALUE 0x008EC930 Scalar_FLOAT64_IEEE 0 speedgoat_test_SN5659_R2020b_CM_double -1.7E+308 1.7E+308 /end CHARACTERISTIC
/begin CHARACTERISTIC speedgoat_test_SN5659__cal_impl.Encode2_P7_p "" VALUE 0x008EDC80 Scalar_FLOAT64_IEEE 0 speedgoat_test_SN5659_R2020b_CM_double -1.7E+308 1.7E+308 /end CHARACTERISTIC
/begin CHARACTERISTIC speedgoat_test_SN5659__cal_impl.Encode2_P8_a "" VALUE 0x008EC948 Scalar_FLOAT64_IEEE 0 speedgoat_test_SN5659_R2020b_CM_double -1.7E+308 1.7E+308 /end CHARACTERISTIC
/begin CHARACTERISTIC speedgoat_test_SN5659__cal_impl.Encode2_P8_b "" VALUE 0x008ED2E8 Scalar_FLOAT64_IEEE 0 speedgoat_test_SN5659_R2020b_CM_double -1.7E+308 1.7E+308 /end CHARACTERISTIC
/begin CHARACTERISTIC speedgoat_test_SN5659__cal_impl.Encode2_P8_hl "" VALUE 0x008ED628 Scalar_FLOAT64_IEEE 0 speedgoat_test_SN5659_R2020b_CM_double -1.7E+308 1.7E+308 /end CHARACTERISTIC
/begin CHARACTERISTIC speedgoat_test_SN5659__cal_impl.Encode2_P8_ig "" VALUE 0x008EECA8 Scalar_FLOAT64_IEEE 0 speedgoat_test_SN5659_R2020b_CM_double -1.7E+308 1.7E+308 /end CHARACTERISTIC
/begin CHARACTERISTIC speedgoat_test_SN5659__cal_impl.Encode2_P8_ip "" VALUE 0x008EDC98 Scalar_FLOAT64_IEEE 0 speedgoat_test_SN5659_R2020b_CM_double -1.7E+308 1.7E+308 /end CHARACTERISTIC
/begin CHARACTERISTIC speedgoat_test_SN5659__cal_impl.Encode2_P8_m "" VALUE 0x008EE308 Scalar_FLOAT64_IEEE 0 speedgoat_test_SN5659_R2020b_CM_double -1.7E+308 1.7E+308 /end CHARACTERISTIC
/begin CHARACTERISTIC speedgoat_test_SN5659__cal_impl.Encode2_P9_dn "" VALUE 0x008ED640 Scalar_FLOAT64_IEEE 0 speedgoat_test_SN5659_R2020b_CM_double -1.7E+308 1.7E+308 /end CHARACTERISTIC
/begin CHARACTERISTIC speedgoat_test_SN5659__cal_impl.Encode2_P9_f "" VALUE 0x008EE320 Scalar_FLOAT64_IEEE 0 speedgoat_test_SN5659_R2020b_CM_double -1.7E+308 1.7E+308 /end CHARACTERISTIC
/begin CHARACTERISTIC speedgoat_test_SN5659__cal_impl.Encode2_P9_g "" VALUE 0x008EECC0 Scalar_FLOAT64_IEEE 0 speedgoat_test_SN5659_R2020b_CM_double -1.7E+308 1.7E+308 /end CHARACTERISTIC
/begin CHARACTERISTIC speedgoat_test_SN5659__cal_impl.Encode2_P9_hv "" VALUE 0x008EDCB0 Scalar_FLOAT64_IEEE 0 speedgoat_test_SN5659_R2020b_CM_double -1.7E+308 1.7E+308 /end CHARACTERISTIC
/begin CHARACTERISTIC speedgoat_test_SN5659__cal_impl.Encode2_P9_l "" VALUE 0x008ED300 Scalar_FLOAT64_IEEE 0 speedgoat_test_SN5659_R2020b_CM_double -1.7E+308 1.7E+308 /end CHARACTERISTIC
/begin CHARACTERISTIC speedgoat_test_SN5659__cal_impl.Encode2_P9_ni "" VALUE 0x008EC960 Scalar_FLOAT64_IEEE 0 speedgoat_test_SN5659_R2020b_CM_double -1.7E+308 1.7E+308 /end CHARACTERISTIC
/begin CHARACTERISTIC speedgoat_test_SN5659__cal_impl.Encode3_P10_f "" VALUE 0x008ED190 Scalar_FLOAT64_IEEE 0 speedgoat_test_SN5659_R2020b_CM_double -1.7E+308 1.7E+308 /end CHARACTERISTIC
/begin CHARACTERISTIC speedgoat_test_SN5659__cal_impl.Encode3_P10_g "" VALUE 0x008ED800 Scalar_FLOAT64_IEEE 0 speedgoat_test_SN5659_R2020b_CM_double -1.7E+308 1.7E+308 /end CHARACTERISTIC
/begin CHARACTERISTIC speedgoat_test_SN5659__cal_impl.Encode3_P10_k "" VALUE 0x008EE4E0 Scalar_FLOAT64_IEEE 0 speedgoat_test_SN5659_R2020b_CM_double -1.7E+308 1.7E+308 /end CHARACTERISTIC
/begin CHARACTERISTIC speedgoat_test_SN5659__cal_impl.Encode3_P10_l15 "" VALUE 0x008EEB50 Scalar_FLOAT64_IEEE 0 speedgoat_test_SN5659_R2020b_CM_double -1.7E+308 1.7E+308 /end CHARACTERISTIC
/begin CHARACTERISTIC speedgoat_test_SN5659__cal_impl.Encode3_P10_od "" VALUE 0x008ECB20 Scalar_FLOAT64_IEEE 0 speedgoat_test_SN5659_R2020b_CM_double -1.7E+308 1.7E+308 /end CHARACTERISTIC
/begin CHARACTERISTIC speedgoat_test_SN5659__cal_impl.Encode3_P10_oe "" VALUE 0x008EDE70 Scalar_FLOAT64_IEEE 0 speedgoat_test_SN5659_R2020b_CM_double -1.7E+308 1.7E+308 /end CHARACTERISTIC
/begin CHARACTERISTIC speedgoat_test_SN5659__cal_impl.Encode3_P11_a "" VAL_BLK 0x008EDE88 Scalar_FLOAT64_IEEE 0 speedgoat_test_SN5659_R2020b_CM_double -1.7E+308 1.7E+308 MATRIX_DIM 2 1 /end CHARACTERISTIC
/begin CHARACTERISTIC speedgoat_test_SN5659__cal_impl.Encode3_P11_ic "" VAL_BLK 0x008ED1A8 Scalar_FLOAT64_IEEE 0 speedgoat_test_SN5659_R2020b_CM_double -1.7E+308 1.7E+308 MATRIX_DIM 2 1 /end CHARACTERISTIC
/begin CHARACTERISTIC speedgoat_test_SN5659__cal_impl.Encode3_P11_jg "" VAL_BLK 0x008EEB68 Scalar_FLOAT64_IEEE 0 speedgoat_test_SN5659_R2020b_CM_double -1.7E+308 1.7E+308 MATRIX_DIM 2 1 /end CHARACTERISTIC
/begin CHARACTERISTIC speedgoat_test_SN5659__cal_impl.Encode3_P11_lg "" VAL_BLK 0x008EE4F8 Scalar_FLOAT64_IEEE 0 speedgoat_test_SN5659_R2020b_CM_double -1.7E+308 1.7E+308 MATRIX_DIM 2 1 /end CHARACTERISTIC
/begin CHARACTERISTIC speedgoat_test_SN5659__cal_impl.Encode3_P11_o "" VAL_BLK 0x008ECB38 Scalar_FLOAT64_IEEE 0 speedgoat_test_SN5659_R2020b_CM_double -1.7E+308 1.7E+308 MATRIX_DIM 2 1 /end CHARACTERISTIC
/begin CHARACTERISTIC speedgoat_test_SN5659__cal_impl.Encode3_P11_ox "" VAL_BLK 0x008ED818 Scalar_FLOAT64_IEEE 0 speedgoat_test_SN5659_R2020b_CM_double -1.7E+308 1.7E+308 MATRIX_DIM 2 1 /end CHARACTERISTIC
/begin CHARACTERISTIC speedgoat_test_SN5659__cal_impl.Encode3_P12_a "" VALUE 0x008EE518 Scalar_FLOAT64_IEEE 0 speedgoat_test_SN5659_R2020b_CM_double -1.7E+308 1.7E+308 /end CHARACTERISTIC
/begin CHARACTERISTIC speedgoat_test_SN5659__cal_impl.Encode3_P12_d3 "" VALUE 0x008ED838 Scalar_FLOAT64_IEEE 0 speedgoat_test_SN5659_R2020b_CM_double -1.7E+308 1.7E+308 /end CHARACTERISTIC
/begin CHARACTERISTIC speedgoat_test_SN5659__cal_impl.Encode3_P12_et "" VALUE 0x008EDEA8 Scalar_FLOAT64_IEEE 0 speedgoat_test_SN5659_R2020b_CM_double -1.7E+308 1.7E+308 /end CHARACTERISTIC
/begin CHARACTERISTIC speedgoat_test_SN5659__cal_impl.Encode3_P12_f "" VALUE 0x008ECB58 Scalar_FLOAT64_IEEE 0 speedgoat_test_SN5659_R2020b_CM_double -1.7E+308 1.7E+308 /end CHARACTERISTIC
/begin CHARACTERISTIC speedgoat_test_SN5659__cal_impl.Encode3_P12_m "" VALUE 0x008ED1C8 Scalar_FLOAT64_IEEE 0 speedgoat_test_SN5659_R2020b_CM_double -1.7E+308 1.7E+308 /end CHARACTERISTIC
/begin CHARACTERISTIC speedgoat_test_SN5659__cal_impl.Encode3_P12_n "" VALUE 0x008EEB88 Scalar_FLOAT64_IEEE 0 speedgoat_test_SN5659_R2020b_CM_double -1.7E+308 1.7E+308 /end CHARACTERISTIC
/begin CHARACTERISTIC speedgoat_test_SN5659__cal_impl.Encode3_P13_a "" VALUE 0x008ECB70 Scalar_FLOAT64_IEEE 0 speedgoat_test_SN5659_R2020b_CM_double -1.7E+308 1.7E+308 /end CHARACTERISTIC
/begin CHARACTERISTIC speedgoat_test_SN5659__cal_impl.Encode3_P13_d "" VALUE 0x008EDEC0 Scalar_FLOAT64_IEEE 0 speedgoat_test_SN5659_R2020b_CM_double -1.7E+308 1.7E+308 /end CHARACTERISTIC
/begin CHARACTERISTIC speedgoat_test_SN5659__cal_impl.Encode3_P13_f "" VALUE 0x008EEBA0 Scalar_FLOAT64_IEEE 0 speedgoat_test_SN5659_R2020b_CM_double -1.7E+308 1.7E+308 /end CHARACTERISTIC
/begin CHARACTERISTIC speedgoat_test_SN5659__cal_impl.Encode3_P13_hi "" VALUE 0x008ED1E0 Scalar_FLOAT64_IEEE 0 speedgoat_test_SN5659_R2020b_CM_double -1.7E+308 1.7E+308 /end CHARACTERISTIC
/begin CHARACTERISTIC speedgoat_test_SN5659__cal_impl.Encode3_P13_n "" VALUE 0x008ED850 Scalar_FLOAT64_IEEE 0 speedgoat_test_SN5659_R2020b_CM_double -1.7E+308 1.7E+308 /end CHARACTERISTIC
/begin CHARACTERISTIC speedgoat_test_SN5659__cal_impl.Encode3_P13_ov "" VALUE 0x008EE530 Scalar_FLOAT64_IEEE 0 speedgoat_test_SN5659_R2020b_CM_double -1.7E+308 1.7E+308 /end CHARACTERISTIC
/begin CHARACTERISTIC speedgoat_test_SN5659__cal_impl.Encode3_P14_bl "" VALUE 0x008ED868 Scalar_FLOAT64_IEEE 0 speedgoat_test_SN5659_R2020b_CM_double -1.7E+308 1.7E+308 /end CHARACTERISTIC
/begin CHARACTERISTIC speedgoat_test_SN5659__cal_impl.Encode3_P14_g "" VALUE 0x008ECB88 Scalar_FLOAT64_IEEE 0 speedgoat_test_SN5659_R2020b_CM_double -1.7E+308 1.7E+308 /end CHARACTERISTIC
/begin CHARACTERISTIC speedgoat_test_SN5659__cal_impl.Encode3_P14_m5 "" VALUE 0x008EE548 Scalar_FLOAT64_IEEE 0 speedgoat_test_SN5659_R2020b_CM_double -1.7E+308 1.7E+308 /end CHARACTERISTIC
/begin CHARACTERISTIC speedgoat_test_SN5659__cal_impl.Encode3_P14_nc "" VALUE 0x008EEBB8 Scalar_FLOAT64_IEEE 0 speedgoat_test_SN5659_R2020b_CM_double -1.7E+308 1.7E+308 /end CHARACTERISTIC
/begin CHARACTERISTIC speedgoat_test_SN5659__cal_impl.Encode3_P14_op "" VALUE 0x008ED1F8 Scalar_FLOAT64_IEEE 0 speedgoat_test_SN5659_R2020b_CM_double -1.7E+308 1.7E+308 /end CHARACTERISTIC
/begin CHARACTERISTIC speedgoat_test_SN5659__cal_impl.Encode3_P14_p "" VALUE 0x008EDED8 Scalar_FLOAT64_IEEE 0 speedgoat_test_SN5659_R2020b_CM_double -1.7E+308 1.7E+308 /end CHARACTERISTIC
/begin CHARACTERISTIC speedgoat_test_SN5659__cal_impl.Encode3_P15_a "" VALUE 0x008ECBA0 Scalar_FLOAT64_IEEE 0 speedgoat_test_SN5659_R2020b_CM_double -1.7E+308 1.7E+308 /end CHARACTERISTIC
/begin CHARACTERISTIC speedgoat_test_SN5659__cal_impl.Encode3_P15_f "" VALUE 0x008ED210 Scalar_FLOAT64_IEEE 0 speedgoat_test_SN5659_R2020b_CM_double -1.7E+308 1.7E+308 /end CHARACTERISTIC
/begin CHARACTERISTIC speedgoat_test_SN5659__cal_impl.Encode3_P15_gy "" VALUE 0x008ED880 Scalar_FLOAT64_IEEE 0 speedgoat_test_SN5659_R2020b_CM_double -1.7E+308 1.7E+308 /end CHARACTERISTIC
/begin CHARACTERISTIC speedgoat_test_SN5659__cal_impl.Encode3_P15_l "" VALUE 0x008EDEF0 Scalar_FLOAT64_IEEE 0 speedgoat_test_SN5659_R2020b_CM_double -1.7E+308 1.7E+308 /end CHARACTERISTIC
/begin CHARACTERISTIC speedgoat_test_SN5659__cal_impl.Encode3_P15_o "" VALUE 0x008EEBD0 Scalar_FLOAT64_IEEE 0 speedgoat_test_SN5659_R2020b_CM_double -1.7E+308 1.7E+308 /end CHARACTERISTIC
/begin CHARACTERISTIC speedgoat_test_SN5659__cal_impl.Encode3_P15_pd "" VALUE 0x008EE560 Scalar_FLOAT64_IEEE 0 speedgoat_test_SN5659_R2020b_CM_double -1.7E+308 1.7E+308 /end CHARACTERISTIC
/begin CHARACTERISTIC speedgoat_test_SN5659__cal_impl.Encode3_P1_ad "" VALUE 0x008ECA48 Scalar_FLOAT64_IEEE 0 speedgoat_test_SN5659_R2020b_CM_double -1.7E+308 1.7E+308 /end CHARACTERISTIC
/begin CHARACTERISTIC speedgoat_test_SN5659__cal_impl.Encode3_P1_d "" VALUE 0x008EE408 Scalar_FLOAT64_IEEE 0 speedgoat_test_SN5659_R2020b_CM_double -1.7E+308 1.7E+308 /end CHARACTERISTIC
/begin CHARACTERISTIC speedgoat_test_SN5659__cal_impl.Encode3_P1_j "" VALUE 0x008ED728 Scalar_FLOAT64_IEEE 0 speedgoat_test_SN5659_R2020b_CM_double -1.7E+308 1.7E+308 /end CHARACTERISTIC
/begin CHARACTERISTIC speedgoat_test_SN5659__cal_impl.Encode3_P1_jy "" VALUE 0x008EDD98 Scalar_FLOAT64_IEEE 0 speedgoat_test_SN5659_R2020b_CM_double -1.7E+308 1.7E+308 /end CHARACTERISTIC
/begin CHARACTERISTIC speedgoat_test_SN5659__cal_impl.Encode3_P1_lu "" VALUE 0x008EEA78 Scalar_FLOAT64_IEEE 0 speedgoat_test_SN5659_R2020b_CM_double -1.7E+308 1.7E+308 /end CHARACTERISTIC
/begin CHARACTERISTIC speedgoat_test_SN5659__cal_impl.Encode3_P1_o "" VALUE 0x008ED0B8 Scalar_FLOAT64_IEEE 0 speedgoat_test_SN5659_R2020b_CM_double -1.7E+308 1.7E+308 /end CHARACTERISTIC
/begin CHARACTERISTIC speedgoat_test_SN5659__cal_impl.Encode3_P2_b0 "" VALUE 0x008ED0D0 Scalar_FLOAT64_IEEE 0 speedgoat_test_SN5659_R2020b_CM_double -1.7E+308 1.7E+308 /end CHARACTERISTIC
/begin CHARACTERISTIC speedgoat_test_SN5659__cal_impl.Encode3_P2_d "" VALUE 0x008EDDB0 Scalar_FLOAT64_IEEE 0 speedgoat_test_SN5659_R2020b_CM_double -1.7E+308 1.7E+308 /end CHARACTERISTIC
/begin CHARACTERISTIC speedgoat_test_SN5659__cal_impl.Encode3_P2_dl "" VALUE 0x008EEA90 Scalar_FLOAT64_IEEE 0 speedgoat_test_SN5659_R2020b_CM_double -1.7E+308 1.7E+308 /end CHARACTERISTIC
/begin CHARACTERISTIC speedgoat_test_SN5659__cal_impl.Encode3_P2_fg "" VALUE 0x008ECA60 Scalar_FLOAT64_IEEE 0 speedgoat_test_SN5659_R2020b_CM_double -1.7E+308 1.7E+308 /end CHARACTERISTIC
/begin CHARACTERISTIC speedgoat_test_SN5659__cal_impl.Encode3_P2_ni "" VALUE 0x008EE420 Scalar_FLOAT64_IEEE 0 speedgoat_test_SN5659_R2020b_CM_double -1.7E+308 1.7E+308 /end CHARACTERISTIC
/begin CHARACTERISTIC speedgoat_test_SN5659__cal_impl.Encode3_P2_p "" VALUE 0x008ED740 Scalar_FLOAT64_IEEE 0 speedgoat_test_SN5659_R2020b_CM_double -1.7E+308 1.7E+308 /end CHARACTERISTIC
/begin CHARACTERISTIC speedgoat_test_SN5659__cal_impl.Encode3_P3_e "" VALUE 0x008EE438 Scalar_FLOAT64_IEEE 0 speedgoat_test_SN5659_R2020b_CM_double -1.7E+308 1.7E+308 /end CHARACTERISTIC
/begin CHARACTERISTIC speedgoat_test_SN5659__cal_impl.Encode3_P3_f "" VALUE 0x008EDDC8 Scalar_FLOAT64_IEEE 0 speedgoat_test_SN5659_R2020b_CM_double -1.7E+308 1.7E+308 /end CHARACTERISTIC
/begin CHARACTERISTIC speedgoat_test_SN5659__cal_impl.Encode3_P3_k "" VALUE 0x008EEAA8 Scalar_FLOAT64_IEEE 0 speedgoat_test_SN5659_R2020b_CM_double -1.7E+308 1.7E+308 /end CHARACTERISTIC
/begin CHARACTERISTIC speedgoat_test_SN5659__cal_impl.Encode3_P3_nx "" VALUE 0x008ECA78 Scalar_FLOAT64_IEEE 0 speedgoat_test_SN5659_R2020b_CM_double -1.7E+308 1.7E+308 /end CHARACTERISTIC
/begin CHARACTERISTIC speedgoat_test_SN5659__cal_impl.Encode3_P3_p "" VALUE 0x008ED0E8 Scalar_FLOAT64_IEEE 0 speedgoat_test_SN5659_R2020b_CM_double -1.7E+308 1.7E+308 /end CHARACTERISTIC
/begin CHARACTERISTIC speedgoat_test_SN5659__cal_impl.Encode3_P3_pb "" VALUE 0x008ED758 Scalar_FLOAT64_IEEE 0 speedgoat_test_SN5659_R2020b_CM_double -1.7E+308 1.7E+308 /end CHARACTERISTIC
/begin CHARACTERISTIC speedgoat_test_SN5659__cal_impl.Encode3_P4_ga "" VALUE 0x008EEAC0 Scalar_FLOAT64_IEEE 0 speedgoat_test_SN5659_R2020b_CM_double -1.7E+308 1.7E+308 /end CHARACTERISTIC
/begin CHARACTERISTIC speedgoat_test_SN5659__cal_impl.Encode3_P4_go "" VALUE 0x008ECA90 Scalar_FLOAT64_IEEE 0 speedgoat_test_SN5659_R2020b_CM_double -1.7E+308 1.7E+308 /end CHARACTERISTIC
/begin CHARACTERISTIC speedgoat_test_SN5659__cal_impl.Encode3_P4_he "" VALUE 0x008EE450 Scalar_FLOAT64_IEEE 0 speedgoat_test_SN5659_R2020b_CM_double -1.7E+308 1.7E+308 /end CHARACTERISTIC
/begin CHARACTERISTIC speedgoat_test_SN5659__cal_impl.Encode3_P4_hs "" VALUE 0x008ED100 Scalar_FLOAT64_IEEE 0 speedgoat_test_SN5659_R2020b_CM_double -1.7E+308 1.7E+308 /end CHARACTERISTIC
/begin CHARACTERISTIC speedgoat_test_SN5659__cal_impl.Encode3_P4_hu "" VALUE 0x008ED770 Scalar_FLOAT64_IEEE 0 speedgoat_test_SN5659_R2020b_CM_double -1.7E+308 1.7E+308 /end CHARACTERISTIC
/begin CHARACTERISTIC speedgoat_test_SN5659__cal_impl.Encode3_P4_mc "" VALUE 0x008EDDE0 Scalar_FLOAT64_IEEE 0 speedgoat_test_SN5659_R2020b_CM_double -1.7E+308 1.7E+308 /end CHARACTERISTIC
/begin CHARACTERISTIC speedgoat_test_SN5659__cal_impl.Encode3_P5_d0 "" VALUE 0x008EDDF8 Scalar_FLOAT64_IEEE 0 speedgoat_test_SN5659_R2020b_CM_double -1.7E+308 1.7E+308 /end CHARACTERISTIC
/begin CHARACTERISTIC speedgoat_test_SN5659__cal_impl.Encode3_P5_g "" VALUE 0x008ED118 Scalar_FLOAT64_IEEE 0 speedgoat_test_SN5659_R2020b_CM_double -1.7E+308 1.7E+308 /end CHARACTERISTIC
/begin CHARACTERISTIC speedgoat_test_SN5659__cal_impl.Encode3_P5_i0 "" VALUE 0x008ECAA8 Scalar_FLOAT64_IEEE 0 speedgoat_test_SN5659_R2020b_CM_double -1.7E+308 1.7E+308 /end CHARACTERISTIC
/begin CHARACTERISTIC speedgoat_test_SN5659__cal_impl.Encode3_P5_j "" VALUE 0x008EEAD8 Scalar_FLOAT64_IEEE 0 speedgoat_test_SN5659_R2020b_CM_double -1.7E+308 1.7E+308 /end CHARACTERISTIC
/begin CHARACTERISTIC speedgoat_test_SN5659__cal_impl.Encode3_P5_kk "" VALUE 0x008ED788 Scalar_FLOAT64_IEEE 0 speedgoat_test_SN5659_R2020b_CM_double -1.7E+308 1.7E+308 /end CHARACTERISTIC
/begin CHARACTERISTIC speedgoat_test_SN5659__cal_impl.Encode3_P5_l "" VALUE 0x008EE468 Scalar_FLOAT64_IEEE 0 speedgoat_test_SN5659_R2020b_CM_double -1.7E+308 1.7E+308 /end CHARACTERISTIC
/begin CHARACTERISTIC speedgoat_test_SN5659__cal_impl.Encode3_P6_a0 "" VALUE 0x008ECAC0 Scalar_FLOAT64_IEEE 0 speedgoat_test_SN5659_R2020b_CM_double -1.7E+308 1.7E+308 /end CHARACTERISTIC
/begin CHARACTERISTIC speedgoat_test_SN5659__cal_impl.Encode3_P6_gz "" VALUE 0x008EEAF0 Scalar_FLOAT64_IEEE 0 speedgoat_test_SN5659_R2020b_CM_double -1.7E+308 1.7E+308 /end CHARACTERISTIC
/begin CHARACTERISTIC speedgoat_test_SN5659__cal_impl.Encode3_P6_hf "" VALUE 0x008EDE10 Scalar_FLOAT64_IEEE 0 speedgoat_test_SN5659_R2020b_CM_double -1.7E+308 1.7E+308 /end CHARACTERISTIC
/begin CHARACTERISTIC speedgoat_test_SN5659__cal_impl.Encode3_P6_hi "" VALUE 0x008ED130 Scalar_FLOAT64_IEEE 0 speedgoat_test_SN5659_R2020b_CM_double -1.7E+308 1.7E+308 /end CHARACTERISTIC
/begin CHARACTERISTIC speedgoat_test_SN5659__cal_impl.Encode3_P6_iy "" VALUE 0x008ED7A0 Scalar_FLOAT64_IEEE 0 speedgoat_test_SN5659_R2020b_CM_double -1.7E+308 1.7E+308 /end CHARACTERISTIC
/begin CHARACTERISTIC speedgoat_test_SN5659__cal_impl.Encode3_P6_o "" VALUE 0x008EE480 Scalar_FLOAT64_IEEE 0 speedgoat_test_SN5659_R2020b_CM_double -1.7E+308 1.7E+308 /end CHARACTERISTIC
/begin CHARACTERISTIC speedgoat_test_SN5659__cal_impl.Encode3_P7_bt "" VALUE 0x008EE498 Scalar_FLOAT64_IEEE 0 speedgoat_test_SN5659_R2020b_CM_double -1.7E+308 1.7E+308 /end CHARACTERISTIC
/begin CHARACTERISTIC speedgoat_test_SN5659__cal_impl.Encode3_P7_c "" VALUE 0x008ED148 Scalar_FLOAT64_IEEE 0 speedgoat_test_SN5659_R2020b_CM_double -1.7E+308 1.7E+308 /end CHARACTERISTIC
/begin CHARACTERISTIC speedgoat_test_SN5659__cal_impl.Encode3_P7_dw "" VALUE 0x008EEB08 Scalar_FLOAT64_IEEE 0 speedgoat_test_SN5659_R2020b_CM_double -1.7E+308 1.7E+308 /end CHARACTERISTIC
/begin CHARACTERISTIC speedgoat_test_SN5659__cal_impl.Encode3_P7_g "" VALUE 0x008ED7B8 Scalar_FLOAT64_IEEE 0 speedgoat_test_SN5659_R2020b_CM_double -1.7E+308 1.7E+308 /end CHARACTERISTIC
/begin CHARACTERISTIC speedgoat_test_SN5659__cal_impl.Encode3_P7_k "" VALUE 0x008EDE28 Scalar_FLOAT64_IEEE 0 speedgoat_test_SN5659_R2020b_CM_double -1.7E+308 1.7E+308 /end CHARACTERISTIC
/begin CHARACTERISTIC speedgoat_test_SN5659__cal_impl.Encode3_P7_p "" VALUE 0x008ECAD8 Scalar_FLOAT64_IEEE 0 speedgoat_test_SN5659_R2020b_CM_double -1.7E+308 1.7E+308 /end CHARACTERISTIC
/begin CHARACTERISTIC speedgoat_test_SN5659__cal_impl.Encode3_P8_a "" VALUE 0x008EEB20 Scalar_FLOAT64_IEEE 0 speedgoat_test_SN5659_R2020b_CM_double -1.7E+308 1.7E+308 /end CHARACTERISTIC
/begin CHARACTERISTIC speedgoat_test_SN5659__cal_impl.Encode3_P8_c "" VALUE 0x008ED7D0 Scalar_FLOAT64_IEEE 0 speedgoat_test_SN5659_R2020b_CM_double -1.7E+308 1.7E+308 /end CHARACTERISTIC
/begin CHARACTERISTIC speedgoat_test_SN5659__cal_impl.Encode3_P8_fe "" VALUE 0x008ED160 Scalar_FLOAT64_IEEE 0 speedgoat_test_SN5659_R2020b_CM_double -1.7E+308 1.7E+308 /end CHARACTERISTIC
/begin CHARACTERISTIC speedgoat_test_SN5659__cal_impl.Encode3_P8_j "" VALUE 0x008ECAF0 Scalar_FLOAT64_IEEE 0 speedgoat_test_SN5659_R2020b_CM_double -1.7E+308 1.7E+308 /end CHARACTERISTIC
/begin CHARACTERISTIC speedgoat_test_SN5659__cal_impl.Encode3_P8_n "" VALUE 0x008EE4B0 Scalar_FLOAT64_IEEE 0 speedgoat_test_SN5659_R2020b_CM_double -1.7E+308 1.7E+308 /end CHARACTERISTIC
/begin CHARACTERISTIC speedgoat_test_SN5659__cal_impl.Encode3_P8_o "" VALUE 0x008EDE40 Scalar_FLOAT64_IEEE 0 speedgoat_test_SN5659_R2020b_CM_double -1.7E+308 1.7E+308 /end CHARACTERISTIC
/begin CHARACTERISTIC speedgoat_test_SN5659__cal_impl.Encode3_P9_a "" VALUE 0x008ED7E8 Scalar_FLOAT64_IEEE 0 speedgoat_test_SN5659_R2020b_CM_double -1.7E+308 1.7E+308 /end CHARACTERISTIC
/begin CHARACTERISTIC speedgoat_test_SN5659__cal_impl.Encode3_P9_cw "" VALUE 0x008EDE58 Scalar_FLOAT64_IEEE 0 speedgoat_test_SN5659_R2020b_CM_double -1.7E+308 1.7E+308 /end CHARACTERISTIC
/begin CHARACTERISTIC speedgoat_test_SN5659__cal_impl.Encode3_P9_e "" VALUE 0x008EE4C8 Scalar_FLOAT64_IEEE 0 speedgoat_test_SN5659_R2020b_CM_double -1.7E+308 1.7E+308 /end CHARACTERISTIC
/begin CHARACTERISTIC speedgoat_test_SN5659__cal_impl.Encode3_P9_l "" VALUE 0x008ED178 Scalar_FLOAT64_IEEE 0 speedgoat_test_SN5659_R2020b_CM_double -1.7E+308 1.7E+308 /end CHARACTERISTIC
/begin CHARACTERISTIC speedgoat_test_SN5659__cal_impl.Encode3_P9_lj "" VALUE 0x008EEB38 Scalar_FLOAT64_IEEE 0 speedgoat_test_SN5659_R2020b_CM_double -1.7E+308 1.7E+308 /end CHARACTERISTIC
/begin CHARACTERISTIC speedgoat_test_SN5659__cal_impl.Encode3_P9_o "" VALUE 0x008ECB08 Scalar_FLOAT64_IEEE 0 speedgoat_test_SN5659_R2020b_CM_double -1.7E+308 1.7E+308 /end CHARACTERISTIC
/begin CHARACTERISTIC speedgoat_test_SN5659__cal_impl.Encode4_P10_h3 "" VALUE 0x008ED988 Scalar_FLOAT64_IEEE 0 speedgoat_test_SN5659_R2020b_CM_double -1.7E+308 1.7E+308 /end CHARACTERISTIC
/begin CHARACTERISTIC speedgoat_test_SN5659__cal_impl.Encode4_P10_jg "" VALUE 0x008EE668 Scalar_FLOAT64_IEEE 0 speedgoat_test_SN5659_R2020b_CM_double -1.7E+308 1.7E+308 /end CHARACTERISTIC
/begin CHARACTERISTIC speedgoat_test_SN5659__cal_impl.Encode4_P10_l "" VALUE 0x008EDFF8 Scalar_FLOAT64_IEEE 0 speedgoat_test_SN5659_R2020b_CM_double -1.7E+308 1.7E+308 /end CHARACTERISTIC
/begin CHARACTERISTIC speedgoat_test_SN5659__cal_impl.Encode4_P10_p "" VALUE 0x008ECCA8 Scalar_FLOAT64_IEEE 0 speedgoat_test_SN5659_R2020b_CM_double -1.7E+308 1.7E+308 /end CHARACTERISTIC
/begin CHARACTERISTIC speedgoat_test_SN5659__cal_impl.Encode4_P11_a "" VAL_BLK 0x008ECCC0 Scalar_FLOAT64_IEEE 0 speedgoat_test_SN5659_R2020b_CM_double -1.7E+308 1.7E+308 MATRIX_DIM 2 1 /end CHARACTERISTIC
/begin CHARACTERISTIC speedgoat_test_SN5659__cal_impl.Encode4_P11_js "" VAL_BLK 0x008EE680 Scalar_FLOAT64_IEEE 0 speedgoat_test_SN5659_R2020b_CM_double -1.7E+308 1.7E+308 MATRIX_DIM 2 1 /end CHARACTERISTIC
/begin CHARACTERISTIC speedgoat_test_SN5659__cal_impl.Encode4_P11_l "" VAL_BLK 0x008ED9A0 Scalar_FLOAT64_IEEE 0 speedgoat_test_SN5659_R2020b_CM_double -1.7E+308 1.7E+308 MATRIX_DIM 2 1 /end CHARACTERISTIC
/begin CHARACTERISTIC speedgoat_test_SN5659__cal_impl.Encode4_P11_pl "" VAL_BLK 0x008EE010 Scalar_FLOAT64_IEEE 0 speedgoat_test_SN5659_R2020b_CM_double -1.7E+308 1.7E+308 MATRIX_DIM 2 1 /end CHARACTERISTIC
/begin CHARACTERISTIC speedgoat_test_SN5659__cal_impl.Encode4_P12_c "" VALUE 0x008ED9C0 Scalar_FLOAT64_IEEE 0 speedgoat_test_SN5659_R2020b_CM_double -1.7E+308 1.7E+308 /end CHARACTERISTIC
/begin CHARACTERISTIC speedgoat_test_SN5659__cal_impl.Encode4_P12_k "" VALUE 0x008EE030 Scalar_FLOAT64_IEEE 0 speedgoat_test_SN5659_R2020b_CM_double -1.7E+308 1.7E+308 /end CHARACTERISTIC
/begin CHARACTERISTIC speedgoat_test_SN5659__cal_impl.Encode4_P12_ld "" VALUE 0x008ECCE0 Scalar_FLOAT64_IEEE 0 speedgoat_test_SN5659_R2020b_CM_double -1.7E+308 1.7E+308 /end CHARACTERISTIC
/begin CHARACTERISTIC speedgoat_test_SN5659__cal_impl.Encode4_P12_n "" VALUE 0x008EE6A0 Scalar_FLOAT64_IEEE 0 speedgoat_test_SN5659_R2020b_CM_double -1.7E+308 1.7E+308 /end CHARACTERISTIC
/begin CHARACTERISTIC speedgoat_test_SN5659__cal_impl.Encode4_P13_g "" VALUE 0x008ECCF8 Scalar_FLOAT64_IEEE 0 speedgoat_test_SN5659_R2020b_CM_double -1.7E+308 1.7E+308 /end CHARACTERISTIC
/begin CHARACTERISTIC speedgoat_test_SN5659__cal_impl.Encode4_P13_hn "" VALUE 0x008EE048 Scalar_FLOAT64_IEEE 0 speedgoat_test_SN5659_R2020b_CM_double -1.7E+308 1.7E+308 /end CHARACTERISTIC
/begin CHARACTERISTIC speedgoat_test_SN5659__cal_impl.Encode4_P13_k "" VALUE 0x008EE6B8 Scalar_FLOAT64_IEEE 0 speedgoat_test_SN5659_R2020b_CM_double -1.7E+308 1.7E+308 /end CHARACTERISTIC
/begin CHARACTERISTIC speedgoat_test_SN5659__cal_impl.Encode4_P13_ml "" VALUE 0x008ED9D8 Scalar_FLOAT64_IEEE 0 speedgoat_test_SN5659_R2020b_CM_double -1.7E+308 1.7E+308 /end CHARACTERISTIC
/begin CHARACTERISTIC speedgoat_test_SN5659__cal_impl.Encode4_P14_f "" VALUE 0x008EE6D0 Scalar_FLOAT64_IEEE 0 speedgoat_test_SN5659_R2020b_CM_double -1.7E+308 1.7E+308 /end CHARACTERISTIC
/begin CHARACTERISTIC speedgoat_test_SN5659__cal_impl.Encode4_P14_k "" VALUE 0x008ED9F0 Scalar_FLOAT64_IEEE 0 speedgoat_test_SN5659_R2020b_CM_double -1.7E+308 1.7E+308 /end CHARACTERISTIC
/begin CHARACTERISTIC speedgoat_test_SN5659__cal_impl.Encode4_P14_ma "" VALUE 0x008EE060 Scalar_FLOAT64_IEEE 0 speedgoat_test_SN5659_R2020b_CM_double -1.7E+308 1.7E+308 /end CHARACTERISTIC
/begin CHARACTERISTIC speedgoat_test_SN5659__cal_impl.Encode4_P14_o "" VALUE 0x008ECD10 Scalar_FLOAT64_IEEE 0 speedgoat_test_SN5659_R2020b_CM_double -1.7E+308 1.7E+308 /end CHARACTERISTIC
/begin CHARACTERISTIC speedgoat_test_SN5659__cal_impl.Encode4_P15_c "" VALUE 0x008EE6E8 Scalar_FLOAT64_IEEE 0 speedgoat_test_SN5659_R2020b_CM_double -1.7E+308 1.7E+308 /end CHARACTERISTIC
/begin CHARACTERISTIC speedgoat_test_SN5659__cal_impl.Encode4_P15_iu "" VALUE 0x008EE078 Scalar_FLOAT64_IEEE 0 speedgoat_test_SN5659_R2020b_CM_double -1.7E+308 1.7E+308 /end CHARACTERISTIC
/begin CHARACTERISTIC speedgoat_test_SN5659__cal_impl.Encode4_P15_j "" VALUE 0x008ECD28 Scalar_FLOAT64_IEEE 0 speedgoat_test_SN5659_R2020b_CM_double -1.7E+308 1.7E+308 /end CHARACTERISTIC
/begin CHARACTERISTIC speedgoat_test_SN5659__cal_impl.Encode4_P15_o "" VALUE 0x008EDA08 Scalar_FLOAT64_IEEE 0 speedgoat_test_SN5659_R2020b_CM_double -1.7E+308 1.7E+308 /end CHARACTERISTIC
/begin CHARACTERISTIC speedgoat_test_SN5659__cal_impl.Encode4_P1_af "" VALUE 0x008ED8B0 Scalar_FLOAT64_IEEE 0 speedgoat_test_SN5659_R2020b_CM_double -1.7E+308 1.7E+308 /end CHARACTERISTIC
/begin CHARACTERISTIC speedgoat_test_SN5659__cal_impl.Encode4_P1_h "" VALUE 0x008ECBD0 Scalar_FLOAT64_IEEE 0 speedgoat_test_SN5659_R2020b_CM_double -1.7E+308 1.7E+308 /end CHARACTERISTIC
/begin CHARACTERISTIC speedgoat_test_SN5659__cal_impl.Encode4_P1_hi "" VALUE 0x008EE590 Scalar_FLOAT64_IEEE 0 speedgoat_test_SN5659_R2020b_CM_double -1.7E+308 1.7E+308 /end CHARACTERISTIC
/begin CHARACTERISTIC speedgoat_test_SN5659__cal_impl.Encode4_P1_o "" VALUE 0x008EDF20 Scalar_FLOAT64_IEEE 0 speedgoat_test_SN5659_R2020b_CM_double -1.7E+308 1.7E+308 /end CHARACTERISTIC
/begin CHARACTERISTIC speedgoat_test_SN5659__cal_impl.Encode4_P2_e "" VALUE 0x008ECBE8 Scalar_FLOAT64_IEEE 0 speedgoat_test_SN5659_R2020b_CM_double -1.7E+308 1.7E+308 /end CHARACTERISTIC
/begin CHARACTERISTIC speedgoat_test_SN5659__cal_impl.Encode4_P2_j "" VALUE 0x008ED8C8 Scalar_FLOAT64_IEEE 0 speedgoat_test_SN5659_R2020b_CM_double -1.7E+308 1.7E+308 /end CHARACTERISTIC
/begin CHARACTERISTIC speedgoat_test_SN5659__cal_impl.Encode4_P2_k "" VALUE 0x008EE5A8 Scalar_FLOAT64_IEEE 0 speedgoat_test_SN5659_R2020b_CM_double -1.7E+308 1.7E+308 /end CHARACTERISTIC
/begin CHARACTERISTIC speedgoat_test_SN5659__cal_impl.Encode4_P2_pk "" VALUE 0x008EDF38 Scalar_FLOAT64_IEEE 0 speedgoat_test_SN5659_R2020b_CM_double -1.7E+308 1.7E+308 /end CHARACTERISTIC
/begin CHARACTERISTIC speedgoat_test_SN5659__cal_impl.Encode4_P3_h5 "" VALUE 0x008EDF50 Scalar_FLOAT64_IEEE 0 speedgoat_test_SN5659_R2020b_CM_double -1.7E+308 1.7E+308 /end CHARACTERISTIC
/begin CHARACTERISTIC speedgoat_test_SN5659__cal_impl.Encode4_P3_j "" VALUE 0x008ECC00 Scalar_FLOAT64_IEEE 0 speedgoat_test_SN5659_R2020b_CM_double -1.7E+308 1.7E+308 /end CHARACTERISTIC
/begin CHARACTERISTIC speedgoat_test_SN5659__cal_impl.Encode4_P3_k "" VALUE 0x008EE5C0 Scalar_FLOAT64_IEEE 0 speedgoat_test_SN5659_R2020b_CM_double -1.7E+308 1.7E+308 /end CHARACTERISTIC
/begin CHARACTERISTIC speedgoat_test_SN5659__cal_impl.Encode4_P3_n5 "" VALUE 0x008ED8E0 Scalar_FLOAT64_IEEE 0 speedgoat_test_SN5659_R2020b_CM_double -1.7E+308 1.7E+308 /end CHARACTERISTIC
/begin CHARACTERISTIC speedgoat_test_SN5659__cal_impl.Encode4_P4_j "" VALUE 0x008EE5D8 Scalar_FLOAT64_IEEE 0 speedgoat_test_SN5659_R2020b_CM_double -1.7E+308 1.7E+308 /end CHARACTERISTIC
/begin CHARACTERISTIC speedgoat_test_SN5659__cal_impl.Encode4_P4_kc "" VALUE 0x008ED8F8 Scalar_FLOAT64_IEEE 0 speedgoat_test_SN5659_R2020b_CM_double -1.7E+308 1.7E+308 /end CHARACTERISTIC
/begin CHARACTERISTIC speedgoat_test_SN5659__cal_impl.Encode4_P4_my "" VALUE 0x008EDF68 Scalar_FLOAT64_IEEE 0 speedgoat_test_SN5659_R2020b_CM_double -1.7E+308 1.7E+308 /end CHARACTERISTIC
/begin CHARACTERISTIC speedgoat_test_SN5659__cal_impl.Encode4_P4_o "" VALUE 0x008ECC18 Scalar_FLOAT64_IEEE 0 speedgoat_test_SN5659_R2020b_CM_double -1.7E+308 1.7E+308 /end CHARACTERISTIC
/begin CHARACTERISTIC speedgoat_test_SN5659__cal_impl.Encode4_P5_d "" VALUE 0x008ED910 Scalar_FLOAT64_IEEE 0 speedgoat_test_SN5659_R2020b_CM_double -1.7E+308 1.7E+308 /end CHARACTERISTIC
/begin CHARACTERISTIC speedgoat_test_SN5659__cal_impl.Encode4_P5_g "" VALUE 0x008EE5F0 Scalar_FLOAT64_IEEE 0 speedgoat_test_SN5659_R2020b_CM_double -1.7E+308 1.7E+308 /end CHARACTERISTIC
/begin CHARACTERISTIC speedgoat_test_SN5659__cal_impl.Encode4_P5_pt "" VALUE 0x008ECC30 Scalar_FLOAT64_IEEE 0 speedgoat_test_SN5659_R2020b_CM_double -1.7E+308 1.7E+308 /end CHARACTERISTIC
/begin CHARACTERISTIC speedgoat_test_SN5659__cal_impl.Encode4_P5_pv "" VALUE 0x008EDF80 Scalar_FLOAT64_IEEE 0 speedgoat_test_SN5659_R2020b_CM_double -1.7E+308 1.7E+308 /end CHARACTERISTIC
/begin CHARACTERISTIC speedgoat_test_SN5659__cal_impl.Encode4_P6_ab "" VALUE 0x008ECC48 Scalar_FLOAT64_IEEE 0 speedgoat_test_SN5659_R2020b_CM_double -1.7E+308 1.7E+308 /end CHARACTERISTIC
/begin CHARACTERISTIC speedgoat_test_SN5659__cal_impl.Encode4_P6_abh "" VALUE 0x008ED928 Scalar_FLOAT64_IEEE 0 speedgoat_test_SN5659_R2020b_CM_double -1.7E+308 1.7E+308 /end CHARACTERISTIC
/begin CHARACTERISTIC speedgoat_test_SN5659__cal_impl.Encode4_P6_ed "" VALUE 0x008EDF98 Scalar_FLOAT64_IEEE 0 speedgoat_test_SN5659_R2020b_CM_double -1.7E+308 1.7E+308 /end CHARACTERISTIC
/begin CHARACTERISTIC speedgoat_test_SN5659__cal_impl.Encode4_P6_g "" VALUE 0x008EE608 Scalar_FLOAT64_IEEE 0 speedgoat_test_SN5659_R2020b_CM_double -1.7E+308 1.7E+308 /end CHARACTERISTIC
/begin CHARACTERISTIC speedgoat_test_SN5659__cal_impl.Encode4_P7_by "" VALUE 0x008EDFB0 Scalar_FLOAT64_IEEE 0 speedgoat_test_SN5659_R2020b_CM_double -1.7E+308 1.7E+308 /end CHARACTERISTIC
/begin CHARACTERISTIC speedgoat_test_SN5659__cal_impl.Encode4_P7_c3 "" VALUE 0x008EE620 Scalar_FLOAT64_IEEE 0 speedgoat_test_SN5659_R2020b_CM_double -1.7E+308 1.7E+308 /end CHARACTERISTIC
/begin CHARACTERISTIC speedgoat_test_SN5659__cal_impl.Encode4_P7_di "" VALUE 0x008ED940 Scalar_FLOAT64_IEEE 0 speedgoat_test_SN5659_R2020b_CM_double -1.7E+308 1.7E+308 /end CHARACTERISTIC
/begin CHARACTERISTIC speedgoat_test_SN5659__cal_impl.Encode4_P7_i "" VALUE 0x008ECC60 Scalar_FLOAT64_IEEE 0 speedgoat_test_SN5659_R2020b_CM_double -1.7E+308 1.7E+308 /end CHARACTERISTIC
/begin CHARACTERISTIC speedgoat_test_SN5659__cal_impl.Encode4_P8_a "" VALUE 0x008EDFC8 Scalar_FLOAT64_IEEE 0 speedgoat_test_SN5659_R2020b_CM_double -1.7E+308 1.7E+308 /end CHARACTERISTIC
/begin CHARACTERISTIC speedgoat_test_SN5659__cal_impl.Encode4_P8_c "" VALUE 0x008EE638 Scalar_FLOAT64_IEEE 0 speedgoat_test_SN5659_R2020b_CM_double -1.7E+308 1.7E+308 /end CHARACTERISTIC
/begin CHARACTERISTIC speedgoat_test_SN5659__cal_impl.Encode4_P8_e "" VALUE 0x008ED958 Scalar_FLOAT64_IEEE 0 speedgoat_test_SN5659_R2020b_CM_double -1.7E+308 1.7E+308 /end CHARACTERISTIC
/begin CHARACTERISTIC speedgoat_test_SN5659__cal_impl.Encode4_P8_hv "" VALUE 0x008ECC78 Scalar_FLOAT64_IEEE 0 speedgoat_test_SN5659_R2020b_CM_double -1.7E+308 1.7E+308 /end CHARACTERISTIC
/begin CHARACTERISTIC speedgoat_test_SN5659__cal_impl.Encode4_P9_a "" VALUE 0x008EDFE0 Scalar_FLOAT64_IEEE 0 speedgoat_test_SN5659_R2020b_CM_double -1.7E+308 1.7E+308 /end CHARACTERISTIC
/begin CHARACTERISTIC speedgoat_test_SN5659__cal_impl.Encode4_P9_d "" VALUE 0x008ED970 Scalar_FLOAT64_IEEE 0 speedgoat_test_SN5659_R2020b_CM_double -1.7E+308 1.7E+308 /end CHARACTERISTIC
/begin CHARACTERISTIC speedgoat_test_SN5659__cal_impl.Encode4_P9_l "" VALUE 0x008ECC90 Scalar_FLOAT64_IEEE 0 speedgoat_test_SN5659_R2020b_CM_double -1.7E+308 1.7E+308 /end CHARACTERISTIC
/begin CHARACTERISTIC speedgoat_test_SN5659__cal_impl.Encode4_P9_m "" VALUE 0x008EE650 Scalar_FLOAT64_IEEE 0 speedgoat_test_SN5659_R2020b_CM_double -1.7E+308 1.7E+308 /end CHARACTERISTIC
/begin CHARACTERISTIC speedgoat_test_SN5659__cal_impl.Encode5_P10_j "" VALUE 0x008ECFE8 Scalar_FLOAT64_IEEE 0 speedgoat_test_SN5659_R2020b_CM_double -1.7E+308 1.7E+308 /end CHARACTERISTIC
/begin CHARACTERISTIC speedgoat_test_SN5659__cal_impl.Encode5_P10_o "" VALUE 0x008EE9A8 Scalar_FLOAT64_IEEE 0 speedgoat_test_SN5659_R2020b_CM_double -1.7E+308 1.7E+308 /end CHARACTERISTIC
/begin CHARACTERISTIC speedgoat_test_SN5659__cal_impl.Encode5_P11_g "" VAL_BLK 0x008EE9C0 Scalar_FLOAT64_IEEE 0 speedgoat_test_SN5659_R2020b_CM_double -1.7E+308 1.7E+308 MATRIX_DIM 2 1 /end CHARACTERISTIC
/begin CHARACTERISTIC speedgoat_test_SN5659__cal_impl.Encode5_P11_h "" VAL_BLK 0x008ED000 Scalar_FLOAT64_IEEE 0 speedgoat_test_SN5659_R2020b_CM_double -1.7E+308 1.7E+308 MATRIX_DIM 2 1 /end CHARACTERISTIC
/begin CHARACTERISTIC speedgoat_test_SN5659__cal_impl.Encode5_P12_c "" VALUE 0x008ED020 Scalar_FLOAT64_IEEE 0 speedgoat_test_SN5659_R2020b_CM_double -1.7E+308 1.7E+308 /end CHARACTERISTIC
/begin CHARACTERISTIC speedgoat_test_SN5659__cal_impl.Encode5_P12_p "" VALUE 0x008EE9E0 Scalar_FLOAT64_IEEE 0 speedgoat_test_SN5659_R2020b_CM_double -1.7E+308 1.7E+308 /end CHARACTERISTIC
/begin CHARACTERISTIC speedgoat_test_SN5659__cal_impl.Encode5_P13_c "" VALUE 0x008ED038 Scalar_FLOAT64_IEEE 0 speedgoat_test_SN5659_R2020b_CM_double -1.7E+308 1.7E+308 /end CHARACTERISTIC
/begin CHARACTERISTIC speedgoat_test_SN5659__cal_impl.Encode5_P13_m "" VALUE 0x008EE9F8 Scalar_FLOAT64_IEEE 0 speedgoat_test_SN5659_R2020b_CM_double -1.7E+308 1.7E+308 /end CHARACTERISTIC
/begin CHARACTERISTIC speedgoat_test_SN5659__cal_impl.Encode5_P14_e "" VALUE 0x008ED050 Scalar_FLOAT64_IEEE 0 speedgoat_test_SN5659_R2020b_CM_double -1.7E+308 1.7E+308 /end CHARACTERISTIC
/begin CHARACTERISTIC speedgoat_test_SN5659__cal_impl.Encode5_P14_k "" VALUE 0x008EEA10 Scalar_FLOAT64_IEEE 0 speedgoat_test_SN5659_R2020b_CM_double -1.7E+308 1.7E+308 /end CHARACTERISTIC
/begin CHARACTERISTIC speedgoat_test_SN5659__cal_impl.Encode5_P15_a "" VALUE 0x008EEA28 Scalar_FLOAT64_IEEE 0 speedgoat_test_SN5659_R2020b_CM_double -1.7E+308 1.7E+308 /end CHARACTERISTIC
/begin CHARACTERISTIC speedgoat_test_SN5659__cal_impl.Encode5_P15_m "" VALUE 0x008ED068 Scalar_FLOAT64_IEEE 0 speedgoat_test_SN5659_R2020b_CM_double -1.7E+308 1.7E+308 /end CHARACTERISTIC
/begin CHARACTERISTIC speedgoat_test_SN5659__cal_impl.Encode5_P1_a "" VALUE 0x008ECF10 Scalar_FLOAT64_IEEE 0 speedgoat_test_SN5659_R2020b_CM_double -1.7E+308 1.7E+308 /end CHARACTERISTIC
/begin CHARACTERISTIC speedgoat_test_SN5659__cal_impl.Encode5_P1_i "" VALUE 0x008EE8D0 Scalar_FLOAT64_IEEE 0 speedgoat_test_SN5659_R2020b_CM_double -1.7E+308 1.7E+308 /end CHARACTERISTIC
/begin CHARACTERISTIC speedgoat_test_SN5659__cal_impl.Encode5_P2_b "" VALUE 0x008EE8E8 Scalar_FLOAT64_IEEE 0 speedgoat_test_SN5659_R2020b_CM_double -1.7E+308 1.7E+308 /end CHARACTERISTIC
/begin CHARACTERISTIC speedgoat_test_SN5659__cal_impl.Encode5_P2_l "" VALUE 0x008ECF28 Scalar_FLOAT64_IEEE 0 speedgoat_test_SN5659_R2020b_CM_double -1.7E+308 1.7E+308 /end CHARACTERISTIC
/begin CHARACTERISTIC speedgoat_test_SN5659__cal_impl.Encode5_P3_c "" VALUE 0x008ECF40 Scalar_FLOAT64_IEEE 0 speedgoat_test_SN5659_R2020b_CM_double -1.7E+308 1.7E+308 /end CHARACTERISTIC
/begin CHARACTERISTIC speedgoat_test_SN5659__cal_impl.Encode5_P3_i "" VALUE 0x008EE900 Scalar_FLOAT64_IEEE 0 speedgoat_test_SN5659_R2020b_CM_double -1.7E+308 1.7E+308 /end CHARACTERISTIC
/begin CHARACTERISTIC speedgoat_test_SN5659__cal_impl.Encode5_P4_k "" VALUE 0x008EE918 Scalar_FLOAT64_IEEE 0 speedgoat_test_SN5659_R2020b_CM_double -1.7E+308 1.7E+308 /end CHARACTERISTIC
/begin CHARACTERISTIC speedgoat_test_SN5659__cal_impl.Encode5_P4_o "" VALUE 0x008ECF58 Scalar_FLOAT64_IEEE 0 speedgoat_test_SN5659_R2020b_CM_double -1.7E+308 1.7E+308 /end CHARACTERISTIC
/begin CHARACTERISTIC speedgoat_test_SN5659__cal_impl.Encode5_P5_ih "" VALUE 0x008ECF70 Scalar_FLOAT64_IEEE 0 speedgoat_test_SN5659_R2020b_CM_double -1.7E+308 1.7E+308 /end CHARACTERISTIC
/begin CHARACTERISTIC speedgoat_test_SN5659__cal_impl.Encode5_P5_o "" VALUE 0x008EE930 Scalar_FLOAT64_IEEE 0 speedgoat_test_SN5659_R2020b_CM_double -1.7E+308 1.7E+308 /end CHARACTERISTIC
/begin CHARACTERISTIC speedgoat_test_SN5659__cal_impl.Encode5_P6_j "" VALUE 0x008EE948 Scalar_FLOAT64_IEEE 0 speedgoat_test_SN5659_R2020b_CM_double -1.7E+308 1.7E+308 /end CHARACTERISTIC
/begin CHARACTERISTIC speedgoat_test_SN5659__cal_impl.Encode5_P6_o "" VALUE 0x008ECF88 Scalar_FLOAT64_IEEE 0 speedgoat_test_SN5659_R2020b_CM_double -1.7E+308 1.7E+308 /end CHARACTERISTIC
/begin CHARACTERISTIC speedgoat_test_SN5659__cal_impl.Encode5_P7_h "" VALUE 0x008EE960 Scalar_FLOAT64_IEEE 0 speedgoat_test_SN5659_R2020b_CM_double -1.7E+308 1.7E+308 /end CHARACTERISTIC
/begin CHARACTERISTIC speedgoat_test_SN5659__cal_impl.Encode5_P7_l "" VALUE 0x008ECFA0 Scalar_FLOAT64_IEEE 0 speedgoat_test_SN5659_R2020b_CM_double -1.7E+308 1.7E+308 /end CHARACTERISTIC
/begin CHARACTERISTIC speedgoat_test_SN5659__cal_impl.Encode5_P8_i "" VALUE 0x008EE978 Scalar_FLOAT64_IEEE 0 speedgoat_test_SN5659_R2020b_CM_double -1.7E+308 1.7E+308 /end CHARACTERISTIC
/begin CHARACTERISTIC speedgoat_test_SN5659__cal_impl.Encode5_P8_m "" VALUE 0x008ECFB8 Scalar_FLOAT64_IEEE 0 speedgoat_test_SN5659_R2020b_CM_double -1.7E+308 1.7E+308 /end CHARACTERISTIC
/begin CHARACTERISTIC speedgoat_test_SN5659__cal_impl.Encode5_P9_g "" VALUE 0x008EE990 Scalar_FLOAT64_IEEE 0 speedgoat_test_SN5659_R2020b_CM_double -1.7E+308 1.7E+308 /end CHARACTERISTIC
/begin CHARACTERISTIC speedgoat_test_SN5659__cal_impl.Encode5_P9_o "" VALUE 0x008ECFD0 Scalar_FLOAT64_IEEE 0 speedgoat_test_SN5659_R2020b_CM_double -1.7E+308 1.7E+308 /end CHARACTERISTIC
/begin CHARACTERISTIC speedgoat_test_SN5659__cal_impl.FixPtConstant_Value_b "" VALUE 0x008EFCF2 Scalar_UWORD 0 speedgoat_test_SN5659_R2020b_CM_uint16 0 65535 /end CHARACTERISTIC
/begin CHARACTERISTIC speedgoat_test_SN5659__cal_impl.FixPtConstant_Value_ie "" VALUE 0x008EFCEC Scalar_UWORD 0 speedgoat_test_SN5659_R2020b_CM_uint16 0 65535 /end CHARACTERISTIC
/begin CHARACTERISTIC speedgoat_test_SN5659__cal_impl.FixPtConstant_Value_jp "" VALUE 0x008EFCF8 Scalar_UWORD 0 speedgoat_test_SN5659_R2020b_CM_uint16 0 65535 /end CHARACTERISTIC
/begin CHARACTERISTIC speedgoat_test_SN5659__cal_impl.FixPtConstant_Value_k "" VALUE 0x008EFCDA Scalar_UWORD 0 speedgoat_test_SN5659_R2020b_CM_uint16 0 65535 /end CHARACTERISTIC
/begin CHARACTERISTIC speedgoat_test_SN5659__cal_impl.FixPtConstant_Value_m "" VALUE 0x008EFCE0 Scalar_UWORD 0 speedgoat_test_SN5659_R2020b_CM_uint16 0 65535 /end CHARACTERISTIC
/begin CHARACTERISTIC speedgoat_test_SN5659__cal_impl.FixPtConstant_Value_n "" VALUE 0x008EFCE6 Scalar_UWORD 0 speedgoat_test_SN5659_R2020b_CM_uint16 0 65535 /end CHARACTERISTIC
/begin CHARACTERISTIC speedgoat_test_SN5659__cal_impl.Label_Value_jf "" VALUE 0x008EFC8C Scalar_ULONG 0 speedgoat_test_SN5659_R2020b_CM_uint32 0 2147483646 /end CHARACTERISTIC
/begin CHARACTERISTIC speedgoat_test_SN5659__cal_impl.Label_Value_kg "" VALUE 0x008EFCA4 Scalar_ULONG 0 speedgoat_test_SN5659_R2020b_CM_uint32 0 2147483646 /end CHARACTERISTIC
/begin CHARACTERISTIC speedgoat_test_SN5659__cal_impl.Label_Value_kp "" VALUE 0x008EFC74 Scalar_ULONG 0 speedgoat_test_SN5659_R2020b_CM_uint32 0 2147483646 /end CHARACTERISTIC
/begin CHARACTERISTIC speedgoat_test_SN5659__cal_impl.Label_Value_l "" VALUE 0x008EFC68 Scalar_ULONG 0 speedgoat_test_SN5659_R2020b_CM_uint32 0 2147483646 /end CHARACTERISTIC
/begin CHARACTERISTIC speedgoat_test_SN5659__cal_impl.Label_Value_p "" VALUE 0x008EFC80 Scalar_ULONG 0 speedgoat_test_SN5659_R2020b_CM_uint32 0 2147483646 /end CHARACTERISTIC
/begin CHARACTERISTIC speedgoat_test_SN5659__cal_impl.Label_Value_pn "" VALUE 0x008EFC98 Scalar_ULONG 0 speedgoat_test_SN5659_R2020b_CM_uint32 0 2147483646 /end CHARACTERISTIC
/begin CHARACTERISTIC speedgoat_test_SN5659__cal_impl.Mask_BitMask_c "" VALUE 0x008DF04C Scalar_ULONG 0 speedgoat_test_SN5659_R2020b_CM_uint32 0 2147483646 /end CHARACTERISTIC
/begin CHARACTERISTIC speedgoat_test_SN5659__cal_impl.Mask_BitMask_cx "" VALUE 0x008DF05C Scalar_ULONG 0 speedgoat_test_SN5659_R2020b_CM_uint32 0 2147483646 /end CHARACTERISTIC
/begin CHARACTERISTIC speedgoat_test_SN5659__cal_impl.Mask_BitMask_er "" VALUE 0x008DF050 Scalar_ULONG 0 speedgoat_test_SN5659_R2020b_CM_uint32 0 2147483646 /end CHARACTERISTIC
/begin CHARACTERISTIC speedgoat_test_SN5659__cal_impl.Mask_BitMask_f "" VALUE 0x008DF048 Scalar_ULONG 0 speedgoat_test_SN5659_R2020b_CM_uint32 0 2147483646 /end CHARACTERISTIC
/begin CHARACTERISTIC speedgoat_test_SN5659__cal_impl.Mask_BitMask_f3 "" VALUE 0x008DF054 Scalar_ULONG 0 speedgoat_test_SN5659_R2020b_CM_uint32 0 2147483646 /end CHARACTERISTIC
/begin CHARACTERISTIC speedgoat_test_SN5659__cal_impl.Mask_BitMask_kz "" VALUE 0x008DF058 Scalar_ULONG 0 speedgoat_test_SN5659_R2020b_CM_uint32 0 2147483646 /end CHARACTERISTIC
/begin CHARACTERISTIC speedgoat_test_SN5659__cal_impl.Output_InitialCondition_a "" VALUE 0x008EFCF0 Scalar_UWORD 0 speedgoat_test_SN5659_R2020b_CM_uint16 0 65535 /end CHARACTERISTIC
/begin CHARACTERISTIC speedgoat_test_SN5659__cal_impl.Output_InitialCondition_aw "" VALUE 0x008EFCF6 Scalar_UWORD 0 speedgoat_test_SN5659_R2020b_CM_uint16 0 65535 /end CHARACTERISTIC
/begin CHARACTERISTIC speedgoat_test_SN5659__cal_impl.Output_InitialCondition_d "" VALUE 0x008EFCD8 Scalar_UWORD 0 speedgoat_test_SN5659_R2020b_CM_uint16 0 65535 /end CHARACTERISTIC
/begin CHARACTERISTIC speedgoat_test_SN5659__cal_impl.Output_InitialCondition_dr "" VALUE 0x008EFCEA Scalar_UWORD 0 speedgoat_test_SN5659_R2020b_CM_uint16 0 65535 /end CHARACTERISTIC
/begin CHARACTERISTIC speedgoat_test_SN5659__cal_impl.Output_InitialCondition_h3 "" VALUE 0x008EFCE4 Scalar_UWORD 0 speedgoat_test_SN5659_R2020b_CM_uint16 0 65535 /end CHARACTERISTIC
/begin CHARACTERISTIC speedgoat_test_SN5659__cal_impl.Output_InitialCondition_nb "" VALUE 0x008EFCDE Scalar_UWORD 0 speedgoat_test_SN5659_R2020b_CM_uint16 0 65535 /end CHARACTERISTIC
/begin CHARACTERISTIC speedgoat_test_SN5659__cal_impl.PulseGenerator_Amp_g3 "" VALUE 0x008EF828 Scalar_FLOAT64_IEEE 0 speedgoat_test_SN5659_R2020b_CM_double -1.7E+308 1.7E+308 /end CHARACTERISTIC
/begin CHARACTERISTIC speedgoat_test_SN5659__cal_impl.PulseGenerator_Duty_h "" VALUE 0x008EF838 Scalar_FLOAT64_IEEE 0 speedgoat_test_SN5659_R2020b_CM_double -1.7E+308 1.7E+308 /end CHARACTERISTIC
/begin CHARACTERISTIC speedgoat_test_SN5659__cal_impl.PulseGenerator_Period_o "" VALUE 0x008EF830 Scalar_FLOAT64_IEEE 0 speedgoat_test_SN5659_R2020b_CM_double -1.7E+308 1.7E+308 /end CHARACTERISTIC
/begin CHARACTERISTIC speedgoat_test_SN5659__cal_impl.PulseGenerator_PhaseDelay_b "" VALUE 0x008EF840 Scalar_FLOAT64_IEEE 0 speedgoat_test_SN5659_R2020b_CM_double -1.7E+308 1.7E+308 /end CHARACTERISTIC
/begin CHARACTERISTIC speedgoat_test_SN5659__cal_impl.Randomnumber_Mean_c "" VALUE 0x008ECD78 Scalar_FLOAT64_IEEE 0 speedgoat_test_SN5659_R2020b_CM_double -1.7E+308 1.7E+308 /end CHARACTERISTIC
/begin CHARACTERISTIC speedgoat_test_SN5659__cal_impl.Randomnumber_Mean_fb "" VALUE 0x008EE738 Scalar_FLOAT64_IEEE 0 speedgoat_test_SN5659_R2020b_CM_double -1.7E+308 1.7E+308 /end CHARACTERISTIC
/begin CHARACTERISTIC speedgoat_test_SN5659__cal_impl.Randomnumber_Mean_l "" VALUE 0x008ED3E8 Scalar_FLOAT64_IEEE 0 speedgoat_test_SN5659_R2020b_CM_double -1.7E+308 1.7E+308 /end CHARACTERISTIC
/begin CHARACTERISTIC speedgoat_test_SN5659__cal_impl.Randomnumber_Mean_p "" VALUE 0x008EC708 Scalar_FLOAT64_IEEE 0 speedgoat_test_SN5659_R2020b_CM_double -1.7E+308 1.7E+308 /end CHARACTERISTIC
/begin CHARACTERISTIC speedgoat_test_SN5659__cal_impl.Randomnumber_Mean_pl "" VALUE 0x008EDA58 Scalar_FLOAT64_IEEE 0 speedgoat_test_SN5659_R2020b_CM_double -1.7E+308 1.7E+308 /end CHARACTERISTIC
/begin CHARACTERISTIC speedgoat_test_SN5659__cal_impl.Randomnumber_Mean_pz "" VALUE 0x008EE0C8 Scalar_FLOAT64_IEEE 0 speedgoat_test_SN5659_R2020b_CM_double -1.7E+308 1.7E+308 /end CHARACTERISTIC
/begin CHARACTERISTIC speedgoat_test_SN5659__cal_impl.Randomnumber_Seed_cg "" VALUE 0x008ED3F8 Scalar_FLOAT64_IEEE 0 speedgoat_test_SN5659_R2020b_CM_double -1.7E+308 1.7E+308 /end CHARACTERISTIC
/begin CHARACTERISTIC speedgoat_test_SN5659__cal_impl.Randomnumber_Seed_e "" VALUE 0x008EDA68 Scalar_FLOAT64_IEEE 0 speedgoat_test_SN5659_R2020b_CM_double -1.7E+308 1.7E+308 /end CHARACTERISTIC
/begin CHARACTERISTIC speedgoat_test_SN5659__cal_impl.Randomnumber_Seed_i "" VALUE 0x008EC718 Scalar_FLOAT64_IEEE 0 speedgoat_test_SN5659_R2020b_CM_double -1.7E+308 1.7E+308 /end CHARACTERISTIC
/begin CHARACTERISTIC speedgoat_test_SN5659__cal_impl.Randomnumber_Seed_j "" VALUE 0x008EE748 Scalar_FLOAT64_IEEE 0 speedgoat_test_SN5659_R2020b_CM_double -1.7E+308 1.7E+308 /end CHARACTERISTIC
/begin CHARACTERISTIC speedgoat_test_SN5659__cal_impl.Randomnumber_Seed_l "" VALUE 0x008EE0D8 Scalar_FLOAT64_IEEE 0 speedgoat_test_SN5659_R2020b_CM_double -1.7E+308 1.7E+308 /end CHARACTERISTIC
/begin CHARACTERISTIC speedgoat_test_SN5659__cal_impl.Randomnumber_Seed_o "" VALUE 0x008ECD88 Scalar_FLOAT64_IEEE 0 speedgoat_test_SN5659_R2020b_CM_double -1.7E+308 1.7E+308 /end CHARACTERISTIC
/begin CHARACTERISTIC speedgoat_test_SN5659__cal_impl.Randomnumber_StdDev_b "" VALUE 0x008EC710 Scalar_FLOAT64_IEEE 0 speedgoat_test_SN5659_R2020b_CM_double -1.7E+308 1.7E+308 /end CHARACTERISTIC
/begin CHARACTERISTIC speedgoat_test_SN5659__cal_impl.Randomnumber_StdDev_e "" VALUE 0x008EE0D0 Scalar_FLOAT64_IEEE 0 speedgoat_test_SN5659_R2020b_CM_double -1.7E+308 1.7E+308 /end CHARACTERISTIC
/begin CHARACTERISTIC speedgoat_test_SN5659__cal_impl.Randomnumber_StdDev_fs "" VALUE 0x008EDA60 Scalar_FLOAT64_IEEE 0 speedgoat_test_SN5659_R2020b_CM_double -1.7E+308 1.7E+308 /end CHARACTERISTIC
/begin CHARACTERISTIC speedgoat_test_SN5659__cal_impl.Randomnumber_StdDev_mo "" VALUE 0x008ECD80 Scalar_FLOAT64_IEEE 0 speedgoat_test_SN5659_R2020b_CM_double -1.7E+308 1.7E+308 /end CHARACTERISTIC
/begin CHARACTERISTIC speedgoat_test_SN5659__cal_impl.Randomnumber_StdDev_o "" VALUE 0x008ED3F0 Scalar_FLOAT64_IEEE 0 speedgoat_test_SN5659_R2020b_CM_double -1.7E+308 1.7E+308 /end CHARACTERISTIC
/begin CHARACTERISTIC speedgoat_test_SN5659__cal_impl.Randomnumber_StdDev_oa "" VALUE 0x008EE740 Scalar_FLOAT64_IEEE 0 speedgoat_test_SN5659_R2020b_CM_double -1.7E+308 1.7E+308 /end CHARACTERISTIC
/begin CHARACTERISTIC speedgoat_test_SN5659__cal_impl.Relays_P1 "" VALUE 0x008EF858 Scalar_FLOAT64_IEEE 0 speedgoat_test_SN5659_R2020b_CM_double -1.7E+308 1.7E+308 /end CHARACTERISTIC
/begin CHARACTERISTIC speedgoat_test_SN5659__cal_impl.Relays_P10 "" VALUE 0x008EFB38 Scalar_FLOAT64_IEEE 0 speedgoat_test_SN5659_R2020b_CM_double -1.7E+308 1.7E+308 /end CHARACTERISTIC
/begin CHARACTERISTIC speedgoat_test_SN5659__cal_impl.Relays_P11 "" VALUE 0x008EFB50 Scalar_FLOAT64_IEEE 0 speedgoat_test_SN5659_R2020b_CM_double -1.7E+308 1.7E+308 /end CHARACTERISTIC
/begin CHARACTERISTIC speedgoat_test_SN5659__cal_impl.Relays_P12 "" VALUE 0x008EFB68 Scalar_FLOAT64_IEEE 0 speedgoat_test_SN5659_R2020b_CM_double -1.7E+308 1.7E+308 /end CHARACTERISTIC
/begin CHARACTERISTIC speedgoat_test_SN5659__cal_impl.Relays_P13 "" VALUE 0x008EFB80 Scalar_FLOAT64_IEEE 0 speedgoat_test_SN5659_R2020b_CM_double -1.7E+308 1.7E+308 /end CHARACTERISTIC
/begin CHARACTERISTIC speedgoat_test_SN5659__cal_impl.Relays_P14 "" VALUE 0x008EFB98 Scalar_FLOAT64_IEEE 0 speedgoat_test_SN5659_R2020b_CM_double -1.7E+308 1.7E+308 /end CHARACTERISTIC
/begin CHARACTERISTIC speedgoat_test_SN5659__cal_impl.Relays_P15 "" VALUE 0x008EFBB0 Scalar_FLOAT64_IEEE 0 speedgoat_test_SN5659_R2020b_CM_double -1.7E+308 1.7E+308 /end CHARACTERISTIC
/begin CHARACTERISTIC speedgoat_test_SN5659__cal_impl.Relays_P16 "" VALUE 0x008EFBC8 Scalar_FLOAT64_IEEE 0 speedgoat_test_SN5659_R2020b_CM_double -1.7E+308 1.7E+308 /end CHARACTERISTIC
/begin CHARACTERISTIC speedgoat_test_SN5659__cal_impl.Relays_P17 "" VALUE 0x008EFBE0 Scalar_FLOAT64_IEEE 0 speedgoat_test_SN5659_R2020b_CM_double -1.7E+308 1.7E+308 /end CHARACTERISTIC
/begin CHARACTERISTIC speedgoat_test_SN5659__cal_impl.Relays_P2 "" VAL_BLK 0x008EF870 Scalar_FLOAT64_IEEE 0 speedgoat_test_SN5659_R2020b_CM_double -1.7E+308 1.7E+308 MATRIX_DIM 45 1 /end CHARACTERISTIC
/begin CHARACTERISTIC speedgoat_test_SN5659__cal_impl.Relays_P3 "" VAL_BLK 0x008EF9E8 Scalar_FLOAT64_IEEE 0 speedgoat_test_SN5659_R2020b_CM_double -1.7E+308 1.7E+308 MATRIX_DIM 8 1 /end CHARACTERISTIC
/begin CHARACTERISTIC speedgoat_test_SN5659__cal_impl.Relays_P4 "" VAL_BLK 0x008EFA38 Scalar_FLOAT64_IEEE 0 speedgoat_test_SN5659_R2020b_CM_double -1.7E+308 1.7E+308 MATRIX_DIM 8 1 /end CHARACTERISTIC
/begin CHARACTERISTIC speedgoat_test_SN5659__cal_impl.Relays_P5 "" VAL_BLK 0x008EFA88 Scalar_FLOAT64_IEEE 0 speedgoat_test_SN5659_R2020b_CM_double -1.7E+308 1.7E+308 MATRIX_DIM 8 1 /end CHARACTERISTIC
/begin CHARACTERISTIC speedgoat_test_SN5659__cal_impl.Relays_P6 "" VALUE 0x008EFAD8 Scalar_FLOAT64_IEEE 0 speedgoat_test_SN5659_R2020b_CM_double -1.7E+308 1.7E+308 /end CHARACTERISTIC
/begin CHARACTERISTIC speedgoat_test_SN5659__cal_impl.Relays_P7 "" VALUE 0x008EFAF0 Scalar_FLOAT64_IEEE 0 speedgoat_test_SN5659_R2020b_CM_double -1.7E+308 1.7E+308 /end CHARACTERISTIC
/begin CHARACTERISTIC speedgoat_test_SN5659__cal_impl.Relays_P8 "" VALUE 0x008EFB08 Scalar_FLOAT64_IEEE 0 speedgoat_test_SN5659_R2020b_CM_double -1.7E+308 1.7E+308 /end CHARACTERISTIC
/begin CHARACTERISTIC speedgoat_test_SN5659__cal_impl.Relays_P9 "" VALUE 0x008EFB20 Scalar_FLOAT64_IEEE 0 speedgoat_test_SN5659_R2020b_CM_double -1.7E+308 1.7E+308 /end CHARACTERISTIC
/begin CHARACTERISTIC speedgoat_test_SN5659__cal_impl.SDI_Value_ai "" VALUE 0x008EFC70 Scalar_ULONG 0 speedgoat_test_SN5659_R2020b_CM_uint32 0 2147483646 /end CHARACTERISTIC
/begin CHARACTERISTIC speedgoat_test_SN5659__cal_impl.SDI_Value_g "" VALUE 0x008EFC64 Scalar_ULONG 0 speedgoat_test_SN5659_R2020b_CM_uint32 0 2147483646 /end CHARACTERISTIC
/begin CHARACTERISTIC speedgoat_test_SN5659__cal_impl.SDI_Value_ig "" VALUE 0x008EFC7C Scalar_ULONG 0 speedgoat_test_SN5659_R2020b_CM_uint32 0 2147483646 /end CHARACTERISTIC
/begin CHARACTERISTIC speedgoat_test_SN5659__cal_impl.SDI_Value_im "" VALUE 0x008EFC94 Scalar_ULONG 0 speedgoat_test_SN5659_R2020b_CM_uint32 0 2147483646 /end CHARACTERISTIC
/begin CHARACTERISTIC speedgoat_test_SN5659__cal_impl.SDI_Value_k "" VALUE 0x008EFC88 Scalar_ULONG 0 speedgoat_test_SN5659_R2020b_CM_uint32 0 2147483646 /end CHARACTERISTIC
/begin CHARACTERISTIC speedgoat_test_SN5659__cal_impl.SDI_Value_mq "" VALUE 0x008EFCA0 Scalar_ULONG 0 speedgoat_test_SN5659_R2020b_CM_uint32 0 2147483646 /end CHARACTERISTIC
/begin CHARACTERISTIC speedgoat_test_SN5659__cal_impl.SSM_Value_a "" VALUE 0x008EFC78 Scalar_ULONG 0 speedgoat_test_SN5659_R2020b_CM_uint32 0 2147483646 /end CHARACTERISTIC
/begin CHARACTERISTIC speedgoat_test_SN5659__cal_impl.SSM_Value_f "" VALUE 0x008EFC6C Scalar_ULONG 0 speedgoat_test_SN5659_R2020b_CM_uint32 0 2147483646 /end CHARACTERISTIC
/begin CHARACTERISTIC speedgoat_test_SN5659__cal_impl.SSM_Value_g "" VALUE 0x008EFC84 Scalar_ULONG 0 speedgoat_test_SN5659_R2020b_CM_uint32 0 2147483646 /end CHARACTERISTIC
/begin CHARACTERISTIC speedgoat_test_SN5659__cal_impl.SSM_Value_jt "" VALUE 0x008EFC9C Scalar_ULONG 0 speedgoat_test_SN5659_R2020b_CM_uint32 0 2147483646 /end CHARACTERISTIC
/begin CHARACTERISTIC speedgoat_test_SN5659__cal_impl.SSM_Value_nl "" VALUE 0x008EFC60 Scalar_ULONG 0 speedgoat_test_SN5659_R2020b_CM_uint32 0 2147483646 /end CHARACTERISTIC
/begin CHARACTERISTIC speedgoat_test_SN5659__cal_impl.SSM_Value_p "" VALUE 0x008EFC90 Scalar_ULONG 0 speedgoat_test_SN5659_R2020b_CM_uint32 0 2147483646 /end CHARACTERISTIC
/begin CHARACTERISTIC speedgoat_test_SN5659__cal_impl.Scale_Value_e3 "" VALUE 0x008EDF00 Scalar_FLOAT64_IEEE 0 speedgoat_test_SN5659_R2020b_CM_double -1.7E+308 1.7E+308 /end CHARACTERISTIC
/begin CHARACTERISTIC speedgoat_test_SN5659__cal_impl.Scale_Value_g "" VALUE 0x008ED220 Scalar_FLOAT64_IEEE 0 speedgoat_test_SN5659_R2020b_CM_double -1.7E+308 1.7E+308 /end CHARACTERISTIC
/begin CHARACTERISTIC speedgoat_test_SN5659__cal_impl.Scale_Value_h "" VALUE 0x008ED890 Scalar_FLOAT64_IEEE 0 speedgoat_test_SN5659_R2020b_CM_double -1.7E+308 1.7E+308 /end CHARACTERISTIC
/begin CHARACTERISTIC speedgoat_test_SN5659__cal_impl.Scale_Value_kb "" VALUE 0x008EE570 Scalar_FLOAT64_IEEE 0 speedgoat_test_SN5659_R2020b_CM_double -1.7E+308 1.7E+308 /end CHARACTERISTIC
/begin CHARACTERISTIC speedgoat_test_SN5659__cal_impl.Scale_Value_n "" VALUE 0x008EEBE0 Scalar_FLOAT64_IEEE 0 speedgoat_test_SN5659_R2020b_CM_double -1.7E+308 1.7E+308 /end CHARACTERISTIC
/begin CHARACTERISTIC speedgoat_test_SN5659__cal_impl.Scale_Value_o "" VALUE 0x008ECBB0 Scalar_FLOAT64_IEEE 0 speedgoat_test_SN5659_R2020b_CM_double -1.7E+308 1.7E+308 /end CHARACTERISTIC
/begin CHARACTERISTIC speedgoat_test_SN5659__cal_impl.Sinewave_Amp_ch "" VALUE 0x008EDD50 Scalar_FLOAT64_IEEE 0 speedgoat_test_SN5659_R2020b_CM_double -1.7E+308 1.7E+308 /end CHARACTERISTIC
/begin CHARACTERISTIC speedgoat_test_SN5659__cal_impl.Sinewave_Amp_f "" VALUE 0x008EEA30 Scalar_FLOAT64_IEEE 0 speedgoat_test_SN5659_R2020b_CM_double -1.7E+308 1.7E+308 /end CHARACTERISTIC
/begin CHARACTERISTIC speedgoat_test_SN5659__cal_impl.Sinewave_Amp_h5 "" VALUE 0x008ED070 Scalar_FLOAT64_IEEE 0 speedgoat_test_SN5659_R2020b_CM_double -1.7E+308 1.7E+308 /end CHARACTERISTIC
/begin CHARACTERISTIC speedgoat_test_SN5659__cal_impl.Sinewave_Amp_hw "" VALUE 0x008EE3C0 Scalar_FLOAT64_IEEE 0 speedgoat_test_SN5659_R2020b_CM_double -1.7E+308 1.7E+308 /end CHARACTERISTIC
/begin CHARACTERISTIC speedgoat_test_SN5659__cal_impl.Sinewave_Amp_m "" VALUE 0x008ECA00 Scalar_FLOAT64_IEEE 0 speedgoat_test_SN5659_R2020b_CM_double -1.7E+308 1.7E+308 /end CHARACTERISTIC
/begin CHARACTERISTIC speedgoat_test_SN5659__cal_impl.Sinewave_Amp_m2 "" VALUE 0x008ED6E0 Scalar_FLOAT64_IEEE 0 speedgoat_test_SN5659_R2020b_CM_double -1.7E+308 1.7E+308 /end CHARACTERISTIC
/begin CHARACTERISTIC speedgoat_test_SN5659__cal_impl.Sinewave_Bias_a "" VALUE 0x008ED078 Scalar_FLOAT64_IEEE 0 speedgoat_test_SN5659_R2020b_CM_double -1.7E+308 1.7E+308 /end CHARACTERISTIC
/begin CHARACTERISTIC speedgoat_test_SN5659__cal_impl.Sinewave_Bias_ac "" VALUE 0x008ED6E8 Scalar_FLOAT64_IEEE 0 speedgoat_test_SN5659_R2020b_CM_double -1.7E+308 1.7E+308 /end CHARACTERISTIC
/begin CHARACTERISTIC speedgoat_test_SN5659__cal_impl.Sinewave_Bias_d "" VALUE 0x008EDD58 Scalar_FLOAT64_IEEE 0 speedgoat_test_SN5659_R2020b_CM_double -1.7E+308 1.7E+308 /end CHARACTERISTIC
/begin CHARACTERISTIC speedgoat_test_SN5659__cal_impl.Sinewave_Bias_je "" VALUE 0x008EEA38 Scalar_FLOAT64_IEEE 0 speedgoat_test_SN5659_R2020b_CM_double -1.7E+308 1.7E+308 /end CHARACTERISTIC
/begin CHARACTERISTIC speedgoat_test_SN5659__cal_impl.Sinewave_Bias_o "" VALUE 0x008ECA08 Scalar_FLOAT64_IEEE 0 speedgoat_test_SN5659_R2020b_CM_double -1.7E+308 1.7E+308 /end CHARACTERISTIC
/begin CHARACTERISTIC speedgoat_test_SN5659__cal_impl.Sinewave_Bias_p "" VALUE 0x008EE3C8 Scalar_FLOAT64_IEEE 0 speedgoat_test_SN5659_R2020b_CM_double -1.7E+308 1.7E+308 /end CHARACTERISTIC
/begin CHARACTERISTIC speedgoat_test_SN5659__cal_impl.Sinewave_Freq_a2 "" VALUE 0x008EDD60 Scalar_FLOAT64_IEEE 0 speedgoat_test_SN5659_R2020b_CM_double -1.7E+308 1.7E+308 /end CHARACTERISTIC
/begin CHARACTERISTIC speedgoat_test_SN5659__cal_impl.Sinewave_Freq_am "" VALUE 0x008ED080 Scalar_FLOAT64_IEEE 0 speedgoat_test_SN5659_R2020b_CM_double -1.7E+308 1.7E+308 /end CHARACTERISTIC
/begin CHARACTERISTIC speedgoat_test_SN5659__cal_impl.Sinewave_Freq_cn "" VALUE 0x008ED6F0 Scalar_FLOAT64_IEEE 0 speedgoat_test_SN5659_R2020b_CM_double -1.7E+308 1.7E+308 /end CHARACTERISTIC
/begin CHARACTERISTIC speedgoat_test_SN5659__cal_impl.Sinewave_Freq_j "" VALUE 0x008EE3D0 Scalar_FLOAT64_IEEE 0 speedgoat_test_SN5659_R2020b_CM_double -1.7E+308 1.7E+308 /end CHARACTERISTIC
/begin CHARACTERISTIC speedgoat_test_SN5659__cal_impl.Sinewave_Freq_k "" VALUE 0x008EEA40 Scalar_FLOAT64_IEEE 0 speedgoat_test_SN5659_R2020b_CM_double -1.7E+308 1.7E+308 /end CHARACTERISTIC
/begin CHARACTERISTIC speedgoat_test_SN5659__cal_impl.Sinewave_Freq_lw "" VALUE 0x008ECA10 Scalar_FLOAT64_IEEE 0 speedgoat_test_SN5659_R2020b_CM_double -1.7E+308 1.7E+308 /end CHARACTERISTIC
/begin CHARACTERISTIC speedgoat_test_SN5659__cal_impl.Sinewave_HCos_e "" VALUE 0x008ECA20 Scalar_FLOAT64_IEEE 0 speedgoat_test_SN5659_R2020b_CM_double -1.7E+308 1.7E+308 /end CHARACTERISTIC
/begin CHARACTERISTIC speedgoat_test_SN5659__cal_impl.Sinewave_HCos_h "" VALUE 0x008EDD70 Scalar_FLOAT64_IEEE 0 speedgoat_test_SN5659_R2020b_CM_double -1.7E+308 1.7E+308 /end CHARACTERISTIC
/begin CHARACTERISTIC speedgoat_test_SN5659__cal_impl.Sinewave_HCos_h2 "" VALUE 0x008EE3E0 Scalar_FLOAT64_IEEE 0 speedgoat_test_SN5659_R2020b_CM_double -1.7E+308 1.7E+308 /end CHARACTERISTIC
/begin CHARACTERISTIC speedgoat_test_SN5659__cal_impl.Sinewave_HCos_i "" VALUE 0x008ED700 Scalar_FLOAT64_IEEE 0 speedgoat_test_SN5659_R2020b_CM_double -1.7E+308 1.7E+308 /end CHARACTERISTIC
/begin CHARACTERISTIC speedgoat_test_SN5659__cal_impl.Sinewave_HCos_n "" VALUE 0x008EEA50 Scalar_FLOAT64_IEEE 0 speedgoat_test_SN5659_R2020b_CM_double -1.7E+308 1.7E+308 /end CHARACTERISTIC
/begin CHARACTERISTIC speedgoat_test_SN5659__cal_impl.Sinewave_HCos_p "" VALUE 0x008ED090 Scalar_FLOAT64_IEEE 0 speedgoat_test_SN5659_R2020b_CM_double -1.7E+308 1.7E+308 /end CHARACTERISTIC
/begin CHARACTERISTIC speedgoat_test_SN5659__cal_impl.Sinewave_Hsin_a "" VALUE 0x008ECA18 Scalar_FLOAT64_IEEE 0 speedgoat_test_SN5659_R2020b_CM_double -1.7E+308 1.7E+308 /end CHARACTERISTIC
/begin CHARACTERISTIC speedgoat_test_SN5659__cal_impl.Sinewave_Hsin_c "" VALUE 0x008ED6F8 Scalar_FLOAT64_IEEE 0 speedgoat_test_SN5659_R2020b_CM_double -1.7E+308 1.7E+308 /end CHARACTERISTIC
/begin CHARACTERISTIC speedgoat_test_SN5659__cal_impl.Sinewave_Hsin_cy "" VALUE 0x008EDD68 Scalar_FLOAT64_IEEE 0 speedgoat_test_SN5659_R2020b_CM_double -1.7E+308 1.7E+308 /end CHARACTERISTIC
/begin CHARACTERISTIC speedgoat_test_SN5659__cal_impl.Sinewave_Hsin_jl "" VALUE 0x008EE3D8 Scalar_FLOAT64_IEEE 0 speedgoat_test_SN5659_R2020b_CM_double -1.7E+308 1.7E+308 /end CHARACTERISTIC
/begin CHARACTERISTIC speedgoat_test_SN5659__cal_impl.Sinewave_Hsin_o2 "" VALUE 0x008EEA48 Scalar_FLOAT64_IEEE 0 speedgoat_test_SN5659_R2020b_CM_double -1.7E+308 1.7E+308 /end CHARACTERISTIC
/begin CHARACTERISTIC speedgoat_test_SN5659__cal_impl.Sinewave_Hsin_p "" VALUE 0x008ED088 Scalar_FLOAT64_IEEE 0 speedgoat_test_SN5659_R2020b_CM_double -1.7E+308 1.7E+308 /end CHARACTERISTIC
/begin CHARACTERISTIC speedgoat_test_SN5659__cal_impl.Sinewave_PCos_d "" VALUE 0x008ED0A0 Scalar_FLOAT64_IEEE 0 speedgoat_test_SN5659_R2020b_CM_double -1.7E+308 1.7E+308 /end CHARACTERISTIC
/begin CHARACTERISTIC speedgoat_test_SN5659__cal_impl.Sinewave_PCos_e "" VALUE 0x008ED710 Scalar_FLOAT64_IEEE 0 speedgoat_test_SN5659_R2020b_CM_double -1.7E+308 1.7E+308 /end CHARACTERISTIC
/begin CHARACTERISTIC speedgoat_test_SN5659__cal_impl.Sinewave_PCos_jo "" VALUE 0x008ECA30 Scalar_FLOAT64_IEEE 0 speedgoat_test_SN5659_R2020b_CM_double -1.7E+308 1.7E+308 /end CHARACTERISTIC
/begin CHARACTERISTIC speedgoat_test_SN5659__cal_impl.Sinewave_PCos_l "" VALUE 0x008EE3F0 Scalar_FLOAT64_IEEE 0 speedgoat_test_SN5659_R2020b_CM_double -1.7E+308 1.7E+308 /end CHARACTERISTIC
/begin CHARACTERISTIC speedgoat_test_SN5659__cal_impl.Sinewave_PCos_lt "" VALUE 0x008EEA60 Scalar_FLOAT64_IEEE 0 speedgoat_test_SN5659_R2020b_CM_double -1.7E+308 1.7E+308 /end CHARACTERISTIC
/begin CHARACTERISTIC speedgoat_test_SN5659__cal_impl.Sinewave_PCos_n "" VALUE 0x008EDD80 Scalar_FLOAT64_IEEE 0 speedgoat_test_SN5659_R2020b_CM_double -1.7E+308 1.7E+308 /end CHARACTERISTIC
/begin CHARACTERISTIC speedgoat_test_SN5659__cal_impl.Sinewave_PSin_b "" VALUE 0x008EE3E8 Scalar_FLOAT64_IEEE 0 speedgoat_test_SN5659_R2020b_CM_double -1.7E+308 1.7E+308 /end CHARACTERISTIC
/begin CHARACTERISTIC speedgoat_test_SN5659__cal_impl.Sinewave_PSin_bm "" VALUE 0x008EEA58 Scalar_FLOAT64_IEEE 0 speedgoat_test_SN5659_R2020b_CM_double -1.7E+308 1.7E+308 /end CHARACTERISTIC
/begin CHARACTERISTIC speedgoat_test_SN5659__cal_impl.Sinewave_PSin_d "" VALUE 0x008ED098 Scalar_FLOAT64_IEEE 0 speedgoat_test_SN5659_R2020b_CM_double -1.7E+308 1.7E+308 /end CHARACTERISTIC
/begin CHARACTERISTIC speedgoat_test_SN5659__cal_impl.Sinewave_PSin_l "" VALUE 0x008ED708 Scalar_FLOAT64_IEEE 0 speedgoat_test_SN5659_R2020b_CM_double -1.7E+308 1.7E+308 /end CHARACTERISTIC
/begin CHARACTERISTIC speedgoat_test_SN5659__cal_impl.Sinewave_PSin_o "" VALUE 0x008EDD78 Scalar_FLOAT64_IEEE 0 speedgoat_test_SN5659_R2020b_CM_double -1.7E+308 1.7E+308 /end CHARACTERISTIC
/begin CHARACTERISTIC speedgoat_test_SN5659__cal_impl.Sinewave_PSin_px "" VALUE 0x008ECA28 Scalar_FLOAT64_IEEE 0 speedgoat_test_SN5659_R2020b_CM_double -1.7E+308 1.7E+308 /end CHARACTERISTIC
/begin CHARACTERISTIC speedgoat_test_SN5659__cal_impl.shiftthedoublevalue27bitslef_hk "" VALUE 0x008EEBE8 Scalar_FLOAT64_IEEE 0 speedgoat_test_SN5659_R2020b_CM_double -1.7E+308 1.7E+308 /end CHARACTERISTIC
/begin CHARACTERISTIC speedgoat_test_SN5659__cal_impl.shiftthedoublevalue27bitslef_jj "" VALUE 0x008EDF08 Scalar_FLOAT64_IEEE 0 speedgoat_test_SN5659_R2020b_CM_double -1.7E+308 1.7E+308 /end CHARACTERISTIC
/begin CHARACTERISTIC speedgoat_test_SN5659__cal_impl.shiftthedoublevalue27bitslef_jt "" VALUE 0x008ECBB8 Scalar_FLOAT64_IEEE 0 speedgoat_test_SN5659_R2020b_CM_double -1.7E+308 1.7E+308 /end CHARACTERISTIC
/begin CHARACTERISTIC speedgoat_test_SN5659__cal_impl.shiftthedoublevalue27bitsleft_b "" VALUE 0x008ED898 Scalar_FLOAT64_IEEE 0 speedgoat_test_SN5659_R2020b_CM_double -1.7E+308 1.7E+308 /end CHARACTERISTIC
/begin CHARACTERISTIC speedgoat_test_SN5659__cal_impl.shiftthedoublevalue27bitsleft_d "" VALUE 0x008ED228 Scalar_FLOAT64_IEEE 0 speedgoat_test_SN5659_R2020b_CM_double -1.7E+308 1.7E+308 /end CHARACTERISTIC
/begin CHARACTERISTIC speedgoat_test_SN5659__cal_impl.shiftthedoublevalue27bitsleft_f "" VALUE 0x008EE578 Scalar_FLOAT64_IEEE 0 speedgoat_test_SN5659_R2020b_CM_double -1.7E+308 1.7E+308 /end CHARACTERISTIC
/begin MEASUREMENT speedgoat_test_SN5659_R2020b_B.BitwiseOperator_b "" ULONG speedgoat_test_SN5659_R2020b_CM_uint32 0 0 0 2147483646 ECU_ADDRESS 0x0095BF3C /end MEASUREMENT
/begin MEASUREMENT speedgoat_test_SN5659_R2020b_B.BitwiseOperator_b5 "" ULONG speedgoat_test_SN5659_R2020b_CM_uint32 0 0 0 2147483646 ECU_ADDRESS 0x0095BF78 /end MEASUREMENT
/begin MEASUREMENT speedgoat_test_SN5659_R2020b_B.BitwiseOperator_eh "" ULONG speedgoat_test_SN5659_R2020b_CM_uint32 0 0 0 2147483646 ECU_ADDRESS 0x0095BF50 /end MEASUREMENT
/begin MEASUREMENT speedgoat_test_SN5659_R2020b_B.BitwiseOperator_fl "" ULONG speedgoat_test_SN5659_R2020b_CM_uint32 0 0 0 2147483646 ECU_ADDRESS 0x0095BF8C /end MEASUREMENT
/begin MEASUREMENT speedgoat_test_SN5659_R2020b_B.BitwiseOperator_n "" ULONG speedgoat_test_SN5659_R2020b_CM_uint32 0 0 0 2147483646 ECU_ADDRESS 0x0095BF64 /end MEASUREMENT
/begin MEASUREMENT speedgoat_test_SN5659_R2020b_B.BitwiseOperator_pk "" ULONG speedgoat_test_SN5659_R2020b_CM_uint32 0 0 0 2147483646 ECU_ADDRESS 0x0095BF28 /end MEASUREMENT
/begin MEASUREMENT speedgoat_test_SN5659_R2020b_B.DataTypeConversion1_e "" FLOAT64_IEEE speedgoat_test_SN5659_R2020b_CM_double 0 0 -1.7E+308 1.7E+308 ECU_ADDRESS 0x0095BDC8 /end MEASUREMENT
/begin MEASUREMENT speedgoat_test_SN5659_R2020b_B.DataTypeConversion1_f "" FLOAT64_IEEE speedgoat_test_SN5659_R2020b_CM_double 0 0 -1.7E+308 1.7E+308 ECU_ADDRESS 0x0095BCD8 /end MEASUREMENT
/begin MEASUREMENT speedgoat_test_SN5659_R2020b_B.DataTypeConversion1_fw "" FLOAT64_IEEE speedgoat_test_SN5659_R2020b_CM_double 0 0 -1.7E+308 1.7E+308 ECU_ADDRESS 0x0095BD28 /end MEASUREMENT
/begin MEASUREMENT speedgoat_test_SN5659_R2020b_B.DataTypeConversion1_gh "" FLOAT64_IEEE speedgoat_test_SN5659_R2020b_CM_double 0 0 -1.7E+308 1.7E+308 ECU_ADDRESS 0x0095BC38 /end MEASUREMENT
/begin MEASUREMENT speedgoat_test_SN5659_R2020b_B.DataTypeConversion1_j "" FLOAT64_IEEE speedgoat_test_SN5659_R2020b_CM_double 0 0 -1.7E+308 1.7E+308 ECU_ADDRESS 0x0095BD78 /end MEASUREMENT
/begin MEASUREMENT speedgoat_test_SN5659_R2020b_B.DataTypeConversion1_nb "" FLOAT64_IEEE speedgoat_test_SN5659_R2020b_CM_double 0 0 -1.7E+308 1.7E+308 ECU_ADDRESS 0x0095BC88 /end MEASUREMENT
/begin MEASUREMENT speedgoat_test_SN5659_R2020b_B.DataTypeConversion_cp "" ULONG speedgoat_test_SN5659_R2020b_CM_uint32 0 0 0 2147483646 ECU_ADDRESS 0x0095BF54 /end MEASUREMENT
/begin MEASUREMENT speedgoat_test_SN5659_R2020b_B.DataTypeConversion_dn "" ULONG speedgoat_test_SN5659_R2020b_CM_uint32 0 0 0 2147483646 ECU_ADDRESS 0x0095BF2C /end MEASUREMENT
/begin MEASUREMENT speedgoat_test_SN5659_R2020b_B.DataTypeConversion_dw "" FLOAT64_IEEE speedgoat_test_SN5659_R2020b_CM_double 0 0 -1.7E+308 1.7E+308 ECU_ADDRESS 0x0095BD98 /end MEASUREMENT
/begin MEASUREMENT speedgoat_test_SN5659_R2020b_B.DataTypeConversion_f "" FLOAT64_IEEE speedgoat_test_SN5659_R2020b_CM_double 0 0 -1.7E+308 1.7E+308 ECU_ADDRESS 0x0095BC08 /end MEASUREMENT
/begin MEASUREMENT speedgoat_test_SN5659_R2020b_B.DataTypeConversion_fr "" ULONG speedgoat_test_SN5659_R2020b_CM_uint32 0 0 0 2147483646 ECU_ADDRESS 0x0095BF18 /end MEASUREMENT
/begin MEASUREMENT speedgoat_test_SN5659_R2020b_B.DataTypeConversion_hb "" FLOAT64_IEEE speedgoat_test_SN5659_R2020b_CM_double 0 0 -1.7E+308 1.7E+308 ECU_ADDRESS 0x0095BC58 /end MEASUREMENT
/begin MEASUREMENT speedgoat_test_SN5659_R2020b_B.DataTypeConversion_i "" FLOAT64_IEEE speedgoat_test_SN5659_R2020b_CM_double 0 0 -1.7E+308 1.7E+308 ECU_ADDRESS 0x0095BCF8 /end MEASUREMENT
/begin MEASUREMENT speedgoat_test_SN5659_R2020b_B.DataTypeConversion_ib "" UBYTE speedgoat_test_SN5659_R2020b_CM_logical 0 0 0 1 ECU_ADDRESS 0x0095C5FE /end MEASUREMENT
/begin MEASUREMENT speedgoat_test_SN5659_R2020b_B.DataTypeConversion_is "" ULONG speedgoat_test_SN5659_R2020b_CM_uint32 0 0 0 2147483646 ECU_ADDRESS 0x0095BF68 /end MEASUREMENT
/begin MEASUREMENT speedgoat_test_SN5659_R2020b_B.DataTypeConversion_k "" FLOAT64_IEEE speedgoat_test_SN5659_R2020b_CM_double 0 0 -1.7E+308 1.7E+308 ECU_ADDRESS 0x0095BD48 /end MEASUREMENT
/begin MEASUREMENT speedgoat_test_SN5659_R2020b_B.DataTypeConversion_ku "" ULONG speedgoat_test_SN5659_R2020b_CM_uint32 0 0 0 2147483646 ECU_ADDRESS 0x0095BF7C /end MEASUREMENT
/begin MEASUREMENT speedgoat_test_SN5659_R2020b_B.DataTypeConversion_m "" ULONG speedgoat_test_SN5659_R2020b_CM_uint32 0 0 0 2147483646 ECU_ADDRESS 0x0095BF40 /end MEASUREMENT
/begin MEASUREMENT speedgoat_test_SN5659_R2020b_B.DataTypeConversion_n "" FLOAT64_IEEE speedgoat_test_SN5659_R2020b_CM_double 0 0 -1.7E+308 1.7E+308 ECU_ADDRESS 0x0095BCA8 /end MEASUREMENT
/begin MEASUREMENT speedgoat_test_SN5659_R2020b_B.Divide_c "" FLOAT64_IEEE speedgoat_test_SN5659_R2020b_CM_double 0 0 -1.7E+308 1.7E+308 ECU_ADDRESS 0x0095BD18 /end MEASUREMENT
/begin MEASUREMENT speedgoat_test_SN5659_R2020b_B.Divide_m "" FLOAT64_IEEE speedgoat_test_SN5659_R2020b_CM_double 0 0 -1.7E+308 1.7E+308 ECU_ADDRESS 0x0095BC78 /end MEASUREMENT
/begin MEASUREMENT speedgoat_test_SN5659_R2020b_B.Divide_o "" FLOAT64_IEEE speedgoat_test_SN5659_R2020b_CM_double 0 0 -1.7E+308 1.7E+308 ECU_ADDRESS 0x0095BC28 /end MEASUREMENT
/begin MEASUREMENT speedgoat_test_SN5659_R2020b_B.Divide_oc "" FLOAT64_IEEE speedgoat_test_SN5659_R2020b_CM_double 0 0 -1.7E+308 1.7E+308 ECU_ADDRESS 0x0095BD68 /end MEASUREMENT
/begin MEASUREMENT speedgoat_test_SN5659_R2020b_B.Divide_os "" FLOAT64_IEEE speedgoat_test_SN5659_R2020b_CM_double 0 0 -1.7E+308 1.7E+308 ECU_ADDRESS 0x0095BDB8 /end MEASUREMENT
/begin MEASUREMENT speedgoat_test_SN5659_R2020b_B.Divide_pl "" FLOAT64_IEEE speedgoat_test_SN5659_R2020b_CM_double 0 0 -1.7E+308 1.7E+308 ECU_ADDRESS 0x0095BCC8 /end MEASUREMENT
/begin MEASUREMENT speedgoat_test_SN5659_R2020b_B.Encode1_c "" FLOAT64_IEEE speedgoat_test_SN5659_R2020b_CM_double 0 0 -1.7E+308 1.7E+308 ECU_ADDRESS 0x0095BC00 /end MEASUREMENT
/begin MEASUREMENT speedgoat_test_SN5659_R2020b_B.Encode1_d "" FLOAT64_IEEE speedgoat_test_SN5659_R2020b_CM_double 0 0 -1.7E+308 1.7E+308 ECU_ADDRESS 0x0095BCA0 /end MEASUREMENT
/begin MEASUREMENT speedgoat_test_SN5659_R2020b_B.Encode1_e "" FLOAT64_IEEE speedgoat_test_SN5659_R2020b_CM_double 0 0 -1.7E+308 1.7E+308 ECU_ADDRESS 0x0095BC50 /end MEASUREMENT
/begin MEASUREMENT speedgoat_test_SN5659_R2020b_B.Encode1_ff "" FLOAT64_IEEE speedgoat_test_SN5659_R2020b_CM_double 0 0 -1.7E+308 1.7E+308 ECU_ADDRESS 0x0095BD40 /end MEASUREMENT
/begin MEASUREMENT speedgoat_test_SN5659_R2020b_B.Encode1_i "" FLOAT64_IEEE speedgoat_test_SN5659_R2020b_CM_double 0 0 -1.7E+308 1.7E+308 ECU_ADDRESS 0x0095BCF0 /end MEASUREMENT
/begin MEASUREMENT speedgoat_test_SN5659_R2020b_B.Encode1_kq "" FLOAT64_IEEE speedgoat_test_SN5659_R2020b_CM_double 0 0 -1.7E+308 1.7E+308 ECU_ADDRESS 0x0095BD90 /end MEASUREMENT
/begin MEASUREMENT speedgoat_test_SN5659_R2020b_B.Encode2_ik "" FLOAT64_IEEE speedgoat_test_SN5659_R2020b_CM_double 0 0 -1.7E+308 1.7E+308 ECU_ADDRESS 0x0095BD00 /end MEASUREMENT
/begin MEASUREMENT speedgoat_test_SN5659_R2020b_B.Encode2_l "" FLOAT64_IEEE speedgoat_test_SN5659_R2020b_CM_double 0 0 -1.7E+308 1.7E+308 ECU_ADDRESS 0x0095BC90 /end MEASUREMENT
/begin MEASUREMENT speedgoat_test_SN5659_R2020b_B.Encode2_o "" FLOAT64_IEEE speedgoat_test_SN5659_R2020b_CM_double 0 0 -1.7E+308 1.7E+308 ECU_ADDRESS 0x0095BC10 /end MEASUREMENT
/begin MEASUREMENT speedgoat_test_SN5659_R2020b_B.Encode2_o3 "" FLOAT64_IEEE speedgoat_test_SN5659_R2020b_CM_double 0 0 -1.7E+308 1.7E+308 ECU_ADDRESS 0x0095BDD0 /end MEASUREMENT
/begin MEASUREMENT speedgoat_test_SN5659_R2020b_B.Encode2_o4 "" FLOAT64_IEEE speedgoat_test_SN5659_R2020b_CM_double 0 0 -1.7E+308 1.7E+308 ECU_ADDRESS 0x0095BD50 /end MEASUREMENT
/begin MEASUREMENT speedgoat_test_SN5659_R2020b_B.Encode2_pt "" FLOAT64_IEEE speedgoat_test_SN5659_R2020b_CM_double 0 0 -1.7E+308 1.7E+308 ECU_ADDRESS 0x0095BCB0 /end MEASUREMENT
/begin MEASUREMENT speedgoat_test_SN5659_R2020b_B.Encode3_bv "" FLOAT64_IEEE speedgoat_test_SN5659_R2020b_CM_double 0 0 -1.7E+308 1.7E+308 ECU_ADDRESS 0x0095BC70 /end MEASUREMENT
/begin MEASUREMENT speedgoat_test_SN5659_R2020b_B.Encode3_dc "" FLOAT64_IEEE speedgoat_test_SN5659_R2020b_CM_double 0 0 -1.7E+308 1.7E+308 ECU_ADDRESS 0x0095BD10 /end MEASUREMENT
/begin MEASUREMENT speedgoat_test_SN5659_R2020b_B.Encode3_dp "" FLOAT64_IEEE speedgoat_test_SN5659_R2020b_CM_double 0 0 -1.7E+308 1.7E+308 ECU_ADDRESS 0x0095BD60 /end MEASUREMENT
/begin MEASUREMENT speedgoat_test_SN5659_R2020b_B.Encode3_g "" FLOAT64_IEEE speedgoat_test_SN5659_R2020b_CM_double 0 0 -1.7E+308 1.7E+308 ECU_ADDRESS 0x0095BC20 /end MEASUREMENT
/begin MEASUREMENT speedgoat_test_SN5659_R2020b_B.Encode3_h "" FLOAT64_IEEE speedgoat_test_SN5659_R2020b_CM_double 0 0 -1.7E+308 1.7E+308 ECU_ADDRESS 0x0095BDB0 /end MEASUREMENT
/begin MEASUREMENT speedgoat_test_SN5659_R2020b_B.Encode3_k "" FLOAT64_IEEE speedgoat_test_SN5659_R2020b_CM_double 0 0 -1.7E+308 1.7E+308 ECU_ADDRESS 0x0095BCC0 /end MEASUREMENT
/begin MEASUREMENT speedgoat_test_SN5659_R2020b_B.Encode4_a "" FLOAT64_IEEE speedgoat_test_SN5659_R2020b_CM_double 0 0 -1.7E+308 1.7E+308 ECU_ADDRESS 0x0095BD80 /end MEASUREMENT
/begin MEASUREMENT speedgoat_test_SN5659_R2020b_B.Encode4_cn "" FLOAT64_IEEE speedgoat_test_SN5659_R2020b_CM_double 0 0 -1.7E+308 1.7E+308 ECU_ADDRESS 0x0095BD30 /end MEASUREMENT
/begin MEASUREMENT speedgoat_test_SN5659_R2020b_B.Encode4_cp "" FLOAT64_IEEE speedgoat_test_SN5659_R2020b_CM_double 0 0 -1.7E+308 1.7E+308 ECU_ADDRESS 0x0095BCE0 /end MEASUREMENT
/begin MEASUREMENT speedgoat_test_SN5659_R2020b_B.Encode4_j "" FLOAT64_IEEE speedgoat_test_SN5659_R2020b_CM_double 0 0 -1.7E+308 1.7E+308 ECU_ADDRESS 0x0095BC40 /end MEASUREMENT
/begin MEASUREMENT speedgoat_test_SN5659_R2020b_B.Encode5_a "" FLOAT64_IEEE speedgoat_test_SN5659_R2020b_CM_double 0 0 -1.7E+308 1.7E+308 ECU_ADDRESS 0x0095BC60 /end MEASUREMENT
/begin MEASUREMENT speedgoat_test_SN5659_R2020b_B.Encode5_n "" FLOAT64_IEEE speedgoat_test_SN5659_R2020b_CM_double 0 0 -1.7E+308 1.7E+308 ECU_ADDRESS 0x0095BDA0 /end MEASUREMENT
/begin MEASUREMENT speedgoat_test_SN5659_R2020b_B.FixPtSum1_b "" UWORD speedgoat_test_SN5659_R2020b_CM_uint16 0 0 0 65535 ECU_ADDRESS 0x0095C3F0 /end MEASUREMENT
/begin MEASUREMENT speedgoat_test_SN5659_R2020b_B.FixPtSum1_f "" UWORD speedgoat_test_SN5659_R2020b_CM_uint16 0 0 0 65535 ECU_ADDRESS 0x0095C3D2 /end MEASUREMENT
/begin MEASUREMENT speedgoat_test_SN5659_R2020b_B.FixPtSum1_h2 "" UWORD speedgoat_test_SN5659_R2020b_CM_uint16 0 0 0 65535 ECU_ADDRESS 0x0095C3D8 /end MEASUREMENT
/begin MEASUREMENT speedgoat_test_SN5659_R2020b_B.FixPtSum1_he "" UWORD speedgoat_test_SN5659_R2020b_CM_uint16 0 0 0 65535 ECU_ADDRESS 0x0095C3E4 /end MEASUREMENT
/begin MEASUREMENT speedgoat_test_SN5659_R2020b_B.FixPtSum1_m "" UWORD speedgoat_test_SN5659_R2020b_CM_uint16 0 0 0 65535 ECU_ADDRESS 0x0095C3DE /end MEASUREMENT
/begin MEASUREMENT speedgoat_test_SN5659_R2020b_B.FixPtSum1_p "" UWORD speedgoat_test_SN5659_R2020b_CM_uint16 0 0 0 65535 ECU_ADDRESS 0x0095C3EA /end MEASUREMENT
/begin MEASUREMENT speedgoat_test_SN5659_R2020b_B.FixPtSwitch_a "" UWORD speedgoat_test_SN5659_R2020b_CM_uint16 0 0 0 65535 ECU_ADDRESS 0x0095C3E6 /end MEASUREMENT
/begin MEASUREMENT speedgoat_test_SN5659_R2020b_B.FixPtSwitch_hh "" UWORD speedgoat_test_SN5659_R2020b_CM_uint16 0 0 0 65535 ECU_ADDRESS 0x0095C3E0 /end MEASUREMENT
/begin MEASUREMENT speedgoat_test_SN5659_R2020b_B.FixPtSwitch_j "" UWORD speedgoat_test_SN5659_R2020b_CM_uint16 0 0 0 65535 ECU_ADDRESS 0x0095C3D4 /end MEASUREMENT
/begin MEASUREMENT speedgoat_test_SN5659_R2020b_B.FixPtSwitch_k "" UWORD speedgoat_test_SN5659_R2020b_CM_uint16 0 0 0 65535 ECU_ADDRESS 0x0095C3DA /end MEASUREMENT
/begin MEASUREMENT speedgoat_test_SN5659_R2020b_B.FixPtSwitch_l0 "" UWORD speedgoat_test_SN5659_R2020b_CM_uint16 0 0 0 65535 ECU_ADDRESS 0x0095C3EC /end MEASUREMENT
/begin MEASUREMENT speedgoat_test_SN5659_R2020b_B.FixPtSwitch_m "" UWORD speedgoat_test_SN5659_R2020b_CM_uint16 0 0 0 65535 ECU_ADDRESS 0x0095C3F2 /end MEASUREMENT
/begin MEASUREMENT speedgoat_test_SN5659_R2020b_B.IO941_CH1 "" UBYTE speedgoat_test_SN5659_R2020b_CM_logical 0 0 0 1 ECU_ADDRESS 0x0095C5FF /end MEASUREMENT
/begin MEASUREMENT speedgoat_test_SN5659_R2020b_B.IO941_CH2 "" UBYTE speedgoat_test_SN5659_R2020b_CM_logical 0 0 0 1 ECU_ADDRESS 0x0095C600 /end MEASUREMENT
/begin MEASUREMENT speedgoat_test_SN5659_R2020b_B.IO941_CH3 "" UBYTE speedgoat_test_SN5659_R2020b_CM_logical 0 0 0 1 ECU_ADDRESS 0x0095C601 /end MEASUREMENT
/begin MEASUREMENT speedgoat_test_SN5659_R2020b_B.IO941_CH4 "" UBYTE speedgoat_test_SN5659_R2020b_CM_logical 0 0 0 1 ECU_ADDRESS 0x0095C602 /end MEASUREMENT
/begin MEASUREMENT speedgoat_test_SN5659_R2020b_B.IO941_CH5 "" UBYTE speedgoat_test_SN5659_R2020b_CM_logical 0 0 0 1 ECU_ADDRESS 0x0095C603 /end MEASUREMENT
/begin MEASUREMENT speedgoat_test_SN5659_R2020b_B.IO941_CH6 "" UBYTE speedgoat_test_SN5659_R2020b_CM_logical 0 0 0 1 ECU_ADDRESS 0x0095C604 /end MEASUREMENT
/begin MEASUREMENT speedgoat_test_SN5659_R2020b_B.IO941_CH7 "" UBYTE speedgoat_test_SN5659_R2020b_CM_logical 0 0 0 1 ECU_ADDRESS 0x0095C605 /end MEASUREMENT
/begin MEASUREMENT speedgoat_test_SN5659_R2020b_B.IO941_CH8 "" UBYTE speedgoat_test_SN5659_R2020b_CM_logical 0 0 0 1 ECU_ADDRESS 0x0095C606 /end MEASUREMENT
/begin MEASUREMENT speedgoat_test_SN5659_R2020b_B.Mask_aj "" ULONG speedgoat_test_SN5659_R2020b_CM_uint32 0 0 0 2147483646 ECU_ADDRESS 0x0095BF6C /end MEASUREMENT
/begin MEASUREMENT speedgoat_test_SN5659_R2020b_B.Mask_b "" ULONG speedgoat_test_SN5659_R2020b_CM_uint32 0 0 0 2147483646 ECU_ADDRESS 0x0095BF58 /end MEASUREMENT
/begin MEASUREMENT speedgoat_test_SN5659_R2020b_B.Mask_cs "" ULONG speedgoat_test_SN5659_R2020b_CM_uint32 0 0 0 2147483646 ECU_ADDRESS 0x0095BF30 /end MEASUREMENT
/begin MEASUREMENT speedgoat_test_SN5659_R2020b_B.Mask_cy "" ULONG speedgoat_test_SN5659_R2020b_CM_uint32 0 0 0 2147483646 ECU_ADDRESS 0x0095BF80 /end MEASUREMENT
/begin MEASUREMENT speedgoat_test_SN5659_R2020b_B.Mask_my "" ULONG speedgoat_test_SN5659_R2020b_CM_uint32 0 0 0 2147483646 ECU_ADDRESS 0x0095BF44 /end MEASUREMENT
/begin MEASUREMENT speedgoat_test_SN5659_R2020b_B.Mask_p "" ULONG speedgoat_test_SN5659_R2020b_CM_uint32 0 0 0 2147483646 ECU_ADDRESS 0x0095BF1C /end MEASUREMENT
/begin MEASUREMENT speedgoat_test_SN5659_R2020b_B.Multiply_b "" FLOAT64_IEEE speedgoat_test_SN5659_R2020b_CM_double 0 0 -1.7E+308 1.7E+308 ECU_ADDRESS 0x0095BC30 /end MEASUREMENT
/begin MEASUREMENT speedgoat_test_SN5659_R2020b_B.Multiply_c "" FLOAT64_IEEE speedgoat_test_SN5659_R2020b_CM_double 0 0 -1.7E+308 1.7E+308 ECU_ADDRESS 0x0095BDC0 /end MEASUREMENT
/begin MEASUREMENT speedgoat_test_SN5659_R2020b_B.Multiply_hz "" FLOAT64_IEEE speedgoat_test_SN5659_R2020b_CM_double 0 0 -1.7E+308 1.7E+308 ECU_ADDRESS 0x0095BD20 /end MEASUREMENT
/begin MEASUREMENT speedgoat_test_SN5659_R2020b_B.Multiply_k "" FLOAT64_IEEE speedgoat_test_SN5659_R2020b_CM_double 0 0 -1.7E+308 1.7E+308 ECU_ADDRESS 0x0095BCD0 /end MEASUREMENT
/begin MEASUREMENT speedgoat_test_SN5659_R2020b_B.Multiply_kl "" FLOAT64_IEEE speedgoat_test_SN5659_R2020b_CM_double 0 0 -1.7E+308 1.7E+308 ECU_ADDRESS 0x0095BD70 /end MEASUREMENT
/begin MEASUREMENT speedgoat_test_SN5659_R2020b_B.Multiply_m "" FLOAT64_IEEE speedgoat_test_SN5659_R2020b_CM_double 0 0 -1.7E+308 1.7E+308 ECU_ADDRESS 0x0095BC80 /end MEASUREMENT
/begin MEASUREMENT speedgoat_test_SN5659_R2020b_B.Output_bg "" UWORD speedgoat_test_SN5659_R2020b_CM_uint16 0 0 0 65535 ECU_ADDRESS 0x0095C3E2 /end MEASUREMENT
/begin MEASUREMENT speedgoat_test_SN5659_R2020b_B.Output_d "" UWORD speedgoat_test_SN5659_R2020b_CM_uint16 0 0 0 65535 ECU_ADDRESS 0x0095C3D0 /end MEASUREMENT
/begin MEASUREMENT speedgoat_test_SN5659_R2020b_B.Output_i "" UWORD speedgoat_test_SN5659_R2020b_CM_uint16 0 0 0 65535 ECU_ADDRESS 0x0095C3DC /end MEASUREMENT
/begin MEASUREMENT speedgoat_test_SN5659_R2020b_B.Output_jl "" UWORD speedgoat_test_SN5659_R2020b_CM_uint16 0 0 0 65535 ECU_ADDRESS 0x0095C3D6 /end MEASUREMENT
/begin MEASUREMENT speedgoat_test_SN5659_R2020b_B.Output_mw "" UWORD speedgoat_test_SN5659_R2020b_CM_uint16 0 0 0 65535 ECU_ADDRESS 0x0095C3E8 /end MEASUREMENT
/begin MEASUREMENT speedgoat_test_SN5659_R2020b_B.Output_pd "" UWORD speedgoat_test_SN5659_R2020b_CM_uint16 0 0 0 65535 ECU_ADDRESS 0x0095C3EE /end MEASUREMENT
/begin MEASUREMENT speedgoat_test_SN5659_R2020b_B.PulseGenerator_p "" FLOAT64_IEEE speedgoat_test_SN5659_R2020b_CM_double 0 0 -1.7E+308 1.7E+308 ECU_ADDRESS 0x0095BE18 /end MEASUREMENT
/begin MEASUREMENT speedgoat_test_SN5659_R2020b_B.Randomnumber_d "" FLOAT64_IEEE speedgoat_test_SN5659_R2020b_CM_double 0 0 -1.7E+308 1.7E+308 ECU_ADDRESS 0x0095BCE8 /end MEASUREMENT
/begin MEASUREMENT speedgoat_test_SN5659_R2020b_B.Randomnumber_g "" FLOAT64_IEEE speedgoat_test_SN5659_R2020b_CM_double 0 0 -1.7E+308 1.7E+308 ECU_ADDRESS 0x0095BBF8 /end MEASUREMENT
/begin MEASUREMENT speedgoat_test_SN5659_R2020b_B.Randomnumber_i "" FLOAT64_IEEE speedgoat_test_SN5659_R2020b_CM_double 0 0 -1.7E+308 1.7E+308 ECU_ADDRESS 0x0095BC48 /end MEASUREMENT
/begin MEASUREMENT speedgoat_test_SN5659_R2020b_B.Randomnumber_i2 "" FLOAT64_IEEE speedgoat_test_SN5659_R2020b_CM_double 0 0 -1.7E+308 1.7E+308 ECU_ADDRESS 0x0095BC98 /end MEASUREMENT
/begin MEASUREMENT speedgoat_test_SN5659_R2020b_B.Randomnumber_j "" FLOAT64_IEEE speedgoat_test_SN5659_R2020b_CM_double 0 0 -1.7E+308 1.7E+308 ECU_ADDRESS 0x0095BD88 /end MEASUREMENT
/begin MEASUREMENT speedgoat_test_SN5659_R2020b_B.Randomnumber_n4 "" FLOAT64_IEEE speedgoat_test_SN5659_R2020b_CM_double 0 0 -1.7E+308 1.7E+308 ECU_ADDRESS 0x0095BD38 /end MEASUREMENT
/begin MEASUREMENT speedgoat_test_SN5659_R2020b_B.Read_o10 "" FLOAT64_IEEE speedgoat_test_SN5659_R2020b_CM_double 0 0 -1.7E+308 1.7E+308 ECU_ADDRESS 0x00959AA0 /end MEASUREMENT
/begin MEASUREMENT speedgoat_test_SN5659_R2020b_B.Read_o12 "" FLOAT64_IEEE speedgoat_test_SN5659_R2020b_CM_double 0 0 -1.7E+308 1.7E+308 ECU_ADDRESS 0x00959AB0 /end MEASUREMENT
/begin MEASUREMENT speedgoat_test_SN5659_R2020b_B.Read_o13 "" FLOAT64_IEEE speedgoat_test_SN5659_R2020b_CM_double 0 0 -1.7E+308 1.7E+308 ECU_ADDRESS 0x00959AB8 /end MEASUREMENT
/begin MEASUREMENT speedgoat_test_SN5659_R2020b_B.Read_o14 "" FLOAT64_IEEE speedgoat_test_SN5659_R2020b_CM_double 0 0 -1.7E+308 1.7E+308 ECU_ADDRESS 0x00959AC0 /end MEASUREMENT
/begin MEASUREMENT speedgoat_test_SN5659_R2020b_B.Read_o15 "" FLOAT64_IEEE speedgoat_test_SN5659_R2020b_CM_double 0 0 -1.7E+308 1.7E+308 ECU_ADDRESS 0x00959AC8 /end MEASUREMENT
/begin MEASUREMENT speedgoat_test_SN5659_R2020b_B.Read_o2 "" FLOAT64_IEEE speedgoat_test_SN5659_R2020b_CM_double 0 0 -1.7E+308 1.7E+308 ECU_ADDRESS 0x00959A60 /end MEASUREMENT
/begin MEASUREMENT speedgoat_test_SN5659_R2020b_B.Read_o3 "" FLOAT64_IEEE speedgoat_test_SN5659_R2020b_CM_double 0 0 -1.7E+308 1.7E+308 ECU_ADDRESS 0x00959A68 /end MEASUREMENT
/begin MEASUREMENT speedgoat_test_SN5659_R2020b_B.Read_o4 "" FLOAT64_IEEE speedgoat_test_SN5659_R2020b_CM_double 0 0 -1.7E+308 1.7E+308 ECU_ADDRESS 0x00959A70 /end MEASUREMENT
/begin MEASUREMENT speedgoat_test_SN5659_R2020b_B.Read_o5 "" FLOAT64_IEEE speedgoat_test_SN5659_R2020b_CM_double 0 0 -1.7E+308 1.7E+308 ECU_ADDRESS 0x00959A78 /end MEASUREMENT
/begin MEASUREMENT speedgoat_test_SN5659_R2020b_B.Read_o7 "" FLOAT64_IEEE speedgoat_test_SN5659_R2020b_CM_double 0 0 -1.7E+308 1.7E+308 ECU_ADDRESS 0x00959A88 /end MEASUREMENT
/begin MEASUREMENT speedgoat_test_SN5659_R2020b_B.Read_o8 "" FLOAT64_IEEE speedgoat_test_SN5659_R2020b_CM_double 0 0 -1.7E+308 1.7E+308 ECU_ADDRESS 0x00959A90 /end MEASUREMENT
/begin MEASUREMENT speedgoat_test_SN5659_R2020b_B.Read_o9 "" FLOAT64_IEEE speedgoat_test_SN5659_R2020b_CM_double 0 0 -1.7E+308 1.7E+308 ECU_ADDRESS 0x00959A98 /end MEASUREMENT
/begin MEASUREMENT speedgoat_test_SN5659_R2020b_B.ShifttoSDIslot_bb "" ULONG speedgoat_test_SN5659_R2020b_CM_uint32 0 0 0 2147483646 ECU_ADDRESS 0x0095BF60 /end MEASUREMENT
/begin MEASUREMENT speedgoat_test_SN5659_R2020b_B.ShifttoSDIslot_ck "" ULONG speedgoat_test_SN5659_R2020b_CM_uint32 0 0 0 2147483646 ECU_ADDRESS 0x0095BF24 /end MEASUREMENT
/begin MEASUREMENT speedgoat_test_SN5659_R2020b_B.ShifttoSDIslot_d "" ULONG speedgoat_test_SN5659_R2020b_CM_uint32 0 0 0 2147483646 ECU_ADDRESS 0x0095BF38 /end MEASUREMENT
/begin MEASUREMENT speedgoat_test_SN5659_R2020b_B.ShifttoSDIslot_f "" ULONG speedgoat_test_SN5659_R2020b_CM_uint32 0 0 0 2147483646 ECU_ADDRESS 0x0095BF74 /end MEASUREMENT
/begin MEASUREMENT speedgoat_test_SN5659_R2020b_B.ShifttoSDIslot_fi "" ULONG speedgoat_test_SN5659_R2020b_CM_uint32 0 0 0 2147483646 ECU_ADDRESS 0x0095BF88 /end MEASUREMENT
/begin MEASUREMENT speedgoat_test_SN5659_R2020b_B.ShifttoSDIslot_mf "" ULONG speedgoat_test_SN5659_R2020b_CM_uint32 0 0 0 2147483646 ECU_ADDRESS 0x0095BF4C /end MEASUREMENT
/begin MEASUREMENT speedgoat_test_SN5659_R2020b_B.ShifttoSSMslot_e "" ULONG speedgoat_test_SN5659_R2020b_CM_uint32 0 0 0 2147483646 ECU_ADDRESS 0x0095BF20 /end MEASUREMENT
/begin MEASUREMENT speedgoat_test_SN5659_R2020b_B.ShifttoSSMslot_ea "" ULONG speedgoat_test_SN5659_R2020b_CM_uint32 0 0 0 2147483646 ECU_ADDRESS 0x0095BF70 /end MEASUREMENT
/begin MEASUREMENT speedgoat_test_SN5659_R2020b_B.ShifttoSSMslot_et "" ULONG speedgoat_test_SN5659_R2020b_CM_uint32 0 0 0 2147483646 ECU_ADDRESS 0x0095BF48 /end MEASUREMENT
/begin MEASUREMENT speedgoat_test_SN5659_R2020b_B.ShifttoSSMslot_hy "" ULONG speedgoat_test_SN5659_R2020b_CM_uint32 0 0 0 2147483646 ECU_ADDRESS 0x0095BF84 /end MEASUREMENT
/begin MEASUREMENT speedgoat_test_SN5659_R2020b_B.ShifttoSSMslot_n "" ULONG speedgoat_test_SN5659_R2020b_CM_uint32 0 0 0 2147483646 ECU_ADDRESS 0x0095BF34 /end MEASUREMENT
/begin MEASUREMENT speedgoat_test_SN5659_R2020b_B.ShifttoSSMslot_o "" ULONG speedgoat_test_SN5659_R2020b_CM_uint32 0 0 0 2147483646 ECU_ADDRESS 0x0095BF5C /end MEASUREMENT
/begin MEASUREMENT speedgoat_test_SN5659_R2020b_B.Sinewave_ao "" FLOAT64_IEEE speedgoat_test_SN5659_R2020b_CM_double 0 0 -1.7E+308 1.7E+308 ECU_ADDRESS 0x0095BDA8 /end MEASUREMENT
/begin MEASUREMENT speedgoat_test_SN5659_R2020b_B.Sinewave_d "" FLOAT64_IEEE speedgoat_test_SN5659_R2020b_CM_double 0 0 -1.7E+308 1.7E+308 ECU_ADDRESS 0x0095BC68 /end MEASUREMENT
/begin MEASUREMENT speedgoat_test_SN5659_R2020b_B.Sinewave_fe "" FLOAT64_IEEE speedgoat_test_SN5659_R2020b_CM_double 0 0 -1.7E+308 1.7E+308 ECU_ADDRESS 0x0095BCB8 /end MEASUREMENT
/begin MEASUREMENT speedgoat_test_SN5659_R2020b_B.Sinewave_ff "" FLOAT64_IEEE speedgoat_test_SN5659_R2020b_CM_double 0 0 -1.7E+308 1.7E+308 ECU_ADDRESS 0x0095BD08 /end MEASUREMENT
/begin MEASUREMENT speedgoat_test_SN5659_R2020b_B.Sinewave_m "" FLOAT64_IEEE speedgoat_test_SN5659_R2020b_CM_double 0 0 -1.7E+308 1.7E+308 ECU_ADDRESS 0x0095BD58 /end MEASUREMENT
/begin MEASUREMENT speedgoat_test_SN5659_R2020b_B.Sinewave_n "" FLOAT64_IEEE speedgoat_test_SN5659_R2020b_CM_double 0 0 -1.7E+308 1.7E+308 ECU_ADDRESS 0x0095BC18 /end MEASUREMENT
/begin MEASUREMENT speedgoat_test_SN5659_R2020b_DW.NextOutput_b "" FLOAT64_IEEE speedgoat_test_SN5659_R2020b_CM_double 0 0 -1.7E+308 1.7E+308 ECU_ADDRESS 0x00958A08 /end MEASUREMENT
/begin MEASUREMENT speedgoat_test_SN5659_R2020b_DW.NextOutput_h "" FLOAT64_IEEE speedgoat_test_SN5659_R2020b_CM_double 0 0 -1.7E+308 1.7E+308 ECU_ADDRESS 0x00958990 /end MEASUREMENT
/begin MEASUREMENT speedgoat_test_SN5659_R2020b_DW.NextOutput_hu "" FLOAT64_IEEE speedgoat_test_SN5659_R2020b_CM_double 0 0 -1.7E+308 1.7E+308 ECU_ADDRESS 0x009589C0 /end MEASUREMENT
/begin MEASUREMENT speedgoat_test_SN5659_R2020b_DW.NextOutput_ir "" FLOAT64_IEEE speedgoat_test_SN5659_R2020b_CM_double 0 0 -1.7E+308 1.7E+308 ECU_ADDRESS 0x009589A8 /end MEASUREMENT
/begin MEASUREMENT speedgoat_test_SN5659_R2020b_DW.NextOutput_jn "" FLOAT64_IEEE speedgoat_test_SN5659_R2020b_CM_double 0 0 -1.7E+308 1.7E+308 ECU_ADDRESS 0x009589F0 /end MEASUREMENT
/begin MEASUREMENT speedgoat_test_SN5659_R2020b_DW.NextOutput_p "" FLOAT64_IEEE speedgoat_test_SN5659_R2020b_CM_double 0 0 -1.7E+308 1.7E+308 ECU_ADDRESS 0x009589D8 /end MEASUREMENT
/begin MEASUREMENT speedgoat_test_SN5659_R2020b_DW.Output_DSTATE_b "" UWORD speedgoat_test_SN5659_R2020b_CM_uint16 0 0 0 65535 ECU_ADDRESS 0x009598E2 /end MEASUREMENT
/begin MEASUREMENT speedgoat_test_SN5659_R2020b_DW.Output_DSTATE_f "" UWORD speedgoat_test_SN5659_R2020b_CM_uint16 0 0 0 65535 ECU_ADDRESS 0x009598E4 /end MEASUREMENT
/begin MEASUREMENT speedgoat_test_SN5659_R2020b_DW.Output_DSTATE_fw "" UWORD speedgoat_test_SN5659_R2020b_CM_uint16 0 0 0 65535 ECU_ADDRESS 0x009598EA /end MEASUREMENT
/begin MEASUREMENT speedgoat_test_SN5659_R2020b_DW.Output_DSTATE_h "" UWORD speedgoat_test_SN5659_R2020b_CM_uint16 0 0 0 65535 ECU_ADDRESS 0x009598E6 /end MEASUREMENT
/begin MEASUREMENT speedgoat_test_SN5659_R2020b_DW.Output_DSTATE_m4 "" UWORD speedgoat_test_SN5659_R2020b_CM_uint16 0 0 0 65535 ECU_ADDRESS 0x009598E8 /end MEASUREMENT
/begin MEASUREMENT speedgoat_test_SN5659_R2020b_DW.Output_DSTATE_p "" UWORD speedgoat_test_SN5659_R2020b_CM_uint16 0 0 0 65535 ECU_ADDRESS 0x009598E0 /end MEASUREMENT
/begin MEASUREMENT speedgoat_test_SN5659_R2020b_DW.RandSeed_bw "" ULONG speedgoat_test_SN5659_R2020b_CM_uint32 0 0 0 2147483646 ECU_ADDRESS 0x009594FC /end MEASUREMENT
/begin MEASUREMENT speedgoat_test_SN5659_R2020b_DW.RandSeed_fs "" ULONG speedgoat_test_SN5659_R2020b_CM_uint32 0 0 0 2147483646 ECU_ADDRESS 0x0095950C /end MEASUREMENT
/begin MEASUREMENT speedgoat_test_SN5659_R2020b_DW.RandSeed_hi "" ULONG speedgoat_test_SN5659_R2020b_CM_uint32 0 0 0 2147483646 ECU_ADDRESS 0x009594F8 /end MEASUREMENT
/begin MEASUREMENT speedgoat_test_SN5659_R2020b_DW.RandSeed_j "" ULONG speedgoat_test_SN5659_R2020b_CM_uint32 0 0 0 2147483646 ECU_ADDRESS 0x00959500 /end MEASUREMENT
/begin MEASUREMENT speedgoat_test_SN5659_R2020b_DW.RandSeed_l "" ULONG speedgoat_test_SN5659_R2020b_CM_uint32 0 0 0 2147483646 ECU_ADDRESS 0x00959508 /end MEASUREMENT
/begin MEASUREMENT speedgoat_test_SN5659_R2020b_DW.RandSeed_n "" ULONG speedgoat_test_SN5659_R2020b_CM_uint32 0 0 0 2147483646 ECU_ADDRESS 0x00959504 /end MEASUREMENT
/begin MEASUREMENT speedgoat_test_SN5659_R2020b_DW.clockTickCounter_i "" SLONG speedgoat_test_SN5659_R2020b_CM_int32 0 0 -2147483648 2147483647 ECU_ADDRESS 0x009594CC /end MEASUREMENT
/begin MEASUREMENT speedgoat_test_SN5659_R2020b_DW.lastCos_bf "" FLOAT64_IEEE speedgoat_test_SN5659_R2020b_CM_double 0 0 -1.7E+308 1.7E+308 ECU_ADDRESS 0x00958A18 /end MEASUREMENT
/begin MEASUREMENT speedgoat_test_SN5659_R2020b_DW.lastCos_ca "" FLOAT64_IEEE speedgoat_test_SN5659_R2020b_CM_double 0 0 -1.7E+308 1.7E+308 ECU_ADDRESS 0x00958A00 /end MEASUREMENT
/begin MEASUREMENT speedgoat_test_SN5659_R2020b_DW.lastCos_ge "" FLOAT64_IEEE speedgoat_test_SN5659_R2020b_CM_double 0 0 -1.7E+308 1.7E+308 ECU_ADDRESS 0x009589A0 /end MEASUREMENT
/begin MEASUREMENT speedgoat_test_SN5659_R2020b_DW.lastCos_jh "" FLOAT64_IEEE speedgoat_test_SN5659_R2020b_CM_double 0 0 -1.7E+308 1.7E+308 ECU_ADDRESS 0x009589E8 /end MEASUREMENT
/begin MEASUREMENT speedgoat_test_SN5659_R2020b_DW.lastCos_oh "" FLOAT64_IEEE speedgoat_test_SN5659_R2020b_CM_double 0 0 -1.7E+308 1.7E+308 ECU_ADDRESS 0x009589B8 /end MEASUREMENT
/begin MEASUREMENT speedgoat_test_SN5659_R2020b_DW.lastCos_oy "" FLOAT64_IEEE speedgoat_test_SN5659_R2020b_CM_double 0 0 -1.7E+308 1.7E+308 ECU_ADDRESS 0x009589D0 /end MEASUREMENT
/begin MEASUREMENT speedgoat_test_SN5659_R2020b_DW.lastSin_a "" FLOAT64_IEEE speedgoat_test_SN5659_R2020b_CM_double 0 0 -1.7E+308 1.7E+308 ECU_ADDRESS 0x009589C8 /end MEASUREMENT
/begin MEASUREMENT speedgoat_test_SN5659_R2020b_DW.lastSin_fv "" FLOAT64_IEEE speedgoat_test_SN5659_R2020b_CM_double 0 0 -1.7E+308 1.7E+308 ECU_ADDRESS 0x00958A10 /end MEASUREMENT
/begin MEASUREMENT speedgoat_test_SN5659_R2020b_DW.lastSin_i3 "" FLOAT64_IEEE speedgoat_test_SN5659_R2020b_CM_double 0 0 -1.7E+308 1.7E+308 ECU_ADDRESS 0x009589B0 /end MEASUREMENT
/begin MEASUREMENT speedgoat_test_SN5659_R2020b_DW.lastSin_iv "" FLOAT64_IEEE speedgoat_test_SN5659_R2020b_CM_double 0 0 -1.7E+308 1.7E+308 ECU_ADDRESS 0x009589F8 /end MEASUREMENT
/begin MEASUREMENT speedgoat_test_SN5659_R2020b_DW.lastSin_l "" FLOAT64_IEEE speedgoat_test_SN5659_R2020b_CM_double 0 0 -1.7E+308 1.7E+308 ECU_ADDRESS 0x00958998 /end MEASUREMENT
/begin MEASUREMENT speedgoat_test_SN5659_R2020b_DW.lastSin_pf "" FLOAT64_IEEE speedgoat_test_SN5659_R2020b_CM_double 0 0 -1.7E+308 1.7E+308 ECU_ADDRESS 0x009589E0 /end MEASUREMENT
/begin MEASUREMENT speedgoat_test_SN5659_R2020b_DW.systemEnable_g "" SLONG speedgoat_test_SN5659_R2020b_CM_int32 0 0 -2147483648 2147483647 ECU_ADDRESS 0x009594A4 /end MEASUREMENT
/begin MEASUREMENT speedgoat_test_SN5659_R2020b_DW.systemEnable_gv "" SLONG speedgoat_test_SN5659_R2020b_CM_int32 0 0 -2147483648 2147483647 ECU_ADDRESS 0x009594B4 /end MEASUREMENT
/begin MEASUREMENT speedgoat_test_SN5659_R2020b_DW.systemEnable_ik "" SLONG speedgoat_test_SN5659_R2020b_CM_int32 0 0 -2147483648 2147483647 ECU_ADDRESS 0x009594AC /end MEASUREMENT
/begin MEASUREMENT speedgoat_test_SN5659_R2020b_DW.systemEnable_jy "" SLONG speedgoat_test_SN5659_R2020b_CM_int32 0 0 -2147483648 2147483647 ECU_ADDRESS 0x009594B0 /end MEASUREMENT
/begin MEASUREMENT speedgoat_test_SN5659_R2020b_DW.systemEnable_o1 "" SLONG speedgoat_test_SN5659_R2020b_CM_int32 0 0 -2147483648 2147483647 ECU_ADDRESS 0x009594B8 /end MEASUREMENT
/begin MEASUREMENT speedgoat_test_SN5659_R2020b_DW.systemEnable_pe "" SLONG speedgoat_test_SN5659_R2020b_CM_int32 0 0 -2147483648 2147483647 ECU_ADDRESS 0x009594A8 /end MEASUREMENT
/begin COMPU_METHOD speedgoat_test_SN5659_R2020b_CM_double "" IDENTICAL "%15.10" "" /end COMPU_METHOD
/begin COMPU_METHOD speedgoat_test_SN5659_R2020b_CM_int32 "" IDENTICAL "%10.0" "" /end COMPU_METHOD
/begin COMPU_METHOD speedgoat_test_SN5659_R2020b_CM_logical "" IDENTICAL "%1.0" "" /end COMPU_METHOD
/begin COMPU_METHOD speedgoat_test_SN5659_R2020b_CM_uint16 "" IDENTICAL "%5.0" "" /end COMPU_METHOD
/begin COMPU_METHOD speedgoat_test_SN5659_R2020b_CM_uint32 "" IDENTICAL "%10.0" "" /end COMPU_METHOD
/begin RECORD_LAYOUT Scalar_FLOAT64_IEEE FNC_VALUES 1 FLOAT64_IEEE COLUMN_DIR DIRECT /end RECORD_LAYOUT
/begin RECORD_LAYOUT Scalar_SLONG FNC_VALUES 1 SLONG COLUMN_DIR DIRECT /end RECORD_LAYOUT
/begin RECORD_LAYOUT Scalar_ULONG FNC_VALUES 1 ULONG COLUMN_DIR DIRECT /end RECORD_LAYOUT
/begin RECORD_LAYOUT Scalar_UWORD FNC_VALUES 1 UWORD COLUMN_DIR DIRECT /end RECORD_LAYOUT
/begin GROUP speedgoat_test_SN5659_R2020b_IO682_Encode_Channel_4 "speedgoat_test_SN5659_R2020b/IO682/Encode Channel 4"
 /begin SUB_GROUP speedgoat_test_SN5659_R2020b_IO682_Encode_Channel_4_Counter_Limited speedgoat_test_SN5659_R2020b_IO682_Encode_Channel_4_Prepare_RAW_value /end SUB_GROUP
 /begin REF_CHARACTERISTIC speedgoat_test_SN5659__cal_impl.Constant_Value_gg speedgoat_test_SN5659__cal_impl.Encode1_P10_j speedgoat_test_SN5659__cal_impl.Encode1_P11_fp speedgoat_test_SN5659__cal_impl.Encode1_P12_kd speedgoat_test_SN5659__cal_impl.Encode1_P13_h speedgoat_test_SN5659__cal_impl.Encode1_P14_ov speedgoat_test_SN5659__cal_impl.Encode1_P15_ka speedgoat_test_SN5659__cal_impl.Encode1_P1_k speedgoat_test_SN5659__cal_impl.Encode1_P2_c speedgoat_test_SN5659__cal_impl.Encode1_P3_g speedgoat_test_SN5659__cal_impl.Encode1_P4_eq speedgoat_test_SN5659__cal_impl.Encode1_P5_jf speedgoat_test_SN5659__cal_impl.Encode1_P6_k speedgoat_test_SN5659__cal_impl.Encode1_P7_p speedgoat_test_SN5659__cal_impl.Encode1_P8_o speedgoat_test_SN5659__cal_impl.Encode1_P9_h speedgoat_test_SN5659__cal_impl.Encode2_P10_ab0 speedgoat_test_SN5659__cal_impl.Encode2_P11_p speedgoat_test_SN5659__cal_impl.Encode2_P12_c speedgoat_test_SN5659__cal_impl.Encode2_P13_a speedgoat_test_SN5659__cal_impl.Encode2_P14_db speedgoat_test_SN5659__cal_impl.Encode2_P15_a speedgoat_test_SN5659__cal_impl.Encode2_P1_f speedgoat_test_SN5659__cal_impl.Encode2_P2_kra speedgoat_test_SN5659__cal_impl.Encode2_P3_d speedgoat_test_SN5659__cal_impl.Encode2_P4_lw speedgoat_test_SN5659__cal_impl.Encode2_P5_mc speedgoat_test_SN5659__cal_impl.Encode2_P6_f speedgoat_test_SN5659__cal_impl.Encode2_P7_oo speedgoat_test_SN5659__cal_impl.Encode2_P8_a speedgoat_test_SN5659__cal_impl.Encode2_P9_ni speedgoat_test_SN5659__cal_impl.Encode3_P10_od speedgoat_test_SN5659__cal_impl.Encode3_P11_o speedgoat_test_SN5659__cal_impl.Encode3_P12_f speedgoat_test_SN5659__cal_impl.Encode3_P13_a speedgoat_test_SN5659__cal_impl.Encode3_P14_g speedgoat_test_SN5659__cal_impl.Encode3_P15_a speedgoat_test_SN5659__cal_impl.Encode3_P1_ad speedgoat_test_SN5659__cal_impl.Encode3_P2_fg speedgoat_test_SN5659__cal_impl.Encode3_P3_nx speedgoat_test_SN5659__cal_impl.Encode3_P4_go speedgoat_test_SN5659__cal_impl.Encode3_P5_i0 speedgoat_test_SN5659__cal_impl.Encode3_P6_a0 speedgoat_test_SN5659__cal_impl.Encode3_P7_p speedgoat_test_SN5659__cal_impl.Encode3_P8_j speedgoat_test_SN5659__cal_impl.Encode3_P9_o speedgoat_test_SN5659__cal_impl.Encode4_P10_p speedgoat_test_SN5659__cal_impl.Encode4_P11_a speedgoat_test_SN5659__cal_impl.Encode4_P12_ld speedgoat_test_SN5659__cal_impl.Encode4_P13_g speedgoat_test_SN5659__cal_impl.Encode4_P14_o speedgoat_test_SN5659__cal_impl.Encode4_P15_j speedgoat_test_SN5659__cal_impl.Encode4_P1_h speedgoat_test_SN5659__cal_impl.Encode4_P2_e speedgoat_test_SN5659__cal_impl.Encode4_P3_j speedgoat_test_SN5659__cal_impl.Encode4_P4_o speedgoat_test_SN5659__cal_impl.Encode4_P5_pt speedgoat_test_SN5659__cal_impl.Encode4_P6_ab speedgoat_test_SN5659__cal_impl.Encode4_P7_i speedgoat_test_SN5659__cal_impl.Encode4_P8_hv speedgoat_test_SN5659__cal_impl.Encode4_P9_l speedgoat_test_SN5659__cal_impl.Randomnumber_Mean_p speedgoat_test_SN5659__cal_impl.Randomnumber_Seed_i speedgoat_test_SN5659__cal_impl.Randomnumber_StdDev_b speedgoat_test_SN5659__cal_impl.Sinewave_Amp_m speedgoat_test_SN5659__cal_impl.Sinewave_Bias_o speedgoat_test_SN5659__cal_impl.Sinewave_Freq_lw speedgoat_test_SN5659__cal_impl.Sinewave_HCos_e speedgoat_test_SN5659__cal_impl.Sinewave_Hsin_a speedgoat_test_SN5659__cal_impl.Sinewave_PCos_jo speedgoat_test_SN5659__cal_impl.Sinewave_PSin_px /end REF_CHARACTERISTIC
 /begin REF_MEASUREMENT speedgoat_test_SN5659_R2020b_B.DataTypeConversion1_gh speedgoat_test_SN5659_R2020b_B.DataTypeConversion_f speedgoat_test_SN5659_R2020b_B.Encode1_c speedgoat_test_SN5659_R2020b_B.Encode2_o speedgoat_test_SN5659_R2020b_B.Encode3_g speedgoat_test_SN5659_R2020b_B.Encode4_j speedgoat_test_SN5659_R2020b_B.Output_d speedgoat_test_SN5659_R2020b_B.Randomnumber_g speedgoat_test_SN5659_R2020b_B.Sinewave_n speedgoat_test_SN5659_R2020b_DW.NextOutput_h speedgoat_test_SN5659_R2020b_DW.RandSeed_hi speedgoat_test_SN5659_R2020b_DW.lastCos_ge speedgoat_test_SN5659_R2020b_DW.lastSin_l speedgoat_test_SN5659_R2020b_DW.systemEnable_g /end REF_MEASUREMENT
/end GROUP
/begin GROUP speedgoat_test_SN5659_R2020b_IO682_Encode_Channel_4_Counter_Limited "speedgoat_test_SN5659_R2020b/IO682/Encode Channel 4/Counter
Limited"
 /begin SUB_GROUP speedgoat_test_SN5659_R2020b_IO682_Encode_Channel_4_Counter_Limited_Increment_Real_World speedgoat_test_SN5659_R2020b_IO682_Encode_Channel_4_Counter_Limited_Wrap_To_Zero /end SUB_GROUP
 /begin REF_CHARACTERISTIC speedgoat_test_SN5659__cal_impl.Output_InitialCondition_d /end REF_CHARACTERISTIC
 /begin REF_MEASUREMENT speedgoat_test_SN5659_R2020b_B.FixPtSwitch_j speedgoat_test_SN5659_R2020b_B.Output_d speedgoat_test_SN5659_R2020b_DW.Output_DSTATE_p /end REF_MEASUREMENT
/end GROUP
/begin GROUP speedgoat_test_SN5659_R2020b_IO682_Encode_Channel_4_Counter_Limited_Increment_Real_World "speedgoat_test_SN5659_R2020b/IO682/Encode Channel 4/Counter
Limited/Increment
Real World" /begin REF_CHARACTERISTIC speedgoat_test_SN5659__cal_impl.FixPtConstant_Value_k /end REF_CHARACTERISTIC
 /begin REF_MEASUREMENT speedgoat_test_SN5659_R2020b_B.FixPtSum1_f speedgoat_test_SN5659_R2020b_B.Output_d /end REF_MEASUREMENT
/end GROUP
/begin GROUP speedgoat_test_SN5659_R2020b_IO682_Encode_Channel_4_Counter_Limited_Wrap_To_Zero "speedgoat_test_SN5659_R2020b/IO682/Encode Channel 4/Counter
Limited/Wrap To Zero"
 /begin REF_CHARACTERISTIC speedgoat_test_SN5659__cal_impl.Constant_Value_ly speedgoat_test_SN5659__cal_impl.CounterLimited_uplimit_p /end REF_CHARACTERISTIC
 /begin REF_MEASUREMENT speedgoat_test_SN5659_R2020b_B.FixPtSum1_f speedgoat_test_SN5659_R2020b_B.FixPtSwitch_j /end REF_MEASUREMENT
/end GROUP
/begin GROUP speedgoat_test_SN5659_R2020b_IO682_Encode_Channel_4_Prepare_RAW_value "speedgoat_test_SN5659_R2020b/IO682/Encode Channel 4/Prepare RAW value"
 /begin REF_CHARACTERISTIC speedgoat_test_SN5659__cal_impl.Label_Value_l speedgoat_test_SN5659__cal_impl.Mask_BitMask_f speedgoat_test_SN5659__cal_impl.SDI_Value_g speedgoat_test_SN5659__cal_impl.SSM_Value_nl speedgoat_test_SN5659__cal_impl.Scale_Value_o speedgoat_test_SN5659__cal_impl.shiftthedoublevalue27bitslef_jt /end REF_CHARACTERISTIC
 /begin REF_MEASUREMENT speedgoat_test_SN5659_R2020b_B.BitwiseOperator_pk speedgoat_test_SN5659_R2020b_B.DataTypeConversion1_gh speedgoat_test_SN5659_R2020b_B.DataTypeConversion_fr speedgoat_test_SN5659_R2020b_B.Divide_o speedgoat_test_SN5659_R2020b_B.Mask_p speedgoat_test_SN5659_R2020b_B.Multiply_b speedgoat_test_SN5659_R2020b_B.ShifttoSDIslot_ck speedgoat_test_SN5659_R2020b_B.ShifttoSSMslot_e /end REF_MEASUREMENT
/end GROUP
/begin GROUP speedgoat_test_SN5659_R2020b_IO682_Encode_Channel_5 "speedgoat_test_SN5659_R2020b/IO682/Encode Channel 5"
 /begin SUB_GROUP speedgoat_test_SN5659_R2020b_IO682_Encode_Channel_5_Counter_Limited speedgoat_test_SN5659_R2020b_IO682_Encode_Channel_5_Prepare_RAW_value /end SUB_GROUP
 /begin REF_CHARACTERISTIC speedgoat_test_SN5659__cal_impl.Constant_Value_h speedgoat_test_SN5659__cal_impl.Encode1_P10_g speedgoat_test_SN5659__cal_impl.Encode1_P11_gb speedgoat_test_SN5659__cal_impl.Encode1_P12_i speedgoat_test_SN5659__cal_impl.Encode1_P13_hz speedgoat_test_SN5659__cal_impl.Encode1_P14_f speedgoat_test_SN5659__cal_impl.Encode1_P15_n speedgoat_test_SN5659__cal_impl.Encode1_P1_n speedgoat_test_SN5659__cal_impl.Encode1_P2_d speedgoat_test_SN5659__cal_impl.Encode1_P3_n speedgoat_test_SN5659__cal_impl.Encode1_P4_b speedgoat_test_SN5659__cal_impl.Encode1_P5_gx speedgoat_test_SN5659__cal_impl.Encode1_P6_mt speedgoat_test_SN5659__cal_impl.Encode1_P7_k speedgoat_test_SN5659__cal_impl.Encode1_P8_bu speedgoat_test_SN5659__cal_impl.Encode1_P9_ju speedgoat_test_SN5659__cal_impl.Encode2_P10_im speedgoat_test_SN5659__cal_impl.Encode2_P11_o speedgoat_test_SN5659__cal_impl.Encode2_P12_k3 speedgoat_test_SN5659__cal_impl.Encode2_P13_m speedgoat_test_SN5659__cal_impl.Encode2_P14_k speedgoat_test_SN5659__cal_impl.Encode2_P15_e1 speedgoat_test_SN5659__cal_impl.Encode2_P1_b speedgoat_test_SN5659__cal_impl.Encode2_P2_di speedgoat_test_SN5659__cal_impl.Encode2_P3_ln speedgoat_test_SN5659__cal_impl.Encode2_P4_n speedgoat_test_SN5659__cal_impl.Encode2_P5_a speedgoat_test_SN5659__cal_impl.Encode2_P6_c speedgoat_test_SN5659__cal_impl.Encode2_P7_iq speedgoat_test_SN5659__cal_impl.Encode2_P8_b speedgoat_test_SN5659__cal_impl.Encode2_P9_l speedgoat_test_SN5659__cal_impl.Encode3_P10_f speedgoat_test_SN5659__cal_impl.Encode3_P11_ic speedgoat_test_SN5659__cal_impl.Encode3_P12_m speedgoat_test_SN5659__cal_impl.Encode3_P13_hi speedgoat_test_SN5659__cal_impl.Encode3_P14_op speedgoat_test_SN5659__cal_impl.Encode3_P15_f speedgoat_test_SN5659__cal_impl.Encode3_P1_o speedgoat_test_SN5659__cal_impl.Encode3_P2_b0 speedgoat_test_SN5659__cal_impl.Encode3_P3_p speedgoat_test_SN5659__cal_impl.Encode3_P4_hs speedgoat_test_SN5659__cal_impl.Encode3_P5_g speedgoat_test_SN5659__cal_impl.Encode3_P6_hi speedgoat_test_SN5659__cal_impl.Encode3_P7_c speedgoat_test_SN5659__cal_impl.Encode3_P8_fe speedgoat_test_SN5659__cal_impl.Encode3_P9_l speedgoat_test_SN5659__cal_impl.Encode5_P10_j speedgoat_test_SN5659__cal_impl.Encode5_P11_h speedgoat_test_SN5659__cal_impl.Encode5_P12_c speedgoat_test_SN5659__cal_impl.Encode5_P13_c speedgoat_test_SN5659__cal_impl.Encode5_P14_e speedgoat_test_SN5659__cal_impl.Encode5_P15_m speedgoat_test_SN5659__cal_impl.Encode5_P1_a speedgoat_test_SN5659__cal_impl.Encode5_P2_l speedgoat_test_SN5659__cal_impl.Encode5_P3_c speedgoat_test_SN5659__cal_impl.Encode5_P4_o speedgoat_test_SN5659__cal_impl.Encode5_P5_ih speedgoat_test_SN5659__cal_impl.Encode5_P6_o speedgoat_test_SN5659__cal_impl.Encode5_P7_l speedgoat_test_SN5659__cal_impl.Encode5_P8_m speedgoat_test_SN5659__cal_impl.Encode5_P9_o speedgoat_test_SN5659__cal_impl.Randomnumber_Mean_c speedgoat_test_SN5659__cal_impl.Randomnumber_Seed_o speedgoat_test_SN5659__cal_impl.Randomnumber_StdDev_mo speedgoat_test_SN5659__cal_impl.Sinewave_Amp_h5 speedgoat_test_SN5659__cal_impl.Sinewave_Bias_a speedgoat_test_SN5659__cal_impl.Sinewave_Freq_am speedgoat_test_SN5659__cal_impl.Sinewave_HCos_p speedgoat_test_SN5659__cal_impl.Sinewave_Hsin_p speedgoat_test_SN5659__cal_impl.Sinewave_PCos_d speedgoat_test_SN5659__cal_impl.Sinewave_PSin_d /end REF_CHARACTERISTIC
 /begin REF_MEASUREMENT speedgoat_test_SN5659_R2020b_B.DataTypeConversion1_nb speedgoat_test_SN5659_R2020b_B.DataTypeConversion_hb speedgoat_test_SN5659_R2020b_B.Encode1_e speedgoat_test_SN5659_R2020b_B.Encode2_l speedgoat_test_SN5659_R2020b_B.Encode3_bv speedgoat_test_SN5659_R2020b_B.Encode5_a speedgoat_test_SN5659_R2020b_B.Output_jl speedgoat_test_SN5659_R2020b_B.Randomnumber_i speedgoat_test_SN5659_R2020b_B.Sinewave_d speedgoat_test_SN5659_R2020b_DW.NextOutput_ir speedgoat_test_SN5659_R2020b_DW.RandSeed_bw speedgoat_test_SN5659_R2020b_DW.lastCos_oh speedgoat_test_SN5659_R2020b_DW.lastSin_i3 speedgoat_test_SN5659_R2020b_DW.systemEnable_pe /end REF_MEASUREMENT
/end GROUP
/begin GROUP speedgoat_test_SN5659_R2020b_IO682_Encode_Channel_5_Counter_Limited "speedgoat_test_SN5659_R2020b/IO682/Encode Channel 5/Counter
Limited"
 /begin SUB_GROUP speedgoat_test_SN5659_R2020b_IO682_Encode_Channel_5_Counter_Limited_Increment_Real_World speedgoat_test_SN5659_R2020b_IO682_Encode_Channel_5_Counter_Limited_Wrap_To_Zero /end SUB_GROUP
 /begin REF_CHARACTERISTIC speedgoat_test_SN5659__cal_impl.Output_InitialCondition_nb /end REF_CHARACTERISTIC
 /begin REF_MEASUREMENT speedgoat_test_SN5659_R2020b_B.FixPtSwitch_k speedgoat_test_SN5659_R2020b_B.Output_jl speedgoat_test_SN5659_R2020b_DW.Output_DSTATE_b /end REF_MEASUREMENT
/end GROUP
/begin GROUP speedgoat_test_SN5659_R2020b_IO682_Encode_Channel_5_Counter_Limited_Increment_Real_World "speedgoat_test_SN5659_R2020b/IO682/Encode Channel 5/Counter
Limited/Increment
Real World" /begin REF_CHARACTERISTIC speedgoat_test_SN5659__cal_impl.FixPtConstant_Value_m /end REF_CHARACTERISTIC
 /begin REF_MEASUREMENT speedgoat_test_SN5659_R2020b_B.FixPtSum1_h2 speedgoat_test_SN5659_R2020b_B.Output_jl /end REF_MEASUREMENT
/end GROUP
/begin GROUP speedgoat_test_SN5659_R2020b_IO682_Encode_Channel_5_Counter_Limited_Wrap_To_Zero "speedgoat_test_SN5659_R2020b/IO682/Encode Channel 5/Counter
Limited/Wrap To Zero"
 /begin REF_CHARACTERISTIC speedgoat_test_SN5659__cal_impl.Constant_Value_ng speedgoat_test_SN5659__cal_impl.CounterLimited_uplimit_ck /end REF_CHARACTERISTIC
 /begin REF_MEASUREMENT speedgoat_test_SN5659_R2020b_B.FixPtSum1_h2 speedgoat_test_SN5659_R2020b_B.FixPtSwitch_k /end REF_MEASUREMENT
/end GROUP
/begin GROUP speedgoat_test_SN5659_R2020b_IO682_Encode_Channel_5_Prepare_RAW_value "speedgoat_test_SN5659_R2020b/IO682/Encode Channel 5/Prepare RAW value"
 /begin REF_CHARACTERISTIC speedgoat_test_SN5659__cal_impl.Label_Value_kp speedgoat_test_SN5659__cal_impl.Mask_BitMask_c speedgoat_test_SN5659__cal_impl.SDI_Value_ai speedgoat_test_SN5659__cal_impl.SSM_Value_f speedgoat_test_SN5659__cal_impl.Scale_Value_g speedgoat_test_SN5659__cal_impl.shiftthedoublevalue27bitsleft_d /end REF_CHARACTERISTIC
 /begin REF_MEASUREMENT speedgoat_test_SN5659_R2020b_B.BitwiseOperator_b speedgoat_test_SN5659_R2020b_B.DataTypeConversion1_nb speedgoat_test_SN5659_R2020b_B.DataTypeConversion_dn speedgoat_test_SN5659_R2020b_B.Divide_m speedgoat_test_SN5659_R2020b_B.Mask_cs speedgoat_test_SN5659_R2020b_B.Multiply_m speedgoat_test_SN5659_R2020b_B.ShifttoSDIslot_d speedgoat_test_SN5659_R2020b_B.ShifttoSSMslot_n /end REF_MEASUREMENT
/end GROUP
/begin GROUP speedgoat_test_SN5659_R2020b_IO682_Encode_Channel_6 "speedgoat_test_SN5659_R2020b/IO682/Encode Channel 6"
 /begin SUB_GROUP speedgoat_test_SN5659_R2020b_IO682_Encode_Channel_6_Counter_Limited speedgoat_test_SN5659_R2020b_IO682_Encode_Channel_6_Prepare_RAW_value /end SUB_GROUP
 /begin REF_CHARACTERISTIC speedgoat_test_SN5659__cal_impl.Constant_Value_f speedgoat_test_SN5659__cal_impl.Encode1_P10_i0 speedgoat_test_SN5659__cal_impl.Encode1_P11_c speedgoat_test_SN5659__cal_impl.Encode1_P12_as speedgoat_test_SN5659__cal_impl.Encode1_P13_b speedgoat_test_SN5659__cal_impl.Encode1_P14_fh speedgoat_test_SN5659__cal_impl.Encode1_P15_h1 speedgoat_test_SN5659__cal_impl.Encode1_P1_gb speedgoat_test_SN5659__cal_impl.Encode1_P2_es speedgoat_test_SN5659__cal_impl.Encode1_P3_eh speedgoat_test_SN5659__cal_impl.Encode1_P4_h speedgoat_test_SN5659__cal_impl.Encode1_P5_d speedgoat_test_SN5659__cal_impl.Encode1_P6_g speedgoat_test_SN5659__cal_impl.Encode1_P7_n speedgoat_test_SN5659__cal_impl.Encode1_P8_cc speedgoat_test_SN5659__cal_impl.Encode1_P9_f speedgoat_test_SN5659__cal_impl.Encode2_P10_d speedgoat_test_SN5659__cal_impl.Encode2_P11_b speedgoat_test_SN5659__cal_impl.Encode2_P12_mp speedgoat_test_SN5659__cal_impl.Encode2_P13_b speedgoat_test_SN5659__cal_impl.Encode2_P14_h speedgoat_test_SN5659__cal_impl.Encode2_P15_d speedgoat_test_SN5659__cal_impl.Encode2_P1_ga speedgoat_test_SN5659__cal_impl.Encode2_P2_ka speedgoat_test_SN5659__cal_impl.Encode2_P3_fe speedgoat_test_SN5659__cal_impl.Encode2_P4_lk speedgoat_test_SN5659__cal_impl.Encode2_P5_n speedgoat_test_SN5659__cal_impl.Encode2_P6_fn speedgoat_test_SN5659__cal_impl.Encode2_P7_jb speedgoat_test_SN5659__cal_impl.Encode2_P8_hl speedgoat_test_SN5659__cal_impl.Encode2_P9_dn speedgoat_test_SN5659__cal_impl.Encode3_P10_g speedgoat_test_SN5659__cal_impl.Encode3_P11_ox speedgoat_test_SN5659__cal_impl.Encode3_P12_d3 speedgoat_test_SN5659__cal_impl.Encode3_P13_n speedgoat_test_SN5659__cal_impl.Encode3_P14_bl speedgoat_test_SN5659__cal_impl.Encode3_P15_gy speedgoat_test_SN5659__cal_impl.Encode3_P1_j speedgoat_test_SN5659__cal_impl.Encode3_P2_p speedgoat_test_SN5659__cal_impl.Encode3_P3_pb speedgoat_test_SN5659__cal_impl.Encode3_P4_hu speedgoat_test_SN5659__cal_impl.Encode3_P5_kk speedgoat_test_SN5659__cal_impl.Encode3_P6_iy speedgoat_test_SN5659__cal_impl.Encode3_P7_g speedgoat_test_SN5659__cal_impl.Encode3_P8_c speedgoat_test_SN5659__cal_impl.Encode3_P9_a speedgoat_test_SN5659__cal_impl.Encode4_P10_h3 speedgoat_test_SN5659__cal_impl.Encode4_P11_l speedgoat_test_SN5659__cal_impl.Encode4_P12_c speedgoat_test_SN5659__cal_impl.Encode4_P13_ml speedgoat_test_SN5659__cal_impl.Encode4_P14_k speedgoat_test_SN5659__cal_impl.Encode4_P15_o speedgoat_test_SN5659__cal_impl.Encode4_P1_af speedgoat_test_SN5659__cal_impl.Encode4_P2_j speedgoat_test_SN5659__cal_impl.Encode4_P3_n5 speedgoat_test_SN5659__cal_impl.Encode4_P4_kc speedgoat_test_SN5659__cal_impl.Encode4_P5_d speedgoat_test_SN5659__cal_impl.Encode4_P6_abh speedgoat_test_SN5659__cal_impl.Encode4_P7_di speedgoat_test_SN5659__cal_impl.Encode4_P8_e speedgoat_test_SN5659__cal_impl.Encode4_P9_d speedgoat_test_SN5659__cal_impl.Randomnumber_Mean_l speedgoat_test_SN5659__cal_impl.Randomnumber_Seed_cg speedgoat_test_SN5659__cal_impl.Randomnumber_StdDev_o speedgoat_test_SN5659__cal_impl.Sinewave_Amp_m2 speedgoat_test_SN5659__cal_impl.Sinewave_Bias_ac speedgoat_test_SN5659__cal_impl.Sinewave_Freq_cn speedgoat_test_SN5659__cal_impl.Sinewave_HCos_i speedgoat_test_SN5659__cal_impl.Sinewave_Hsin_c speedgoat_test_SN5659__cal_impl.Sinewave_PCos_e speedgoat_test_SN5659__cal_impl.Sinewave_PSin_l /end REF_CHARACTERISTIC
 /begin REF_MEASUREMENT speedgoat_test_SN5659_R2020b_B.DataTypeConversion1_f speedgoat_test_SN5659_R2020b_B.DataTypeConversion_n speedgoat_test_SN5659_R2020b_B.Encode1_d speedgoat_test_SN5659_R2020b_B.Encode2_pt speedgoat_test_SN5659_R2020b_B.Encode3_k speedgoat_test_SN5659_R2020b_B.Encode4_cp speedgoat_test_SN5659_R2020b_B.Output_i speedgoat_test_SN5659_R2020b_B.Randomnumber_i2 speedgoat_test_SN5659_R2020b_B.Sinewave_fe speedgoat_test_SN5659_R2020b_DW.NextOutput_hu speedgoat_test_SN5659_R2020b_DW.RandSeed_j speedgoat_test_SN5659_R2020b_DW.lastCos_oy speedgoat_test_SN5659_R2020b_DW.lastSin_a speedgoat_test_SN5659_R2020b_DW.systemEnable_ik /end REF_MEASUREMENT
/end GROUP
/begin GROUP speedgoat_test_SN5659_R2020b_IO682_Encode_Channel_6_Counter_Limited "speedgoat_test_SN5659_R2020b/IO682/Encode Channel 6/Counter
Limited"
 /begin SUB_GROUP speedgoat_test_SN5659_R2020b_IO682_Encode_Channel_6_Counter_Limited_Increment_Real_World speedgoat_test_SN5659_R2020b_IO682_Encode_Channel_6_Counter_Limited_Wrap_To_Zero /end SUB_GROUP
 /begin REF_CHARACTERISTIC speedgoat_test_SN5659__cal_impl.Output_InitialCondition_h3 /end REF_CHARACTERISTIC
 /begin REF_MEASUREMENT speedgoat_test_SN5659_R2020b_B.FixPtSwitch_hh speedgoat_test_SN5659_R2020b_B.Output_i speedgoat_test_SN5659_R2020b_DW.Output_DSTATE_f /end REF_MEASUREMENT
/end GROUP
/begin GROUP speedgoat_test_SN5659_R2020b_IO682_Encode_Channel_6_Counter_Limited_Increment_Real_World "speedgoat_test_SN5659_R2020b/IO682/Encode Channel 6/Counter
Limited/Increment
Real World" /begin REF_CHARACTERISTIC speedgoat_test_SN5659__cal_impl.FixPtConstant_Value_n /end REF_CHARACTERISTIC
 /begin REF_MEASUREMENT speedgoat_test_SN5659_R2020b_B.FixPtSum1_m speedgoat_test_SN5659_R2020b_B.Output_i /end REF_MEASUREMENT
/end GROUP
/begin GROUP speedgoat_test_SN5659_R2020b_IO682_Encode_Channel_6_Counter_Limited_Wrap_To_Zero "speedgoat_test_SN5659_R2020b/IO682/Encode Channel 6/Counter
Limited/Wrap To Zero"
 /begin REF_CHARACTERISTIC speedgoat_test_SN5659__cal_impl.Constant_Value_oy speedgoat_test_SN5659__cal_impl.CounterLimited_uplimit_l /end REF_CHARACTERISTIC
 /begin REF_MEASUREMENT speedgoat_test_SN5659_R2020b_B.FixPtSum1_m speedgoat_test_SN5659_R2020b_B.FixPtSwitch_hh /end REF_MEASUREMENT
/end GROUP
/begin GROUP speedgoat_test_SN5659_R2020b_IO682_Encode_Channel_6_Prepare_RAW_value "speedgoat_test_SN5659_R2020b/IO682/Encode Channel 6/Prepare RAW value"
 /begin REF_CHARACTERISTIC speedgoat_test_SN5659__cal_impl.Label_Value_p speedgoat_test_SN5659__cal_impl.Mask_BitMask_er speedgoat_test_SN5659__cal_impl.SDI_Value_ig speedgoat_test_SN5659__cal_impl.SSM_Value_a speedgoat_test_SN5659__cal_impl.Scale_Value_h speedgoat_test_SN5659__cal_impl.shiftthedoublevalue27bitsleft_b /end REF_CHARACTERISTIC
 /begin REF_MEASUREMENT speedgoat_test_SN5659_R2020b_B.BitwiseOperator_eh speedgoat_test_SN5659_R2020b_B.DataTypeConversion1_f speedgoat_test_SN5659_R2020b_B.DataTypeConversion_m speedgoat_test_SN5659_R2020b_B.Divide_pl speedgoat_test_SN5659_R2020b_B.Mask_my speedgoat_test_SN5659_R2020b_B.Multiply_k speedgoat_test_SN5659_R2020b_B.ShifttoSDIslot_mf speedgoat_test_SN5659_R2020b_B.ShifttoSSMslot_et /end REF_MEASUREMENT
/end GROUP
/begin GROUP speedgoat_test_SN5659_R2020b_IO682_Encode_Channel_7 "speedgoat_test_SN5659_R2020b/IO682/Encode Channel 7"
 /begin SUB_GROUP speedgoat_test_SN5659_R2020b_IO682_Encode_Channel_7_Counter_Limited speedgoat_test_SN5659_R2020b_IO682_Encode_Channel_7_Prepare_RAW_value /end SUB_GROUP
 /begin REF_CHARACTERISTIC speedgoat_test_SN5659__cal_impl.Constant_Value_bz speedgoat_test_SN5659__cal_impl.Encode1_P10_i5 speedgoat_test_SN5659__cal_impl.Encode1_P11_am speedgoat_test_SN5659__cal_impl.Encode1_P12_mt speedgoat_test_SN5659__cal_impl.Encode1_P13_is speedgoat_test_SN5659__cal_impl.Encode1_P14_cd speedgoat_test_SN5659__cal_impl.Encode1_P15_kak speedgoat_test_SN5659__cal_impl.Encode1_P1_cy speedgoat_test_SN5659__cal_impl.Encode1_P2_a speedgoat_test_SN5659__cal_impl.Encode1_P3_em speedgoat_test_SN5659__cal_impl.Encode1_P4_m speedgoat_test_SN5659__cal_impl.Encode1_P5_dq speedgoat_test_SN5659__cal_impl.Encode1_P6_ad speedgoat_test_SN5659__cal_impl.Encode1_P7_eo speedgoat_test_SN5659__cal_impl.Encode1_P8_n speedgoat_test_SN5659__cal_impl.Encode1_P9_a2 speedgoat_test_SN5659__cal_impl.Encode2_P10_dc speedgoat_test_SN5659__cal_impl.Encode2_P11_hq speedgoat_test_SN5659__cal_impl.Encode2_P12_ek speedgoat_test_SN5659__cal_impl.Encode2_P13_oo speedgoat_test_SN5659__cal_impl.Encode2_P14_j speedgoat_test_SN5659__cal_impl.Encode2_P15_n speedgoat_test_SN5659__cal_impl.Encode2_P1_o speedgoat_test_SN5659__cal_impl.Encode2_P2_g speedgoat_test_SN5659__cal_impl.Encode2_P3_kx speedgoat_test_SN5659__cal_impl.Encode2_P4_a speedgoat_test_SN5659__cal_impl.Encode2_P5_pz speedgoat_test_SN5659__cal_impl.Encode2_P6_k speedgoat_test_SN5659__cal_impl.Encode2_P7_p speedgoat_test_SN5659__cal_impl.Encode2_P8_ip speedgoat_test_SN5659__cal_impl.Encode2_P9_hv speedgoat_test_SN5659__cal_impl.Encode3_P10_oe speedgoat_test_SN5659__cal_impl.Encode3_P11_a speedgoat_test_SN5659__cal_impl.Encode3_P12_et speedgoat_test_SN5659__cal_impl.Encode3_P13_d speedgoat_test_SN5659__cal_impl.Encode3_P14_p speedgoat_test_SN5659__cal_impl.Encode3_P15_l speedgoat_test_SN5659__cal_impl.Encode3_P1_jy speedgoat_test_SN5659__cal_impl.Encode3_P2_d speedgoat_test_SN5659__cal_impl.Encode3_P3_f speedgoat_test_SN5659__cal_impl.Encode3_P4_mc speedgoat_test_SN5659__cal_impl.Encode3_P5_d0 speedgoat_test_SN5659__cal_impl.Encode3_P6_hf speedgoat_test_SN5659__cal_impl.Encode3_P7_k speedgoat_test_SN5659__cal_impl.Encode3_P8_o speedgoat_test_SN5659__cal_impl.Encode3_P9_cw speedgoat_test_SN5659__cal_impl.Encode4_P10_l speedgoat_test_SN5659__cal_impl.Encode4_P11_pl speedgoat_test_SN5659__cal_impl.Encode4_P12_k speedgoat_test_SN5659__cal_impl.Encode4_P13_hn speedgoat_test_SN5659__cal_impl.Encode4_P14_ma speedgoat_test_SN5659__cal_impl.Encode4_P15_iu speedgoat_test_SN5659__cal_impl.Encode4_P1_o speedgoat_test_SN5659__cal_impl.Encode4_P2_pk speedgoat_test_SN5659__cal_impl.Encode4_P3_h5 speedgoat_test_SN5659__cal_impl.Encode4_P4_my speedgoat_test_SN5659__cal_impl.Encode4_P5_pv speedgoat_test_SN5659__cal_impl.Encode4_P6_ed speedgoat_test_SN5659__cal_impl.Encode4_P7_by speedgoat_test_SN5659__cal_impl.Encode4_P8_a speedgoat_test_SN5659__cal_impl.Encode4_P9_a speedgoat_test_SN5659__cal_impl.Randomnumber_Mean_pl speedgoat_test_SN5659__cal_impl.Randomnumber_Seed_e speedgoat_test_SN5659__cal_impl.Randomnumber_StdDev_fs speedgoat_test_SN5659__cal_impl.Sinewave_Amp_ch speedgoat_test_SN5659__cal_impl.Sinewave_Bias_d speedgoat_test_SN5659__cal_impl.Sinewave_Freq_a2 speedgoat_test_SN5659__cal_impl.Sinewave_HCos_h speedgoat_test_SN5659__cal_impl.Sinewave_Hsin_cy speedgoat_test_SN5659__cal_impl.Sinewave_PCos_n speedgoat_test_SN5659__cal_impl.Sinewave_PSin_o /end REF_CHARACTERISTIC
 /begin REF_MEASUREMENT speedgoat_test_SN5659_R2020b_B.DataTypeConversion1_fw speedgoat_test_SN5659_R2020b_B.DataTypeConversion_i speedgoat_test_SN5659_R2020b_B.Encode1_i speedgoat_test_SN5659_R2020b_B.Encode2_ik speedgoat_test_SN5659_R2020b_B.Encode3_dc speedgoat_test_SN5659_R2020b_B.Encode4_cn speedgoat_test_SN5659_R2020b_B.Output_bg speedgoat_test_SN5659_R2020b_B.Randomnumber_d speedgoat_test_SN5659_R2020b_B.Sinewave_ff speedgoat_test_SN5659_R2020b_DW.NextOutput_p speedgoat_test_SN5659_R2020b_DW.RandSeed_n speedgoat_test_SN5659_R2020b_DW.lastCos_jh speedgoat_test_SN5659_R2020b_DW.lastSin_pf speedgoat_test_SN5659_R2020b_DW.systemEnable_jy /end REF_MEASUREMENT
/end GROUP
/begin GROUP speedgoat_test_SN5659_R2020b_IO682_Encode_Channel_7_Counter_Limited "speedgoat_test_SN5659_R2020b/IO682/Encode Channel 7/Counter
Limited"
 /begin SUB_GROUP speedgoat_test_SN5659_R2020b_IO682_Encode_Channel_7_Counter_Limited_Increment_Real_World speedgoat_test_SN5659_R2020b_IO682_Encode_Channel_7_Counter_Limited_Wrap_To_Zero /end SUB_GROUP
 /begin REF_CHARACTERISTIC speedgoat_test_SN5659__cal_impl.Output_InitialCondition_dr /end REF_CHARACTERISTIC
 /begin REF_MEASUREMENT speedgoat_test_SN5659_R2020b_B.FixPtSwitch_a speedgoat_test_SN5659_R2020b_B.Output_bg speedgoat_test_SN5659_R2020b_DW.Output_DSTATE_h /end REF_MEASUREMENT
/end GROUP
/begin GROUP speedgoat_test_SN5659_R2020b_IO682_Encode_Channel_7_Counter_Limited_Increment_Real_World "speedgoat_test_SN5659_R2020b/IO682/Encode Channel 7/Counter
Limited/Increment
Real World" /begin REF_CHARACTERISTIC speedgoat_test_SN5659__cal_impl.FixPtConstant_Value_ie /end REF_CHARACTERISTIC
 /begin REF_MEASUREMENT speedgoat_test_SN5659_R2020b_B.FixPtSum1_he speedgoat_test_SN5659_R2020b_B.Output_bg /end REF_MEASUREMENT
/end GROUP
/begin GROUP speedgoat_test_SN5659_R2020b_IO682_Encode_Channel_7_Counter_Limited_Wrap_To_Zero "speedgoat_test_SN5659_R2020b/IO682/Encode Channel 7/Counter
Limited/Wrap To Zero"
 /begin REF_CHARACTERISTIC speedgoat_test_SN5659__cal_impl.Constant_Value_pl speedgoat_test_SN5659__cal_impl.CounterLimited_uplimit_du /end REF_CHARACTERISTIC
 /begin REF_MEASUREMENT speedgoat_test_SN5659_R2020b_B.FixPtSum1_he speedgoat_test_SN5659_R2020b_B.FixPtSwitch_a /end REF_MEASUREMENT
/end GROUP
/begin GROUP speedgoat_test_SN5659_R2020b_IO682_Encode_Channel_7_Prepare_RAW_value "speedgoat_test_SN5659_R2020b/IO682/Encode Channel 7/Prepare RAW value"
 /begin REF_CHARACTERISTIC speedgoat_test_SN5659__cal_impl.Label_Value_jf speedgoat_test_SN5659__cal_impl.Mask_BitMask_f3 speedgoat_test_SN5659__cal_impl.SDI_Value_k speedgoat_test_SN5659__cal_impl.SSM_Value_g speedgoat_test_SN5659__cal_impl.Scale_Value_e3 speedgoat_test_SN5659__cal_impl.shiftthedoublevalue27bitslef_jj /end REF_CHARACTERISTIC
 /begin REF_MEASUREMENT speedgoat_test_SN5659_R2020b_B.BitwiseOperator_n speedgoat_test_SN5659_R2020b_B.DataTypeConversion1_fw speedgoat_test_SN5659_R2020b_B.DataTypeConversion_cp speedgoat_test_SN5659_R2020b_B.Divide_c speedgoat_test_SN5659_R2020b_B.Mask_b speedgoat_test_SN5659_R2020b_B.Multiply_hz speedgoat_test_SN5659_R2020b_B.ShifttoSDIslot_bb speedgoat_test_SN5659_R2020b_B.ShifttoSSMslot_o /end REF_MEASUREMENT
/end GROUP
/begin GROUP speedgoat_test_SN5659_R2020b_IO682_Encode_Channel_8 "speedgoat_test_SN5659_R2020b/IO682/Encode Channel 8"
 /begin SUB_GROUP speedgoat_test_SN5659_R2020b_IO682_Encode_Channel_8_Counter_Limited speedgoat_test_SN5659_R2020b_IO682_Encode_Channel_8_Prepare_RAW_value /end SUB_GROUP
 /begin REF_CHARACTERISTIC speedgoat_test_SN5659__cal_impl.Constant_Value_b5 speedgoat_test_SN5659__cal_impl.Encode1_P10_pr speedgoat_test_SN5659__cal_impl.Encode1_P11_d speedgoat_test_SN5659__cal_impl.Encode1_P12_a2 speedgoat_test_SN5659__cal_impl.Encode1_P13_g speedgoat_test_SN5659__cal_impl.Encode1_P14_av speedgoat_test_SN5659__cal_impl.Encode1_P15_c speedgoat_test_SN5659__cal_impl.Encode1_P1_d speedgoat_test_SN5659__cal_impl.Encode1_P2_cw speedgoat_test_SN5659__cal_impl.Encode1_P3_hc speedgoat_test_SN5659__cal_impl.Encode1_P4_f speedgoat_test_SN5659__cal_impl.Encode1_P5_p speedgoat_test_SN5659__cal_impl.Encode1_P6_gn speedgoat_test_SN5659__cal_impl.Encode1_P7_h speedgoat_test_SN5659__cal_impl.Encode1_P8_bi speedgoat_test_SN5659__cal_impl.Encode1_P9_i speedgoat_test_SN5659__cal_impl.Encode2_P10_og speedgoat_test_SN5659__cal_impl.Encode2_P11_df speedgoat_test_SN5659__cal_impl.Encode2_P12_l speedgoat_test_SN5659__cal_impl.Encode2_P13_ol speedgoat_test_SN5659__cal_impl.Encode2_P14_dr speedgoat_test_SN5659__cal_impl.Encode2_P15_f speedgoat_test_SN5659__cal_impl.Encode2_P1_i speedgoat_test_SN5659__cal_impl.Encode2_P2_gi speedgoat_test_SN5659__cal_impl.Encode2_P3_oj speedgoat_test_SN5659__cal_impl.Encode2_P4_nt speedgoat_test_SN5659__cal_impl.Encode2_P5_af speedgoat_test_SN5659__cal_impl.Encode2_P6_ny speedgoat_test_SN5659__cal_impl.Encode2_P7_g speedgoat_test_SN5659__cal_impl.Encode2_P8_m speedgoat_test_SN5659__cal_impl.Encode2_P9_f speedgoat_test_SN5659__cal_impl.Encode3_P10_k speedgoat_test_SN5659__cal_impl.Encode3_P11_lg speedgoat_test_SN5659__cal_impl.Encode3_P12_a speedgoat_test_SN5659__cal_impl.Encode3_P13_ov speedgoat_test_SN5659__cal_impl.Encode3_P14_m5 speedgoat_test_SN5659__cal_impl.Encode3_P15_pd speedgoat_test_SN5659__cal_impl.Encode3_P1_d speedgoat_test_SN5659__cal_impl.Encode3_P2_ni speedgoat_test_SN5659__cal_impl.Encode3_P3_e speedgoat_test_SN5659__cal_impl.Encode3_P4_he speedgoat_test_SN5659__cal_impl.Encode3_P5_l speedgoat_test_SN5659__cal_impl.Encode3_P6_o speedgoat_test_SN5659__cal_impl.Encode3_P7_bt speedgoat_test_SN5659__cal_impl.Encode3_P8_n speedgoat_test_SN5659__cal_impl.Encode3_P9_e speedgoat_test_SN5659__cal_impl.Encode4_P10_jg speedgoat_test_SN5659__cal_impl.Encode4_P11_js speedgoat_test_SN5659__cal_impl.Encode4_P12_n speedgoat_test_SN5659__cal_impl.Encode4_P13_k speedgoat_test_SN5659__cal_impl.Encode4_P14_f speedgoat_test_SN5659__cal_impl.Encode4_P15_c speedgoat_test_SN5659__cal_impl.Encode4_P1_hi speedgoat_test_SN5659__cal_impl.Encode4_P2_k speedgoat_test_SN5659__cal_impl.Encode4_P3_k speedgoat_test_SN5659__cal_impl.Encode4_P4_j speedgoat_test_SN5659__cal_impl.Encode4_P5_g speedgoat_test_SN5659__cal_impl.Encode4_P6_g speedgoat_test_SN5659__cal_impl.Encode4_P7_c3 speedgoat_test_SN5659__cal_impl.Encode4_P8_c speedgoat_test_SN5659__cal_impl.Encode4_P9_m speedgoat_test_SN5659__cal_impl.Randomnumber_Mean_pz speedgoat_test_SN5659__cal_impl.Randomnumber_Seed_l speedgoat_test_SN5659__cal_impl.Randomnumber_StdDev_e speedgoat_test_SN5659__cal_impl.Sinewave_Amp_hw speedgoat_test_SN5659__cal_impl.Sinewave_Bias_p speedgoat_test_SN5659__cal_impl.Sinewave_Freq_j speedgoat_test_SN5659__cal_impl.Sinewave_HCos_h2 speedgoat_test_SN5659__cal_impl.Sinewave_Hsin_jl speedgoat_test_SN5659__cal_impl.Sinewave_PCos_l speedgoat_test_SN5659__cal_impl.Sinewave_PSin_b /end REF_CHARACTERISTIC
 /begin REF_MEASUREMENT speedgoat_test_SN5659_R2020b_B.DataTypeConversion1_j speedgoat_test_SN5659_R2020b_B.DataTypeConversion_k speedgoat_test_SN5659_R2020b_B.Encode1_ff speedgoat_test_SN5659_R2020b_B.Encode2_o4 speedgoat_test_SN5659_R2020b_B.Encode3_dp speedgoat_test_SN5659_R2020b_B.Encode4_a speedgoat_test_SN5659_R2020b_B.Output_mw speedgoat_test_SN5659_R2020b_B.Randomnumber_n4 speedgoat_test_SN5659_R2020b_B.Sinewave_m speedgoat_test_SN5659_R2020b_DW.NextOutput_jn speedgoat_test_SN5659_R2020b_DW.RandSeed_l speedgoat_test_SN5659_R2020b_DW.lastCos_ca speedgoat_test_SN5659_R2020b_DW.lastSin_iv speedgoat_test_SN5659_R2020b_DW.systemEnable_gv /end REF_MEASUREMENT
/end GROUP
/begin GROUP speedgoat_test_SN5659_R2020b_IO682_Encode_Channel_8_Counter_Limited "speedgoat_test_SN5659_R2020b/IO682/Encode Channel 8/Counter
Limited"
 /begin SUB_GROUP speedgoat_test_SN5659_R2020b_IO682_Encode_Channel_8_Counter_Limited_Increment_Real_World speedgoat_test_SN5659_R2020b_IO682_Encode_Channel_8_Counter_Limited_Wrap_To_Zero /end SUB_GROUP
 /begin REF_CHARACTERISTIC speedgoat_test_SN5659__cal_impl.Output_InitialCondition_a /end REF_CHARACTERISTIC
 /begin REF_MEASUREMENT speedgoat_test_SN5659_R2020b_B.FixPtSwitch_l0 speedgoat_test_SN5659_R2020b_B.Output_mw speedgoat_test_SN5659_R2020b_DW.Output_DSTATE_m4 /end REF_MEASUREMENT
/end GROUP
/begin GROUP speedgoat_test_SN5659_R2020b_IO682_Encode_Channel_8_Counter_Limited_Increment_Real_World "speedgoat_test_SN5659_R2020b/IO682/Encode Channel 8/Counter
Limited/Increment
Real World" /begin REF_CHARACTERISTIC speedgoat_test_SN5659__cal_impl.FixPtConstant_Value_b /end REF_CHARACTERISTIC
 /begin REF_MEASUREMENT speedgoat_test_SN5659_R2020b_B.FixPtSum1_p speedgoat_test_SN5659_R2020b_B.Output_mw /end REF_MEASUREMENT
/end GROUP
/begin GROUP speedgoat_test_SN5659_R2020b_IO682_Encode_Channel_8_Counter_Limited_Wrap_To_Zero "speedgoat_test_SN5659_R2020b/IO682/Encode Channel 8/Counter
Limited/Wrap To Zero"
 /begin REF_CHARACTERISTIC speedgoat_test_SN5659__cal_impl.Constant_Value_pv speedgoat_test_SN5659__cal_impl.CounterLimited_uplimit_b /end REF_CHARACTERISTIC
 /begin REF_MEASUREMENT speedgoat_test_SN5659_R2020b_B.FixPtSum1_p speedgoat_test_SN5659_R2020b_B.FixPtSwitch_l0 /end REF_MEASUREMENT
/end GROUP
/begin GROUP speedgoat_test_SN5659_R2020b_IO682_Encode_Channel_8_Prepare_RAW_value "speedgoat_test_SN5659_R2020b/IO682/Encode Channel 8/Prepare RAW value"
 /begin REF_CHARACTERISTIC speedgoat_test_SN5659__cal_impl.Label_Value_pn speedgoat_test_SN5659__cal_impl.Mask_BitMask_kz speedgoat_test_SN5659__cal_impl.SDI_Value_im speedgoat_test_SN5659__cal_impl.SSM_Value_p speedgoat_test_SN5659__cal_impl.Scale_Value_kb speedgoat_test_SN5659__cal_impl.shiftthedoublevalue27bitsleft_f /end REF_CHARACTERISTIC
 /begin REF_MEASUREMENT speedgoat_test_SN5659_R2020b_B.BitwiseOperator_b5 speedgoat_test_SN5659_R2020b_B.DataTypeConversion1_j speedgoat_test_SN5659_R2020b_B.DataTypeConversion_is speedgoat_test_SN5659_R2020b_B.Divide_oc speedgoat_test_SN5659_R2020b_B.Mask_aj speedgoat_test_SN5659_R2020b_B.Multiply_kl speedgoat_test_SN5659_R2020b_B.ShifttoSDIslot_f speedgoat_test_SN5659_R2020b_B.ShifttoSSMslot_ea /end REF_MEASUREMENT
/end GROUP
/begin GROUP speedgoat_test_SN5659_R2020b_IO682_Encode_Channel_9 "speedgoat_test_SN5659_R2020b/IO682/Encode Channel 9"
 /begin SUB_GROUP speedgoat_test_SN5659_R2020b_IO682_Encode_Channel_9_Counter_Limited speedgoat_test_SN5659_R2020b_IO682_Encode_Channel_9_Prepare_RAW_value /end SUB_GROUP
 /begin REF_CHARACTERISTIC speedgoat_test_SN5659__cal_impl.Constant_Value_le speedgoat_test_SN5659__cal_impl.Encode1_P10_d speedgoat_test_SN5659__cal_impl.Encode1_P11_i speedgoat_test_SN5659__cal_impl.Encode1_P12_jx speedgoat_test_SN5659__cal_impl.Encode1_P13_gu speedgoat_test_SN5659__cal_impl.Encode1_P14_fz speedgoat_test_SN5659__cal_impl.Encode1_P15_d speedgoat_test_SN5659__cal_impl.Encode1_P1_kw speedgoat_test_SN5659__cal_impl.Encode1_P2_ho speedgoat_test_SN5659__cal_impl.Encode1_P3_lm speedgoat_test_SN5659__cal_impl.Encode1_P4_cs speedgoat_test_SN5659__cal_impl.Encode1_P5_m speedgoat_test_SN5659__cal_impl.Encode1_P6_am speedgoat_test_SN5659__cal_impl.Encode1_P7_b3 speedgoat_test_SN5659__cal_impl.Encode1_P8_j speedgoat_test_SN5659__cal_impl.Encode1_P9_oc speedgoat_test_SN5659__cal_impl.Encode2_P10_dz speedgoat_test_SN5659__cal_impl.Encode2_P11_dm speedgoat_test_SN5659__cal_impl.Encode2_P12_j speedgoat_test_SN5659__cal_impl.Encode2_P13_g speedgoat_test_SN5659__cal_impl.Encode2_P14_hh speedgoat_test_SN5659__cal_impl.Encode2_P15_km speedgoat_test_SN5659__cal_impl.Encode2_P1_bc speedgoat_test_SN5659__cal_impl.Encode2_P2_hl speedgoat_test_SN5659__cal_impl.Encode2_P3_dm speedgoat_test_SN5659__cal_impl.Encode2_P4_ny speedgoat_test_SN5659__cal_impl.Encode2_P5_im speedgoat_test_SN5659__cal_impl.Encode2_P6_g speedgoat_test_SN5659__cal_impl.Encode2_P7_k5 speedgoat_test_SN5659__cal_impl.Encode2_P8_ig speedgoat_test_SN5659__cal_impl.Encode2_P9_g speedgoat_test_SN5659__cal_impl.Encode3_P10_l15 speedgoat_test_SN5659__cal_impl.Encode3_P11_jg speedgoat_test_SN5659__cal_impl.Encode3_P12_n speedgoat_test_SN5659__cal_impl.Encode3_P13_f speedgoat_test_SN5659__cal_impl.Encode3_P14_nc speedgoat_test_SN5659__cal_impl.Encode3_P15_o speedgoat_test_SN5659__cal_impl.Encode3_P1_lu speedgoat_test_SN5659__cal_impl.Encode3_P2_dl speedgoat_test_SN5659__cal_impl.Encode3_P3_k speedgoat_test_SN5659__cal_impl.Encode3_P4_ga speedgoat_test_SN5659__cal_impl.Encode3_P5_j speedgoat_test_SN5659__cal_impl.Encode3_P6_gz speedgoat_test_SN5659__cal_impl.Encode3_P7_dw speedgoat_test_SN5659__cal_impl.Encode3_P8_a speedgoat_test_SN5659__cal_impl.Encode3_P9_lj speedgoat_test_SN5659__cal_impl.Encode5_P10_o speedgoat_test_SN5659__cal_impl.Encode5_P11_g speedgoat_test_SN5659__cal_impl.Encode5_P12_p speedgoat_test_SN5659__cal_impl.Encode5_P13_m speedgoat_test_SN5659__cal_impl.Encode5_P14_k speedgoat_test_SN5659__cal_impl.Encode5_P15_a speedgoat_test_SN5659__cal_impl.Encode5_P1_i speedgoat_test_SN5659__cal_impl.Encode5_P2_b speedgoat_test_SN5659__cal_impl.Encode5_P3_i speedgoat_test_SN5659__cal_impl.Encode5_P4_k speedgoat_test_SN5659__cal_impl.Encode5_P5_o speedgoat_test_SN5659__cal_impl.Encode5_P6_j speedgoat_test_SN5659__cal_impl.Encode5_P7_h speedgoat_test_SN5659__cal_impl.Encode5_P8_i speedgoat_test_SN5659__cal_impl.Encode5_P9_g speedgoat_test_SN5659__cal_impl.Randomnumber_Mean_fb speedgoat_test_SN5659__cal_impl.Randomnumber_Seed_j speedgoat_test_SN5659__cal_impl.Randomnumber_StdDev_oa speedgoat_test_SN5659__cal_impl.Sinewave_Amp_f speedgoat_test_SN5659__cal_impl.Sinewave_Bias_je speedgoat_test_SN5659__cal_impl.Sinewave_Freq_k speedgoat_test_SN5659__cal_impl.Sinewave_HCos_n speedgoat_test_SN5659__cal_impl.Sinewave_Hsin_o2 speedgoat_test_SN5659__cal_impl.Sinewave_PCos_lt speedgoat_test_SN5659__cal_impl.Sinewave_PSin_bm /end REF_CHARACTERISTIC
 /begin REF_MEASUREMENT speedgoat_test_SN5659_R2020b_B.DataTypeConversion1_e speedgoat_test_SN5659_R2020b_B.DataTypeConversion_dw speedgoat_test_SN5659_R2020b_B.Encode1_kq speedgoat_test_SN5659_R2020b_B.Encode2_o3 speedgoat_test_SN5659_R2020b_B.Encode3_h speedgoat_test_SN5659_R2020b_B.Encode5_n speedgoat_test_SN5659_R2020b_B.Output_pd speedgoat_test_SN5659_R2020b_B.Randomnumber_j speedgoat_test_SN5659_R2020b_B.Sinewave_ao speedgoat_test_SN5659_R2020b_DW.NextOutput_b speedgoat_test_SN5659_R2020b_DW.RandSeed_fs speedgoat_test_SN5659_R2020b_DW.lastCos_bf speedgoat_test_SN5659_R2020b_DW.lastSin_fv speedgoat_test_SN5659_R2020b_DW.systemEnable_o1 /end REF_MEASUREMENT
/end GROUP
/begin GROUP speedgoat_test_SN5659_R2020b_IO682_Encode_Channel_9_Counter_Limited "speedgoat_test_SN5659_R2020b/IO682/Encode Channel 9/Counter
Limited"
 /begin SUB_GROUP speedgoat_test_SN5659_R2020b_IO682_Encode_Channel_9_Counter_Limited_Increment_Real_World speedgoat_test_SN5659_R2020b_IO682_Encode_Channel_9_Counter_Limited_Wrap_To_Zero /end SUB_GROUP
 /begin REF_CHARACTERISTIC speedgoat_test_SN5659__cal_impl.Output_InitialCondition_aw /end REF_CHARACTERISTIC
 /begin REF_MEASUREMENT speedgoat_test_SN5659_R2020b_B.FixPtSwitch_m speedgoat_test_SN5659_R2020b_B.Output_pd speedgoat_test_SN5659_R2020b_DW.Output_DSTATE_fw /end REF_MEASUREMENT
/end GROUP
/begin GROUP speedgoat_test_SN5659_R2020b_IO682_Encode_Channel_9_Counter_Limited_Increment_Real_World "speedgoat_test_SN5659_R2020b/IO682/Encode Channel 9/Counter
Limited/Increment
Real World" /begin REF_CHARACTERISTIC speedgoat_test_SN5659__cal_impl.FixPtConstant_Value_jp /end REF_CHARACTERISTIC
 /begin REF_MEASUREMENT speedgoat_test_SN5659_R2020b_B.FixPtSum1_b speedgoat_test_SN5659_R2020b_B.Output_pd /end REF_MEASUREMENT
/end GROUP
/begin GROUP speedgoat_test_SN5659_R2020b_IO682_Encode_Channel_9_Counter_Limited_Wrap_To_Zero "speedgoat_test_SN5659_R2020b/IO682/Encode Channel 9/Counter
Limited/Wrap To Zero"
 /begin REF_CHARACTERISTIC speedgoat_test_SN5659__cal_impl.Constant_Value_b2 speedgoat_test_SN5659__cal_impl.CounterLimited_uplimit_a /end REF_CHARACTERISTIC
 /begin REF_MEASUREMENT speedgoat_test_SN5659_R2020b_B.FixPtSum1_b speedgoat_test_SN5659_R2020b_B.FixPtSwitch_m /end REF_MEASUREMENT
/end GROUP
/begin GROUP speedgoat_test_SN5659_R2020b_IO682_Encode_Channel_9_Prepare_RAW_value "speedgoat_test_SN5659_R2020b/IO682/Encode Channel 9/Prepare RAW value"
 /begin REF_CHARACTERISTIC speedgoat_test_SN5659__cal_impl.Label_Value_kg speedgoat_test_SN5659__cal_impl.Mask_BitMask_cx speedgoat_test_SN5659__cal_impl.SDI_Value_mq speedgoat_test_SN5659__cal_impl.SSM_Value_jt speedgoat_test_SN5659__cal_impl.Scale_Value_n speedgoat_test_SN5659__cal_impl.shiftthedoublevalue27bitslef_hk /end REF_CHARACTERISTIC
 /begin REF_MEASUREMENT speedgoat_test_SN5659_R2020b_B.BitwiseOperator_fl speedgoat_test_SN5659_R2020b_B.DataTypeConversion1_e speedgoat_test_SN5659_R2020b_B.DataTypeConversion_ku speedgoat_test_SN5659_R2020b_B.Divide_os speedgoat_test_SN5659_R2020b_B.Mask_cy speedgoat_test_SN5659_R2020b_B.Multiply_c speedgoat_test_SN5659_R2020b_B.ShifttoSDIslot_fi speedgoat_test_SN5659_R2020b_B.ShifttoSSMslot_hy /end REF_MEASUREMENT
/end GROUP
/begin GROUP speedgoat_test_SN5659_R2020b_IO941_SPDT_64 "speedgoat_test_SN5659_R2020b/IO941-SPDT-64"
 /begin REF_CHARACTERISTIC speedgoat_test_SN5659__cal_impl.PulseGenerator_Amp_g3 speedgoat_test_SN5659__cal_impl.PulseGenerator_Duty_h speedgoat_test_SN5659__cal_impl.PulseGenerator_Period_o speedgoat_test_SN5659__cal_impl.PulseGenerator_PhaseDelay_b speedgoat_test_SN5659__cal_impl.Relays_P1 speedgoat_test_SN5659__cal_impl.Relays_P10 speedgoat_test_SN5659__cal_impl.Relays_P11 speedgoat_test_SN5659__cal_impl.Relays_P12 speedgoat_test_SN5659__cal_impl.Relays_P13 speedgoat_test_SN5659__cal_impl.Relays_P14 speedgoat_test_SN5659__cal_impl.Relays_P15 speedgoat_test_SN5659__cal_impl.Relays_P16 speedgoat_test_SN5659__cal_impl.Relays_P17 speedgoat_test_SN5659__cal_impl.Relays_P2 speedgoat_test_SN5659__cal_impl.Relays_P3 speedgoat_test_SN5659__cal_impl.Relays_P4 speedgoat_test_SN5659__cal_impl.Relays_P5 speedgoat_test_SN5659__cal_impl.Relays_P6 speedgoat_test_SN5659__cal_impl.Relays_P7 speedgoat_test_SN5659__cal_impl.Relays_P8 speedgoat_test_SN5659__cal_impl.Relays_P9 /end REF_CHARACTERISTIC
 /begin REF_MEASUREMENT speedgoat_test_SN5659_R2020b_B.DataTypeConversion_ib speedgoat_test_SN5659_R2020b_B.IO941_CH1 speedgoat_test_SN5659_R2020b_B.IO941_CH2 speedgoat_test_SN5659_R2020b_B.IO941_CH3 speedgoat_test_SN5659_R2020b_B.IO941_CH4 speedgoat_test_SN5659_R2020b_B.IO941_CH5 speedgoat_test_SN5659_R2020b_B.IO941_CH6 speedgoat_test_SN5659_R2020b_B.IO941_CH7 speedgoat_test_SN5659_R2020b_B.IO941_CH8 speedgoat_test_SN5659_R2020b_B.PulseGenerator_p speedgoat_test_SN5659_R2020b_DW.Scope_PWORK_n speedgoat_test_SN5659_R2020b_DW.clockTickCounter_i /end REF_MEASUREMENT
/end GROUP
/end MODULE
/end PROJECT
