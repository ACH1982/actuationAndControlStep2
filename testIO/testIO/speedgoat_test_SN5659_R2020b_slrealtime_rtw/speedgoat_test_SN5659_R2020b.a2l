ASAP2_VERSION 1 71
/begin PROJECT ProjectName "Project Comment Goes Here"
/begin HEADER "Header Comments go here" /end HEADER
/begin MODULE ModuleName "Module Comment Goes Here"
/begin MOD_COMMON "Mod Common Comment Here" BYTE_ORDER MSB_LAST ALIGNMENT_BYTE 1 ALIGNMENT_WORD 2 ALIGNMENT_LONG 4 ALIGNMENT_FLOAT32_IEEE 4 ALIGNMENT_FLOAT64_IEEE 8 ALIGNMENT_INT64 8 /end MOD_COMMON
/begin CHARACTERISTIC speedgoat_test_SN5659__cal_impl.Decode1_P1 "" VALUE 0x008E1DB0 Scalar_FLOAT64_IEEE 0 speedgoat_test_SN5659_R2020b_CM_double -1.7E+308 1.7E+308 /end CHARACTERISTIC
/begin CHARACTERISTIC speedgoat_test_SN5659__cal_impl.Decode1_P10 "" VAL_BLK 0x008E1E88 Scalar_FLOAT64_IEEE 0 speedgoat_test_SN5659_R2020b_CM_double -1.7E+308 1.7E+308 MATRIX_DIM 2 1 /end CHARACTERISTIC
/begin CHARACTERISTIC speedgoat_test_SN5659__cal_impl.Decode1_P10_a "" VAL_BLK 0x008E4CB0 Scalar_FLOAT64_IEEE 0 speedgoat_test_SN5659_R2020b_CM_double -1.7E+308 1.7E+308 MATRIX_DIM 2 1 /end CHARACTERISTIC
/begin CHARACTERISTIC speedgoat_test_SN5659__cal_impl.Decode1_P10_e "" VAL_BLK 0x008E59E0 Scalar_FLOAT64_IEEE 0 speedgoat_test_SN5659_R2020b_CM_double -1.7E+308 1.7E+308 MATRIX_DIM 2 1 /end CHARACTERISTIC
/begin CHARACTERISTIC speedgoat_test_SN5659__cal_impl.Decode1_P10_h "" VAL_BLK 0x008E3250 Scalar_FLOAT64_IEEE 0 speedgoat_test_SN5659_R2020b_CM_double -1.7E+308 1.7E+308 MATRIX_DIM 2 1 /end CHARACTERISTIC
/begin CHARACTERISTIC speedgoat_test_SN5659__cal_impl.Decode1_P10_k "" VAL_BLK 0x008E2520 Scalar_FLOAT64_IEEE 0 speedgoat_test_SN5659_R2020b_CM_double -1.7E+308 1.7E+308 MATRIX_DIM 2 1 /end CHARACTERISTIC
/begin CHARACTERISTIC speedgoat_test_SN5659__cal_impl.Decode1_P10_k1 "" VAL_BLK 0x008E3F80 Scalar_FLOAT64_IEEE 0 speedgoat_test_SN5659_R2020b_CM_double -1.7E+308 1.7E+308 MATRIX_DIM 2 1 /end CHARACTERISTIC
/begin CHARACTERISTIC speedgoat_test_SN5659__cal_impl.Decode1_P10_lb "" VAL_BLK 0x008E4618 Scalar_FLOAT64_IEEE 0 speedgoat_test_SN5659_R2020b_CM_double -1.7E+308 1.7E+308 MATRIX_DIM 2 1 /end CHARACTERISTIC
/begin CHARACTERISTIC speedgoat_test_SN5659__cal_impl.Decode1_P10_lbu "" VAL_BLK 0x008E5348 Scalar_FLOAT64_IEEE 0 speedgoat_test_SN5659_R2020b_CM_double -1.7E+308 1.7E+308 MATRIX_DIM 2 1 /end CHARACTERISTIC
/begin CHARACTERISTIC speedgoat_test_SN5659__cal_impl.Decode1_P10_lm "" VAL_BLK 0x008E38E8 Scalar_FLOAT64_IEEE 0 speedgoat_test_SN5659_R2020b_CM_double -1.7E+308 1.7E+308 MATRIX_DIM 2 1 /end CHARACTERISTIC
/begin CHARACTERISTIC speedgoat_test_SN5659__cal_impl.Decode1_P11 "" VALUE 0x008E1EA8 Scalar_FLOAT64_IEEE 0 speedgoat_test_SN5659_R2020b_CM_double -1.7E+308 1.7E+308 /end CHARACTERISTIC
/begin CHARACTERISTIC speedgoat_test_SN5659__cal_impl.Decode1_P11_a "" VALUE 0x008E5A00 Scalar_FLOAT64_IEEE 0 speedgoat_test_SN5659_R2020b_CM_double -1.7E+308 1.7E+308 /end CHARACTERISTIC
/begin CHARACTERISTIC speedgoat_test_SN5659__cal_impl.Decode1_P11_e "" VALUE 0x008E2540 Scalar_FLOAT64_IEEE 0 speedgoat_test_SN5659_R2020b_CM_double -1.7E+308 1.7E+308 /end CHARACTERISTIC
/begin CHARACTERISTIC speedgoat_test_SN5659__cal_impl.Decode1_P11_f "" VALUE 0x008E3908 Scalar_FLOAT64_IEEE 0 speedgoat_test_SN5659_R2020b_CM_double -1.7E+308 1.7E+308 /end CHARACTERISTIC
/begin CHARACTERISTIC speedgoat_test_SN5659__cal_impl.Decode1_P11_fz "" VALUE 0x008E5368 Scalar_FLOAT64_IEEE 0 speedgoat_test_SN5659_R2020b_CM_double -1.7E+308 1.7E+308 /end CHARACTERISTIC
/begin CHARACTERISTIC speedgoat_test_SN5659__cal_impl.Decode1_P11_g "" VALUE 0x008E4CD0 Scalar_FLOAT64_IEEE 0 speedgoat_test_SN5659_R2020b_CM_double -1.7E+308 1.7E+308 /end CHARACTERISTIC
/begin CHARACTERISTIC speedgoat_test_SN5659__cal_impl.Decode1_P11_i "" VALUE 0x008E3FA0 Scalar_FLOAT64_IEEE 0 speedgoat_test_SN5659_R2020b_CM_double -1.7E+308 1.7E+308 /end CHARACTERISTIC
/begin CHARACTERISTIC speedgoat_test_SN5659__cal_impl.Decode1_P11_m "" VALUE 0x008E4638 Scalar_FLOAT64_IEEE 0 speedgoat_test_SN5659_R2020b_CM_double -1.7E+308 1.7E+308 /end CHARACTERISTIC
/begin CHARACTERISTIC speedgoat_test_SN5659__cal_impl.Decode1_P11_p "" VALUE 0x008E3270 Scalar_FLOAT64_IEEE 0 speedgoat_test_SN5659_R2020b_CM_double -1.7E+308 1.7E+308 /end CHARACTERISTIC
/begin CHARACTERISTIC speedgoat_test_SN5659__cal_impl.Decode1_P12 "" VALUE 0x008E1EC0 Scalar_FLOAT64_IEEE 0 speedgoat_test_SN5659_R2020b_CM_double -1.7E+308 1.7E+308 /end CHARACTERISTIC
/begin CHARACTERISTIC speedgoat_test_SN5659__cal_impl.Decode1_P12_a "" VALUE 0x008E5A18 Scalar_FLOAT64_IEEE 0 speedgoat_test_SN5659_R2020b_CM_double -1.7E+308 1.7E+308 /end CHARACTERISTIC
/begin CHARACTERISTIC speedgoat_test_SN5659__cal_impl.Decode1_P12_b "" VALUE 0x008E4650 Scalar_FLOAT64_IEEE 0 speedgoat_test_SN5659_R2020b_CM_double -1.7E+308 1.7E+308 /end CHARACTERISTIC
/begin CHARACTERISTIC speedgoat_test_SN5659__cal_impl.Decode1_P12_d "" VALUE 0x008E4CE8 Scalar_FLOAT64_IEEE 0 speedgoat_test_SN5659_R2020b_CM_double -1.7E+308 1.7E+308 /end CHARACTERISTIC
/begin CHARACTERISTIC speedgoat_test_SN5659__cal_impl.Decode1_P12_h "" VALUE 0x008E3288 Scalar_FLOAT64_IEEE 0 speedgoat_test_SN5659_R2020b_CM_double -1.7E+308 1.7E+308 /end CHARACTERISTIC
/begin CHARACTERISTIC speedgoat_test_SN5659__cal_impl.Decode1_P12_j "" VALUE 0x008E3FB8 Scalar_FLOAT64_IEEE 0 speedgoat_test_SN5659_R2020b_CM_double -1.7E+308 1.7E+308 /end CHARACTERISTIC
/begin CHARACTERISTIC speedgoat_test_SN5659__cal_impl.Decode1_P12_k "" VALUE 0x008E5380 Scalar_FLOAT64_IEEE 0 speedgoat_test_SN5659_R2020b_CM_double -1.7E+308 1.7E+308 /end CHARACTERISTIC
/begin CHARACTERISTIC speedgoat_test_SN5659__cal_impl.Decode1_P12_p "" VALUE 0x008E2558 Scalar_FLOAT64_IEEE 0 speedgoat_test_SN5659_R2020b_CM_double -1.7E+308 1.7E+308 /end CHARACTERISTIC
/begin CHARACTERISTIC speedgoat_test_SN5659__cal_impl.Decode1_P12_pv "" VALUE 0x008E3920 Scalar_FLOAT64_IEEE 0 speedgoat_test_SN5659_R2020b_CM_double -1.7E+308 1.7E+308 /end CHARACTERISTIC
/begin CHARACTERISTIC speedgoat_test_SN5659__cal_impl.Decode1_P13 "" VALUE 0x008E1ED8 Scalar_FLOAT64_IEEE 0 speedgoat_test_SN5659_R2020b_CM_double -1.7E+308 1.7E+308 /end CHARACTERISTIC
/begin CHARACTERISTIC speedgoat_test_SN5659__cal_impl.Decode1_P13_a "" VALUE 0x008E2570 Scalar_FLOAT64_IEEE 0 speedgoat_test_SN5659_R2020b_CM_double -1.7E+308 1.7E+308 /end CHARACTERISTIC
/begin CHARACTERISTIC speedgoat_test_SN5659__cal_impl.Decode1_P13_aa "" VALUE 0x008E3FD0 Scalar_FLOAT64_IEEE 0 speedgoat_test_SN5659_R2020b_CM_double -1.7E+308 1.7E+308 /end CHARACTERISTIC
/begin CHARACTERISTIC speedgoat_test_SN5659__cal_impl.Decode1_P13_c "" VALUE 0x008E4D00 Scalar_FLOAT64_IEEE 0 speedgoat_test_SN5659_R2020b_CM_double -1.7E+308 1.7E+308 /end CHARACTERISTIC
/begin CHARACTERISTIC speedgoat_test_SN5659__cal_impl.Decode1_P13_d "" VALUE 0x008E5398 Scalar_FLOAT64_IEEE 0 speedgoat_test_SN5659_R2020b_CM_double -1.7E+308 1.7E+308 /end CHARACTERISTIC
/begin CHARACTERISTIC speedgoat_test_SN5659__cal_impl.Decode1_P13_fg "" VALUE 0x008E3938 Scalar_FLOAT64_IEEE 0 speedgoat_test_SN5659_R2020b_CM_double -1.7E+308 1.7E+308 /end CHARACTERISTIC
/begin CHARACTERISTIC speedgoat_test_SN5659__cal_impl.Decode1_P13_k "" VALUE 0x008E5A30 Scalar_FLOAT64_IEEE 0 speedgoat_test_SN5659_R2020b_CM_double -1.7E+308 1.7E+308 /end CHARACTERISTIC
/begin CHARACTERISTIC speedgoat_test_SN5659__cal_impl.Decode1_P13_l "" VALUE 0x008E32A0 Scalar_FLOAT64_IEEE 0 speedgoat_test_SN5659_R2020b_CM_double -1.7E+308 1.7E+308 /end CHARACTERISTIC
/begin CHARACTERISTIC speedgoat_test_SN5659__cal_impl.Decode1_P13_lz "" VALUE 0x008E4668 Scalar_FLOAT64_IEEE 0 speedgoat_test_SN5659_R2020b_CM_double -1.7E+308 1.7E+308 /end CHARACTERISTIC
/begin CHARACTERISTIC speedgoat_test_SN5659__cal_impl.Decode1_P14 "" VALUE 0x008E1EF0 Scalar_FLOAT64_IEEE 0 speedgoat_test_SN5659_R2020b_CM_double -1.7E+308 1.7E+308 /end CHARACTERISTIC
/begin CHARACTERISTIC speedgoat_test_SN5659__cal_impl.Decode1_P14_d "" VALUE 0x008E3FE8 Scalar_FLOAT64_IEEE 0 speedgoat_test_SN5659_R2020b_CM_double -1.7E+308 1.7E+308 /end CHARACTERISTIC
/begin CHARACTERISTIC speedgoat_test_SN5659__cal_impl.Decode1_P14_g "" VALUE 0x008E32B8 Scalar_FLOAT64_IEEE 0 speedgoat_test_SN5659_R2020b_CM_double -1.7E+308 1.7E+308 /end CHARACTERISTIC
/begin CHARACTERISTIC speedgoat_test_SN5659__cal_impl.Decode1_P14_gc "" VALUE 0x008E4D18 Scalar_FLOAT64_IEEE 0 speedgoat_test_SN5659_R2020b_CM_double -1.7E+308 1.7E+308 /end CHARACTERISTIC
/begin CHARACTERISTIC speedgoat_test_SN5659__cal_impl.Decode1_P14_gk "" VALUE 0x008E3950 Scalar_FLOAT64_IEEE 0 speedgoat_test_SN5659_R2020b_CM_double -1.7E+308 1.7E+308 /end CHARACTERISTIC
/begin CHARACTERISTIC speedgoat_test_SN5659__cal_impl.Decode1_P14_i "" VALUE 0x008E53B0 Scalar_FLOAT64_IEEE 0 speedgoat_test_SN5659_R2020b_CM_double -1.7E+308 1.7E+308 /end CHARACTERISTIC
/begin CHARACTERISTIC speedgoat_test_SN5659__cal_impl.Decode1_P14_k "" VALUE 0x008E4680 Scalar_FLOAT64_IEEE 0 speedgoat_test_SN5659_R2020b_CM_double -1.7E+308 1.7E+308 /end CHARACTERISTIC
/begin CHARACTERISTIC speedgoat_test_SN5659__cal_impl.Decode1_P14_o "" VALUE 0x008E2588 Scalar_FLOAT64_IEEE 0 speedgoat_test_SN5659_R2020b_CM_double -1.7E+308 1.7E+308 /end CHARACTERISTIC
/begin CHARACTERISTIC speedgoat_test_SN5659__cal_impl.Decode1_P14_o4 "" VALUE 0x008E5A48 Scalar_FLOAT64_IEEE 0 speedgoat_test_SN5659_R2020b_CM_double -1.7E+308 1.7E+308 /end CHARACTERISTIC
/begin CHARACTERISTIC speedgoat_test_SN5659__cal_impl.Decode1_P15 "" VALUE 0x008E1F08 Scalar_FLOAT64_IEEE 0 speedgoat_test_SN5659_R2020b_CM_double -1.7E+308 1.7E+308 /end CHARACTERISTIC
/begin CHARACTERISTIC speedgoat_test_SN5659__cal_impl.Decode1_P15_a "" VALUE 0x008E3968 Scalar_FLOAT64_IEEE 0 speedgoat_test_SN5659_R2020b_CM_double -1.7E+308 1.7E+308 /end CHARACTERISTIC
/begin CHARACTERISTIC speedgoat_test_SN5659__cal_impl.Decode1_P15_be "" VALUE 0x008E5A60 Scalar_FLOAT64_IEEE 0 speedgoat_test_SN5659_R2020b_CM_double -1.7E+308 1.7E+308 /end CHARACTERISTIC
/begin CHARACTERISTIC speedgoat_test_SN5659__cal_impl.Decode1_P15_g "" VALUE 0x008E32D0 Scalar_FLOAT64_IEEE 0 speedgoat_test_SN5659_R2020b_CM_double -1.7E+308 1.7E+308 /end CHARACTERISTIC
/begin CHARACTERISTIC speedgoat_test_SN5659__cal_impl.Decode1_P15_h "" VALUE 0x008E4000 Scalar_FLOAT64_IEEE 0 speedgoat_test_SN5659_R2020b_CM_double -1.7E+308 1.7E+308 /end CHARACTERISTIC
/begin CHARACTERISTIC speedgoat_test_SN5659__cal_impl.Decode1_P15_h1 "" VALUE 0x008E4698 Scalar_FLOAT64_IEEE 0 speedgoat_test_SN5659_R2020b_CM_double -1.7E+308 1.7E+308 /end CHARACTERISTIC
/begin CHARACTERISTIC speedgoat_test_SN5659__cal_impl.Decode1_P15_j "" VALUE 0x008E4D30 Scalar_FLOAT64_IEEE 0 speedgoat_test_SN5659_R2020b_CM_double -1.7E+308 1.7E+308 /end CHARACTERISTIC
/begin CHARACTERISTIC speedgoat_test_SN5659__cal_impl.Decode1_P15_l "" VALUE 0x008E25A0 Scalar_FLOAT64_IEEE 0 speedgoat_test_SN5659_R2020b_CM_double -1.7E+308 1.7E+308 /end CHARACTERISTIC
/begin CHARACTERISTIC speedgoat_test_SN5659__cal_impl.Decode1_P15_n "" VALUE 0x008E53C8 Scalar_FLOAT64_IEEE 0 speedgoat_test_SN5659_R2020b_CM_double -1.7E+308 1.7E+308 /end CHARACTERISTIC
/begin CHARACTERISTIC speedgoat_test_SN5659__cal_impl.Decode1_P16 "" VALUE 0x008E1F20 Scalar_FLOAT64_IEEE 0 speedgoat_test_SN5659_R2020b_CM_double -1.7E+308 1.7E+308 /end CHARACTERISTIC
/begin CHARACTERISTIC speedgoat_test_SN5659__cal_impl.Decode1_P16_e "" VALUE 0x008E32E8 Scalar_FLOAT64_IEEE 0 speedgoat_test_SN5659_R2020b_CM_double -1.7E+308 1.7E+308 /end CHARACTERISTIC
/begin CHARACTERISTIC speedgoat_test_SN5659__cal_impl.Decode1_P16_ey "" VALUE 0x008E5A78 Scalar_FLOAT64_IEEE 0 speedgoat_test_SN5659_R2020b_CM_double -1.7E+308 1.7E+308 /end CHARACTERISTIC
/begin CHARACTERISTIC speedgoat_test_SN5659__cal_impl.Decode1_P16_f "" VALUE 0x008E46B0 Scalar_FLOAT64_IEEE 0 speedgoat_test_SN5659_R2020b_CM_double -1.7E+308 1.7E+308 /end CHARACTERISTIC
/begin CHARACTERISTIC speedgoat_test_SN5659__cal_impl.Decode1_P16_j "" VALUE 0x008E25B8 Scalar_FLOAT64_IEEE 0 speedgoat_test_SN5659_R2020b_CM_double -1.7E+308 1.7E+308 /end CHARACTERISTIC
/begin CHARACTERISTIC speedgoat_test_SN5659__cal_impl.Decode1_P16_jd "" VALUE 0x008E4D48 Scalar_FLOAT64_IEEE 0 speedgoat_test_SN5659_R2020b_CM_double -1.7E+308 1.7E+308 /end CHARACTERISTIC
/begin CHARACTERISTIC speedgoat_test_SN5659__cal_impl.Decode1_P16_js "" VALUE 0x008E53E0 Scalar_FLOAT64_IEEE 0 speedgoat_test_SN5659_R2020b_CM_double -1.7E+308 1.7E+308 /end CHARACTERISTIC
/begin CHARACTERISTIC speedgoat_test_SN5659__cal_impl.Decode1_P16_m "" VALUE 0x008E4018 Scalar_FLOAT64_IEEE 0 speedgoat_test_SN5659_R2020b_CM_double -1.7E+308 1.7E+308 /end CHARACTERISTIC
/begin CHARACTERISTIC speedgoat_test_SN5659__cal_impl.Decode1_P16_n "" VALUE 0x008E3980 Scalar_FLOAT64_IEEE 0 speedgoat_test_SN5659_R2020b_CM_double -1.7E+308 1.7E+308 /end CHARACTERISTIC
/begin CHARACTERISTIC speedgoat_test_SN5659__cal_impl.Decode1_P1_c "" VALUE 0x008E2448 Scalar_FLOAT64_IEEE 0 speedgoat_test_SN5659_R2020b_CM_double -1.7E+308 1.7E+308 /end CHARACTERISTIC
/begin CHARACTERISTIC speedgoat_test_SN5659__cal_impl.Decode1_P1_d "" VALUE 0x008E4BD8 Scalar_FLOAT64_IEEE 0 speedgoat_test_SN5659_R2020b_CM_double -1.7E+308 1.7E+308 /end CHARACTERISTIC
/begin CHARACTERISTIC speedgoat_test_SN5659__cal_impl.Decode1_P1_e "" VALUE 0x008E3EA8 Scalar_FLOAT64_IEEE 0 speedgoat_test_SN5659_R2020b_CM_double -1.7E+308 1.7E+308 /end CHARACTERISTIC
/begin CHARACTERISTIC speedgoat_test_SN5659__cal_impl.Decode1_P1_e3 "" VALUE 0x008E4540 Scalar_FLOAT64_IEEE 0 speedgoat_test_SN5659_R2020b_CM_double -1.7E+308 1.7E+308 /end CHARACTERISTIC
/begin CHARACTERISTIC speedgoat_test_SN5659__cal_impl.Decode1_P1_i "" VALUE 0x008E5908 Scalar_FLOAT64_IEEE 0 speedgoat_test_SN5659_R2020b_CM_double -1.7E+308 1.7E+308 /end CHARACTERISTIC
/begin CHARACTERISTIC speedgoat_test_SN5659__cal_impl.Decode1_P1_l "" VALUE 0x008E5270 Scalar_FLOAT64_IEEE 0 speedgoat_test_SN5659_R2020b_CM_double -1.7E+308 1.7E+308 /end CHARACTERISTIC
/begin CHARACTERISTIC speedgoat_test_SN5659__cal_impl.Decode1_P1_n "" VALUE 0x008E3178 Scalar_FLOAT64_IEEE 0 speedgoat_test_SN5659_R2020b_CM_double -1.7E+308 1.7E+308 /end CHARACTERISTIC
/begin CHARACTERISTIC speedgoat_test_SN5659__cal_impl.Decode1_P1_ng "" VALUE 0x008E3810 Scalar_FLOAT64_IEEE 0 speedgoat_test_SN5659_R2020b_CM_double -1.7E+308 1.7E+308 /end CHARACTERISTIC
/begin CHARACTERISTIC speedgoat_test_SN5659__cal_impl.Decode1_P2 "" VALUE 0x008E1DC8 Scalar_FLOAT64_IEEE 0 speedgoat_test_SN5659_R2020b_CM_double -1.7E+308 1.7E+308 /end CHARACTERISTIC
/begin CHARACTERISTIC speedgoat_test_SN5659__cal_impl.Decode1_P2_e "" VALUE 0x008E4558 Scalar_FLOAT64_IEEE 0 speedgoat_test_SN5659_R2020b_CM_double -1.7E+308 1.7E+308 /end CHARACTERISTIC
/begin CHARACTERISTIC speedgoat_test_SN5659__cal_impl.Decode1_P2_en "" VALUE 0x008E4BF0 Scalar_FLOAT64_IEEE 0 speedgoat_test_SN5659_R2020b_CM_double -1.7E+308 1.7E+308 /end CHARACTERISTIC
/begin CHARACTERISTIC speedgoat_test_SN5659__cal_impl.Decode1_P2_f "" VALUE 0x008E5288 Scalar_FLOAT64_IEEE 0 speedgoat_test_SN5659_R2020b_CM_double -1.7E+308 1.7E+308 /end CHARACTERISTIC
/begin CHARACTERISTIC speedgoat_test_SN5659__cal_impl.Decode1_P2_g "" VALUE 0x008E2460 Scalar_FLOAT64_IEEE 0 speedgoat_test_SN5659_R2020b_CM_double -1.7E+308 1.7E+308 /end CHARACTERISTIC
/begin CHARACTERISTIC speedgoat_test_SN5659__cal_impl.Decode1_P2_j "" VALUE 0x008E5920 Scalar_FLOAT64_IEEE 0 speedgoat_test_SN5659_R2020b_CM_double -1.7E+308 1.7E+308 /end CHARACTERISTIC
/begin CHARACTERISTIC speedgoat_test_SN5659__cal_impl.Decode1_P2_k "" VALUE 0x008E3828 Scalar_FLOAT64_IEEE 0 speedgoat_test_SN5659_R2020b_CM_double -1.7E+308 1.7E+308 /end CHARACTERISTIC
/begin CHARACTERISTIC speedgoat_test_SN5659__cal_impl.Decode1_P2_o "" VALUE 0x008E3190 Scalar_FLOAT64_IEEE 0 speedgoat_test_SN5659_R2020b_CM_double -1.7E+308 1.7E+308 /end CHARACTERISTIC
/begin CHARACTERISTIC speedgoat_test_SN5659__cal_impl.Decode1_P2_ov "" VALUE 0x008E3EC0 Scalar_FLOAT64_IEEE 0 speedgoat_test_SN5659_R2020b_CM_double -1.7E+308 1.7E+308 /end CHARACTERISTIC
/begin CHARACTERISTIC speedgoat_test_SN5659__cal_impl.Decode1_P3 "" VALUE 0x008E1DE0 Scalar_FLOAT64_IEEE 0 speedgoat_test_SN5659_R2020b_CM_double -1.7E+308 1.7E+308 /end CHARACTERISTIC
/begin CHARACTERISTIC speedgoat_test_SN5659__cal_impl.Decode1_P3_b "" VALUE 0x008E2478 Scalar_FLOAT64_IEEE 0 speedgoat_test_SN5659_R2020b_CM_double -1.7E+308 1.7E+308 /end CHARACTERISTIC
/begin CHARACTERISTIC speedgoat_test_SN5659__cal_impl.Decode1_P3_c "" VALUE 0x008E4C08 Scalar_FLOAT64_IEEE 0 speedgoat_test_SN5659_R2020b_CM_double -1.7E+308 1.7E+308 /end CHARACTERISTIC
/begin CHARACTERISTIC speedgoat_test_SN5659__cal_impl.Decode1_P3_f "" VALUE 0x008E3840 Scalar_FLOAT64_IEEE 0 speedgoat_test_SN5659_R2020b_CM_double -1.7E+308 1.7E+308 /end CHARACTERISTIC
/begin CHARACTERISTIC speedgoat_test_SN5659__cal_impl.Decode1_P3_f2 "" VALUE 0x008E5938 Scalar_FLOAT64_IEEE 0 speedgoat_test_SN5659_R2020b_CM_double -1.7E+308 1.7E+308 /end CHARACTERISTIC
/begin CHARACTERISTIC speedgoat_test_SN5659__cal_impl.Decode1_P3_j "" VALUE 0x008E4570 Scalar_FLOAT64_IEEE 0 speedgoat_test_SN5659_R2020b_CM_double -1.7E+308 1.7E+308 /end CHARACTERISTIC
/begin CHARACTERISTIC speedgoat_test_SN5659__cal_impl.Decode1_P3_j5 "" VALUE 0x008E52A0 Scalar_FLOAT64_IEEE 0 speedgoat_test_SN5659_R2020b_CM_double -1.7E+308 1.7E+308 /end CHARACTERISTIC
/begin CHARACTERISTIC speedgoat_test_SN5659__cal_impl.Decode1_P3_o "" VALUE 0x008E31A8 Scalar_FLOAT64_IEEE 0 speedgoat_test_SN5659_R2020b_CM_double -1.7E+308 1.7E+308 /end CHARACTERISTIC
/begin CHARACTERISTIC speedgoat_test_SN5659__cal_impl.Decode1_P3_p "" VALUE 0x008E3ED8 Scalar_FLOAT64_IEEE 0 speedgoat_test_SN5659_R2020b_CM_double -1.7E+308 1.7E+308 /end CHARACTERISTIC
/begin CHARACTERISTIC speedgoat_test_SN5659__cal_impl.Decode1_P4 "" VALUE 0x008E1DF8 Scalar_FLOAT64_IEEE 0 speedgoat_test_SN5659_R2020b_CM_double -1.7E+308 1.7E+308 /end CHARACTERISTIC
/begin CHARACTERISTIC speedgoat_test_SN5659__cal_impl.Decode1_P4_b "" VALUE 0x008E2490 Scalar_FLOAT64_IEEE 0 speedgoat_test_SN5659_R2020b_CM_double -1.7E+308 1.7E+308 /end CHARACTERISTIC
/begin CHARACTERISTIC speedgoat_test_SN5659__cal_impl.Decode1_P4_c "" VALUE 0x008E3858 Scalar_FLOAT64_IEEE 0 speedgoat_test_SN5659_R2020b_CM_double -1.7E+308 1.7E+308 /end CHARACTERISTIC
/begin CHARACTERISTIC speedgoat_test_SN5659__cal_impl.Decode1_P4_cf "" VALUE 0x008E52B8 Scalar_FLOAT64_IEEE 0 speedgoat_test_SN5659_R2020b_CM_double -1.7E+308 1.7E+308 /end CHARACTERISTIC
/begin CHARACTERISTIC speedgoat_test_SN5659__cal_impl.Decode1_P4_i "" VALUE 0x008E4588 Scalar_FLOAT64_IEEE 0 speedgoat_test_SN5659_R2020b_CM_double -1.7E+308 1.7E+308 /end CHARACTERISTIC
/begin CHARACTERISTIC speedgoat_test_SN5659__cal_impl.Decode1_P4_l "" VALUE 0x008E31C0 Scalar_FLOAT64_IEEE 0 speedgoat_test_SN5659_R2020b_CM_double -1.7E+308 1.7E+308 /end CHARACTERISTIC
/begin CHARACTERISTIC speedgoat_test_SN5659__cal_impl.Decode1_P4_ls "" VALUE 0x008E3EF0 Scalar_FLOAT64_IEEE 0 speedgoat_test_SN5659_R2020b_CM_double -1.7E+308 1.7E+308 /end CHARACTERISTIC
/begin CHARACTERISTIC speedgoat_test_SN5659__cal_impl.Decode1_P4_m "" VALUE 0x008E4C20 Scalar_FLOAT64_IEEE 0 speedgoat_test_SN5659_R2020b_CM_double -1.7E+308 1.7E+308 /end CHARACTERISTIC
/begin CHARACTERISTIC speedgoat_test_SN5659__cal_impl.Decode1_P4_p "" VALUE 0x008E5950 Scalar_FLOAT64_IEEE 0 speedgoat_test_SN5659_R2020b_CM_double -1.7E+308 1.7E+308 /end CHARACTERISTIC
/begin CHARACTERISTIC speedgoat_test_SN5659__cal_impl.Decode1_P5 "" VALUE 0x008E1E10 Scalar_FLOAT64_IEEE 0 speedgoat_test_SN5659_R2020b_CM_double -1.7E+308 1.7E+308 /end CHARACTERISTIC
/begin CHARACTERISTIC speedgoat_test_SN5659__cal_impl.Decode1_P5_a "" VALUE 0x008E52D0 Scalar_FLOAT64_IEEE 0 speedgoat_test_SN5659_R2020b_CM_double -1.7E+308 1.7E+308 /end CHARACTERISTIC
/begin CHARACTERISTIC speedgoat_test_SN5659__cal_impl.Decode1_P5_c "" VALUE 0x008E4C38 Scalar_FLOAT64_IEEE 0 speedgoat_test_SN5659_R2020b_CM_double -1.7E+308 1.7E+308 /end CHARACTERISTIC
/begin CHARACTERISTIC speedgoat_test_SN5659__cal_impl.Decode1_P5_f "" VALUE 0x008E24A8 Scalar_FLOAT64_IEEE 0 speedgoat_test_SN5659_R2020b_CM_double -1.7E+308 1.7E+308 /end CHARACTERISTIC
/begin CHARACTERISTIC speedgoat_test_SN5659__cal_impl.Decode1_P5_fb "" VALUE 0x008E3870 Scalar_FLOAT64_IEEE 0 speedgoat_test_SN5659_R2020b_CM_double -1.7E+308 1.7E+308 /end CHARACTERISTIC
/begin CHARACTERISTIC speedgoat_test_SN5659__cal_impl.Decode1_P5_k "" VALUE 0x008E31D8 Scalar_FLOAT64_IEEE 0 speedgoat_test_SN5659_R2020b_CM_double -1.7E+308 1.7E+308 /end CHARACTERISTIC
/begin CHARACTERISTIC speedgoat_test_SN5659__cal_impl.Decode1_P5_m "" VALUE 0x008E3F08 Scalar_FLOAT64_IEEE 0 speedgoat_test_SN5659_R2020b_CM_double -1.7E+308 1.7E+308 /end CHARACTERISTIC
/begin CHARACTERISTIC speedgoat_test_SN5659__cal_impl.Decode1_P5_nq "" VALUE 0x008E5968 Scalar_FLOAT64_IEEE 0 speedgoat_test_SN5659_R2020b_CM_double -1.7E+308 1.7E+308 /end CHARACTERISTIC
/begin CHARACTERISTIC speedgoat_test_SN5659__cal_impl.Decode1_P5_o "" VALUE 0x008E45A0 Scalar_FLOAT64_IEEE 0 speedgoat_test_SN5659_R2020b_CM_double -1.7E+308 1.7E+308 /end CHARACTERISTIC
/begin CHARACTERISTIC speedgoat_test_SN5659__cal_impl.Decode1_P6 "" VALUE 0x008E1E28 Scalar_FLOAT64_IEEE 0 speedgoat_test_SN5659_R2020b_CM_double -1.7E+308 1.7E+308 /end CHARACTERISTIC
/begin CHARACTERISTIC speedgoat_test_SN5659__cal_impl.Decode1_P6_b "" VALUE 0x008E3888 Scalar_FLOAT64_IEEE 0 speedgoat_test_SN5659_R2020b_CM_double -1.7E+308 1.7E+308 /end CHARACTERISTIC
/begin CHARACTERISTIC speedgoat_test_SN5659__cal_impl.Decode1_P6_ba "" VALUE 0x008E5980 Scalar_FLOAT64_IEEE 0 speedgoat_test_SN5659_R2020b_CM_double -1.7E+308 1.7E+308 /end CHARACTERISTIC
/begin CHARACTERISTIC speedgoat_test_SN5659__cal_impl.Decode1_P6_d "" VALUE 0x008E31F0 Scalar_FLOAT64_IEEE 0 speedgoat_test_SN5659_R2020b_CM_double -1.7E+308 1.7E+308 /end CHARACTERISTIC
/begin CHARACTERISTIC speedgoat_test_SN5659__cal_impl.Decode1_P6_f "" VALUE 0x008E24C0 Scalar_FLOAT64_IEEE 0 speedgoat_test_SN5659_R2020b_CM_double -1.7E+308 1.7E+308 /end CHARACTERISTIC
/begin CHARACTERISTIC speedgoat_test_SN5659__cal_impl.Decode1_P6_fp "" VALUE 0x008E52E8 Scalar_FLOAT64_IEEE 0 speedgoat_test_SN5659_R2020b_CM_double -1.7E+308 1.7E+308 /end CHARACTERISTIC
/begin CHARACTERISTIC speedgoat_test_SN5659__cal_impl.Decode1_P6_i "" VALUE 0x008E4C50 Scalar_FLOAT64_IEEE 0 speedgoat_test_SN5659_R2020b_CM_double -1.7E+308 1.7E+308 /end CHARACTERISTIC
/begin CHARACTERISTIC speedgoat_test_SN5659__cal_impl.Decode1_P6_n "" VALUE 0x008E3F20 Scalar_FLOAT64_IEEE 0 speedgoat_test_SN5659_R2020b_CM_double -1.7E+308 1.7E+308 /end CHARACTERISTIC
/begin CHARACTERISTIC speedgoat_test_SN5659__cal_impl.Decode1_P6_p "" VALUE 0x008E45B8 Scalar_FLOAT64_IEEE 0 speedgoat_test_SN5659_R2020b_CM_double -1.7E+308 1.7E+308 /end CHARACTERISTIC
/begin CHARACTERISTIC speedgoat_test_SN5659__cal_impl.Decode1_P7 "" VALUE 0x008E1E40 Scalar_FLOAT64_IEEE 0 speedgoat_test_SN5659_R2020b_CM_double -1.7E+308 1.7E+308 /end CHARACTERISTIC
/begin CHARACTERISTIC speedgoat_test_SN5659__cal_impl.Decode1_P7_a "" VALUE 0x008E3208 Scalar_FLOAT64_IEEE 0 speedgoat_test_SN5659_R2020b_CM_double -1.7E+308 1.7E+308 /end CHARACTERISTIC
/begin CHARACTERISTIC speedgoat_test_SN5659__cal_impl.Decode1_P7_b "" VALUE 0x008E5300 Scalar_FLOAT64_IEEE 0 speedgoat_test_SN5659_R2020b_CM_double -1.7E+308 1.7E+308 /end CHARACTERISTIC
/begin CHARACTERISTIC speedgoat_test_SN5659__cal_impl.Decode1_P7_d "" VALUE 0x008E3F38 Scalar_FLOAT64_IEEE 0 speedgoat_test_SN5659_R2020b_CM_double -1.7E+308 1.7E+308 /end CHARACTERISTIC
/begin CHARACTERISTIC speedgoat_test_SN5659__cal_impl.Decode1_P7_dn "" VALUE 0x008E45D0 Scalar_FLOAT64_IEEE 0 speedgoat_test_SN5659_R2020b_CM_double -1.7E+308 1.7E+308 /end CHARACTERISTIC
/begin CHARACTERISTIC speedgoat_test_SN5659__cal_impl.Decode1_P7_h "" VALUE 0x008E24D8 Scalar_FLOAT64_IEEE 0 speedgoat_test_SN5659_R2020b_CM_double -1.7E+308 1.7E+308 /end CHARACTERISTIC
/begin CHARACTERISTIC speedgoat_test_SN5659__cal_impl.Decode1_P7_hm "" VALUE 0x008E5998 Scalar_FLOAT64_IEEE 0 speedgoat_test_SN5659_R2020b_CM_double -1.7E+308 1.7E+308 /end CHARACTERISTIC
/begin CHARACTERISTIC speedgoat_test_SN5659__cal_impl.Decode1_P7_m "" VALUE 0x008E38A0 Scalar_FLOAT64_IEEE 0 speedgoat_test_SN5659_R2020b_CM_double -1.7E+308 1.7E+308 /end CHARACTERISTIC
/begin CHARACTERISTIC speedgoat_test_SN5659__cal_impl.Decode1_P7_o "" VALUE 0x008E4C68 Scalar_FLOAT64_IEEE 0 speedgoat_test_SN5659_R2020b_CM_double -1.7E+308 1.7E+308 /end CHARACTERISTIC
/begin CHARACTERISTIC speedgoat_test_SN5659__cal_impl.Decode1_P8 "" VALUE 0x008E1E58 Scalar_FLOAT64_IEEE 0 speedgoat_test_SN5659_R2020b_CM_double -1.7E+308 1.7E+308 /end CHARACTERISTIC
/begin CHARACTERISTIC speedgoat_test_SN5659__cal_impl.Decode1_P8_c "" VALUE 0x008E24F0 Scalar_FLOAT64_IEEE 0 speedgoat_test_SN5659_R2020b_CM_double -1.7E+308 1.7E+308 /end CHARACTERISTIC
/begin CHARACTERISTIC speedgoat_test_SN5659__cal_impl.Decode1_P8_e "" VALUE 0x008E38B8 Scalar_FLOAT64_IEEE 0 speedgoat_test_SN5659_R2020b_CM_double -1.7E+308 1.7E+308 /end CHARACTERISTIC
/begin CHARACTERISTIC speedgoat_test_SN5659__cal_impl.Decode1_P8_g "" VALUE 0x008E3220 Scalar_FLOAT64_IEEE 0 speedgoat_test_SN5659_R2020b_CM_double -1.7E+308 1.7E+308 /end CHARACTERISTIC
/begin CHARACTERISTIC speedgoat_test_SN5659__cal_impl.Decode1_P8_gl "" VALUE 0x008E59B0 Scalar_FLOAT64_IEEE 0 speedgoat_test_SN5659_R2020b_CM_double -1.7E+308 1.7E+308 /end CHARACTERISTIC
/begin CHARACTERISTIC speedgoat_test_SN5659__cal_impl.Decode1_P8_i "" VALUE 0x008E4C80 Scalar_FLOAT64_IEEE 0 speedgoat_test_SN5659_R2020b_CM_double -1.7E+308 1.7E+308 /end CHARACTERISTIC
/begin CHARACTERISTIC speedgoat_test_SN5659__cal_impl.Decode1_P8_lr "" VALUE 0x008E45E8 Scalar_FLOAT64_IEEE 0 speedgoat_test_SN5659_R2020b_CM_double -1.7E+308 1.7E+308 /end CHARACTERISTIC
/begin CHARACTERISTIC speedgoat_test_SN5659__cal_impl.Decode1_P8_p "" VALUE 0x008E3F50 Scalar_FLOAT64_IEEE 0 speedgoat_test_SN5659_R2020b_CM_double -1.7E+308 1.7E+308 /end CHARACTERISTIC
/begin CHARACTERISTIC speedgoat_test_SN5659__cal_impl.Decode1_P8_pw "" VALUE 0x008E5318 Scalar_FLOAT64_IEEE 0 speedgoat_test_SN5659_R2020b_CM_double -1.7E+308 1.7E+308 /end CHARACTERISTIC
/begin CHARACTERISTIC speedgoat_test_SN5659__cal_impl.Decode1_P9 "" VALUE 0x008E1E70 Scalar_FLOAT64_IEEE 0 speedgoat_test_SN5659_R2020b_CM_double -1.7E+308 1.7E+308 /end CHARACTERISTIC
/begin CHARACTERISTIC speedgoat_test_SN5659__cal_impl.Decode1_P9_b "" VALUE 0x008E38D0 Scalar_FLOAT64_IEEE 0 speedgoat_test_SN5659_R2020b_CM_double -1.7E+308 1.7E+308 /end CHARACTERISTIC
/begin CHARACTERISTIC speedgoat_test_SN5659__cal_impl.Decode1_P9_d "" VALUE 0x008E5330 Scalar_FLOAT64_IEEE 0 speedgoat_test_SN5659_R2020b_CM_double -1.7E+308 1.7E+308 /end CHARACTERISTIC
/begin CHARACTERISTIC speedgoat_test_SN5659__cal_impl.Decode1_P9_dd "" VALUE 0x008E59C8 Scalar_FLOAT64_IEEE 0 speedgoat_test_SN5659_R2020b_CM_double -1.7E+308 1.7E+308 /end CHARACTERISTIC
/begin CHARACTERISTIC speedgoat_test_SN5659__cal_impl.Decode1_P9_g "" VALUE 0x008E3F68 Scalar_FLOAT64_IEEE 0 speedgoat_test_SN5659_R2020b_CM_double -1.7E+308 1.7E+308 /end CHARACTERISTIC
/begin CHARACTERISTIC speedgoat_test_SN5659__cal_impl.Decode1_P9_i "" VALUE 0x008E4600 Scalar_FLOAT64_IEEE 0 speedgoat_test_SN5659_R2020b_CM_double -1.7E+308 1.7E+308 /end CHARACTERISTIC
/begin CHARACTERISTIC speedgoat_test_SN5659__cal_impl.Decode1_P9_l "" VALUE 0x008E4C98 Scalar_FLOAT64_IEEE 0 speedgoat_test_SN5659_R2020b_CM_double -1.7E+308 1.7E+308 /end CHARACTERISTIC
/begin CHARACTERISTIC speedgoat_test_SN5659__cal_impl.Decode1_P9_o "" VALUE 0x008E3238 Scalar_FLOAT64_IEEE 0 speedgoat_test_SN5659_R2020b_CM_double -1.7E+308 1.7E+308 /end CHARACTERISTIC
/begin CHARACTERISTIC speedgoat_test_SN5659__cal_impl.Decode1_P9_p "" VALUE 0x008E2508 Scalar_FLOAT64_IEEE 0 speedgoat_test_SN5659_R2020b_CM_double -1.7E+308 1.7E+308 /end CHARACTERISTIC
/begin CHARACTERISTIC speedgoat_test_SN5659__cal_impl.Decode2_P1 "" VALUE 0x008E25D0 Scalar_FLOAT64_IEEE 0 speedgoat_test_SN5659_R2020b_CM_double -1.7E+308 1.7E+308 /end CHARACTERISTIC
/begin CHARACTERISTIC speedgoat_test_SN5659__cal_impl.Decode2_P10 "" VAL_BLK 0x008E26A8 Scalar_FLOAT64_IEEE 0 speedgoat_test_SN5659_R2020b_CM_double -1.7E+308 1.7E+308 MATRIX_DIM 2 1 /end CHARACTERISTIC
/begin CHARACTERISTIC speedgoat_test_SN5659__cal_impl.Decode2_P10_b "" VAL_BLK 0x008E54D0 Scalar_FLOAT64_IEEE 0 speedgoat_test_SN5659_R2020b_CM_double -1.7E+308 1.7E+308 MATRIX_DIM 2 1 /end CHARACTERISTIC
/begin CHARACTERISTIC speedgoat_test_SN5659__cal_impl.Decode2_P10_c "" VAL_BLK 0x008E3A70 Scalar_FLOAT64_IEEE 0 speedgoat_test_SN5659_R2020b_CM_double -1.7E+308 1.7E+308 MATRIX_DIM 2 1 /end CHARACTERISTIC
/begin CHARACTERISTIC speedgoat_test_SN5659__cal_impl.Decode2_P10_h "" VAL_BLK 0x008E33D8 Scalar_FLOAT64_IEEE 0 speedgoat_test_SN5659_R2020b_CM_double -1.7E+308 1.7E+308 MATRIX_DIM 2 1 /end CHARACTERISTIC
/begin CHARACTERISTIC speedgoat_test_SN5659__cal_impl.Decode2_P10_j "" VAL_BLK 0x008E4108 Scalar_FLOAT64_IEEE 0 speedgoat_test_SN5659_R2020b_CM_double -1.7E+308 1.7E+308 MATRIX_DIM 2 1 /end CHARACTERISTIC
/begin CHARACTERISTIC speedgoat_test_SN5659__cal_impl.Decode2_P10_js "" VAL_BLK 0x008E5B68 Scalar_FLOAT64_IEEE 0 speedgoat_test_SN5659_R2020b_CM_double -1.7E+308 1.7E+308 MATRIX_DIM 2 1 /end CHARACTERISTIC
/begin CHARACTERISTIC speedgoat_test_SN5659__cal_impl.Decode2_P10_n "" VAL_BLK 0x008E4E38 Scalar_FLOAT64_IEEE 0 speedgoat_test_SN5659_R2020b_CM_double -1.7E+308 1.7E+308 MATRIX_DIM 2 1 /end CHARACTERISTIC
/begin CHARACTERISTIC speedgoat_test_SN5659__cal_impl.Decode2_P11 "" VALUE 0x008E26C8 Scalar_FLOAT64_IEEE 0 speedgoat_test_SN5659_R2020b_CM_double -1.7E+308 1.7E+308 /end CHARACTERISTIC
/begin CHARACTERISTIC speedgoat_test_SN5659__cal_impl.Decode2_P11_b "" VALUE 0x008E54F0 Scalar_FLOAT64_IEEE 0 speedgoat_test_SN5659_R2020b_CM_double -1.7E+308 1.7E+308 /end CHARACTERISTIC
/begin CHARACTERISTIC speedgoat_test_SN5659__cal_impl.Decode2_P11_f "" VALUE 0x008E3A90 Scalar_FLOAT64_IEEE 0 speedgoat_test_SN5659_R2020b_CM_double -1.7E+308 1.7E+308 /end CHARACTERISTIC
/begin CHARACTERISTIC speedgoat_test_SN5659__cal_impl.Decode2_P11_j "" VALUE 0x008E33F8 Scalar_FLOAT64_IEEE 0 speedgoat_test_SN5659_R2020b_CM_double -1.7E+308 1.7E+308 /end CHARACTERISTIC
/begin CHARACTERISTIC speedgoat_test_SN5659__cal_impl.Decode2_P11_jv "" VALUE 0x008E5B88 Scalar_FLOAT64_IEEE 0 speedgoat_test_SN5659_R2020b_CM_double -1.7E+308 1.7E+308 /end CHARACTERISTIC
/begin CHARACTERISTIC speedgoat_test_SN5659__cal_impl.Decode2_P11_k "" VALUE 0x008E4E58 Scalar_FLOAT64_IEEE 0 speedgoat_test_SN5659_R2020b_CM_double -1.7E+308 1.7E+308 /end CHARACTERISTIC
/begin CHARACTERISTIC speedgoat_test_SN5659__cal_impl.Decode2_P11_m "" VALUE 0x008E4128 Scalar_FLOAT64_IEEE 0 speedgoat_test_SN5659_R2020b_CM_double -1.7E+308 1.7E+308 /end CHARACTERISTIC
/begin CHARACTERISTIC speedgoat_test_SN5659__cal_impl.Decode2_P12 "" VALUE 0x008E26E0 Scalar_FLOAT64_IEEE 0 speedgoat_test_SN5659_R2020b_CM_double -1.7E+308 1.7E+308 /end CHARACTERISTIC
/begin CHARACTERISTIC speedgoat_test_SN5659__cal_impl.Decode2_P12_f "" VALUE 0x008E3AA8 Scalar_FLOAT64_IEEE 0 speedgoat_test_SN5659_R2020b_CM_double -1.7E+308 1.7E+308 /end CHARACTERISTIC
/begin CHARACTERISTIC speedgoat_test_SN5659__cal_impl.Decode2_P12_g "" VALUE 0x008E3410 Scalar_FLOAT64_IEEE 0 speedgoat_test_SN5659_R2020b_CM_double -1.7E+308 1.7E+308 /end CHARACTERISTIC
/begin CHARACTERISTIC speedgoat_test_SN5659__cal_impl.Decode2_P12_i "" VALUE 0x008E4E70 Scalar_FLOAT64_IEEE 0 speedgoat_test_SN5659_R2020b_CM_double -1.7E+308 1.7E+308 /end CHARACTERISTIC
/begin CHARACTERISTIC speedgoat_test_SN5659__cal_impl.Decode2_P12_k "" VALUE 0x008E4140 Scalar_FLOAT64_IEEE 0 speedgoat_test_SN5659_R2020b_CM_double -1.7E+308 1.7E+308 /end CHARACTERISTIC
/begin CHARACTERISTIC speedgoat_test_SN5659__cal_impl.Decode2_P12_l "" VALUE 0x008E5508 Scalar_FLOAT64_IEEE 0 speedgoat_test_SN5659_R2020b_CM_double -1.7E+308 1.7E+308 /end CHARACTERISTIC
/begin CHARACTERISTIC speedgoat_test_SN5659__cal_impl.Decode2_P12_p "" VALUE 0x008E5BA0 Scalar_FLOAT64_IEEE 0 speedgoat_test_SN5659_R2020b_CM_double -1.7E+308 1.7E+308 /end CHARACTERISTIC
/begin CHARACTERISTIC speedgoat_test_SN5659__cal_impl.Decode2_P13 "" VALUE 0x008E26F8 Scalar_FLOAT64_IEEE 0 speedgoat_test_SN5659_R2020b_CM_double -1.7E+308 1.7E+308 /end CHARACTERISTIC
/begin CHARACTERISTIC speedgoat_test_SN5659__cal_impl.Decode2_P13_e "" VALUE 0x008E4E88 Scalar_FLOAT64_IEEE 0 speedgoat_test_SN5659_R2020b_CM_double -1.7E+308 1.7E+308 /end CHARACTERISTIC
/begin CHARACTERISTIC speedgoat_test_SN5659__cal_impl.Decode2_P13_f "" VALUE 0x008E5520 Scalar_FLOAT64_IEEE 0 speedgoat_test_SN5659_R2020b_CM_double -1.7E+308 1.7E+308 /end CHARACTERISTIC
/begin CHARACTERISTIC speedgoat_test_SN5659__cal_impl.Decode2_P13_i "" VALUE 0x008E3428 Scalar_FLOAT64_IEEE 0 speedgoat_test_SN5659_R2020b_CM_double -1.7E+308 1.7E+308 /end CHARACTERISTIC
/begin CHARACTERISTIC speedgoat_test_SN5659__cal_impl.Decode2_P13_iy "" VALUE 0x008E5BB8 Scalar_FLOAT64_IEEE 0 speedgoat_test_SN5659_R2020b_CM_double -1.7E+308 1.7E+308 /end CHARACTERISTIC
/begin CHARACTERISTIC speedgoat_test_SN5659__cal_impl.Decode2_P13_j "" VALUE 0x008E4158 Scalar_FLOAT64_IEEE 0 speedgoat_test_SN5659_R2020b_CM_double -1.7E+308 1.7E+308 /end CHARACTERISTIC
/begin CHARACTERISTIC speedgoat_test_SN5659__cal_impl.Decode2_P13_k "" VALUE 0x008E3AC0 Scalar_FLOAT64_IEEE 0 speedgoat_test_SN5659_R2020b_CM_double -1.7E+308 1.7E+308 /end CHARACTERISTIC
/begin CHARACTERISTIC speedgoat_test_SN5659__cal_impl.Decode2_P14 "" VALUE 0x008E2710 Scalar_FLOAT64_IEEE 0 speedgoat_test_SN5659_R2020b_CM_double -1.7E+308 1.7E+308 /end CHARACTERISTIC
/begin CHARACTERISTIC speedgoat_test_SN5659__cal_impl.Decode2_P14_b "" VALUE 0x008E4EA0 Scalar_FLOAT64_IEEE 0 speedgoat_test_SN5659_R2020b_CM_double -1.7E+308 1.7E+308 /end CHARACTERISTIC
/begin CHARACTERISTIC speedgoat_test_SN5659__cal_impl.Decode2_P14_e "" VALUE 0x008E3440 Scalar_FLOAT64_IEEE 0 speedgoat_test_SN5659_R2020b_CM_double -1.7E+308 1.7E+308 /end CHARACTERISTIC
/begin CHARACTERISTIC speedgoat_test_SN5659__cal_impl.Decode2_P14_f "" VALUE 0x008E5BD0 Scalar_FLOAT64_IEEE 0 speedgoat_test_SN5659_R2020b_CM_double -1.7E+308 1.7E+308 /end CHARACTERISTIC
/begin CHARACTERISTIC speedgoat_test_SN5659__cal_impl.Decode2_P14_m "" VALUE 0x008E3AD8 Scalar_FLOAT64_IEEE 0 speedgoat_test_SN5659_R2020b_CM_double -1.7E+308 1.7E+308 /end CHARACTERISTIC
/begin CHARACTERISTIC speedgoat_test_SN5659__cal_impl.Decode2_P14_mb "" VALUE 0x008E5538 Scalar_FLOAT64_IEEE 0 speedgoat_test_SN5659_R2020b_CM_double -1.7E+308 1.7E+308 /end CHARACTERISTIC
/begin CHARACTERISTIC speedgoat_test_SN5659__cal_impl.Decode2_P14_o "" VALUE 0x008E4170 Scalar_FLOAT64_IEEE 0 speedgoat_test_SN5659_R2020b_CM_double -1.7E+308 1.7E+308 /end CHARACTERISTIC
/begin CHARACTERISTIC speedgoat_test_SN5659__cal_impl.Decode2_P15 "" VALUE 0x008E2728 Scalar_FLOAT64_IEEE 0 speedgoat_test_SN5659_R2020b_CM_double -1.7E+308 1.7E+308 /end CHARACTERISTIC
/begin CHARACTERISTIC speedgoat_test_SN5659__cal_impl.Decode2_P15_a "" VALUE 0x008E3458 Scalar_FLOAT64_IEEE 0 speedgoat_test_SN5659_R2020b_CM_double -1.7E+308 1.7E+308 /end CHARACTERISTIC
/begin CHARACTERISTIC speedgoat_test_SN5659__cal_impl.Decode2_P15_c "" VALUE 0x008E3AF0 Scalar_FLOAT64_IEEE 0 speedgoat_test_SN5659_R2020b_CM_double -1.7E+308 1.7E+308 /end CHARACTERISTIC
/begin CHARACTERISTIC speedgoat_test_SN5659__cal_impl.Decode2_P15_cj "" VALUE 0x008E5BE8 Scalar_FLOAT64_IEEE 0 speedgoat_test_SN5659_R2020b_CM_double -1.7E+308 1.7E+308 /end CHARACTERISTIC
/begin CHARACTERISTIC speedgoat_test_SN5659__cal_impl.Decode2_P15_g "" VALUE 0x008E4188 Scalar_FLOAT64_IEEE 0 speedgoat_test_SN5659_R2020b_CM_double -1.7E+308 1.7E+308 /end CHARACTERISTIC
/begin CHARACTERISTIC speedgoat_test_SN5659__cal_impl.Decode2_P15_j "" VALUE 0x008E5550 Scalar_FLOAT64_IEEE 0 speedgoat_test_SN5659_R2020b_CM_double -1.7E+308 1.7E+308 /end CHARACTERISTIC
/begin CHARACTERISTIC speedgoat_test_SN5659__cal_impl.Decode2_P15_n "" VALUE 0x008E4EB8 Scalar_FLOAT64_IEEE 0 speedgoat_test_SN5659_R2020b_CM_double -1.7E+308 1.7E+308 /end CHARACTERISTIC
/begin CHARACTERISTIC speedgoat_test_SN5659__cal_impl.Decode2_P16 "" VALUE 0x008E2740 Scalar_FLOAT64_IEEE 0 speedgoat_test_SN5659_R2020b_CM_double -1.7E+308 1.7E+308 /end CHARACTERISTIC
/begin CHARACTERISTIC speedgoat_test_SN5659__cal_impl.Decode2_P16_c "" VALUE 0x008E3470 Scalar_FLOAT64_IEEE 0 speedgoat_test_SN5659_R2020b_CM_double -1.7E+308 1.7E+308 /end CHARACTERISTIC
/begin CHARACTERISTIC speedgoat_test_SN5659__cal_impl.Decode2_P16_cj "" VALUE 0x008E41A0 Scalar_FLOAT64_IEEE 0 speedgoat_test_SN5659_R2020b_CM_double -1.7E+308 1.7E+308 /end CHARACTERISTIC
/begin CHARACTERISTIC speedgoat_test_SN5659__cal_impl.Decode2_P16_i "" VALUE 0x008E5C00 Scalar_FLOAT64_IEEE 0 speedgoat_test_SN5659_R2020b_CM_double -1.7E+308 1.7E+308 /end CHARACTERISTIC
/begin CHARACTERISTIC speedgoat_test_SN5659__cal_impl.Decode2_P16_j "" VALUE 0x008E5568 Scalar_FLOAT64_IEEE 0 speedgoat_test_SN5659_R2020b_CM_double -1.7E+308 1.7E+308 /end CHARACTERISTIC
/begin CHARACTERISTIC speedgoat_test_SN5659__cal_impl.Decode2_P16_m "" VALUE 0x008E3B08 Scalar_FLOAT64_IEEE 0 speedgoat_test_SN5659_R2020b_CM_double -1.7E+308 1.7E+308 /end CHARACTERISTIC
/begin CHARACTERISTIC speedgoat_test_SN5659__cal_impl.Decode2_P16_n "" VALUE 0x008E4ED0 Scalar_FLOAT64_IEEE 0 speedgoat_test_SN5659_R2020b_CM_double -1.7E+308 1.7E+308 /end CHARACTERISTIC
/begin CHARACTERISTIC speedgoat_test_SN5659__cal_impl.Decode2_P1_c "" VALUE 0x008E5A90 Scalar_FLOAT64_IEEE 0 speedgoat_test_SN5659_R2020b_CM_double -1.7E+308 1.7E+308 /end CHARACTERISTIC
/begin CHARACTERISTIC speedgoat_test_SN5659__cal_impl.Decode2_P1_d "" VALUE 0x008E3300 Scalar_FLOAT64_IEEE 0 speedgoat_test_SN5659_R2020b_CM_double -1.7E+308 1.7E+308 /end CHARACTERISTIC
/begin CHARACTERISTIC speedgoat_test_SN5659__cal_impl.Decode2_P1_e "" VALUE 0x008E4030 Scalar_FLOAT64_IEEE 0 speedgoat_test_SN5659_R2020b_CM_double -1.7E+308 1.7E+308 /end CHARACTERISTIC
/begin CHARACTERISTIC speedgoat_test_SN5659__cal_impl.Decode2_P1_g "" VALUE 0x008E3998 Scalar_FLOAT64_IEEE 0 speedgoat_test_SN5659_R2020b_CM_double -1.7E+308 1.7E+308 /end CHARACTERISTIC
/begin CHARACTERISTIC speedgoat_test_SN5659__cal_impl.Decode2_P1_h "" VALUE 0x008E4D60 Scalar_FLOAT64_IEEE 0 speedgoat_test_SN5659_R2020b_CM_double -1.7E+308 1.7E+308 /end CHARACTERISTIC
/begin CHARACTERISTIC speedgoat_test_SN5659__cal_impl.Decode2_P1_o "" VALUE 0x008E53F8 Scalar_FLOAT64_IEEE 0 speedgoat_test_SN5659_R2020b_CM_double -1.7E+308 1.7E+308 /end CHARACTERISTIC
/begin CHARACTERISTIC speedgoat_test_SN5659__cal_impl.Decode2_P2 "" VALUE 0x008E25E8 Scalar_FLOAT64_IEEE 0 speedgoat_test_SN5659_R2020b_CM_double -1.7E+308 1.7E+308 /end CHARACTERISTIC
/begin CHARACTERISTIC speedgoat_test_SN5659__cal_impl.Decode2_P2_e "" VALUE 0x008E39B0 Scalar_FLOAT64_IEEE 0 speedgoat_test_SN5659_R2020b_CM_double -1.7E+308 1.7E+308 /end CHARACTERISTIC
/begin CHARACTERISTIC speedgoat_test_SN5659__cal_impl.Decode2_P2_ex "" VALUE 0x008E5410 Scalar_FLOAT64_IEEE 0 speedgoat_test_SN5659_R2020b_CM_double -1.7E+308 1.7E+308 /end CHARACTERISTIC
/begin CHARACTERISTIC speedgoat_test_SN5659__cal_impl.Decode2_P2_h "" VALUE 0x008E4D78 Scalar_FLOAT64_IEEE 0 speedgoat_test_SN5659_R2020b_CM_double -1.7E+308 1.7E+308 /end CHARACTERISTIC
/begin CHARACTERISTIC speedgoat_test_SN5659__cal_impl.Decode2_P2_j "" VALUE 0x008E4048 Scalar_FLOAT64_IEEE 0 speedgoat_test_SN5659_R2020b_CM_double -1.7E+308 1.7E+308 /end CHARACTERISTIC
/begin CHARACTERISTIC speedgoat_test_SN5659__cal_impl.Decode2_P2_k "" VALUE 0x008E5AA8 Scalar_FLOAT64_IEEE 0 speedgoat_test_SN5659_R2020b_CM_double -1.7E+308 1.7E+308 /end CHARACTERISTIC
/begin CHARACTERISTIC speedgoat_test_SN5659__cal_impl.Decode2_P2_m "" VALUE 0x008E3318 Scalar_FLOAT64_IEEE 0 speedgoat_test_SN5659_R2020b_CM_double -1.7E+308 1.7E+308 /end CHARACTERISTIC
/begin CHARACTERISTIC speedgoat_test_SN5659__cal_impl.Decode2_P3 "" VALUE 0x008E2600 Scalar_FLOAT64_IEEE 0 speedgoat_test_SN5659_R2020b_CM_double -1.7E+308 1.7E+308 /end CHARACTERISTIC
/begin CHARACTERISTIC speedgoat_test_SN5659__cal_impl.Decode2_P3_a "" VALUE 0x008E3330 Scalar_FLOAT64_IEEE 0 speedgoat_test_SN5659_R2020b_CM_double -1.7E+308 1.7E+308 /end CHARACTERISTIC
/begin CHARACTERISTIC speedgoat_test_SN5659__cal_impl.Decode2_P3_b "" VALUE 0x008E5AC0 Scalar_FLOAT64_IEEE 0 speedgoat_test_SN5659_R2020b_CM_double -1.7E+308 1.7E+308 /end CHARACTERISTIC
/begin CHARACTERISTIC speedgoat_test_SN5659__cal_impl.Decode2_P3_d "" VALUE 0x008E4D90 Scalar_FLOAT64_IEEE 0 speedgoat_test_SN5659_R2020b_CM_double -1.7E+308 1.7E+308 /end CHARACTERISTIC
/begin CHARACTERISTIC speedgoat_test_SN5659__cal_impl.Decode2_P3_e "" VALUE 0x008E39C8 Scalar_FLOAT64_IEEE 0 speedgoat_test_SN5659_R2020b_CM_double -1.7E+308 1.7E+308 /end CHARACTERISTIC
/begin CHARACTERISTIC speedgoat_test_SN5659__cal_impl.Decode2_P3_g "" VALUE 0x008E5428 Scalar_FLOAT64_IEEE 0 speedgoat_test_SN5659_R2020b_CM_double -1.7E+308 1.7E+308 /end CHARACTERISTIC
/begin CHARACTERISTIC speedgoat_test_SN5659__cal_impl.Decode2_P3_k "" VALUE 0x008E4060 Scalar_FLOAT64_IEEE 0 speedgoat_test_SN5659_R2020b_CM_double -1.7E+308 1.7E+308 /end CHARACTERISTIC
/begin CHARACTERISTIC speedgoat_test_SN5659__cal_impl.Decode2_P4 "" VALUE 0x008E2618 Scalar_FLOAT64_IEEE 0 speedgoat_test_SN5659_R2020b_CM_double -1.7E+308 1.7E+308 /end CHARACTERISTIC
/begin CHARACTERISTIC speedgoat_test_SN5659__cal_impl.Decode2_P4_c "" VALUE 0x008E4078 Scalar_FLOAT64_IEEE 0 speedgoat_test_SN5659_R2020b_CM_double -1.7E+308 1.7E+308 /end CHARACTERISTIC
/begin CHARACTERISTIC speedgoat_test_SN5659__cal_impl.Decode2_P4_f "" VALUE 0x008E4DA8 Scalar_FLOAT64_IEEE 0 speedgoat_test_SN5659_R2020b_CM_double -1.7E+308 1.7E+308 /end CHARACTERISTIC
/begin CHARACTERISTIC speedgoat_test_SN5659__cal_impl.Decode2_P4_g "" VALUE 0x008E3348 Scalar_FLOAT64_IEEE 0 speedgoat_test_SN5659_R2020b_CM_double -1.7E+308 1.7E+308 /end CHARACTERISTIC
/begin CHARACTERISTIC speedgoat_test_SN5659__cal_impl.Decode2_P4_j "" VALUE 0x008E5440 Scalar_FLOAT64_IEEE 0 speedgoat_test_SN5659_R2020b_CM_double -1.7E+308 1.7E+308 /end CHARACTERISTIC
/begin CHARACTERISTIC speedgoat_test_SN5659__cal_impl.Decode2_P4_l "" VALUE 0x008E39E0 Scalar_FLOAT64_IEEE 0 speedgoat_test_SN5659_R2020b_CM_double -1.7E+308 1.7E+308 /end CHARACTERISTIC
/begin CHARACTERISTIC speedgoat_test_SN5659__cal_impl.Decode2_P4_o "" VALUE 0x008E5AD8 Scalar_FLOAT64_IEEE 0 speedgoat_test_SN5659_R2020b_CM_double -1.7E+308 1.7E+308 /end CHARACTERISTIC
/begin CHARACTERISTIC speedgoat_test_SN5659__cal_impl.Decode2_P5 "" VALUE 0x008E2630 Scalar_FLOAT64_IEEE 0 speedgoat_test_SN5659_R2020b_CM_double -1.7E+308 1.7E+308 /end CHARACTERISTIC
/begin CHARACTERISTIC speedgoat_test_SN5659__cal_impl.Decode2_P5_c "" VALUE 0x008E4090 Scalar_FLOAT64_IEEE 0 speedgoat_test_SN5659_R2020b_CM_double -1.7E+308 1.7E+308 /end CHARACTERISTIC
/begin CHARACTERISTIC speedgoat_test_SN5659__cal_impl.Decode2_P5_e "" VALUE 0x008E5458 Scalar_FLOAT64_IEEE 0 speedgoat_test_SN5659_R2020b_CM_double -1.7E+308 1.7E+308 /end CHARACTERISTIC
/begin CHARACTERISTIC speedgoat_test_SN5659__cal_impl.Decode2_P5_f "" VALUE 0x008E39F8 Scalar_FLOAT64_IEEE 0 speedgoat_test_SN5659_R2020b_CM_double -1.7E+308 1.7E+308 /end CHARACTERISTIC
/begin CHARACTERISTIC speedgoat_test_SN5659__cal_impl.Decode2_P5_g "" VALUE 0x008E3360 Scalar_FLOAT64_IEEE 0 speedgoat_test_SN5659_R2020b_CM_double -1.7E+308 1.7E+308 /end CHARACTERISTIC
/begin CHARACTERISTIC speedgoat_test_SN5659__cal_impl.Decode2_P5_gd "" VALUE 0x008E4DC0 Scalar_FLOAT64_IEEE 0 speedgoat_test_SN5659_R2020b_CM_double -1.7E+308 1.7E+308 /end CHARACTERISTIC
/begin CHARACTERISTIC speedgoat_test_SN5659__cal_impl.Decode2_P5_j "" VALUE 0x008E5AF0 Scalar_FLOAT64_IEEE 0 speedgoat_test_SN5659_R2020b_CM_double -1.7E+308 1.7E+308 /end CHARACTERISTIC
/begin CHARACTERISTIC speedgoat_test_SN5659__cal_impl.Decode2_P6 "" VALUE 0x008E2648 Scalar_FLOAT64_IEEE 0 speedgoat_test_SN5659_R2020b_CM_double -1.7E+308 1.7E+308 /end CHARACTERISTIC
/begin CHARACTERISTIC speedgoat_test_SN5659__cal_impl.Decode2_P6_h "" VALUE 0x008E5B08 Scalar_FLOAT64_IEEE 0 speedgoat_test_SN5659_R2020b_CM_double -1.7E+308 1.7E+308 /end CHARACTERISTIC
/begin CHARACTERISTIC speedgoat_test_SN5659__cal_impl.Decode2_P6_l "" VALUE 0x008E3378 Scalar_FLOAT64_IEEE 0 speedgoat_test_SN5659_R2020b_CM_double -1.7E+308 1.7E+308 /end CHARACTERISTIC
/begin CHARACTERISTIC speedgoat_test_SN5659__cal_impl.Decode2_P6_o "" VALUE 0x008E3A10 Scalar_FLOAT64_IEEE 0 speedgoat_test_SN5659_R2020b_CM_double -1.7E+308 1.7E+308 /end CHARACTERISTIC
/begin CHARACTERISTIC speedgoat_test_SN5659__cal_impl.Decode2_P6_oa "" VALUE 0x008E4DD8 Scalar_FLOAT64_IEEE 0 speedgoat_test_SN5659_R2020b_CM_double -1.7E+308 1.7E+308 /end CHARACTERISTIC
/begin CHARACTERISTIC speedgoat_test_SN5659__cal_impl.Decode2_P6_p "" VALUE 0x008E40A8 Scalar_FLOAT64_IEEE 0 speedgoat_test_SN5659_R2020b_CM_double -1.7E+308 1.7E+308 /end CHARACTERISTIC
/begin CHARACTERISTIC speedgoat_test_SN5659__cal_impl.Decode2_P6_pp "" VALUE 0x008E5470 Scalar_FLOAT64_IEEE 0 speedgoat_test_SN5659_R2020b_CM_double -1.7E+308 1.7E+308 /end CHARACTERISTIC
/begin CHARACTERISTIC speedgoat_test_SN5659__cal_impl.Decode2_P7 "" VALUE 0x008E2660 Scalar_FLOAT64_IEEE 0 speedgoat_test_SN5659_R2020b_CM_double -1.7E+308 1.7E+308 /end CHARACTERISTIC
/begin CHARACTERISTIC speedgoat_test_SN5659__cal_impl.Decode2_P7_g "" VALUE 0x008E3390 Scalar_FLOAT64_IEEE 0 speedgoat_test_SN5659_R2020b_CM_double -1.7E+308 1.7E+308 /end CHARACTERISTIC
/begin CHARACTERISTIC speedgoat_test_SN5659__cal_impl.Decode2_P7_j "" VALUE 0x008E4DF0 Scalar_FLOAT64_IEEE 0 speedgoat_test_SN5659_R2020b_CM_double -1.7E+308 1.7E+308 /end CHARACTERISTIC
/begin CHARACTERISTIC speedgoat_test_SN5659__cal_impl.Decode2_P7_jq "" VALUE 0x008E5B20 Scalar_FLOAT64_IEEE 0 speedgoat_test_SN5659_R2020b_CM_double -1.7E+308 1.7E+308 /end CHARACTERISTIC
/begin CHARACTERISTIC speedgoat_test_SN5659__cal_impl.Decode2_P7_m "" VALUE 0x008E3A28 Scalar_FLOAT64_IEEE 0 speedgoat_test_SN5659_R2020b_CM_double -1.7E+308 1.7E+308 /end CHARACTERISTIC
/begin CHARACTERISTIC speedgoat_test_SN5659__cal_impl.Decode2_P7_mb "" VALUE 0x008E5488 Scalar_FLOAT64_IEEE 0 speedgoat_test_SN5659_R2020b_CM_double -1.7E+308 1.7E+308 /end CHARACTERISTIC
/begin CHARACTERISTIC speedgoat_test_SN5659__cal_impl.Decode2_P7_o "" VALUE 0x008E40C0 Scalar_FLOAT64_IEEE 0 speedgoat_test_SN5659_R2020b_CM_double -1.7E+308 1.7E+308 /end CHARACTERISTIC
/begin CHARACTERISTIC speedgoat_test_SN5659__cal_impl.Decode2_P8 "" VALUE 0x008E2678 Scalar_FLOAT64_IEEE 0 speedgoat_test_SN5659_R2020b_CM_double -1.7E+308 1.7E+308 /end CHARACTERISTIC
/begin CHARACTERISTIC speedgoat_test_SN5659__cal_impl.Decode2_P8_b "" VALUE 0x008E40D8 Scalar_FLOAT64_IEEE 0 speedgoat_test_SN5659_R2020b_CM_double -1.7E+308 1.7E+308 /end CHARACTERISTIC
/begin CHARACTERISTIC speedgoat_test_SN5659__cal_impl.Decode2_P8_c "" VALUE 0x008E54A0 Scalar_FLOAT64_IEEE 0 speedgoat_test_SN5659_R2020b_CM_double -1.7E+308 1.7E+308 /end CHARACTERISTIC
/begin CHARACTERISTIC speedgoat_test_SN5659__cal_impl.Decode2_P8_f "" VALUE 0x008E3A40 Scalar_FLOAT64_IEEE 0 speedgoat_test_SN5659_R2020b_CM_double -1.7E+308 1.7E+308 /end CHARACTERISTIC
/begin CHARACTERISTIC speedgoat_test_SN5659__cal_impl.Decode2_P8_h "" VALUE 0x008E4E08 Scalar_FLOAT64_IEEE 0 speedgoat_test_SN5659_R2020b_CM_double -1.7E+308 1.7E+308 /end CHARACTERISTIC
/begin CHARACTERISTIC speedgoat_test_SN5659__cal_impl.Decode2_P8_j "" VALUE 0x008E5B38 Scalar_FLOAT64_IEEE 0 speedgoat_test_SN5659_R2020b_CM_double -1.7E+308 1.7E+308 /end CHARACTERISTIC
/begin CHARACTERISTIC speedgoat_test_SN5659__cal_impl.Decode2_P8_l "" VALUE 0x008E33A8 Scalar_FLOAT64_IEEE 0 speedgoat_test_SN5659_R2020b_CM_double -1.7E+308 1.7E+308 /end CHARACTERISTIC
/begin CHARACTERISTIC speedgoat_test_SN5659__cal_impl.Decode2_P9 "" VALUE 0x008E2690 Scalar_FLOAT64_IEEE 0 speedgoat_test_SN5659_R2020b_CM_double -1.7E+308 1.7E+308 /end CHARACTERISTIC
/begin CHARACTERISTIC speedgoat_test_SN5659__cal_impl.Decode2_P9_c "" VALUE 0x008E5B50 Scalar_FLOAT64_IEEE 0 speedgoat_test_SN5659_R2020b_CM_double -1.7E+308 1.7E+308 /end CHARACTERISTIC
/begin CHARACTERISTIC speedgoat_test_SN5659__cal_impl.Decode2_P9_g "" VALUE 0x008E40F0 Scalar_FLOAT64_IEEE 0 speedgoat_test_SN5659_R2020b_CM_double -1.7E+308 1.7E+308 /end CHARACTERISTIC
/begin CHARACTERISTIC speedgoat_test_SN5659__cal_impl.Decode2_P9_l "" VALUE 0x008E33C0 Scalar_FLOAT64_IEEE 0 speedgoat_test_SN5659_R2020b_CM_double -1.7E+308 1.7E+308 /end CHARACTERISTIC
/begin CHARACTERISTIC speedgoat_test_SN5659__cal_impl.Decode2_P9_n "" VALUE 0x008E54B8 Scalar_FLOAT64_IEEE 0 speedgoat_test_SN5659_R2020b_CM_double -1.7E+308 1.7E+308 /end CHARACTERISTIC
/begin CHARACTERISTIC speedgoat_test_SN5659__cal_impl.Decode2_P9_p "" VALUE 0x008E3A58 Scalar_FLOAT64_IEEE 0 speedgoat_test_SN5659_R2020b_CM_double -1.7E+308 1.7E+308 /end CHARACTERISTIC
/begin CHARACTERISTIC speedgoat_test_SN5659__cal_impl.Decode2_P9_pb "" VALUE 0x008E4E20 Scalar_FLOAT64_IEEE 0 speedgoat_test_SN5659_R2020b_CM_double -1.7E+308 1.7E+308 /end CHARACTERISTIC
/begin CHARACTERISTIC speedgoat_test_SN5659__cal_impl.Decode3_P1 "" VALUE 0x008E20C0 Scalar_FLOAT64_IEEE 0 speedgoat_test_SN5659_R2020b_CM_double -1.7E+308 1.7E+308 /end CHARACTERISTIC
/begin CHARACTERISTIC speedgoat_test_SN5659__cal_impl.Decode3_P10 "" VAL_BLK 0x008E2198 Scalar_FLOAT64_IEEE 0 speedgoat_test_SN5659_R2020b_CM_double -1.7E+308 1.7E+308 MATRIX_DIM 2 1 /end CHARACTERISTIC
/begin CHARACTERISTIC speedgoat_test_SN5659__cal_impl.Decode3_P10_a "" VAL_BLK 0x008E2830 Scalar_FLOAT64_IEEE 0 speedgoat_test_SN5659_R2020b_CM_double -1.7E+308 1.7E+308 MATRIX_DIM 2 1 /end CHARACTERISTIC
/begin CHARACTERISTIC speedgoat_test_SN5659__cal_impl.Decode3_P10_b "" VAL_BLK 0x008E4928 Scalar_FLOAT64_IEEE 0 speedgoat_test_SN5659_R2020b_CM_double -1.7E+308 1.7E+308 MATRIX_DIM 2 1 /end CHARACTERISTIC
/begin CHARACTERISTIC speedgoat_test_SN5659__cal_impl.Decode3_P10_c "" VAL_BLK 0x008E4FC0 Scalar_FLOAT64_IEEE 0 speedgoat_test_SN5659_R2020b_CM_double -1.7E+308 1.7E+308 MATRIX_DIM 2 1 /end CHARACTERISTIC
/begin CHARACTERISTIC speedgoat_test_SN5659__cal_impl.Decode3_P10_f "" VAL_BLK 0x008E3BF8 Scalar_FLOAT64_IEEE 0 speedgoat_test_SN5659_R2020b_CM_double -1.7E+308 1.7E+308 MATRIX_DIM 2 1 /end CHARACTERISTIC
/begin CHARACTERISTIC speedgoat_test_SN5659__cal_impl.Decode3_P10_l "" VAL_BLK 0x008E3560 Scalar_FLOAT64_IEEE 0 speedgoat_test_SN5659_R2020b_CM_double -1.7E+308 1.7E+308 MATRIX_DIM 2 1 /end CHARACTERISTIC
/begin CHARACTERISTIC speedgoat_test_SN5659__cal_impl.Decode3_P10_m "" VAL_BLK 0x008E5CF0 Scalar_FLOAT64_IEEE 0 speedgoat_test_SN5659_R2020b_CM_double -1.7E+308 1.7E+308 MATRIX_DIM 2 1 /end CHARACTERISTIC
/begin CHARACTERISTIC speedgoat_test_SN5659__cal_impl.Decode3_P10_n "" VAL_BLK 0x008E5658 Scalar_FLOAT64_IEEE 0 speedgoat_test_SN5659_R2020b_CM_double -1.7E+308 1.7E+308 MATRIX_DIM 2 1 /end CHARACTERISTIC
/begin CHARACTERISTIC speedgoat_test_SN5659__cal_impl.Decode3_P10_o "" VAL_BLK 0x008E4290 Scalar_FLOAT64_IEEE 0 speedgoat_test_SN5659_R2020b_CM_double -1.7E+308 1.7E+308 MATRIX_DIM 2 1 /end CHARACTERISTIC
/begin CHARACTERISTIC speedgoat_test_SN5659__cal_impl.Decode3_P11 "" VALUE 0x008E21B8 Scalar_FLOAT64_IEEE 0 speedgoat_test_SN5659_R2020b_CM_double -1.7E+308 1.7E+308 /end CHARACTERISTIC
/begin CHARACTERISTIC speedgoat_test_SN5659__cal_impl.Decode3_P11_a "" VALUE 0x008E4948 Scalar_FLOAT64_IEEE 0 speedgoat_test_SN5659_R2020b_CM_double -1.7E+308 1.7E+308 /end CHARACTERISTIC
/begin CHARACTERISTIC speedgoat_test_SN5659__cal_impl.Decode3_P11_b "" VALUE 0x008E2850 Scalar_FLOAT64_IEEE 0 speedgoat_test_SN5659_R2020b_CM_double -1.7E+308 1.7E+308 /end CHARACTERISTIC
/begin CHARACTERISTIC speedgoat_test_SN5659__cal_impl.Decode3_P11_bu "" VALUE 0x008E5D10 Scalar_FLOAT64_IEEE 0 speedgoat_test_SN5659_R2020b_CM_double -1.7E+308 1.7E+308 /end CHARACTERISTIC
/begin CHARACTERISTIC speedgoat_test_SN5659__cal_impl.Decode3_P11_d "" VALUE 0x008E4FE0 Scalar_FLOAT64_IEEE 0 speedgoat_test_SN5659_R2020b_CM_double -1.7E+308 1.7E+308 /end CHARACTERISTIC
/begin CHARACTERISTIC speedgoat_test_SN5659__cal_impl.Decode3_P11_h "" VALUE 0x008E3C18 Scalar_FLOAT64_IEEE 0 speedgoat_test_SN5659_R2020b_CM_double -1.7E+308 1.7E+308 /end CHARACTERISTIC
/begin CHARACTERISTIC speedgoat_test_SN5659__cal_impl.Decode3_P11_i "" VALUE 0x008E3580 Scalar_FLOAT64_IEEE 0 speedgoat_test_SN5659_R2020b_CM_double -1.7E+308 1.7E+308 /end CHARACTERISTIC
/begin CHARACTERISTIC speedgoat_test_SN5659__cal_impl.Decode3_P11_k "" VALUE 0x008E42B0 Scalar_FLOAT64_IEEE 0 speedgoat_test_SN5659_R2020b_CM_double -1.7E+308 1.7E+308 /end CHARACTERISTIC
/begin CHARACTERISTIC speedgoat_test_SN5659__cal_impl.Decode3_P11_k1 "" VALUE 0x008E5678 Scalar_FLOAT64_IEEE 0 speedgoat_test_SN5659_R2020b_CM_double -1.7E+308 1.7E+308 /end CHARACTERISTIC
/begin CHARACTERISTIC speedgoat_test_SN5659__cal_impl.Decode3_P12 "" VALUE 0x008E21D0 Scalar_FLOAT64_IEEE 0 speedgoat_test_SN5659_R2020b_CM_double -1.7E+308 1.7E+308 /end CHARACTERISTIC
/begin CHARACTERISTIC speedgoat_test_SN5659__cal_impl.Decode3_P12_a "" VALUE 0x008E3598 Scalar_FLOAT64_IEEE 0 speedgoat_test_SN5659_R2020b_CM_double -1.7E+308 1.7E+308 /end CHARACTERISTIC
/begin CHARACTERISTIC speedgoat_test_SN5659__cal_impl.Decode3_P12_b "" VALUE 0x008E4FF8 Scalar_FLOAT64_IEEE 0 speedgoat_test_SN5659_R2020b_CM_double -1.7E+308 1.7E+308 /end CHARACTERISTIC
/begin CHARACTERISTIC speedgoat_test_SN5659__cal_impl.Decode3_P12_f "" VALUE 0x008E5D28 Scalar_FLOAT64_IEEE 0 speedgoat_test_SN5659_R2020b_CM_double -1.7E+308 1.7E+308 /end CHARACTERISTIC
/begin CHARACTERISTIC speedgoat_test_SN5659__cal_impl.Decode3_P12_k "" VALUE 0x008E3C30 Scalar_FLOAT64_IEEE 0 speedgoat_test_SN5659_R2020b_CM_double -1.7E+308 1.7E+308 /end CHARACTERISTIC
/begin CHARACTERISTIC speedgoat_test_SN5659__cal_impl.Decode3_P12_ku "" VALUE 0x008E42C8 Scalar_FLOAT64_IEEE 0 speedgoat_test_SN5659_R2020b_CM_double -1.7E+308 1.7E+308 /end CHARACTERISTIC
/begin CHARACTERISTIC speedgoat_test_SN5659__cal_impl.Decode3_P12_l "" VALUE 0x008E5690 Scalar_FLOAT64_IEEE 0 speedgoat_test_SN5659_R2020b_CM_double -1.7E+308 1.7E+308 /end CHARACTERISTIC
/begin CHARACTERISTIC speedgoat_test_SN5659__cal_impl.Decode3_P12_p "" VALUE 0x008E2868 Scalar_FLOAT64_IEEE 0 speedgoat_test_SN5659_R2020b_CM_double -1.7E+308 1.7E+308 /end CHARACTERISTIC
/begin CHARACTERISTIC speedgoat_test_SN5659__cal_impl.Decode3_P12_pk "" VALUE 0x008E4960 Scalar_FLOAT64_IEEE 0 speedgoat_test_SN5659_R2020b_CM_double -1.7E+308 1.7E+308 /end CHARACTERISTIC
/begin CHARACTERISTIC speedgoat_test_SN5659__cal_impl.Decode3_P13 "" VALUE 0x008E21E8 Scalar_FLOAT64_IEEE 0 speedgoat_test_SN5659_R2020b_CM_double -1.7E+308 1.7E+308 /end CHARACTERISTIC
/begin CHARACTERISTIC speedgoat_test_SN5659__cal_impl.Decode3_P13_b "" VALUE 0x008E35B0 Scalar_FLOAT64_IEEE 0 speedgoat_test_SN5659_R2020b_CM_double -1.7E+308 1.7E+308 /end CHARACTERISTIC
/begin CHARACTERISTIC speedgoat_test_SN5659__cal_impl.Decode3_P13_d "" VALUE 0x008E2880 Scalar_FLOAT64_IEEE 0 speedgoat_test_SN5659_R2020b_CM_double -1.7E+308 1.7E+308 /end CHARACTERISTIC
/begin CHARACTERISTIC speedgoat_test_SN5659__cal_impl.Decode3_P13_dz "" VALUE 0x008E4978 Scalar_FLOAT64_IEEE 0 speedgoat_test_SN5659_R2020b_CM_double -1.7E+308 1.7E+308 /end CHARACTERISTIC
/begin CHARACTERISTIC speedgoat_test_SN5659__cal_impl.Decode3_P13_e "" VALUE 0x008E42E0 Scalar_FLOAT64_IEEE 0 speedgoat_test_SN5659_R2020b_CM_double -1.7E+308 1.7E+308 /end CHARACTERISTIC
/begin CHARACTERISTIC speedgoat_test_SN5659__cal_impl.Decode3_P13_f "" VALUE 0x008E5D40 Scalar_FLOAT64_IEEE 0 speedgoat_test_SN5659_R2020b_CM_double -1.7E+308 1.7E+308 /end CHARACTERISTIC
/begin CHARACTERISTIC speedgoat_test_SN5659__cal_impl.Decode3_P13_i "" VALUE 0x008E5010 Scalar_FLOAT64_IEEE 0 speedgoat_test_SN5659_R2020b_CM_double -1.7E+308 1.7E+308 /end CHARACTERISTIC
/begin CHARACTERISTIC speedgoat_test_SN5659__cal_impl.Decode3_P13_l "" VALUE 0x008E56A8 Scalar_FLOAT64_IEEE 0 speedgoat_test_SN5659_R2020b_CM_double -1.7E+308 1.7E+308 /end CHARACTERISTIC
/begin CHARACTERISTIC speedgoat_test_SN5659__cal_impl.Decode3_P13_m "" VALUE 0x008E3C48 Scalar_FLOAT64_IEEE 0 speedgoat_test_SN5659_R2020b_CM_double -1.7E+308 1.7E+308 /end CHARACTERISTIC
/begin CHARACTERISTIC speedgoat_test_SN5659__cal_impl.Decode3_P14 "" VALUE 0x008E2200 Scalar_FLOAT64_IEEE 0 speedgoat_test_SN5659_R2020b_CM_double -1.7E+308 1.7E+308 /end CHARACTERISTIC
/begin CHARACTERISTIC speedgoat_test_SN5659__cal_impl.Decode3_P14_f "" VALUE 0x008E4990 Scalar_FLOAT64_IEEE 0 speedgoat_test_SN5659_R2020b_CM_double -1.7E+308 1.7E+308 /end CHARACTERISTIC
/begin CHARACTERISTIC speedgoat_test_SN5659__cal_impl.Decode3_P14_fx "" VALUE 0x008E56C0 Scalar_FLOAT64_IEEE 0 speedgoat_test_SN5659_R2020b_CM_double -1.7E+308 1.7E+308 /end CHARACTERISTIC
/begin CHARACTERISTIC speedgoat_test_SN5659__cal_impl.Decode3_P14_j "" VALUE 0x008E2898 Scalar_FLOAT64_IEEE 0 speedgoat_test_SN5659_R2020b_CM_double -1.7E+308 1.7E+308 /end CHARACTERISTIC
/begin CHARACTERISTIC speedgoat_test_SN5659__cal_impl.Decode3_P14_jy "" VALUE 0x008E42F8 Scalar_FLOAT64_IEEE 0 speedgoat_test_SN5659_R2020b_CM_double -1.7E+308 1.7E+308 /end CHARACTERISTIC
/begin CHARACTERISTIC speedgoat_test_SN5659__cal_impl.Decode3_P14_k "" VALUE 0x008E5028 Scalar_FLOAT64_IEEE 0 speedgoat_test_SN5659_R2020b_CM_double -1.7E+308 1.7E+308 /end CHARACTERISTIC
/begin CHARACTERISTIC speedgoat_test_SN5659__cal_impl.Decode3_P14_l "" VALUE 0x008E3C60 Scalar_FLOAT64_IEEE 0 speedgoat_test_SN5659_R2020b_CM_double -1.7E+308 1.7E+308 /end CHARACTERISTIC
/begin CHARACTERISTIC speedgoat_test_SN5659__cal_impl.Decode3_P14_n "" VALUE 0x008E5D58 Scalar_FLOAT64_IEEE 0 speedgoat_test_SN5659_R2020b_CM_double -1.7E+308 1.7E+308 /end CHARACTERISTIC
/begin CHARACTERISTIC speedgoat_test_SN5659__cal_impl.Decode3_P14_px "" VALUE 0x008E35C8 Scalar_FLOAT64_IEEE 0 speedgoat_test_SN5659_R2020b_CM_double -1.7E+308 1.7E+308 /end CHARACTERISTIC
/begin CHARACTERISTIC speedgoat_test_SN5659__cal_impl.Decode3_P15 "" VALUE 0x008E2218 Scalar_FLOAT64_IEEE 0 speedgoat_test_SN5659_R2020b_CM_double -1.7E+308 1.7E+308 /end CHARACTERISTIC
/begin CHARACTERISTIC speedgoat_test_SN5659__cal_impl.Decode3_P15_b "" VALUE 0x008E5D70 Scalar_FLOAT64_IEEE 0 speedgoat_test_SN5659_R2020b_CM_double -1.7E+308 1.7E+308 /end CHARACTERISTIC
/begin CHARACTERISTIC speedgoat_test_SN5659__cal_impl.Decode3_P15_d "" VALUE 0x008E28B0 Scalar_FLOAT64_IEEE 0 speedgoat_test_SN5659_R2020b_CM_double -1.7E+308 1.7E+308 /end CHARACTERISTIC
/begin CHARACTERISTIC speedgoat_test_SN5659__cal_impl.Decode3_P15_e "" VALUE 0x008E49A8 Scalar_FLOAT64_IEEE 0 speedgoat_test_SN5659_R2020b_CM_double -1.7E+308 1.7E+308 /end CHARACTERISTIC
/begin CHARACTERISTIC speedgoat_test_SN5659__cal_impl.Decode3_P15_j "" VALUE 0x008E35E0 Scalar_FLOAT64_IEEE 0 speedgoat_test_SN5659_R2020b_CM_double -1.7E+308 1.7E+308 /end CHARACTERISTIC
/begin CHARACTERISTIC speedgoat_test_SN5659__cal_impl.Decode3_P15_jx "" VALUE 0x008E5040 Scalar_FLOAT64_IEEE 0 speedgoat_test_SN5659_R2020b_CM_double -1.7E+308 1.7E+308 /end CHARACTERISTIC
/begin CHARACTERISTIC speedgoat_test_SN5659__cal_impl.Decode3_P15_l "" VALUE 0x008E3C78 Scalar_FLOAT64_IEEE 0 speedgoat_test_SN5659_R2020b_CM_double -1.7E+308 1.7E+308 /end CHARACTERISTIC
/begin CHARACTERISTIC speedgoat_test_SN5659__cal_impl.Decode3_P15_l0 "" VALUE 0x008E4310 Scalar_FLOAT64_IEEE 0 speedgoat_test_SN5659_R2020b_CM_double -1.7E+308 1.7E+308 /end CHARACTERISTIC
/begin CHARACTERISTIC speedgoat_test_SN5659__cal_impl.Decode3_P15_p "" VALUE 0x008E56D8 Scalar_FLOAT64_IEEE 0 speedgoat_test_SN5659_R2020b_CM_double -1.7E+308 1.7E+308 /end CHARACTERISTIC
/begin CHARACTERISTIC speedgoat_test_SN5659__cal_impl.Decode3_P16 "" VALUE 0x008E2230 Scalar_FLOAT64_IEEE 0 speedgoat_test_SN5659_R2020b_CM_double -1.7E+308 1.7E+308 /end CHARACTERISTIC
/begin CHARACTERISTIC speedgoat_test_SN5659__cal_impl.Decode3_P16_b "" VALUE 0x008E28C8 Scalar_FLOAT64_IEEE 0 speedgoat_test_SN5659_R2020b_CM_double -1.7E+308 1.7E+308 /end CHARACTERISTIC
/begin CHARACTERISTIC speedgoat_test_SN5659__cal_impl.Decode3_P16_b1 "" VALUE 0x008E35F8 Scalar_FLOAT64_IEEE 0 speedgoat_test_SN5659_R2020b_CM_double -1.7E+308 1.7E+308 /end CHARACTERISTIC
/begin CHARACTERISTIC speedgoat_test_SN5659__cal_impl.Decode3_P16_e "" VALUE 0x008E49C0 Scalar_FLOAT64_IEEE 0 speedgoat_test_SN5659_R2020b_CM_double -1.7E+308 1.7E+308 /end CHARACTERISTIC
/begin CHARACTERISTIC speedgoat_test_SN5659__cal_impl.Decode3_P16_f "" VALUE 0x008E5058 Scalar_FLOAT64_IEEE 0 speedgoat_test_SN5659_R2020b_CM_double -1.7E+308 1.7E+308 /end CHARACTERISTIC
/begin CHARACTERISTIC speedgoat_test_SN5659__cal_impl.Decode3_P16_fl "" VALUE 0x008E5D88 Scalar_FLOAT64_IEEE 0 speedgoat_test_SN5659_R2020b_CM_double -1.7E+308 1.7E+308 /end CHARACTERISTIC
/begin CHARACTERISTIC speedgoat_test_SN5659__cal_impl.Decode3_P16_h "" VALUE 0x008E3C90 Scalar_FLOAT64_IEEE 0 speedgoat_test_SN5659_R2020b_CM_double -1.7E+308 1.7E+308 /end CHARACTERISTIC
/begin CHARACTERISTIC speedgoat_test_SN5659__cal_impl.Decode3_P16_hp "" VALUE 0x008E4328 Scalar_FLOAT64_IEEE 0 speedgoat_test_SN5659_R2020b_CM_double -1.7E+308 1.7E+308 /end CHARACTERISTIC
/begin CHARACTERISTIC speedgoat_test_SN5659__cal_impl.Decode3_P16_o "" VALUE 0x008E56F0 Scalar_FLOAT64_IEEE 0 speedgoat_test_SN5659_R2020b_CM_double -1.7E+308 1.7E+308 /end CHARACTERISTIC
/begin CHARACTERISTIC speedgoat_test_SN5659__cal_impl.Decode3_P1_a "" VALUE 0x008E2758 Scalar_FLOAT64_IEEE 0 speedgoat_test_SN5659_R2020b_CM_double -1.7E+308 1.7E+308 /end CHARACTERISTIC
/begin CHARACTERISTIC speedgoat_test_SN5659__cal_impl.Decode3_P1_a1 "" VALUE 0x008E3488 Scalar_FLOAT64_IEEE 0 speedgoat_test_SN5659_R2020b_CM_double -1.7E+308 1.7E+308 /end CHARACTERISTIC
/begin CHARACTERISTIC speedgoat_test_SN5659__cal_impl.Decode3_P1_a1u "" VALUE 0x008E4850 Scalar_FLOAT64_IEEE 0 speedgoat_test_SN5659_R2020b_CM_double -1.7E+308 1.7E+308 /end CHARACTERISTIC
/begin CHARACTERISTIC speedgoat_test_SN5659__cal_impl.Decode3_P1_b "" VALUE 0x008E5580 Scalar_FLOAT64_IEEE 0 speedgoat_test_SN5659_R2020b_CM_double -1.7E+308 1.7E+308 /end CHARACTERISTIC
/begin CHARACTERISTIC speedgoat_test_SN5659__cal_impl.Decode3_P1_cm "" VALUE 0x008E41B8 Scalar_FLOAT64_IEEE 0 speedgoat_test_SN5659_R2020b_CM_double -1.7E+308 1.7E+308 /end CHARACTERISTIC
/begin CHARACTERISTIC speedgoat_test_SN5659__cal_impl.Decode3_P1_e "" VALUE 0x008E4EE8 Scalar_FLOAT64_IEEE 0 speedgoat_test_SN5659_R2020b_CM_double -1.7E+308 1.7E+308 /end CHARACTERISTIC
/begin CHARACTERISTIC speedgoat_test_SN5659__cal_impl.Decode3_P1_k "" VALUE 0x008E3B20 Scalar_FLOAT64_IEEE 0 speedgoat_test_SN5659_R2020b_CM_double -1.7E+308 1.7E+308 /end CHARACTERISTIC
/begin CHARACTERISTIC speedgoat_test_SN5659__cal_impl.Decode3_P1_kn "" VALUE 0x008E5C18 Scalar_FLOAT64_IEEE 0 speedgoat_test_SN5659_R2020b_CM_double -1.7E+308 1.7E+308 /end CHARACTERISTIC
/begin CHARACTERISTIC speedgoat_test_SN5659__cal_impl.Decode3_P2 "" VALUE 0x008E20D8 Scalar_FLOAT64_IEEE 0 speedgoat_test_SN5659_R2020b_CM_double -1.7E+308 1.7E+308 /end CHARACTERISTIC
/begin CHARACTERISTIC speedgoat_test_SN5659__cal_impl.Decode3_P2_h "" VALUE 0x008E41D0 Scalar_FLOAT64_IEEE 0 speedgoat_test_SN5659_R2020b_CM_double -1.7E+308 1.7E+308 /end CHARACTERISTIC
/begin CHARACTERISTIC speedgoat_test_SN5659__cal_impl.Decode3_P2_js "" VALUE 0x008E5C30 Scalar_FLOAT64_IEEE 0 speedgoat_test_SN5659_R2020b_CM_double -1.7E+308 1.7E+308 /end CHARACTERISTIC
/begin CHARACTERISTIC speedgoat_test_SN5659__cal_impl.Decode3_P2_l "" VALUE 0x008E2770 Scalar_FLOAT64_IEEE 0 speedgoat_test_SN5659_R2020b_CM_double -1.7E+308 1.7E+308 /end CHARACTERISTIC
/begin CHARACTERISTIC speedgoat_test_SN5659__cal_impl.Decode3_P2_l2 "" VALUE 0x008E4F00 Scalar_FLOAT64_IEEE 0 speedgoat_test_SN5659_R2020b_CM_double -1.7E+308 1.7E+308 /end CHARACTERISTIC
/begin CHARACTERISTIC speedgoat_test_SN5659__cal_impl.Decode3_P2_ls "" VALUE 0x008E5598 Scalar_FLOAT64_IEEE 0 speedgoat_test_SN5659_R2020b_CM_double -1.7E+308 1.7E+308 /end CHARACTERISTIC
/begin CHARACTERISTIC speedgoat_test_SN5659__cal_impl.Decode3_P2_o "" VALUE 0x008E3B38 Scalar_FLOAT64_IEEE 0 speedgoat_test_SN5659_R2020b_CM_double -1.7E+308 1.7E+308 /end CHARACTERISTIC
/begin CHARACTERISTIC speedgoat_test_SN5659__cal_impl.Decode3_P2_of "" VALUE 0x008E4868 Scalar_FLOAT64_IEEE 0 speedgoat_test_SN5659_R2020b_CM_double -1.7E+308 1.7E+308 /end CHARACTERISTIC
/begin CHARACTERISTIC speedgoat_test_SN5659__cal_impl.Decode3_P2_p "" VALUE 0x008E34A0 Scalar_FLOAT64_IEEE 0 speedgoat_test_SN5659_R2020b_CM_double -1.7E+308 1.7E+308 /end CHARACTERISTIC
/begin CHARACTERISTIC speedgoat_test_SN5659__cal_impl.Decode3_P3 "" VALUE 0x008E20F0 Scalar_FLOAT64_IEEE 0 speedgoat_test_SN5659_R2020b_CM_double -1.7E+308 1.7E+308 /end CHARACTERISTIC
/begin CHARACTERISTIC speedgoat_test_SN5659__cal_impl.Decode3_P3_b "" VALUE 0x008E41E8 Scalar_FLOAT64_IEEE 0 speedgoat_test_SN5659_R2020b_CM_double -1.7E+308 1.7E+308 /end CHARACTERISTIC
/begin CHARACTERISTIC speedgoat_test_SN5659__cal_impl.Decode3_P3_c "" VALUE 0x008E3B50 Scalar_FLOAT64_IEEE 0 speedgoat_test_SN5659_R2020b_CM_double -1.7E+308 1.7E+308 /end CHARACTERISTIC
/begin CHARACTERISTIC speedgoat_test_SN5659__cal_impl.Decode3_P3_cq "" VALUE 0x008E4F18 Scalar_FLOAT64_IEEE 0 speedgoat_test_SN5659_R2020b_CM_double -1.7E+308 1.7E+308 /end CHARACTERISTIC
/begin CHARACTERISTIC speedgoat_test_SN5659__cal_impl.Decode3_P3_h "" VALUE 0x008E34B8 Scalar_FLOAT64_IEEE 0 speedgoat_test_SN5659_R2020b_CM_double -1.7E+308 1.7E+308 /end CHARACTERISTIC
/begin CHARACTERISTIC speedgoat_test_SN5659__cal_impl.Decode3_P3_jq "" VALUE 0x008E5C48 Scalar_FLOAT64_IEEE 0 speedgoat_test_SN5659_R2020b_CM_double -1.7E+308 1.7E+308 /end CHARACTERISTIC
/begin CHARACTERISTIC speedgoat_test_SN5659__cal_impl.Decode3_P3_l "" VALUE 0x008E55B0 Scalar_FLOAT64_IEEE 0 speedgoat_test_SN5659_R2020b_CM_double -1.7E+308 1.7E+308 /end CHARACTERISTIC
/begin CHARACTERISTIC speedgoat_test_SN5659__cal_impl.Decode3_P3_p "" VALUE 0x008E2788 Scalar_FLOAT64_IEEE 0 speedgoat_test_SN5659_R2020b_CM_double -1.7E+308 1.7E+308 /end CHARACTERISTIC
/begin CHARACTERISTIC speedgoat_test_SN5659__cal_impl.Decode3_P3_pi "" VALUE 0x008E4880 Scalar_FLOAT64_IEEE 0 speedgoat_test_SN5659_R2020b_CM_double -1.7E+308 1.7E+308 /end CHARACTERISTIC
/begin CHARACTERISTIC speedgoat_test_SN5659__cal_impl.Decode3_P4 "" VALUE 0x008E2108 Scalar_FLOAT64_IEEE 0 speedgoat_test_SN5659_R2020b_CM_double -1.7E+308 1.7E+308 /end CHARACTERISTIC
/begin CHARACTERISTIC speedgoat_test_SN5659__cal_impl.Decode3_P4_a "" VALUE 0x008E4898 Scalar_FLOAT64_IEEE 0 speedgoat_test_SN5659_R2020b_CM_double -1.7E+308 1.7E+308 /end CHARACTERISTIC
/begin CHARACTERISTIC speedgoat_test_SN5659__cal_impl.Decode3_P4_d "" VALUE 0x008E34D0 Scalar_FLOAT64_IEEE 0 speedgoat_test_SN5659_R2020b_CM_double -1.7E+308 1.7E+308 /end CHARACTERISTIC
/begin CHARACTERISTIC speedgoat_test_SN5659__cal_impl.Decode3_P4_i "" VALUE 0x008E3B68 Scalar_FLOAT64_IEEE 0 speedgoat_test_SN5659_R2020b_CM_double -1.7E+308 1.7E+308 /end CHARACTERISTIC
/begin CHARACTERISTIC speedgoat_test_SN5659__cal_impl.Decode3_P4_j "" VALUE 0x008E4F30 Scalar_FLOAT64_IEEE 0 speedgoat_test_SN5659_R2020b_CM_double -1.7E+308 1.7E+308 /end CHARACTERISTIC
/begin CHARACTERISTIC speedgoat_test_SN5659__cal_impl.Decode3_P4_ja "" VALUE 0x008E55C8 Scalar_FLOAT64_IEEE 0 speedgoat_test_SN5659_R2020b_CM_double -1.7E+308 1.7E+308 /end CHARACTERISTIC
/begin CHARACTERISTIC speedgoat_test_SN5659__cal_impl.Decode3_P4_m "" VALUE 0x008E27A0 Scalar_FLOAT64_IEEE 0 speedgoat_test_SN5659_R2020b_CM_double -1.7E+308 1.7E+308 /end CHARACTERISTIC
/begin CHARACTERISTIC speedgoat_test_SN5659__cal_impl.Decode3_P4_o "" VALUE 0x008E4200 Scalar_FLOAT64_IEEE 0 speedgoat_test_SN5659_R2020b_CM_double -1.7E+308 1.7E+308 /end CHARACTERISTIC
/begin CHARACTERISTIC speedgoat_test_SN5659__cal_impl.Decode3_P4_o3 "" VALUE 0x008E5C60 Scalar_FLOAT64_IEEE 0 speedgoat_test_SN5659_R2020b_CM_double -1.7E+308 1.7E+308 /end CHARACTERISTIC
/begin CHARACTERISTIC speedgoat_test_SN5659__cal_impl.Decode3_P5 "" VALUE 0x008E2120 Scalar_FLOAT64_IEEE 0 speedgoat_test_SN5659_R2020b_CM_double -1.7E+308 1.7E+308 /end CHARACTERISTIC
/begin CHARACTERISTIC speedgoat_test_SN5659__cal_impl.Decode3_P5_a "" VALUE 0x008E3B80 Scalar_FLOAT64_IEEE 0 speedgoat_test_SN5659_R2020b_CM_double -1.7E+308 1.7E+308 /end CHARACTERISTIC
/begin CHARACTERISTIC speedgoat_test_SN5659__cal_impl.Decode3_P5_ae "" VALUE 0x008E4218 Scalar_FLOAT64_IEEE 0 speedgoat_test_SN5659_R2020b_CM_double -1.7E+308 1.7E+308 /end CHARACTERISTIC
/begin CHARACTERISTIC speedgoat_test_SN5659__cal_impl.Decode3_P5_c "" VALUE 0x008E27B8 Scalar_FLOAT64_IEEE 0 speedgoat_test_SN5659_R2020b_CM_double -1.7E+308 1.7E+308 /end CHARACTERISTIC
/begin CHARACTERISTIC speedgoat_test_SN5659__cal_impl.Decode3_P5_f "" VALUE 0x008E55E0 Scalar_FLOAT64_IEEE 0 speedgoat_test_SN5659_R2020b_CM_double -1.7E+308 1.7E+308 /end CHARACTERISTIC
/begin CHARACTERISTIC speedgoat_test_SN5659__cal_impl.Decode3_P5_g "" VALUE 0x008E5C78 Scalar_FLOAT64_IEEE 0 speedgoat_test_SN5659_R2020b_CM_double -1.7E+308 1.7E+308 /end CHARACTERISTIC
/begin CHARACTERISTIC speedgoat_test_SN5659__cal_impl.Decode3_P5_h "" VALUE 0x008E48B0 Scalar_FLOAT64_IEEE 0 speedgoat_test_SN5659_R2020b_CM_double -1.7E+308 1.7E+308 /end CHARACTERISTIC
/begin CHARACTERISTIC speedgoat_test_SN5659__cal_impl.Decode3_P5_m "" VALUE 0x008E34E8 Scalar_FLOAT64_IEEE 0 speedgoat_test_SN5659_R2020b_CM_double -1.7E+308 1.7E+308 /end CHARACTERISTIC
/begin CHARACTERISTIC speedgoat_test_SN5659__cal_impl.Decode3_P5_n "" VALUE 0x008E4F48 Scalar_FLOAT64_IEEE 0 speedgoat_test_SN5659_R2020b_CM_double -1.7E+308 1.7E+308 /end CHARACTERISTIC
/begin CHARACTERISTIC speedgoat_test_SN5659__cal_impl.Decode3_P6 "" VALUE 0x008E2138 Scalar_FLOAT64_IEEE 0 speedgoat_test_SN5659_R2020b_CM_double -1.7E+308 1.7E+308 /end CHARACTERISTIC
/begin CHARACTERISTIC speedgoat_test_SN5659__cal_impl.Decode3_P6_d "" VALUE 0x008E4230 Scalar_FLOAT64_IEEE 0 speedgoat_test_SN5659_R2020b_CM_double -1.7E+308 1.7E+308 /end CHARACTERISTIC
/begin CHARACTERISTIC speedgoat_test_SN5659__cal_impl.Decode3_P6_d3 "" VALUE 0x008E55F8 Scalar_FLOAT64_IEEE 0 speedgoat_test_SN5659_R2020b_CM_double -1.7E+308 1.7E+308 /end CHARACTERISTIC
/begin CHARACTERISTIC speedgoat_test_SN5659__cal_impl.Decode3_P6_e "" VALUE 0x008E4F60 Scalar_FLOAT64_IEEE 0 speedgoat_test_SN5659_R2020b_CM_double -1.7E+308 1.7E+308 /end CHARACTERISTIC
/begin CHARACTERISTIC speedgoat_test_SN5659__cal_impl.Decode3_P6_i "" VALUE 0x008E3B98 Scalar_FLOAT64_IEEE 0 speedgoat_test_SN5659_R2020b_CM_double -1.7E+308 1.7E+308 /end CHARACTERISTIC
/begin CHARACTERISTIC speedgoat_test_SN5659__cal_impl.Decode3_P6_ih "" VALUE 0x008E5C90 Scalar_FLOAT64_IEEE 0 speedgoat_test_SN5659_R2020b_CM_double -1.7E+308 1.7E+308 /end CHARACTERISTIC
/begin CHARACTERISTIC speedgoat_test_SN5659__cal_impl.Decode3_P6_k "" VALUE 0x008E27D0 Scalar_FLOAT64_IEEE 0 speedgoat_test_SN5659_R2020b_CM_double -1.7E+308 1.7E+308 /end CHARACTERISTIC
/begin CHARACTERISTIC speedgoat_test_SN5659__cal_impl.Decode3_P6_o "" VALUE 0x008E3500 Scalar_FLOAT64_IEEE 0 speedgoat_test_SN5659_R2020b_CM_double -1.7E+308 1.7E+308 /end CHARACTERISTIC
/begin CHARACTERISTIC speedgoat_test_SN5659__cal_impl.Decode3_P6_ot "" VALUE 0x008E48C8 Scalar_FLOAT64_IEEE 0 speedgoat_test_SN5659_R2020b_CM_double -1.7E+308 1.7E+308 /end CHARACTERISTIC
/begin CHARACTERISTIC speedgoat_test_SN5659__cal_impl.Decode3_P7 "" VALUE 0x008E2150 Scalar_FLOAT64_IEEE 0 speedgoat_test_SN5659_R2020b_CM_double -1.7E+308 1.7E+308 /end CHARACTERISTIC
/begin CHARACTERISTIC speedgoat_test_SN5659__cal_impl.Decode3_P7_b "" VALUE 0x008E4F78 Scalar_FLOAT64_IEEE 0 speedgoat_test_SN5659_R2020b_CM_double -1.7E+308 1.7E+308 /end CHARACTERISTIC
/begin CHARACTERISTIC speedgoat_test_SN5659__cal_impl.Decode3_P7_c "" VALUE 0x008E3BB0 Scalar_FLOAT64_IEEE 0 speedgoat_test_SN5659_R2020b_CM_double -1.7E+308 1.7E+308 /end CHARACTERISTIC
/begin CHARACTERISTIC speedgoat_test_SN5659__cal_impl.Decode3_P7_cp "" VALUE 0x008E5CA8 Scalar_FLOAT64_IEEE 0 speedgoat_test_SN5659_R2020b_CM_double -1.7E+308 1.7E+308 /end CHARACTERISTIC
/begin CHARACTERISTIC speedgoat_test_SN5659__cal_impl.Decode3_P7_e "" VALUE 0x008E4248 Scalar_FLOAT64_IEEE 0 speedgoat_test_SN5659_R2020b_CM_double -1.7E+308 1.7E+308 /end CHARACTERISTIC
/begin CHARACTERISTIC speedgoat_test_SN5659__cal_impl.Decode3_P7_f "" VALUE 0x008E48E0 Scalar_FLOAT64_IEEE 0 speedgoat_test_SN5659_R2020b_CM_double -1.7E+308 1.7E+308 /end CHARACTERISTIC
/begin CHARACTERISTIC speedgoat_test_SN5659__cal_impl.Decode3_P7_i "" VALUE 0x008E5610 Scalar_FLOAT64_IEEE 0 speedgoat_test_SN5659_R2020b_CM_double -1.7E+308 1.7E+308 /end CHARACTERISTIC
/begin CHARACTERISTIC speedgoat_test_SN5659__cal_impl.Decode3_P7_k "" VALUE 0x008E27E8 Scalar_FLOAT64_IEEE 0 speedgoat_test_SN5659_R2020b_CM_double -1.7E+308 1.7E+308 /end CHARACTERISTIC
/begin CHARACTERISTIC speedgoat_test_SN5659__cal_impl.Decode3_P7_kc "" VALUE 0x008E3518 Scalar_FLOAT64_IEEE 0 speedgoat_test_SN5659_R2020b_CM_double -1.7E+308 1.7E+308 /end CHARACTERISTIC
/begin CHARACTERISTIC speedgoat_test_SN5659__cal_impl.Decode3_P8 "" VALUE 0x008E2168 Scalar_FLOAT64_IEEE 0 speedgoat_test_SN5659_R2020b_CM_double -1.7E+308 1.7E+308 /end CHARACTERISTIC
/begin CHARACTERISTIC speedgoat_test_SN5659__cal_impl.Decode3_P8_e "" VALUE 0x008E48F8 Scalar_FLOAT64_IEEE 0 speedgoat_test_SN5659_R2020b_CM_double -1.7E+308 1.7E+308 /end CHARACTERISTIC
/begin CHARACTERISTIC speedgoat_test_SN5659__cal_impl.Decode3_P8_g "" VALUE 0x008E2800 Scalar_FLOAT64_IEEE 0 speedgoat_test_SN5659_R2020b_CM_double -1.7E+308 1.7E+308 /end CHARACTERISTIC
/begin CHARACTERISTIC speedgoat_test_SN5659__cal_impl.Decode3_P8_g0 "" VALUE 0x008E3BC8 Scalar_FLOAT64_IEEE 0 speedgoat_test_SN5659_R2020b_CM_double -1.7E+308 1.7E+308 /end CHARACTERISTIC
/begin CHARACTERISTIC speedgoat_test_SN5659__cal_impl.Decode3_P8_i "" VALUE 0x008E4260 Scalar_FLOAT64_IEEE 0 speedgoat_test_SN5659_R2020b_CM_double -1.7E+308 1.7E+308 /end CHARACTERISTIC
/begin CHARACTERISTIC speedgoat_test_SN5659__cal_impl.Decode3_P8_l "" VALUE 0x008E5CC0 Scalar_FLOAT64_IEEE 0 speedgoat_test_SN5659_R2020b_CM_double -1.7E+308 1.7E+308 /end CHARACTERISTIC
/begin CHARACTERISTIC speedgoat_test_SN5659__cal_impl.Decode3_P8_m "" VALUE 0x008E3530 Scalar_FLOAT64_IEEE 0 speedgoat_test_SN5659_R2020b_CM_double -1.7E+308 1.7E+308 /end CHARACTERISTIC
/begin CHARACTERISTIC speedgoat_test_SN5659__cal_impl.Decode3_P8_m3 "" VALUE 0x008E5628 Scalar_FLOAT64_IEEE 0 speedgoat_test_SN5659_R2020b_CM_double -1.7E+308 1.7E+308 /end CHARACTERISTIC
/begin CHARACTERISTIC speedgoat_test_SN5659__cal_impl.Decode3_P8_p "" VALUE 0x008E4F90 Scalar_FLOAT64_IEEE 0 speedgoat_test_SN5659_R2020b_CM_double -1.7E+308 1.7E+308 /end CHARACTERISTIC
/begin CHARACTERISTIC speedgoat_test_SN5659__cal_impl.Decode3_P9 "" VALUE 0x008E2180 Scalar_FLOAT64_IEEE 0 speedgoat_test_SN5659_R2020b_CM_double -1.7E+308 1.7E+308 /end CHARACTERISTIC
/begin CHARACTERISTIC speedgoat_test_SN5659__cal_impl.Decode3_P9_d "" VALUE 0x008E3BE0 Scalar_FLOAT64_IEEE 0 speedgoat_test_SN5659_R2020b_CM_double -1.7E+308 1.7E+308 /end CHARACTERISTIC
/begin CHARACTERISTIC speedgoat_test_SN5659__cal_impl.Decode3_P9_h "" VALUE 0x008E2818 Scalar_FLOAT64_IEEE 0 speedgoat_test_SN5659_R2020b_CM_double -1.7E+308 1.7E+308 /end CHARACTERISTIC
/begin CHARACTERISTIC speedgoat_test_SN5659__cal_impl.Decode3_P9_h1 "" VALUE 0x008E5640 Scalar_FLOAT64_IEEE 0 speedgoat_test_SN5659_R2020b_CM_double -1.7E+308 1.7E+308 /end CHARACTERISTIC
/begin CHARACTERISTIC speedgoat_test_SN5659__cal_impl.Decode3_P9_hu "" VALUE 0x008E4FA8 Scalar_FLOAT64_IEEE 0 speedgoat_test_SN5659_R2020b_CM_double -1.7E+308 1.7E+308 /end CHARACTERISTIC
/begin CHARACTERISTIC speedgoat_test_SN5659__cal_impl.Decode3_P9_hv "" VALUE 0x008E5CD8 Scalar_FLOAT64_IEEE 0 speedgoat_test_SN5659_R2020b_CM_double -1.7E+308 1.7E+308 /end CHARACTERISTIC
/begin CHARACTERISTIC speedgoat_test_SN5659__cal_impl.Decode3_P9_m "" VALUE 0x008E4910 Scalar_FLOAT64_IEEE 0 speedgoat_test_SN5659_R2020b_CM_double -1.7E+308 1.7E+308 /end CHARACTERISTIC
/begin CHARACTERISTIC speedgoat_test_SN5659__cal_impl.Decode3_P9_o "" VALUE 0x008E3548 Scalar_FLOAT64_IEEE 0 speedgoat_test_SN5659_R2020b_CM_double -1.7E+308 1.7E+308 /end CHARACTERISTIC
/begin CHARACTERISTIC speedgoat_test_SN5659__cal_impl.Decode3_P9_o2 "" VALUE 0x008E4278 Scalar_FLOAT64_IEEE 0 speedgoat_test_SN5659_R2020b_CM_double -1.7E+308 1.7E+308 /end CHARACTERISTIC
/begin CHARACTERISTIC speedgoat_test_SN5659__cal_impl.Decode4_P1 "" VALUE 0x008E2248 Scalar_FLOAT64_IEEE 0 speedgoat_test_SN5659_R2020b_CM_double -1.7E+308 1.7E+308 /end CHARACTERISTIC
/begin CHARACTERISTIC speedgoat_test_SN5659__cal_impl.Decode4_P10 "" VAL_BLK 0x008E2320 Scalar_FLOAT64_IEEE 0 speedgoat_test_SN5659_R2020b_CM_double -1.7E+308 1.7E+308 MATRIX_DIM 2 1 /end CHARACTERISTIC
/begin CHARACTERISTIC speedgoat_test_SN5659__cal_impl.Decode4_P10_a "" VAL_BLK 0x008E5E78 Scalar_FLOAT64_IEEE 0 speedgoat_test_SN5659_R2020b_CM_double -1.7E+308 1.7E+308 MATRIX_DIM 2 1 /end CHARACTERISTIC
/begin CHARACTERISTIC speedgoat_test_SN5659__cal_impl.Decode4_P10_b "" VAL_BLK 0x008E29B8 Scalar_FLOAT64_IEEE 0 speedgoat_test_SN5659_R2020b_CM_double -1.7E+308 1.7E+308 MATRIX_DIM 2 1 /end CHARACTERISTIC
/begin CHARACTERISTIC speedgoat_test_SN5659__cal_impl.Decode4_P10_bm "" VAL_BLK 0x008E4AB0 Scalar_FLOAT64_IEEE 0 speedgoat_test_SN5659_R2020b_CM_double -1.7E+308 1.7E+308 MATRIX_DIM 2 1 /end CHARACTERISTIC
/begin CHARACTERISTIC speedgoat_test_SN5659__cal_impl.Decode4_P10_e "" VAL_BLK 0x008E57E0 Scalar_FLOAT64_IEEE 0 speedgoat_test_SN5659_R2020b_CM_double -1.7E+308 1.7E+308 MATRIX_DIM 2 1 /end CHARACTERISTIC
/begin CHARACTERISTIC speedgoat_test_SN5659__cal_impl.Decode4_P10_f "" VAL_BLK 0x008E4418 Scalar_FLOAT64_IEEE 0 speedgoat_test_SN5659_R2020b_CM_double -1.7E+308 1.7E+308 MATRIX_DIM 2 1 /end CHARACTERISTIC
/begin CHARACTERISTIC speedgoat_test_SN5659__cal_impl.Decode4_P10_g "" VAL_BLK 0x008E36E8 Scalar_FLOAT64_IEEE 0 speedgoat_test_SN5659_R2020b_CM_double -1.7E+308 1.7E+308 MATRIX_DIM 2 1 /end CHARACTERISTIC
/begin CHARACTERISTIC speedgoat_test_SN5659__cal_impl.Decode4_P10_h "" VAL_BLK 0x008E5148 Scalar_FLOAT64_IEEE 0 speedgoat_test_SN5659_R2020b_CM_double -1.7E+308 1.7E+308 MATRIX_DIM 2 1 /end CHARACTERISTIC
/begin CHARACTERISTIC speedgoat_test_SN5659__cal_impl.Decode4_P10_m "" VAL_BLK 0x008E3D80 Scalar_FLOAT64_IEEE 0 speedgoat_test_SN5659_R2020b_CM_double -1.7E+308 1.7E+308 MATRIX_DIM 2 1 /end CHARACTERISTIC
/begin CHARACTERISTIC speedgoat_test_SN5659__cal_impl.Decode4_P11 "" VALUE 0x008E2340 Scalar_FLOAT64_IEEE 0 speedgoat_test_SN5659_R2020b_CM_double -1.7E+308 1.7E+308 /end CHARACTERISTIC
/begin CHARACTERISTIC speedgoat_test_SN5659__cal_impl.Decode4_P11_d "" VALUE 0x008E3DA0 Scalar_FLOAT64_IEEE 0 speedgoat_test_SN5659_R2020b_CM_double -1.7E+308 1.7E+308 /end CHARACTERISTIC
/begin CHARACTERISTIC speedgoat_test_SN5659__cal_impl.Decode4_P11_gt "" VALUE 0x008E5800 Scalar_FLOAT64_IEEE 0 speedgoat_test_SN5659_R2020b_CM_double -1.7E+308 1.7E+308 /end CHARACTERISTIC
/begin CHARACTERISTIC speedgoat_test_SN5659__cal_impl.Decode4_P11_h "" VALUE 0x008E3708 Scalar_FLOAT64_IEEE 0 speedgoat_test_SN5659_R2020b_CM_double -1.7E+308 1.7E+308 /end CHARACTERISTIC
/begin CHARACTERISTIC speedgoat_test_SN5659__cal_impl.Decode4_P11_hn "" VALUE 0x008E5E98 Scalar_FLOAT64_IEEE 0 speedgoat_test_SN5659_R2020b_CM_double -1.7E+308 1.7E+308 /end CHARACTERISTIC
/begin CHARACTERISTIC speedgoat_test_SN5659__cal_impl.Decode4_P11_l "" VALUE 0x008E4AD0 Scalar_FLOAT64_IEEE 0 speedgoat_test_SN5659_R2020b_CM_double -1.7E+308 1.7E+308 /end CHARACTERISTIC
/begin CHARACTERISTIC speedgoat_test_SN5659__cal_impl.Decode4_P11_m "" VALUE 0x008E29D8 Scalar_FLOAT64_IEEE 0 speedgoat_test_SN5659_R2020b_CM_double -1.7E+308 1.7E+308 /end CHARACTERISTIC
/begin CHARACTERISTIC speedgoat_test_SN5659__cal_impl.Decode4_P11_n "" VALUE 0x008E5168 Scalar_FLOAT64_IEEE 0 speedgoat_test_SN5659_R2020b_CM_double -1.7E+308 1.7E+308 /end CHARACTERISTIC
/begin CHARACTERISTIC speedgoat_test_SN5659__cal_impl.Decode4_P11_p "" VALUE 0x008E4438 Scalar_FLOAT64_IEEE 0 speedgoat_test_SN5659_R2020b_CM_double -1.7E+308 1.7E+308 /end CHARACTERISTIC
/begin CHARACTERISTIC speedgoat_test_SN5659__cal_impl.Decode4_P12 "" VALUE 0x008E2358 Scalar_FLOAT64_IEEE 0 speedgoat_test_SN5659_R2020b_CM_double -1.7E+308 1.7E+308 /end CHARACTERISTIC
/begin CHARACTERISTIC speedgoat_test_SN5659__cal_impl.Decode4_P12_c "" VALUE 0x008E5180 Scalar_FLOAT64_IEEE 0 speedgoat_test_SN5659_R2020b_CM_double -1.7E+308 1.7E+308 /end CHARACTERISTIC
/begin CHARACTERISTIC speedgoat_test_SN5659__cal_impl.Decode4_P12_d "" VALUE 0x008E29F0 Scalar_FLOAT64_IEEE 0 speedgoat_test_SN5659_R2020b_CM_double -1.7E+308 1.7E+308 /end CHARACTERISTIC
/begin CHARACTERISTIC speedgoat_test_SN5659__cal_impl.Decode4_P12_f "" VALUE 0x008E3720 Scalar_FLOAT64_IEEE 0 speedgoat_test_SN5659_R2020b_CM_double -1.7E+308 1.7E+308 /end CHARACTERISTIC
/begin CHARACTERISTIC speedgoat_test_SN5659__cal_impl.Decode4_P12_g "" VALUE 0x008E4450 Scalar_FLOAT64_IEEE 0 speedgoat_test_SN5659_R2020b_CM_double -1.7E+308 1.7E+308 /end CHARACTERISTIC
/begin CHARACTERISTIC speedgoat_test_SN5659__cal_impl.Decode4_P12_k "" VALUE 0x008E3DB8 Scalar_FLOAT64_IEEE 0 speedgoat_test_SN5659_R2020b_CM_double -1.7E+308 1.7E+308 /end CHARACTERISTIC
/begin CHARACTERISTIC speedgoat_test_SN5659__cal_impl.Decode4_P12_ko "" VALUE 0x008E5EB0 Scalar_FLOAT64_IEEE 0 speedgoat_test_SN5659_R2020b_CM_double -1.7E+308 1.7E+308 /end CHARACTERISTIC
/begin CHARACTERISTIC speedgoat_test_SN5659__cal_impl.Decode4_P12_n "" VALUE 0x008E5818 Scalar_FLOAT64_IEEE 0 speedgoat_test_SN5659_R2020b_CM_double -1.7E+308 1.7E+308 /end CHARACTERISTIC
/begin CHARACTERISTIC speedgoat_test_SN5659__cal_impl.Decode4_P12_o "" VALUE 0x008E4AE8 Scalar_FLOAT64_IEEE 0 speedgoat_test_SN5659_R2020b_CM_double -1.7E+308 1.7E+308 /end CHARACTERISTIC
/begin CHARACTERISTIC speedgoat_test_SN5659__cal_impl.Decode4_P13 "" VALUE 0x008E2370 Scalar_FLOAT64_IEEE 0 speedgoat_test_SN5659_R2020b_CM_double -1.7E+308 1.7E+308 /end CHARACTERISTIC
/begin CHARACTERISTIC speedgoat_test_SN5659__cal_impl.Decode4_P13_a "" VALUE 0x008E4468 Scalar_FLOAT64_IEEE 0 speedgoat_test_SN5659_R2020b_CM_double -1.7E+308 1.7E+308 /end CHARACTERISTIC
/begin CHARACTERISTIC speedgoat_test_SN5659__cal_impl.Decode4_P13_c "" VALUE 0x008E4B00 Scalar_FLOAT64_IEEE 0 speedgoat_test_SN5659_R2020b_CM_double -1.7E+308 1.7E+308 /end CHARACTERISTIC
/begin CHARACTERISTIC speedgoat_test_SN5659__cal_impl.Decode4_P13_ct "" VALUE 0x008E5198 Scalar_FLOAT64_IEEE 0 speedgoat_test_SN5659_R2020b_CM_double -1.7E+308 1.7E+308 /end CHARACTERISTIC
/begin CHARACTERISTIC speedgoat_test_SN5659__cal_impl.Decode4_P13_f "" VALUE 0x008E3DD0 Scalar_FLOAT64_IEEE 0 speedgoat_test_SN5659_R2020b_CM_double -1.7E+308 1.7E+308 /end CHARACTERISTIC
/begin CHARACTERISTIC speedgoat_test_SN5659__cal_impl.Decode4_P13_g "" VALUE 0x008E3738 Scalar_FLOAT64_IEEE 0 speedgoat_test_SN5659_R2020b_CM_double -1.7E+308 1.7E+308 /end CHARACTERISTIC
/begin CHARACTERISTIC speedgoat_test_SN5659__cal_impl.Decode4_P13_h "" VALUE 0x008E5EC8 Scalar_FLOAT64_IEEE 0 speedgoat_test_SN5659_R2020b_CM_double -1.7E+308 1.7E+308 /end CHARACTERISTIC
/begin CHARACTERISTIC speedgoat_test_SN5659__cal_impl.Decode4_P13_i "" VALUE 0x008E5830 Scalar_FLOAT64_IEEE 0 speedgoat_test_SN5659_R2020b_CM_double -1.7E+308 1.7E+308 /end CHARACTERISTIC
/begin CHARACTERISTIC speedgoat_test_SN5659__cal_impl.Decode4_P13_p "" VALUE 0x008E2A08 Scalar_FLOAT64_IEEE 0 speedgoat_test_SN5659_R2020b_CM_double -1.7E+308 1.7E+308 /end CHARACTERISTIC
/begin CHARACTERISTIC speedgoat_test_SN5659__cal_impl.Decode4_P14 "" VALUE 0x008E2388 Scalar_FLOAT64_IEEE 0 speedgoat_test_SN5659_R2020b_CM_double -1.7E+308 1.7E+308 /end CHARACTERISTIC
/begin CHARACTERISTIC speedgoat_test_SN5659__cal_impl.Decode4_P14_a "" VALUE 0x008E5848 Scalar_FLOAT64_IEEE 0 speedgoat_test_SN5659_R2020b_CM_double -1.7E+308 1.7E+308 /end CHARACTERISTIC
/begin CHARACTERISTIC speedgoat_test_SN5659__cal_impl.Decode4_P14_aq "" VALUE 0x008E5EE0 Scalar_FLOAT64_IEEE 0 speedgoat_test_SN5659_R2020b_CM_double -1.7E+308 1.7E+308 /end CHARACTERISTIC
/begin CHARACTERISTIC speedgoat_test_SN5659__cal_impl.Decode4_P14_d "" VALUE 0x008E3DE8 Scalar_FLOAT64_IEEE 0 speedgoat_test_SN5659_R2020b_CM_double -1.7E+308 1.7E+308 /end CHARACTERISTIC
/begin CHARACTERISTIC speedgoat_test_SN5659__cal_impl.Decode4_P14_f "" VALUE 0x008E3750 Scalar_FLOAT64_IEEE 0 speedgoat_test_SN5659_R2020b_CM_double -1.7E+308 1.7E+308 /end CHARACTERISTIC
/begin CHARACTERISTIC speedgoat_test_SN5659__cal_impl.Decode4_P14_h "" VALUE 0x008E2A20 Scalar_FLOAT64_IEEE 0 speedgoat_test_SN5659_R2020b_CM_double -1.7E+308 1.7E+308 /end CHARACTERISTIC
/begin CHARACTERISTIC speedgoat_test_SN5659__cal_impl.Decode4_P14_j "" VALUE 0x008E51B0 Scalar_FLOAT64_IEEE 0 speedgoat_test_SN5659_R2020b_CM_double -1.7E+308 1.7E+308 /end CHARACTERISTIC
/begin CHARACTERISTIC speedgoat_test_SN5659__cal_impl.Decode4_P14_l "" VALUE 0x008E4B18 Scalar_FLOAT64_IEEE 0 speedgoat_test_SN5659_R2020b_CM_double -1.7E+308 1.7E+308 /end CHARACTERISTIC
/begin CHARACTERISTIC speedgoat_test_SN5659__cal_impl.Decode4_P14_n "" VALUE 0x008E4480 Scalar_FLOAT64_IEEE 0 speedgoat_test_SN5659_R2020b_CM_double -1.7E+308 1.7E+308 /end CHARACTERISTIC
/begin CHARACTERISTIC speedgoat_test_SN5659__cal_impl.Decode4_P15 "" VALUE 0x008E23A0 Scalar_FLOAT64_IEEE 0 speedgoat_test_SN5659_R2020b_CM_double -1.7E+308 1.7E+308 /end CHARACTERISTIC
/begin CHARACTERISTIC speedgoat_test_SN5659__cal_impl.Decode4_P15_a "" VALUE 0x008E3768 Scalar_FLOAT64_IEEE 0 speedgoat_test_SN5659_R2020b_CM_double -1.7E+308 1.7E+308 /end CHARACTERISTIC
/begin CHARACTERISTIC speedgoat_test_SN5659__cal_impl.Decode4_P15_c "" VALUE 0x008E2A38 Scalar_FLOAT64_IEEE 0 speedgoat_test_SN5659_R2020b_CM_double -1.7E+308 1.7E+308 /end CHARACTERISTIC
/begin CHARACTERISTIC speedgoat_test_SN5659__cal_impl.Decode4_P15_d "" VALUE 0x008E4498 Scalar_FLOAT64_IEEE 0 speedgoat_test_SN5659_R2020b_CM_double -1.7E+308 1.7E+308 /end CHARACTERISTIC
/begin CHARACTERISTIC speedgoat_test_SN5659__cal_impl.Decode4_P15_dw "" VALUE 0x008E51C8 Scalar_FLOAT64_IEEE 0 speedgoat_test_SN5659_R2020b_CM_double -1.7E+308 1.7E+308 /end CHARACTERISTIC
/begin CHARACTERISTIC speedgoat_test_SN5659__cal_impl.Decode4_P15_f "" VALUE 0x008E3E00 Scalar_FLOAT64_IEEE 0 speedgoat_test_SN5659_R2020b_CM_double -1.7E+308 1.7E+308 /end CHARACTERISTIC
/begin CHARACTERISTIC speedgoat_test_SN5659__cal_impl.Decode4_P15_ft "" VALUE 0x008E5EF8 Scalar_FLOAT64_IEEE 0 speedgoat_test_SN5659_R2020b_CM_double -1.7E+308 1.7E+308 /end CHARACTERISTIC
/begin CHARACTERISTIC speedgoat_test_SN5659__cal_impl.Decode4_P15_i "" VALUE 0x008E4B30 Scalar_FLOAT64_IEEE 0 speedgoat_test_SN5659_R2020b_CM_double -1.7E+308 1.7E+308 /end CHARACTERISTIC
/begin CHARACTERISTIC speedgoat_test_SN5659__cal_impl.Decode4_P15_i0 "" VALUE 0x008E5860 Scalar_FLOAT64_IEEE 0 speedgoat_test_SN5659_R2020b_CM_double -1.7E+308 1.7E+308 /end CHARACTERISTIC
/begin CHARACTERISTIC speedgoat_test_SN5659__cal_impl.Decode4_P16 "" VALUE 0x008E23B8 Scalar_FLOAT64_IEEE 0 speedgoat_test_SN5659_R2020b_CM_double -1.7E+308 1.7E+308 /end CHARACTERISTIC
/begin CHARACTERISTIC speedgoat_test_SN5659__cal_impl.Decode4_P16_a "" VALUE 0x008E5F10 Scalar_FLOAT64_IEEE 0 speedgoat_test_SN5659_R2020b_CM_double -1.7E+308 1.7E+308 /end CHARACTERISTIC
/begin CHARACTERISTIC speedgoat_test_SN5659__cal_impl.Decode4_P16_c "" VALUE 0x008E4B48 Scalar_FLOAT64_IEEE 0 speedgoat_test_SN5659_R2020b_CM_double -1.7E+308 1.7E+308 /end CHARACTERISTIC
/begin CHARACTERISTIC speedgoat_test_SN5659__cal_impl.Decode4_P16_d "" VALUE 0x008E44B0 Scalar_FLOAT64_IEEE 0 speedgoat_test_SN5659_R2020b_CM_double -1.7E+308 1.7E+308 /end CHARACTERISTIC
/begin CHARACTERISTIC speedgoat_test_SN5659__cal_impl.Decode4_P16_e "" VALUE 0x008E3E18 Scalar_FLOAT64_IEEE 0 speedgoat_test_SN5659_R2020b_CM_double -1.7E+308 1.7E+308 /end CHARACTERISTIC
/begin CHARACTERISTIC speedgoat_test_SN5659__cal_impl.Decode4_P16_g "" VALUE 0x008E2A50 Scalar_FLOAT64_IEEE 0 speedgoat_test_SN5659_R2020b_CM_double -1.7E+308 1.7E+308 /end CHARACTERISTIC
/begin CHARACTERISTIC speedgoat_test_SN5659__cal_impl.Decode4_P16_l "" VALUE 0x008E5878 Scalar_FLOAT64_IEEE 0 speedgoat_test_SN5659_R2020b_CM_double -1.7E+308 1.7E+308 /end CHARACTERISTIC
/begin CHARACTERISTIC speedgoat_test_SN5659__cal_impl.Decode4_P16_o "" VALUE 0x008E51E0 Scalar_FLOAT64_IEEE 0 speedgoat_test_SN5659_R2020b_CM_double -1.7E+308 1.7E+308 /end CHARACTERISTIC
/begin CHARACTERISTIC speedgoat_test_SN5659__cal_impl.Decode4_P16_p "" VALUE 0x008E3780 Scalar_FLOAT64_IEEE 0 speedgoat_test_SN5659_R2020b_CM_double -1.7E+308 1.7E+308 /end CHARACTERISTIC
/begin CHARACTERISTIC speedgoat_test_SN5659__cal_impl.Decode4_P1_a "" VALUE 0x008E5070 Scalar_FLOAT64_IEEE 0 speedgoat_test_SN5659_R2020b_CM_double -1.7E+308 1.7E+308 /end CHARACTERISTIC
/begin CHARACTERISTIC speedgoat_test_SN5659__cal_impl.Decode4_P1_c "" VALUE 0x008E3CA8 Scalar_FLOAT64_IEEE 0 speedgoat_test_SN5659_R2020b_CM_double -1.7E+308 1.7E+308 /end CHARACTERISTIC
/begin CHARACTERISTIC speedgoat_test_SN5659__cal_impl.Decode4_P1_g "" VALUE 0x008E28E0 Scalar_FLOAT64_IEEE 0 speedgoat_test_SN5659_R2020b_CM_double -1.7E+308 1.7E+308 /end CHARACTERISTIC
/begin CHARACTERISTIC speedgoat_test_SN5659__cal_impl.Decode4_P1_k "" VALUE 0x008E4340 Scalar_FLOAT64_IEEE 0 speedgoat_test_SN5659_R2020b_CM_double -1.7E+308 1.7E+308 /end CHARACTERISTIC
/begin CHARACTERISTIC speedgoat_test_SN5659__cal_impl.Decode4_P1_kt "" VALUE 0x008E5708 Scalar_FLOAT64_IEEE 0 speedgoat_test_SN5659_R2020b_CM_double -1.7E+308 1.7E+308 /end CHARACTERISTIC
/begin CHARACTERISTIC speedgoat_test_SN5659__cal_impl.Decode4_P1_n "" VALUE 0x008E5DA0 Scalar_FLOAT64_IEEE 0 speedgoat_test_SN5659_R2020b_CM_double -1.7E+308 1.7E+308 /end CHARACTERISTIC
/begin CHARACTERISTIC speedgoat_test_SN5659__cal_impl.Decode4_P1_p "" VALUE 0x008E3610 Scalar_FLOAT64_IEEE 0 speedgoat_test_SN5659_R2020b_CM_double -1.7E+308 1.7E+308 /end CHARACTERISTIC
/begin CHARACTERISTIC speedgoat_test_SN5659__cal_impl.Decode4_P1_pt "" VALUE 0x008E49D8 Scalar_FLOAT64_IEEE 0 speedgoat_test_SN5659_R2020b_CM_double -1.7E+308 1.7E+308 /end CHARACTERISTIC
/begin CHARACTERISTIC speedgoat_test_SN5659__cal_impl.Decode4_P2 "" VALUE 0x008E2260 Scalar_FLOAT64_IEEE 0 speedgoat_test_SN5659_R2020b_CM_double -1.7E+308 1.7E+308 /end CHARACTERISTIC
/begin CHARACTERISTIC speedgoat_test_SN5659__cal_impl.Decode4_P2_c "" VALUE 0x008E49F0 Scalar_FLOAT64_IEEE 0 speedgoat_test_SN5659_R2020b_CM_double -1.7E+308 1.7E+308 /end CHARACTERISTIC
/begin CHARACTERISTIC speedgoat_test_SN5659__cal_impl.Decode4_P2_j "" VALUE 0x008E3628 Scalar_FLOAT64_IEEE 0 speedgoat_test_SN5659_R2020b_CM_double -1.7E+308 1.7E+308 /end CHARACTERISTIC
/begin CHARACTERISTIC speedgoat_test_SN5659__cal_impl.Decode4_P2_l "" VALUE 0x008E3CC0 Scalar_FLOAT64_IEEE 0 speedgoat_test_SN5659_R2020b_CM_double -1.7E+308 1.7E+308 /end CHARACTERISTIC
/begin CHARACTERISTIC speedgoat_test_SN5659__cal_impl.Decode4_P2_lo "" VALUE 0x008E5720 Scalar_FLOAT64_IEEE 0 speedgoat_test_SN5659_R2020b_CM_double -1.7E+308 1.7E+308 /end CHARACTERISTIC
/begin CHARACTERISTIC speedgoat_test_SN5659__cal_impl.Decode4_P2_m "" VALUE 0x008E5088 Scalar_FLOAT64_IEEE 0 speedgoat_test_SN5659_R2020b_CM_double -1.7E+308 1.7E+308 /end CHARACTERISTIC
/begin CHARACTERISTIC speedgoat_test_SN5659__cal_impl.Decode4_P2_n "" VALUE 0x008E5DB8 Scalar_FLOAT64_IEEE 0 speedgoat_test_SN5659_R2020b_CM_double -1.7E+308 1.7E+308 /end CHARACTERISTIC
/begin CHARACTERISTIC speedgoat_test_SN5659__cal_impl.Decode4_P2_p "" VALUE 0x008E28F8 Scalar_FLOAT64_IEEE 0 speedgoat_test_SN5659_R2020b_CM_double -1.7E+308 1.7E+308 /end CHARACTERISTIC
/begin CHARACTERISTIC speedgoat_test_SN5659__cal_impl.Decode4_P2_p0 "" VALUE 0x008E4358 Scalar_FLOAT64_IEEE 0 speedgoat_test_SN5659_R2020b_CM_double -1.7E+308 1.7E+308 /end CHARACTERISTIC
/begin CHARACTERISTIC speedgoat_test_SN5659__cal_impl.Decode4_P3 "" VALUE 0x008E2278 Scalar_FLOAT64_IEEE 0 speedgoat_test_SN5659_R2020b_CM_double -1.7E+308 1.7E+308 /end CHARACTERISTIC
/begin CHARACTERISTIC speedgoat_test_SN5659__cal_impl.Decode4_P3_b "" VALUE 0x008E5738 Scalar_FLOAT64_IEEE 0 speedgoat_test_SN5659_R2020b_CM_double -1.7E+308 1.7E+308 /end CHARACTERISTIC
/begin CHARACTERISTIC speedgoat_test_SN5659__cal_impl.Decode4_P3_c "" VALUE 0x008E2910 Scalar_FLOAT64_IEEE 0 speedgoat_test_SN5659_R2020b_CM_double -1.7E+308 1.7E+308 /end CHARACTERISTIC
/begin CHARACTERISTIC speedgoat_test_SN5659__cal_impl.Decode4_P3_cw "" VALUE 0x008E4370 Scalar_FLOAT64_IEEE 0 speedgoat_test_SN5659_R2020b_CM_double -1.7E+308 1.7E+308 /end CHARACTERISTIC
/begin CHARACTERISTIC speedgoat_test_SN5659__cal_impl.Decode4_P3_e "" VALUE 0x008E3CD8 Scalar_FLOAT64_IEEE 0 speedgoat_test_SN5659_R2020b_CM_double -1.7E+308 1.7E+308 /end CHARACTERISTIC
/begin CHARACTERISTIC speedgoat_test_SN5659__cal_impl.Decode4_P3_j "" VALUE 0x008E5DD0 Scalar_FLOAT64_IEEE 0 speedgoat_test_SN5659_R2020b_CM_double -1.7E+308 1.7E+308 /end CHARACTERISTIC
/begin CHARACTERISTIC speedgoat_test_SN5659__cal_impl.Decode4_P3_m "" VALUE 0x008E4A08 Scalar_FLOAT64_IEEE 0 speedgoat_test_SN5659_R2020b_CM_double -1.7E+308 1.7E+308 /end CHARACTERISTIC
/begin CHARACTERISTIC speedgoat_test_SN5659__cal_impl.Decode4_P3_mr "" VALUE 0x008E50A0 Scalar_FLOAT64_IEEE 0 speedgoat_test_SN5659_R2020b_CM_double -1.7E+308 1.7E+308 /end CHARACTERISTIC
/begin CHARACTERISTIC speedgoat_test_SN5659__cal_impl.Decode4_P3_p "" VALUE 0x008E3640 Scalar_FLOAT64_IEEE 0 speedgoat_test_SN5659_R2020b_CM_double -1.7E+308 1.7E+308 /end CHARACTERISTIC
/begin CHARACTERISTIC speedgoat_test_SN5659__cal_impl.Decode4_P4 "" VALUE 0x008E2290 Scalar_FLOAT64_IEEE 0 speedgoat_test_SN5659_R2020b_CM_double -1.7E+308 1.7E+308 /end CHARACTERISTIC
/begin CHARACTERISTIC speedgoat_test_SN5659__cal_impl.Decode4_P4_e "" VALUE 0x008E2928 Scalar_FLOAT64_IEEE 0 speedgoat_test_SN5659_R2020b_CM_double -1.7E+308 1.7E+308 /end CHARACTERISTIC
/begin CHARACTERISTIC speedgoat_test_SN5659__cal_impl.Decode4_P4_f "" VALUE 0x008E50B8 Scalar_FLOAT64_IEEE 0 speedgoat_test_SN5659_R2020b_CM_double -1.7E+308 1.7E+308 /end CHARACTERISTIC
/begin CHARACTERISTIC speedgoat_test_SN5659__cal_impl.Decode4_P4_h "" VALUE 0x008E4A20 Scalar_FLOAT64_IEEE 0 speedgoat_test_SN5659_R2020b_CM_double -1.7E+308 1.7E+308 /end CHARACTERISTIC
/begin CHARACTERISTIC speedgoat_test_SN5659__cal_impl.Decode4_P4_hj "" VALUE 0x008E5DE8 Scalar_FLOAT64_IEEE 0 speedgoat_test_SN5659_R2020b_CM_double -1.7E+308 1.7E+308 /end CHARACTERISTIC
/begin CHARACTERISTIC speedgoat_test_SN5659__cal_impl.Decode4_P4_hz "" VALUE 0x008E5750 Scalar_FLOAT64_IEEE 0 speedgoat_test_SN5659_R2020b_CM_double -1.7E+308 1.7E+308 /end CHARACTERISTIC
/begin CHARACTERISTIC speedgoat_test_SN5659__cal_impl.Decode4_P4_i "" VALUE 0x008E3CF0 Scalar_FLOAT64_IEEE 0 speedgoat_test_SN5659_R2020b_CM_double -1.7E+308 1.7E+308 /end CHARACTERISTIC
/begin CHARACTERISTIC speedgoat_test_SN5659__cal_impl.Decode4_P4_l "" VALUE 0x008E3658 Scalar_FLOAT64_IEEE 0 speedgoat_test_SN5659_R2020b_CM_double -1.7E+308 1.7E+308 /end CHARACTERISTIC
/begin CHARACTERISTIC speedgoat_test_SN5659__cal_impl.Decode4_P4_p "" VALUE 0x008E4388 Scalar_FLOAT64_IEEE 0 speedgoat_test_SN5659_R2020b_CM_double -1.7E+308 1.7E+308 /end CHARACTERISTIC
/begin CHARACTERISTIC speedgoat_test_SN5659__cal_impl.Decode4_P5 "" VALUE 0x008E22A8 Scalar_FLOAT64_IEEE 0 speedgoat_test_SN5659_R2020b_CM_double -1.7E+308 1.7E+308 /end CHARACTERISTIC
/begin CHARACTERISTIC speedgoat_test_SN5659__cal_impl.Decode4_P5_a "" VALUE 0x008E43A0 Scalar_FLOAT64_IEEE 0 speedgoat_test_SN5659_R2020b_CM_double -1.7E+308 1.7E+308 /end CHARACTERISTIC
/begin CHARACTERISTIC speedgoat_test_SN5659__cal_impl.Decode4_P5_c "" VALUE 0x008E3670 Scalar_FLOAT64_IEEE 0 speedgoat_test_SN5659_R2020b_CM_double -1.7E+308 1.7E+308 /end CHARACTERISTIC
/begin CHARACTERISTIC speedgoat_test_SN5659__cal_impl.Decode4_P5_cn "" VALUE 0x008E50D0 Scalar_FLOAT64_IEEE 0 speedgoat_test_SN5659_R2020b_CM_double -1.7E+308 1.7E+308 /end CHARACTERISTIC
/begin CHARACTERISTIC speedgoat_test_SN5659__cal_impl.Decode4_P5_cq "" VALUE 0x008E4A38 Scalar_FLOAT64_IEEE 0 speedgoat_test_SN5659_R2020b_CM_double -1.7E+308 1.7E+308 /end CHARACTERISTIC
/begin CHARACTERISTIC speedgoat_test_SN5659__cal_impl.Decode4_P5_e "" VALUE 0x008E3D08 Scalar_FLOAT64_IEEE 0 speedgoat_test_SN5659_R2020b_CM_double -1.7E+308 1.7E+308 /end CHARACTERISTIC
/begin CHARACTERISTIC speedgoat_test_SN5659__cal_impl.Decode4_P5_k "" VALUE 0x008E5E00 Scalar_FLOAT64_IEEE 0 speedgoat_test_SN5659_R2020b_CM_double -1.7E+308 1.7E+308 /end CHARACTERISTIC
/begin CHARACTERISTIC speedgoat_test_SN5659__cal_impl.Decode4_P5_l "" VALUE 0x008E5768 Scalar_FLOAT64_IEEE 0 speedgoat_test_SN5659_R2020b_CM_double -1.7E+308 1.7E+308 /end CHARACTERISTIC
/begin CHARACTERISTIC speedgoat_test_SN5659__cal_impl.Decode4_P5_p "" VALUE 0x008E2940 Scalar_FLOAT64_IEEE 0 speedgoat_test_SN5659_R2020b_CM_double -1.7E+308 1.7E+308 /end CHARACTERISTIC
/begin CHARACTERISTIC speedgoat_test_SN5659__cal_impl.Decode4_P6 "" VALUE 0x008E22C0 Scalar_FLOAT64_IEEE 0 speedgoat_test_SN5659_R2020b_CM_double -1.7E+308 1.7E+308 /end CHARACTERISTIC
/begin CHARACTERISTIC speedgoat_test_SN5659__cal_impl.Decode4_P6_a "" VALUE 0x008E43B8 Scalar_FLOAT64_IEEE 0 speedgoat_test_SN5659_R2020b_CM_double -1.7E+308 1.7E+308 /end CHARACTERISTIC
/begin CHARACTERISTIC speedgoat_test_SN5659__cal_impl.Decode4_P6_aj "" VALUE 0x008E5E18 Scalar_FLOAT64_IEEE 0 speedgoat_test_SN5659_R2020b_CM_double -1.7E+308 1.7E+308 /end CHARACTERISTIC
/begin CHARACTERISTIC speedgoat_test_SN5659__cal_impl.Decode4_P6_aw "" VALUE 0x008E50E8 Scalar_FLOAT64_IEEE 0 speedgoat_test_SN5659_R2020b_CM_double -1.7E+308 1.7E+308 /end CHARACTERISTIC
/begin CHARACTERISTIC speedgoat_test_SN5659__cal_impl.Decode4_P6_c "" VALUE 0x008E3688 Scalar_FLOAT64_IEEE 0 speedgoat_test_SN5659_R2020b_CM_double -1.7E+308 1.7E+308 /end CHARACTERISTIC
/begin CHARACTERISTIC speedgoat_test_SN5659__cal_impl.Decode4_P6_e "" VALUE 0x008E4A50 Scalar_FLOAT64_IEEE 0 speedgoat_test_SN5659_R2020b_CM_double -1.7E+308 1.7E+308 /end CHARACTERISTIC
/begin CHARACTERISTIC speedgoat_test_SN5659__cal_impl.Decode4_P6_f "" VALUE 0x008E5780 Scalar_FLOAT64_IEEE 0 speedgoat_test_SN5659_R2020b_CM_double -1.7E+308 1.7E+308 /end CHARACTERISTIC
/begin CHARACTERISTIC speedgoat_test_SN5659__cal_impl.Decode4_P6_h "" VALUE 0x008E2958 Scalar_FLOAT64_IEEE 0 speedgoat_test_SN5659_R2020b_CM_double -1.7E+308 1.7E+308 /end CHARACTERISTIC
/begin CHARACTERISTIC speedgoat_test_SN5659__cal_impl.Decode4_P6_p "" VALUE 0x008E3D20 Scalar_FLOAT64_IEEE 0 speedgoat_test_SN5659_R2020b_CM_double -1.7E+308 1.7E+308 /end CHARACTERISTIC
/begin CHARACTERISTIC speedgoat_test_SN5659__cal_impl.Decode4_P7 "" VALUE 0x008E22D8 Scalar_FLOAT64_IEEE 0 speedgoat_test_SN5659_R2020b_CM_double -1.7E+308 1.7E+308 /end CHARACTERISTIC
/begin CHARACTERISTIC speedgoat_test_SN5659__cal_impl.Decode4_P7_b "" VALUE 0x008E5100 Scalar_FLOAT64_IEEE 0 speedgoat_test_SN5659_R2020b_CM_double -1.7E+308 1.7E+308 /end CHARACTERISTIC
/begin CHARACTERISTIC speedgoat_test_SN5659__cal_impl.Decode4_P7_d "" VALUE 0x008E4A68 Scalar_FLOAT64_IEEE 0 speedgoat_test_SN5659_R2020b_CM_double -1.7E+308 1.7E+308 /end CHARACTERISTIC
/begin CHARACTERISTIC speedgoat_test_SN5659__cal_impl.Decode4_P7_f "" VALUE 0x008E2970 Scalar_FLOAT64_IEEE 0 speedgoat_test_SN5659_R2020b_CM_double -1.7E+308 1.7E+308 /end CHARACTERISTIC
/begin CHARACTERISTIC speedgoat_test_SN5659__cal_impl.Decode4_P7_fb "" VALUE 0x008E5798 Scalar_FLOAT64_IEEE 0 speedgoat_test_SN5659_R2020b_CM_double -1.7E+308 1.7E+308 /end CHARACTERISTIC
/begin CHARACTERISTIC speedgoat_test_SN5659__cal_impl.Decode4_P7_g "" VALUE 0x008E43D0 Scalar_FLOAT64_IEEE 0 speedgoat_test_SN5659_R2020b_CM_double -1.7E+308 1.7E+308 /end CHARACTERISTIC
/begin CHARACTERISTIC speedgoat_test_SN5659__cal_impl.Decode4_P7_h "" VALUE 0x008E5E30 Scalar_FLOAT64_IEEE 0 speedgoat_test_SN5659_R2020b_CM_double -1.7E+308 1.7E+308 /end CHARACTERISTIC
/begin CHARACTERISTIC speedgoat_test_SN5659__cal_impl.Decode4_P7_nt "" VALUE 0x008E36A0 Scalar_FLOAT64_IEEE 0 speedgoat_test_SN5659_R2020b_CM_double -1.7E+308 1.7E+308 /end CHARACTERISTIC
/begin CHARACTERISTIC speedgoat_test_SN5659__cal_impl.Decode4_P7_o "" VALUE 0x008E3D38 Scalar_FLOAT64_IEEE 0 speedgoat_test_SN5659_R2020b_CM_double -1.7E+308 1.7E+308 /end CHARACTERISTIC
/begin CHARACTERISTIC speedgoat_test_SN5659__cal_impl.Decode4_P8 "" VALUE 0x008E22F0 Scalar_FLOAT64_IEEE 0 speedgoat_test_SN5659_R2020b_CM_double -1.7E+308 1.7E+308 /end CHARACTERISTIC
/begin CHARACTERISTIC speedgoat_test_SN5659__cal_impl.Decode4_P8_b "" VALUE 0x008E2988 Scalar_FLOAT64_IEEE 0 speedgoat_test_SN5659_R2020b_CM_double -1.7E+308 1.7E+308 /end CHARACTERISTIC
/begin CHARACTERISTIC speedgoat_test_SN5659__cal_impl.Decode4_P8_d "" VALUE 0x008E57B0 Scalar_FLOAT64_IEEE 0 speedgoat_test_SN5659_R2020b_CM_double -1.7E+308 1.7E+308 /end CHARACTERISTIC
/begin CHARACTERISTIC speedgoat_test_SN5659__cal_impl.Decode4_P8_e "" VALUE 0x008E3D50 Scalar_FLOAT64_IEEE 0 speedgoat_test_SN5659_R2020b_CM_double -1.7E+308 1.7E+308 /end CHARACTERISTIC
/begin CHARACTERISTIC speedgoat_test_SN5659__cal_impl.Decode4_P8_gh "" VALUE 0x008E4A80 Scalar_FLOAT64_IEEE 0 speedgoat_test_SN5659_R2020b_CM_double -1.7E+308 1.7E+308 /end CHARACTERISTIC
/begin CHARACTERISTIC speedgoat_test_SN5659__cal_impl.Decode4_P8_i "" VALUE 0x008E43E8 Scalar_FLOAT64_IEEE 0 speedgoat_test_SN5659_R2020b_CM_double -1.7E+308 1.7E+308 /end CHARACTERISTIC
/begin CHARACTERISTIC speedgoat_test_SN5659__cal_impl.Decode4_P8_iy "" VALUE 0x008E5E48 Scalar_FLOAT64_IEEE 0 speedgoat_test_SN5659_R2020b_CM_double -1.7E+308 1.7E+308 /end CHARACTERISTIC
/begin CHARACTERISTIC speedgoat_test_SN5659__cal_impl.Decode4_P8_j "" VALUE 0x008E36B8 Scalar_FLOAT64_IEEE 0 speedgoat_test_SN5659_R2020b_CM_double -1.7E+308 1.7E+308 /end CHARACTERISTIC
/begin CHARACTERISTIC speedgoat_test_SN5659__cal_impl.Decode4_P8_m "" VALUE 0x008E5118 Scalar_FLOAT64_IEEE 0 speedgoat_test_SN5659_R2020b_CM_double -1.7E+308 1.7E+308 /end CHARACTERISTIC
/begin CHARACTERISTIC speedgoat_test_SN5659__cal_impl.Decode4_P9 "" VALUE 0x008E2308 Scalar_FLOAT64_IEEE 0 speedgoat_test_SN5659_R2020b_CM_double -1.7E+308 1.7E+308 /end CHARACTERISTIC
/begin CHARACTERISTIC speedgoat_test_SN5659__cal_impl.Decode4_P9_a "" VALUE 0x008E29A0 Scalar_FLOAT64_IEEE 0 speedgoat_test_SN5659_R2020b_CM_double -1.7E+308 1.7E+308 /end CHARACTERISTIC
/begin CHARACTERISTIC speedgoat_test_SN5659__cal_impl.Decode4_P9_ay "" VALUE 0x008E3D68 Scalar_FLOAT64_IEEE 0 speedgoat_test_SN5659_R2020b_CM_double -1.7E+308 1.7E+308 /end CHARACTERISTIC
/begin CHARACTERISTIC speedgoat_test_SN5659__cal_impl.Decode4_P9_b "" VALUE 0x008E36D0 Scalar_FLOAT64_IEEE 0 speedgoat_test_SN5659_R2020b_CM_double -1.7E+308 1.7E+308 /end CHARACTERISTIC
/begin CHARACTERISTIC speedgoat_test_SN5659__cal_impl.Decode4_P9_bz "" VALUE 0x008E5E60 Scalar_FLOAT64_IEEE 0 speedgoat_test_SN5659_R2020b_CM_double -1.7E+308 1.7E+308 /end CHARACTERISTIC
/begin CHARACTERISTIC speedgoat_test_SN5659__cal_impl.Decode4_P9_d "" VALUE 0x008E4400 Scalar_FLOAT64_IEEE 0 speedgoat_test_SN5659_R2020b_CM_double -1.7E+308 1.7E+308 /end CHARACTERISTIC
/begin CHARACTERISTIC speedgoat_test_SN5659__cal_impl.Decode4_P9_l "" VALUE 0x008E57C8 Scalar_FLOAT64_IEEE 0 speedgoat_test_SN5659_R2020b_CM_double -1.7E+308 1.7E+308 /end CHARACTERISTIC
/begin CHARACTERISTIC speedgoat_test_SN5659__cal_impl.Decode4_P9_n "" VALUE 0x008E4A98 Scalar_FLOAT64_IEEE 0 speedgoat_test_SN5659_R2020b_CM_double -1.7E+308 1.7E+308 /end CHARACTERISTIC
/begin CHARACTERISTIC speedgoat_test_SN5659__cal_impl.Decode4_P9_o "" VALUE 0x008E5130 Scalar_FLOAT64_IEEE 0 speedgoat_test_SN5659_R2020b_CM_double -1.7E+308 1.7E+308 /end CHARACTERISTIC
/begin CHARACTERISTIC speedgoat_test_SN5659__cal_impl.Decode5_P1 "" VALUE 0x008E1F38 Scalar_FLOAT64_IEEE 0 speedgoat_test_SN5659_R2020b_CM_double -1.7E+308 1.7E+308 /end CHARACTERISTIC
/begin CHARACTERISTIC speedgoat_test_SN5659__cal_impl.Decode5_P10 "" VAL_BLK 0x008E2010 Scalar_FLOAT64_IEEE 0 speedgoat_test_SN5659_R2020b_CM_double -1.7E+308 1.7E+308 MATRIX_DIM 2 1 /end CHARACTERISTIC
/begin CHARACTERISTIC speedgoat_test_SN5659__cal_impl.Decode5_P10_k "" VAL_BLK 0x008E47A0 Scalar_FLOAT64_IEEE 0 speedgoat_test_SN5659_R2020b_CM_double -1.7E+308 1.7E+308 MATRIX_DIM 2 1 /end CHARACTERISTIC
/begin CHARACTERISTIC speedgoat_test_SN5659__cal_impl.Decode5_P11 "" VALUE 0x008E2030 Scalar_FLOAT64_IEEE 0 speedgoat_test_SN5659_R2020b_CM_double -1.7E+308 1.7E+308 /end CHARACTERISTIC
/begin CHARACTERISTIC speedgoat_test_SN5659__cal_impl.Decode5_P11_c "" VALUE 0x008E47C0 Scalar_FLOAT64_IEEE 0 speedgoat_test_SN5659_R2020b_CM_double -1.7E+308 1.7E+308 /end CHARACTERISTIC
/begin CHARACTERISTIC speedgoat_test_SN5659__cal_impl.Decode5_P12 "" VALUE 0x008E2048 Scalar_FLOAT64_IEEE 0 speedgoat_test_SN5659_R2020b_CM_double -1.7E+308 1.7E+308 /end CHARACTERISTIC
/begin CHARACTERISTIC speedgoat_test_SN5659__cal_impl.Decode5_P12_e "" VALUE 0x008E47D8 Scalar_FLOAT64_IEEE 0 speedgoat_test_SN5659_R2020b_CM_double -1.7E+308 1.7E+308 /end CHARACTERISTIC
/begin CHARACTERISTIC speedgoat_test_SN5659__cal_impl.Decode5_P13 "" VALUE 0x008E2060 Scalar_FLOAT64_IEEE 0 speedgoat_test_SN5659_R2020b_CM_double -1.7E+308 1.7E+308 /end CHARACTERISTIC
/begin CHARACTERISTIC speedgoat_test_SN5659__cal_impl.Decode5_P13_o "" VALUE 0x008E47F0 Scalar_FLOAT64_IEEE 0 speedgoat_test_SN5659_R2020b_CM_double -1.7E+308 1.7E+308 /end CHARACTERISTIC
/begin CHARACTERISTIC speedgoat_test_SN5659__cal_impl.Decode5_P14 "" VALUE 0x008E2078 Scalar_FLOAT64_IEEE 0 speedgoat_test_SN5659_R2020b_CM_double -1.7E+308 1.7E+308 /end CHARACTERISTIC
/begin CHARACTERISTIC speedgoat_test_SN5659__cal_impl.Decode5_P14_g "" VALUE 0x008E4808 Scalar_FLOAT64_IEEE 0 speedgoat_test_SN5659_R2020b_CM_double -1.7E+308 1.7E+308 /end CHARACTERISTIC
/begin CHARACTERISTIC speedgoat_test_SN5659__cal_impl.Decode5_P15 "" VALUE 0x008E2090 Scalar_FLOAT64_IEEE 0 speedgoat_test_SN5659_R2020b_CM_double -1.7E+308 1.7E+308 /end CHARACTERISTIC
/begin CHARACTERISTIC speedgoat_test_SN5659__cal_impl.Decode5_P15_o "" VALUE 0x008E4820 Scalar_FLOAT64_IEEE 0 speedgoat_test_SN5659_R2020b_CM_double -1.7E+308 1.7E+308 /end CHARACTERISTIC
/begin CHARACTERISTIC speedgoat_test_SN5659__cal_impl.Decode5_P16 "" VALUE 0x008E20A8 Scalar_FLOAT64_IEEE 0 speedgoat_test_SN5659_R2020b_CM_double -1.7E+308 1.7E+308 /end CHARACTERISTIC
/begin CHARACTERISTIC speedgoat_test_SN5659__cal_impl.Decode5_P16_m "" VALUE 0x008E4838 Scalar_FLOAT64_IEEE 0 speedgoat_test_SN5659_R2020b_CM_double -1.7E+308 1.7E+308 /end CHARACTERISTIC
/begin CHARACTERISTIC speedgoat_test_SN5659__cal_impl.Decode5_P1_m "" VALUE 0x008E46C8 Scalar_FLOAT64_IEEE 0 speedgoat_test_SN5659_R2020b_CM_double -1.7E+308 1.7E+308 /end CHARACTERISTIC
/begin CHARACTERISTIC speedgoat_test_SN5659__cal_impl.Decode5_P2 "" VALUE 0x008E1F50 Scalar_FLOAT64_IEEE 0 speedgoat_test_SN5659_R2020b_CM_double -1.7E+308 1.7E+308 /end CHARACTERISTIC
/begin CHARACTERISTIC speedgoat_test_SN5659__cal_impl.Decode5_P2_f "" VALUE 0x008E46E0 Scalar_FLOAT64_IEEE 0 speedgoat_test_SN5659_R2020b_CM_double -1.7E+308 1.7E+308 /end CHARACTERISTIC
/begin CHARACTERISTIC speedgoat_test_SN5659__cal_impl.Decode5_P3 "" VALUE 0x008E1F68 Scalar_FLOAT64_IEEE 0 speedgoat_test_SN5659_R2020b_CM_double -1.7E+308 1.7E+308 /end CHARACTERISTIC
/begin CHARACTERISTIC speedgoat_test_SN5659__cal_impl.Decode5_P3_d "" VALUE 0x008E46F8 Scalar_FLOAT64_IEEE 0 speedgoat_test_SN5659_R2020b_CM_double -1.7E+308 1.7E+308 /end CHARACTERISTIC
/begin CHARACTERISTIC speedgoat_test_SN5659__cal_impl.Decode5_P4 "" VALUE 0x008E1F80 Scalar_FLOAT64_IEEE 0 speedgoat_test_SN5659_R2020b_CM_double -1.7E+308 1.7E+308 /end CHARACTERISTIC
/begin CHARACTERISTIC speedgoat_test_SN5659__cal_impl.Decode5_P4_j "" VALUE 0x008E4710 Scalar_FLOAT64_IEEE 0 speedgoat_test_SN5659_R2020b_CM_double -1.7E+308 1.7E+308 /end CHARACTERISTIC
/begin CHARACTERISTIC speedgoat_test_SN5659__cal_impl.Decode5_P5 "" VALUE 0x008E1F98 Scalar_FLOAT64_IEEE 0 speedgoat_test_SN5659_R2020b_CM_double -1.7E+308 1.7E+308 /end CHARACTERISTIC
/begin CHARACTERISTIC speedgoat_test_SN5659__cal_impl.Decode5_P5_n "" VALUE 0x008E4728 Scalar_FLOAT64_IEEE 0 speedgoat_test_SN5659_R2020b_CM_double -1.7E+308 1.7E+308 /end CHARACTERISTIC
/begin CHARACTERISTIC speedgoat_test_SN5659__cal_impl.Decode5_P6 "" VALUE 0x008E1FB0 Scalar_FLOAT64_IEEE 0 speedgoat_test_SN5659_R2020b_CM_double -1.7E+308 1.7E+308 /end CHARACTERISTIC
/begin CHARACTERISTIC speedgoat_test_SN5659__cal_impl.Decode5_P6_b "" VALUE 0x008E4740 Scalar_FLOAT64_IEEE 0 speedgoat_test_SN5659_R2020b_CM_double -1.7E+308 1.7E+308 /end CHARACTERISTIC
/begin CHARACTERISTIC speedgoat_test_SN5659__cal_impl.Decode5_P7 "" VALUE 0x008E1FC8 Scalar_FLOAT64_IEEE 0 speedgoat_test_SN5659_R2020b_CM_double -1.7E+308 1.7E+308 /end CHARACTERISTIC
/begin CHARACTERISTIC speedgoat_test_SN5659__cal_impl.Decode5_P7_j "" VALUE 0x008E4758 Scalar_FLOAT64_IEEE 0 speedgoat_test_SN5659_R2020b_CM_double -1.7E+308 1.7E+308 /end CHARACTERISTIC
/begin CHARACTERISTIC speedgoat_test_SN5659__cal_impl.Decode5_P8 "" VALUE 0x008E1FE0 Scalar_FLOAT64_IEEE 0 speedgoat_test_SN5659_R2020b_CM_double -1.7E+308 1.7E+308 /end CHARACTERISTIC
/begin CHARACTERISTIC speedgoat_test_SN5659__cal_impl.Decode5_P8_d "" VALUE 0x008E4770 Scalar_FLOAT64_IEEE 0 speedgoat_test_SN5659_R2020b_CM_double -1.7E+308 1.7E+308 /end CHARACTERISTIC
/begin CHARACTERISTIC speedgoat_test_SN5659__cal_impl.Decode5_P9 "" VALUE 0x008E1FF8 Scalar_FLOAT64_IEEE 0 speedgoat_test_SN5659_R2020b_CM_double -1.7E+308 1.7E+308 /end CHARACTERISTIC
/begin CHARACTERISTIC speedgoat_test_SN5659__cal_impl.Decode5_P9_i "" VALUE 0x008E4788 Scalar_FLOAT64_IEEE 0 speedgoat_test_SN5659_R2020b_CM_double -1.7E+308 1.7E+308 /end CHARACTERISTIC
/begin CHARACTERISTIC speedgoat_test_SN5659__cal_impl.Receivev210_P1 "" VALUE 0x008E3798 Scalar_FLOAT64_IEEE 0 speedgoat_test_SN5659_R2020b_CM_double -1.7E+308 1.7E+308 /end CHARACTERISTIC
/begin CHARACTERISTIC speedgoat_test_SN5659__cal_impl.Receivev210_P2 "" VALUE 0x008E37B0 Scalar_FLOAT64_IEEE 0 speedgoat_test_SN5659_R2020b_CM_double -1.7E+308 1.7E+308 /end CHARACTERISTIC
/begin CHARACTERISTIC speedgoat_test_SN5659__cal_impl.Receivev210_P3 "" VALUE 0x008E37C8 Scalar_FLOAT64_IEEE 0 speedgoat_test_SN5659_R2020b_CM_double -1.7E+308 1.7E+308 /end CHARACTERISTIC
/begin CHARACTERISTIC speedgoat_test_SN5659__cal_impl.Receivev210_P4 "" VALUE 0x008E37E0 Scalar_FLOAT64_IEEE 0 speedgoat_test_SN5659_R2020b_CM_double -1.7E+308 1.7E+308 /end CHARACTERISTIC
/begin CHARACTERISTIC speedgoat_test_SN5659__cal_impl.Receivev210_P5 "" VALUE 0x008E37F8 Scalar_FLOAT64_IEEE 0 speedgoat_test_SN5659_R2020b_CM_double -1.7E+308 1.7E+308 /end CHARACTERISTIC
/begin CHARACTERISTIC speedgoat_test_SN5659__cal_impl.Receivev211_P1 "" VALUE 0x008E3E30 Scalar_FLOAT64_IEEE 0 speedgoat_test_SN5659_R2020b_CM_double -1.7E+308 1.7E+308 /end CHARACTERISTIC
/begin CHARACTERISTIC speedgoat_test_SN5659__cal_impl.Receivev211_P2 "" VALUE 0x008E3E48 Scalar_FLOAT64_IEEE 0 speedgoat_test_SN5659_R2020b_CM_double -1.7E+308 1.7E+308 /end CHARACTERISTIC
/begin CHARACTERISTIC speedgoat_test_SN5659__cal_impl.Receivev211_P3 "" VALUE 0x008E3E60 Scalar_FLOAT64_IEEE 0 speedgoat_test_SN5659_R2020b_CM_double -1.7E+308 1.7E+308 /end CHARACTERISTIC
/begin CHARACTERISTIC speedgoat_test_SN5659__cal_impl.Receivev211_P4 "" VALUE 0x008E3E78 Scalar_FLOAT64_IEEE 0 speedgoat_test_SN5659_R2020b_CM_double -1.7E+308 1.7E+308 /end CHARACTERISTIC
/begin CHARACTERISTIC speedgoat_test_SN5659__cal_impl.Receivev211_P5 "" VALUE 0x008E3E90 Scalar_FLOAT64_IEEE 0 speedgoat_test_SN5659_R2020b_CM_double -1.7E+308 1.7E+308 /end CHARACTERISTIC
/begin CHARACTERISTIC speedgoat_test_SN5659__cal_impl.Receivev212_P1 "" VALUE 0x008E44C8 Scalar_FLOAT64_IEEE 0 speedgoat_test_SN5659_R2020b_CM_double -1.7E+308 1.7E+308 /end CHARACTERISTIC
/begin CHARACTERISTIC speedgoat_test_SN5659__cal_impl.Receivev212_P2 "" VALUE 0x008E44E0 Scalar_FLOAT64_IEEE 0 speedgoat_test_SN5659_R2020b_CM_double -1.7E+308 1.7E+308 /end CHARACTERISTIC
/begin CHARACTERISTIC speedgoat_test_SN5659__cal_impl.Receivev212_P3 "" VALUE 0x008E44F8 Scalar_FLOAT64_IEEE 0 speedgoat_test_SN5659_R2020b_CM_double -1.7E+308 1.7E+308 /end CHARACTERISTIC
/begin CHARACTERISTIC speedgoat_test_SN5659__cal_impl.Receivev212_P4 "" VALUE 0x008E4510 Scalar_FLOAT64_IEEE 0 speedgoat_test_SN5659_R2020b_CM_double -1.7E+308 1.7E+308 /end CHARACTERISTIC
/begin CHARACTERISTIC speedgoat_test_SN5659__cal_impl.Receivev212_P5 "" VALUE 0x008E4528 Scalar_FLOAT64_IEEE 0 speedgoat_test_SN5659_R2020b_CM_double -1.7E+308 1.7E+308 /end CHARACTERISTIC
/begin CHARACTERISTIC speedgoat_test_SN5659__cal_impl.Receivev213_P1 "" VALUE 0x008E4B60 Scalar_FLOAT64_IEEE 0 speedgoat_test_SN5659_R2020b_CM_double -1.7E+308 1.7E+308 /end CHARACTERISTIC
/begin CHARACTERISTIC speedgoat_test_SN5659__cal_impl.Receivev213_P2 "" VALUE 0x008E4B78 Scalar_FLOAT64_IEEE 0 speedgoat_test_SN5659_R2020b_CM_double -1.7E+308 1.7E+308 /end CHARACTERISTIC
/begin CHARACTERISTIC speedgoat_test_SN5659__cal_impl.Receivev213_P3 "" VALUE 0x008E4B90 Scalar_FLOAT64_IEEE 0 speedgoat_test_SN5659_R2020b_CM_double -1.7E+308 1.7E+308 /end CHARACTERISTIC
/begin CHARACTERISTIC speedgoat_test_SN5659__cal_impl.Receivev213_P4 "" VALUE 0x008E4BA8 Scalar_FLOAT64_IEEE 0 speedgoat_test_SN5659_R2020b_CM_double -1.7E+308 1.7E+308 /end CHARACTERISTIC
/begin CHARACTERISTIC speedgoat_test_SN5659__cal_impl.Receivev213_P5 "" VALUE 0x008E4BC0 Scalar_FLOAT64_IEEE 0 speedgoat_test_SN5659_R2020b_CM_double -1.7E+308 1.7E+308 /end CHARACTERISTIC
/begin CHARACTERISTIC speedgoat_test_SN5659__cal_impl.Receivev214_P1 "" VALUE 0x008E51F8 Scalar_FLOAT64_IEEE 0 speedgoat_test_SN5659_R2020b_CM_double -1.7E+308 1.7E+308 /end CHARACTERISTIC
/begin CHARACTERISTIC speedgoat_test_SN5659__cal_impl.Receivev214_P2 "" VALUE 0x008E5210 Scalar_FLOAT64_IEEE 0 speedgoat_test_SN5659_R2020b_CM_double -1.7E+308 1.7E+308 /end CHARACTERISTIC
/begin CHARACTERISTIC speedgoat_test_SN5659__cal_impl.Receivev214_P3 "" VALUE 0x008E5228 Scalar_FLOAT64_IEEE 0 speedgoat_test_SN5659_R2020b_CM_double -1.7E+308 1.7E+308 /end CHARACTERISTIC
/begin CHARACTERISTIC speedgoat_test_SN5659__cal_impl.Receivev214_P4 "" VALUE 0x008E5240 Scalar_FLOAT64_IEEE 0 speedgoat_test_SN5659_R2020b_CM_double -1.7E+308 1.7E+308 /end CHARACTERISTIC
/begin CHARACTERISTIC speedgoat_test_SN5659__cal_impl.Receivev214_P5 "" VALUE 0x008E5258 Scalar_FLOAT64_IEEE 0 speedgoat_test_SN5659_R2020b_CM_double -1.7E+308 1.7E+308 /end CHARACTERISTIC
/begin CHARACTERISTIC speedgoat_test_SN5659__cal_impl.Receivev215_P1 "" VALUE 0x008E5890 Scalar_FLOAT64_IEEE 0 speedgoat_test_SN5659_R2020b_CM_double -1.7E+308 1.7E+308 /end CHARACTERISTIC
/begin CHARACTERISTIC speedgoat_test_SN5659__cal_impl.Receivev215_P2 "" VALUE 0x008E58A8 Scalar_FLOAT64_IEEE 0 speedgoat_test_SN5659_R2020b_CM_double -1.7E+308 1.7E+308 /end CHARACTERISTIC
/begin CHARACTERISTIC speedgoat_test_SN5659__cal_impl.Receivev215_P3 "" VALUE 0x008E58C0 Scalar_FLOAT64_IEEE 0 speedgoat_test_SN5659_R2020b_CM_double -1.7E+308 1.7E+308 /end CHARACTERISTIC
/begin CHARACTERISTIC speedgoat_test_SN5659__cal_impl.Receivev215_P4 "" VALUE 0x008E58D8 Scalar_FLOAT64_IEEE 0 speedgoat_test_SN5659_R2020b_CM_double -1.7E+308 1.7E+308 /end CHARACTERISTIC
/begin CHARACTERISTIC speedgoat_test_SN5659__cal_impl.Receivev215_P5 "" VALUE 0x008E58F0 Scalar_FLOAT64_IEEE 0 speedgoat_test_SN5659_R2020b_CM_double -1.7E+308 1.7E+308 /end CHARACTERISTIC
/begin CHARACTERISTIC speedgoat_test_SN5659__cal_impl.Receivev21_P1 "" VALUE 0x008E23D0 Scalar_FLOAT64_IEEE 0 speedgoat_test_SN5659_R2020b_CM_double -1.7E+308 1.7E+308 /end CHARACTERISTIC
/begin CHARACTERISTIC speedgoat_test_SN5659__cal_impl.Receivev21_P2 "" VALUE 0x008E23E8 Scalar_FLOAT64_IEEE 0 speedgoat_test_SN5659_R2020b_CM_double -1.7E+308 1.7E+308 /end CHARACTERISTIC
/begin CHARACTERISTIC speedgoat_test_SN5659__cal_impl.Receivev21_P3 "" VALUE 0x008E2400 Scalar_FLOAT64_IEEE 0 speedgoat_test_SN5659_R2020b_CM_double -1.7E+308 1.7E+308 /end CHARACTERISTIC
/begin CHARACTERISTIC speedgoat_test_SN5659__cal_impl.Receivev21_P4 "" VALUE 0x008E2418 Scalar_FLOAT64_IEEE 0 speedgoat_test_SN5659_R2020b_CM_double -1.7E+308 1.7E+308 /end CHARACTERISTIC
/begin CHARACTERISTIC speedgoat_test_SN5659__cal_impl.Receivev21_P5 "" VALUE 0x008E2430 Scalar_FLOAT64_IEEE 0 speedgoat_test_SN5659_R2020b_CM_double -1.7E+308 1.7E+308 /end CHARACTERISTIC
/begin CHARACTERISTIC speedgoat_test_SN5659__cal_impl.Receivev22_P1 "" VALUE 0x008E5F28 Scalar_FLOAT64_IEEE 0 speedgoat_test_SN5659_R2020b_CM_double -1.7E+308 1.7E+308 /end CHARACTERISTIC
/begin CHARACTERISTIC speedgoat_test_SN5659__cal_impl.Receivev22_P2 "" VALUE 0x008E5F40 Scalar_FLOAT64_IEEE 0 speedgoat_test_SN5659_R2020b_CM_double -1.7E+308 1.7E+308 /end CHARACTERISTIC
/begin CHARACTERISTIC speedgoat_test_SN5659__cal_impl.Receivev22_P3 "" VALUE 0x008E5F58 Scalar_FLOAT64_IEEE 0 speedgoat_test_SN5659_R2020b_CM_double -1.7E+308 1.7E+308 /end CHARACTERISTIC
/begin CHARACTERISTIC speedgoat_test_SN5659__cal_impl.Receivev22_P4 "" VALUE 0x008E5F70 Scalar_FLOAT64_IEEE 0 speedgoat_test_SN5659_R2020b_CM_double -1.7E+308 1.7E+308 /end CHARACTERISTIC
/begin CHARACTERISTIC speedgoat_test_SN5659__cal_impl.Receivev22_P5 "" VALUE 0x008E5F88 Scalar_FLOAT64_IEEE 0 speedgoat_test_SN5659_R2020b_CM_double -1.7E+308 1.7E+308 /end CHARACTERISTIC
/begin CHARACTERISTIC speedgoat_test_SN5659__cal_impl.Receivev23_P1 "" VALUE 0x008E65C0 Scalar_FLOAT64_IEEE 0 speedgoat_test_SN5659_R2020b_CM_double -1.7E+308 1.7E+308 /end CHARACTERISTIC
/begin CHARACTERISTIC speedgoat_test_SN5659__cal_impl.Receivev23_P2 "" VALUE 0x008E65D8 Scalar_FLOAT64_IEEE 0 speedgoat_test_SN5659_R2020b_CM_double -1.7E+308 1.7E+308 /end CHARACTERISTIC
/begin CHARACTERISTIC speedgoat_test_SN5659__cal_impl.Receivev23_P3 "" VALUE 0x008E65F0 Scalar_FLOAT64_IEEE 0 speedgoat_test_SN5659_R2020b_CM_double -1.7E+308 1.7E+308 /end CHARACTERISTIC
/begin CHARACTERISTIC speedgoat_test_SN5659__cal_impl.Receivev23_P4 "" VALUE 0x008E6608 Scalar_FLOAT64_IEEE 0 speedgoat_test_SN5659_R2020b_CM_double -1.7E+308 1.7E+308 /end CHARACTERISTIC
/begin CHARACTERISTIC speedgoat_test_SN5659__cal_impl.Receivev23_P5 "" VALUE 0x008E6620 Scalar_FLOAT64_IEEE 0 speedgoat_test_SN5659_R2020b_CM_double -1.7E+308 1.7E+308 /end CHARACTERISTIC
/begin CHARACTERISTIC speedgoat_test_SN5659__cal_impl.Receivev24_P1 "" VALUE 0x008E6C58 Scalar_FLOAT64_IEEE 0 speedgoat_test_SN5659_R2020b_CM_double -1.7E+308 1.7E+308 /end CHARACTERISTIC
/begin CHARACTERISTIC speedgoat_test_SN5659__cal_impl.Receivev24_P2 "" VALUE 0x008E6C70 Scalar_FLOAT64_IEEE 0 speedgoat_test_SN5659_R2020b_CM_double -1.7E+308 1.7E+308 /end CHARACTERISTIC
/begin CHARACTERISTIC speedgoat_test_SN5659__cal_impl.Receivev24_P3 "" VALUE 0x008E6C88 Scalar_FLOAT64_IEEE 0 speedgoat_test_SN5659_R2020b_CM_double -1.7E+308 1.7E+308 /end CHARACTERISTIC
/begin CHARACTERISTIC speedgoat_test_SN5659__cal_impl.Receivev24_P4 "" VALUE 0x008E6CA0 Scalar_FLOAT64_IEEE 0 speedgoat_test_SN5659_R2020b_CM_double -1.7E+308 1.7E+308 /end CHARACTERISTIC
/begin CHARACTERISTIC speedgoat_test_SN5659__cal_impl.Receivev24_P5 "" VALUE 0x008E6CB8 Scalar_FLOAT64_IEEE 0 speedgoat_test_SN5659_R2020b_CM_double -1.7E+308 1.7E+308 /end CHARACTERISTIC
/begin CHARACTERISTIC speedgoat_test_SN5659__cal_impl.Receivev25_P1 "" VALUE 0x008E72F0 Scalar_FLOAT64_IEEE 0 speedgoat_test_SN5659_R2020b_CM_double -1.7E+308 1.7E+308 /end CHARACTERISTIC
/begin CHARACTERISTIC speedgoat_test_SN5659__cal_impl.Receivev25_P2 "" VALUE 0x008E7308 Scalar_FLOAT64_IEEE 0 speedgoat_test_SN5659_R2020b_CM_double -1.7E+308 1.7E+308 /end CHARACTERISTIC
/begin CHARACTERISTIC speedgoat_test_SN5659__cal_impl.Receivev25_P3 "" VALUE 0x008E7320 Scalar_FLOAT64_IEEE 0 speedgoat_test_SN5659_R2020b_CM_double -1.7E+308 1.7E+308 /end CHARACTERISTIC
/begin CHARACTERISTIC speedgoat_test_SN5659__cal_impl.Receivev25_P4 "" VALUE 0x008E7338 Scalar_FLOAT64_IEEE 0 speedgoat_test_SN5659_R2020b_CM_double -1.7E+308 1.7E+308 /end CHARACTERISTIC
/begin CHARACTERISTIC speedgoat_test_SN5659__cal_impl.Receivev25_P5 "" VALUE 0x008E7350 Scalar_FLOAT64_IEEE 0 speedgoat_test_SN5659_R2020b_CM_double -1.7E+308 1.7E+308 /end CHARACTERISTIC
/begin CHARACTERISTIC speedgoat_test_SN5659__cal_impl.Receivev26_P1 "" VALUE 0x008E7988 Scalar_FLOAT64_IEEE 0 speedgoat_test_SN5659_R2020b_CM_double -1.7E+308 1.7E+308 /end CHARACTERISTIC
/begin CHARACTERISTIC speedgoat_test_SN5659__cal_impl.Receivev26_P2 "" VALUE 0x008E79A0 Scalar_FLOAT64_IEEE 0 speedgoat_test_SN5659_R2020b_CM_double -1.7E+308 1.7E+308 /end CHARACTERISTIC
/begin CHARACTERISTIC speedgoat_test_SN5659__cal_impl.Receivev26_P3 "" VALUE 0x008E79B8 Scalar_FLOAT64_IEEE 0 speedgoat_test_SN5659_R2020b_CM_double -1.7E+308 1.7E+308 /end CHARACTERISTIC
/begin CHARACTERISTIC speedgoat_test_SN5659__cal_impl.Receivev26_P4 "" VALUE 0x008E79D0 Scalar_FLOAT64_IEEE 0 speedgoat_test_SN5659_R2020b_CM_double -1.7E+308 1.7E+308 /end CHARACTERISTIC
/begin CHARACTERISTIC speedgoat_test_SN5659__cal_impl.Receivev26_P5 "" VALUE 0x008E79E8 Scalar_FLOAT64_IEEE 0 speedgoat_test_SN5659_R2020b_CM_double -1.7E+308 1.7E+308 /end CHARACTERISTIC
/begin CHARACTERISTIC speedgoat_test_SN5659__cal_impl.Receivev27_P1 "" VALUE 0x008E8020 Scalar_FLOAT64_IEEE 0 speedgoat_test_SN5659_R2020b_CM_double -1.7E+308 1.7E+308 /end CHARACTERISTIC
/begin CHARACTERISTIC speedgoat_test_SN5659__cal_impl.Receivev27_P2 "" VALUE 0x008E8038 Scalar_FLOAT64_IEEE 0 speedgoat_test_SN5659_R2020b_CM_double -1.7E+308 1.7E+308 /end CHARACTERISTIC
/begin CHARACTERISTIC speedgoat_test_SN5659__cal_impl.Receivev27_P3 "" VALUE 0x008E8050 Scalar_FLOAT64_IEEE 0 speedgoat_test_SN5659_R2020b_CM_double -1.7E+308 1.7E+308 /end CHARACTERISTIC
/begin CHARACTERISTIC speedgoat_test_SN5659__cal_impl.Receivev27_P4 "" VALUE 0x008E8068 Scalar_FLOAT64_IEEE 0 speedgoat_test_SN5659_R2020b_CM_double -1.7E+308 1.7E+308 /end CHARACTERISTIC
/begin CHARACTERISTIC speedgoat_test_SN5659__cal_impl.Receivev27_P5 "" VALUE 0x008E8080 Scalar_FLOAT64_IEEE 0 speedgoat_test_SN5659_R2020b_CM_double -1.7E+308 1.7E+308 /end CHARACTERISTIC
/begin CHARACTERISTIC speedgoat_test_SN5659__cal_impl.Receivev28_P1 "" VALUE 0x008E2A68 Scalar_FLOAT64_IEEE 0 speedgoat_test_SN5659_R2020b_CM_double -1.7E+308 1.7E+308 /end CHARACTERISTIC
/begin CHARACTERISTIC speedgoat_test_SN5659__cal_impl.Receivev28_P2 "" VALUE 0x008E2A80 Scalar_FLOAT64_IEEE 0 speedgoat_test_SN5659_R2020b_CM_double -1.7E+308 1.7E+308 /end CHARACTERISTIC
/begin CHARACTERISTIC speedgoat_test_SN5659__cal_impl.Receivev28_P3 "" VALUE 0x008E2A98 Scalar_FLOAT64_IEEE 0 speedgoat_test_SN5659_R2020b_CM_double -1.7E+308 1.7E+308 /end CHARACTERISTIC
/begin CHARACTERISTIC speedgoat_test_SN5659__cal_impl.Receivev28_P4 "" VALUE 0x008E2AB0 Scalar_FLOAT64_IEEE 0 speedgoat_test_SN5659_R2020b_CM_double -1.7E+308 1.7E+308 /end CHARACTERISTIC
/begin CHARACTERISTIC speedgoat_test_SN5659__cal_impl.Receivev28_P5 "" VALUE 0x008E2AC8 Scalar_FLOAT64_IEEE 0 speedgoat_test_SN5659_R2020b_CM_double -1.7E+308 1.7E+308 /end CHARACTERISTIC
/begin CHARACTERISTIC speedgoat_test_SN5659__cal_impl.Receivev29_P1 "" VALUE 0x008E3100 Scalar_FLOAT64_IEEE 0 speedgoat_test_SN5659_R2020b_CM_double -1.7E+308 1.7E+308 /end CHARACTERISTIC
/begin CHARACTERISTIC speedgoat_test_SN5659__cal_impl.Receivev29_P2 "" VALUE 0x008E3118 Scalar_FLOAT64_IEEE 0 speedgoat_test_SN5659_R2020b_CM_double -1.7E+308 1.7E+308 /end CHARACTERISTIC
/begin CHARACTERISTIC speedgoat_test_SN5659__cal_impl.Receivev29_P3 "" VALUE 0x008E3130 Scalar_FLOAT64_IEEE 0 speedgoat_test_SN5659_R2020b_CM_double -1.7E+308 1.7E+308 /end CHARACTERISTIC
/begin CHARACTERISTIC speedgoat_test_SN5659__cal_impl.Receivev29_P4 "" VALUE 0x008E3148 Scalar_FLOAT64_IEEE 0 speedgoat_test_SN5659_R2020b_CM_double -1.7E+308 1.7E+308 /end CHARACTERISTIC
/begin CHARACTERISTIC speedgoat_test_SN5659__cal_impl.Receivev29_P5 "" VALUE 0x008E3160 Scalar_FLOAT64_IEEE 0 speedgoat_test_SN5659_R2020b_CM_double -1.7E+308 1.7E+308 /end CHARACTERISTIC
/begin CHARACTERISTIC speedgoat_test_SN5659__cal_impl.Receivev2_P1 "" VALUE 0x008E1D38 Scalar_FLOAT64_IEEE 0 speedgoat_test_SN5659_R2020b_CM_double -1.7E+308 1.7E+308 /end CHARACTERISTIC
/begin CHARACTERISTIC speedgoat_test_SN5659__cal_impl.Receivev2_P2 "" VALUE 0x008E1D50 Scalar_FLOAT64_IEEE 0 speedgoat_test_SN5659_R2020b_CM_double -1.7E+308 1.7E+308 /end CHARACTERISTIC
/begin CHARACTERISTIC speedgoat_test_SN5659__cal_impl.Receivev2_P3 "" VALUE 0x008E1D68 Scalar_FLOAT64_IEEE 0 speedgoat_test_SN5659_R2020b_CM_double -1.7E+308 1.7E+308 /end CHARACTERISTIC
/begin CHARACTERISTIC speedgoat_test_SN5659__cal_impl.Receivev2_P4 "" VALUE 0x008E1D80 Scalar_FLOAT64_IEEE 0 speedgoat_test_SN5659_R2020b_CM_double -1.7E+308 1.7E+308 /end CHARACTERISTIC
/begin CHARACTERISTIC speedgoat_test_SN5659__cal_impl.Receivev2_P5 "" VALUE 0x008E1D98 Scalar_FLOAT64_IEEE 0 speedgoat_test_SN5659_R2020b_CM_double -1.7E+308 1.7E+308 /end CHARACTERISTIC
/begin CHARACTERISTIC speedgoat_test_SN5659__cal_impl.Sendv210_P1 "" VALUE 0x008E99C0 Scalar_FLOAT64_IEEE 0 speedgoat_test_SN5659_R2020b_CM_double -1.7E+308 1.7E+308 /end CHARACTERISTIC
/begin CHARACTERISTIC speedgoat_test_SN5659__cal_impl.Sendv210_P2 "" VALUE 0x008E99D8 Scalar_FLOAT64_IEEE 0 speedgoat_test_SN5659_R2020b_CM_double -1.7E+308 1.7E+308 /end CHARACTERISTIC
/begin CHARACTERISTIC speedgoat_test_SN5659__cal_impl.Sendv210_P3 "" VALUE 0x008E99F0 Scalar_FLOAT64_IEEE 0 speedgoat_test_SN5659_R2020b_CM_double -1.7E+308 1.7E+308 /end CHARACTERISTIC
/begin CHARACTERISTIC speedgoat_test_SN5659__cal_impl.Sendv211_P1 "" VALUE 0x008EA030 Scalar_FLOAT64_IEEE 0 speedgoat_test_SN5659_R2020b_CM_double -1.7E+308 1.7E+308 /end CHARACTERISTIC
/begin CHARACTERISTIC speedgoat_test_SN5659__cal_impl.Sendv211_P2 "" VALUE 0x008EA048 Scalar_FLOAT64_IEEE 0 speedgoat_test_SN5659_R2020b_CM_double -1.7E+308 1.7E+308 /end CHARACTERISTIC
/begin CHARACTERISTIC speedgoat_test_SN5659__cal_impl.Sendv211_P3 "" VALUE 0x008EA060 Scalar_FLOAT64_IEEE 0 speedgoat_test_SN5659_R2020b_CM_double -1.7E+308 1.7E+308 /end CHARACTERISTIC
/begin CHARACTERISTIC speedgoat_test_SN5659__cal_impl.Sendv212_P1 "" VALUE 0x008EA6A0 Scalar_FLOAT64_IEEE 0 speedgoat_test_SN5659_R2020b_CM_double -1.7E+308 1.7E+308 /end CHARACTERISTIC
/begin CHARACTERISTIC speedgoat_test_SN5659__cal_impl.Sendv212_P2 "" VALUE 0x008EA6B8 Scalar_FLOAT64_IEEE 0 speedgoat_test_SN5659_R2020b_CM_double -1.7E+308 1.7E+308 /end CHARACTERISTIC
/begin CHARACTERISTIC speedgoat_test_SN5659__cal_impl.Sendv212_P3 "" VALUE 0x008EA6D0 Scalar_FLOAT64_IEEE 0 speedgoat_test_SN5659_R2020b_CM_double -1.7E+308 1.7E+308 /end CHARACTERISTIC
/begin CHARACTERISTIC speedgoat_test_SN5659__cal_impl.Sendv213_P1 "" VALUE 0x008EAD10 Scalar_FLOAT64_IEEE 0 speedgoat_test_SN5659_R2020b_CM_double -1.7E+308 1.7E+308 /end CHARACTERISTIC
/begin CHARACTERISTIC speedgoat_test_SN5659__cal_impl.Sendv213_P2 "" VALUE 0x008EAD28 Scalar_FLOAT64_IEEE 0 speedgoat_test_SN5659_R2020b_CM_double -1.7E+308 1.7E+308 /end CHARACTERISTIC
/begin CHARACTERISTIC speedgoat_test_SN5659__cal_impl.Sendv213_P3 "" VALUE 0x008EAD40 Scalar_FLOAT64_IEEE 0 speedgoat_test_SN5659_R2020b_CM_double -1.7E+308 1.7E+308 /end CHARACTERISTIC
/begin CHARACTERISTIC speedgoat_test_SN5659__cal_impl.Sendv214_P1 "" VALUE 0x008EB380 Scalar_FLOAT64_IEEE 0 speedgoat_test_SN5659_R2020b_CM_double -1.7E+308 1.7E+308 /end CHARACTERISTIC
/begin CHARACTERISTIC speedgoat_test_SN5659__cal_impl.Sendv214_P2 "" VALUE 0x008EB398 Scalar_FLOAT64_IEEE 0 speedgoat_test_SN5659_R2020b_CM_double -1.7E+308 1.7E+308 /end CHARACTERISTIC
/begin CHARACTERISTIC speedgoat_test_SN5659__cal_impl.Sendv214_P3 "" VALUE 0x008EB3B0 Scalar_FLOAT64_IEEE 0 speedgoat_test_SN5659_R2020b_CM_double -1.7E+308 1.7E+308 /end CHARACTERISTIC
/begin CHARACTERISTIC speedgoat_test_SN5659__cal_impl.Sendv215_P1 "" VALUE 0x008EB9F0 Scalar_FLOAT64_IEEE 0 speedgoat_test_SN5659_R2020b_CM_double -1.7E+308 1.7E+308 /end CHARACTERISTIC
/begin CHARACTERISTIC speedgoat_test_SN5659__cal_impl.Sendv215_P2 "" VALUE 0x008EBA08 Scalar_FLOAT64_IEEE 0 speedgoat_test_SN5659_R2020b_CM_double -1.7E+308 1.7E+308 /end CHARACTERISTIC
/begin CHARACTERISTIC speedgoat_test_SN5659__cal_impl.Sendv215_P3 "" VALUE 0x008EBA20 Scalar_FLOAT64_IEEE 0 speedgoat_test_SN5659_R2020b_CM_double -1.7E+308 1.7E+308 /end CHARACTERISTIC
/begin CHARACTERISTIC speedgoat_test_SN5659__cal_impl.Sendv21_P1 "" VALUE 0x008EC060 Scalar_FLOAT64_IEEE 0 speedgoat_test_SN5659_R2020b_CM_double -1.7E+308 1.7E+308 /end CHARACTERISTIC
/begin CHARACTERISTIC speedgoat_test_SN5659__cal_impl.Sendv21_P2 "" VALUE 0x008EC078 Scalar_FLOAT64_IEEE 0 speedgoat_test_SN5659_R2020b_CM_double -1.7E+308 1.7E+308 /end CHARACTERISTIC
/begin CHARACTERISTIC speedgoat_test_SN5659__cal_impl.Sendv21_P3 "" VALUE 0x008EC090 Scalar_FLOAT64_IEEE 0 speedgoat_test_SN5659_R2020b_CM_double -1.7E+308 1.7E+308 /end CHARACTERISTIC
/begin CHARACTERISTIC speedgoat_test_SN5659__cal_impl.Sendv22_P1 "" VALUE 0x008EC6D0 Scalar_FLOAT64_IEEE 0 speedgoat_test_SN5659_R2020b_CM_double -1.7E+308 1.7E+308 /end CHARACTERISTIC
/begin CHARACTERISTIC speedgoat_test_SN5659__cal_impl.Sendv22_P2 "" VALUE 0x008EC6E8 Scalar_FLOAT64_IEEE 0 speedgoat_test_SN5659_R2020b_CM_double -1.7E+308 1.7E+308 /end CHARACTERISTIC
/begin CHARACTERISTIC speedgoat_test_SN5659__cal_impl.Sendv22_P3 "" VALUE 0x008EC700 Scalar_FLOAT64_IEEE 0 speedgoat_test_SN5659_R2020b_CM_double -1.7E+308 1.7E+308 /end CHARACTERISTIC
/begin CHARACTERISTIC speedgoat_test_SN5659__cal_impl.Sendv23_P1 "" VALUE 0x008ECD40 Scalar_FLOAT64_IEEE 0 speedgoat_test_SN5659_R2020b_CM_double -1.7E+308 1.7E+308 /end CHARACTERISTIC
/begin CHARACTERISTIC speedgoat_test_SN5659__cal_impl.Sendv23_P2 "" VALUE 0x008ECD58 Scalar_FLOAT64_IEEE 0 speedgoat_test_SN5659_R2020b_CM_double -1.7E+308 1.7E+308 /end CHARACTERISTIC
/begin CHARACTERISTIC speedgoat_test_SN5659__cal_impl.Sendv23_P3 "" VALUE 0x008ECD70 Scalar_FLOAT64_IEEE 0 speedgoat_test_SN5659_R2020b_CM_double -1.7E+308 1.7E+308 /end CHARACTERISTIC
/begin CHARACTERISTIC speedgoat_test_SN5659__cal_impl.Sendv24_P1 "" VALUE 0x008ED3B0 Scalar_FLOAT64_IEEE 0 speedgoat_test_SN5659_R2020b_CM_double -1.7E+308 1.7E+308 /end CHARACTERISTIC
/begin CHARACTERISTIC speedgoat_test_SN5659__cal_impl.Sendv24_P2 "" VALUE 0x008ED3C8 Scalar_FLOAT64_IEEE 0 speedgoat_test_SN5659_R2020b_CM_double -1.7E+308 1.7E+308 /end CHARACTERISTIC
/begin CHARACTERISTIC speedgoat_test_SN5659__cal_impl.Sendv24_P3 "" VALUE 0x008ED3E0 Scalar_FLOAT64_IEEE 0 speedgoat_test_SN5659_R2020b_CM_double -1.7E+308 1.7E+308 /end CHARACTERISTIC
/begin CHARACTERISTIC speedgoat_test_SN5659__cal_impl.Sendv25_P1 "" VALUE 0x008EDA20 Scalar_FLOAT64_IEEE 0 speedgoat_test_SN5659_R2020b_CM_double -1.7E+308 1.7E+308 /end CHARACTERISTIC
/begin CHARACTERISTIC speedgoat_test_SN5659__cal_impl.Sendv25_P2 "" VALUE 0x008EDA38 Scalar_FLOAT64_IEEE 0 speedgoat_test_SN5659_R2020b_CM_double -1.7E+308 1.7E+308 /end CHARACTERISTIC
/begin CHARACTERISTIC speedgoat_test_SN5659__cal_impl.Sendv25_P3 "" VALUE 0x008EDA50 Scalar_FLOAT64_IEEE 0 speedgoat_test_SN5659_R2020b_CM_double -1.7E+308 1.7E+308 /end CHARACTERISTIC
/begin CHARACTERISTIC speedgoat_test_SN5659__cal_impl.Sendv26_P1 "" VALUE 0x008EE090 Scalar_FLOAT64_IEEE 0 speedgoat_test_SN5659_R2020b_CM_double -1.7E+308 1.7E+308 /end CHARACTERISTIC
/begin CHARACTERISTIC speedgoat_test_SN5659__cal_impl.Sendv26_P2 "" VALUE 0x008EE0A8 Scalar_FLOAT64_IEEE 0 speedgoat_test_SN5659_R2020b_CM_double -1.7E+308 1.7E+308 /end CHARACTERISTIC
/begin CHARACTERISTIC speedgoat_test_SN5659__cal_impl.Sendv26_P3 "" VALUE 0x008EE0C0 Scalar_FLOAT64_IEEE 0 speedgoat_test_SN5659_R2020b_CM_double -1.7E+308 1.7E+308 /end CHARACTERISTIC
/begin CHARACTERISTIC speedgoat_test_SN5659__cal_impl.Sendv27_P1 "" VALUE 0x008EE700 Scalar_FLOAT64_IEEE 0 speedgoat_test_SN5659_R2020b_CM_double -1.7E+308 1.7E+308 /end CHARACTERISTIC
/begin CHARACTERISTIC speedgoat_test_SN5659__cal_impl.Sendv27_P2 "" VALUE 0x008EE718 Scalar_FLOAT64_IEEE 0 speedgoat_test_SN5659_R2020b_CM_double -1.7E+308 1.7E+308 /end CHARACTERISTIC
/begin CHARACTERISTIC speedgoat_test_SN5659__cal_impl.Sendv27_P3 "" VALUE 0x008EE730 Scalar_FLOAT64_IEEE 0 speedgoat_test_SN5659_R2020b_CM_double -1.7E+308 1.7E+308 /end CHARACTERISTIC
/begin CHARACTERISTIC speedgoat_test_SN5659__cal_impl.Sendv28_P1 "" VALUE 0x008EED70 Scalar_FLOAT64_IEEE 0 speedgoat_test_SN5659_R2020b_CM_double -1.7E+308 1.7E+308 /end CHARACTERISTIC
/begin CHARACTERISTIC speedgoat_test_SN5659__cal_impl.Sendv28_P2 "" VALUE 0x008EED88 Scalar_FLOAT64_IEEE 0 speedgoat_test_SN5659_R2020b_CM_double -1.7E+308 1.7E+308 /end CHARACTERISTIC
/begin CHARACTERISTIC speedgoat_test_SN5659__cal_impl.Sendv28_P3 "" VALUE 0x008EEDA0 Scalar_FLOAT64_IEEE 0 speedgoat_test_SN5659_R2020b_CM_double -1.7E+308 1.7E+308 /end CHARACTERISTIC
/begin CHARACTERISTIC speedgoat_test_SN5659__cal_impl.Sendv29_P1 "" VALUE 0x008E9350 Scalar_FLOAT64_IEEE 0 speedgoat_test_SN5659_R2020b_CM_double -1.7E+308 1.7E+308 /end CHARACTERISTIC
/begin CHARACTERISTIC speedgoat_test_SN5659__cal_impl.Sendv29_P2 "" VALUE 0x008E9368 Scalar_FLOAT64_IEEE 0 speedgoat_test_SN5659_R2020b_CM_double -1.7E+308 1.7E+308 /end CHARACTERISTIC
/begin CHARACTERISTIC speedgoat_test_SN5659__cal_impl.Sendv29_P3 "" VALUE 0x008E9380 Scalar_FLOAT64_IEEE 0 speedgoat_test_SN5659_R2020b_CM_double -1.7E+308 1.7E+308 /end CHARACTERISTIC
/begin CHARACTERISTIC speedgoat_test_SN5659__cal_impl.Sendv2_P1 "" VALUE 0x008E8CE0 Scalar_FLOAT64_IEEE 0 speedgoat_test_SN5659_R2020b_CM_double -1.7E+308 1.7E+308 /end CHARACTERISTIC
/begin CHARACTERISTIC speedgoat_test_SN5659__cal_impl.Sendv2_P2 "" VALUE 0x008E8CF8 Scalar_FLOAT64_IEEE 0 speedgoat_test_SN5659_R2020b_CM_double -1.7E+308 1.7E+308 /end CHARACTERISTIC
/begin CHARACTERISTIC speedgoat_test_SN5659__cal_impl.Sendv2_P3 "" VALUE 0x008E8D10 Scalar_FLOAT64_IEEE 0 speedgoat_test_SN5659_R2020b_CM_double -1.7E+308 1.7E+308 /end CHARACTERISTIC
/begin CHARACTERISTIC speedgoat_test_SN5659__cal_impl.Setupv2_P1_p "" VALUE 0x008E0CA0 Scalar_FLOAT64_IEEE 0 speedgoat_test_SN5659_R2020b_CM_double -1.7E+308 1.7E+308 /end CHARACTERISTIC
/begin CHARACTERISTIC speedgoat_test_SN5659__cal_impl.Setupv2_P2_h "" VALUE 0x008E0CB8 Scalar_FLOAT64_IEEE 0 speedgoat_test_SN5659_R2020b_CM_double -1.7E+308 1.7E+308 /end CHARACTERISTIC
/begin CHARACTERISTIC speedgoat_test_SN5659__cal_impl.Setupv2_P3_o "" VALUE 0x008E0CD0 Scalar_FLOAT64_IEEE 0 speedgoat_test_SN5659_R2020b_CM_double -1.7E+308 1.7E+308 /end CHARACTERISTIC
/begin CHARACTERISTIC speedgoat_test_SN5659__cal_impl.Setupv2_P4_p "" VALUE 0x008E0CE8 Scalar_FLOAT64_IEEE 0 speedgoat_test_SN5659_R2020b_CM_double -1.7E+308 1.7E+308 /end CHARACTERISTIC
/begin CHARACTERISTIC speedgoat_test_SN5659__cal_impl.Setupv2_P5_p "" VALUE 0x008E0D00 Scalar_FLOAT64_IEEE 0 speedgoat_test_SN5659_R2020b_CM_double -1.7E+308 1.7E+308 /end CHARACTERISTIC
/begin CHARACTERISTIC speedgoat_test_SN5659__cal_impl.Setupv2_P6_a "" VALUE 0x008E0D18 Scalar_FLOAT64_IEEE 0 speedgoat_test_SN5659_R2020b_CM_double -1.7E+308 1.7E+308 /end CHARACTERISTIC
/begin CHARACTERISTIC speedgoat_test_SN5659__cal_impl.Setupv2_P7_c "" VAL_BLK 0x008E0D30 Scalar_FLOAT64_IEEE 0 speedgoat_test_SN5659_R2020b_CM_double -1.7E+308 1.7E+308 MATRIX_DIM 5 16 /end CHARACTERISTIC
/begin CHARACTERISTIC speedgoat_test_SN5659__cal_impl.Setupv2_P8_o "" VAL_BLK 0x008E0FC0 Scalar_FLOAT64_IEEE 0 speedgoat_test_SN5659_R2020b_CM_double -1.7E+308 1.7E+308 MATRIX_DIM 4 16 /end CHARACTERISTIC
/begin MEASUREMENT speedgoat_test_SN5659_R2020b_B.Decode1 "" FLOAT64_IEEE speedgoat_test_SN5659_R2020b_CM_double 0 0 -1.7E+308 1.7E+308 ECU_ADDRESS 0x00959CF0 /end MEASUREMENT
/begin MEASUREMENT speedgoat_test_SN5659_R2020b_B.Decode1_a "" FLOAT64_IEEE speedgoat_test_SN5659_R2020b_CM_double 0 0 -1.7E+308 1.7E+308 ECU_ADDRESS 0x0095A628 /end MEASUREMENT
/begin MEASUREMENT speedgoat_test_SN5659_R2020b_B.Decode1_al "" FLOAT64_IEEE speedgoat_test_SN5659_R2020b_CM_double 0 0 -1.7E+308 1.7E+308 ECU_ADDRESS 0x0095AD88 /end MEASUREMENT
/begin MEASUREMENT speedgoat_test_SN5659_R2020b_B.Decode1_f "" FLOAT64_IEEE speedgoat_test_SN5659_R2020b_CM_double 0 0 -1.7E+308 1.7E+308 ECU_ADDRESS 0x0095A450 /end MEASUREMENT
/begin MEASUREMENT speedgoat_test_SN5659_R2020b_B.Decode1_g "" FLOAT64_IEEE speedgoat_test_SN5659_R2020b_CM_double 0 0 -1.7E+308 1.7E+308 ECU_ADDRESS 0x0095A278 /end MEASUREMENT
/begin MEASUREMENT speedgoat_test_SN5659_R2020b_B.Decode1_i "" FLOAT64_IEEE speedgoat_test_SN5659_R2020b_CM_double 0 0 -1.7E+308 1.7E+308 ECU_ADDRESS 0x0095A800 /end MEASUREMENT
/begin MEASUREMENT speedgoat_test_SN5659_R2020b_B.Decode1_m "" FLOAT64_IEEE speedgoat_test_SN5659_R2020b_CM_double 0 0 -1.7E+308 1.7E+308 ECU_ADDRESS 0x00959EC8 /end MEASUREMENT
/begin MEASUREMENT speedgoat_test_SN5659_R2020b_B.Decode1_my "" FLOAT64_IEEE speedgoat_test_SN5659_R2020b_CM_double 0 0 -1.7E+308 1.7E+308 ECU_ADDRESS 0x0095A9D8 /end MEASUREMENT
/begin MEASUREMENT speedgoat_test_SN5659_R2020b_B.Decode1_n "" FLOAT64_IEEE speedgoat_test_SN5659_R2020b_CM_double 0 0 -1.7E+308 1.7E+308 ECU_ADDRESS 0x0095ABB0 /end MEASUREMENT
/begin MEASUREMENT speedgoat_test_SN5659_R2020b_B.Decode2 "" FLOAT64_IEEE speedgoat_test_SN5659_R2020b_CM_double 0 0 -1.7E+308 1.7E+308 ECU_ADDRESS 0x00959ED0 /end MEASUREMENT
/begin MEASUREMENT speedgoat_test_SN5659_R2020b_B.Decode2_b "" FLOAT64_IEEE speedgoat_test_SN5659_R2020b_CM_double 0 0 -1.7E+308 1.7E+308 ECU_ADDRESS 0x0095ABB8 /end MEASUREMENT
/begin MEASUREMENT speedgoat_test_SN5659_R2020b_B.Decode2_i "" FLOAT64_IEEE speedgoat_test_SN5659_R2020b_CM_double 0 0 -1.7E+308 1.7E+308 ECU_ADDRESS 0x0095A9E0 /end MEASUREMENT
/begin MEASUREMENT speedgoat_test_SN5659_R2020b_B.Decode2_j "" FLOAT64_IEEE speedgoat_test_SN5659_R2020b_CM_double 0 0 -1.7E+308 1.7E+308 ECU_ADDRESS 0x0095A458 /end MEASUREMENT
/begin MEASUREMENT speedgoat_test_SN5659_R2020b_B.Decode2_j2 "" FLOAT64_IEEE speedgoat_test_SN5659_R2020b_CM_double 0 0 -1.7E+308 1.7E+308 ECU_ADDRESS 0x0095A630 /end MEASUREMENT
/begin MEASUREMENT speedgoat_test_SN5659_R2020b_B.Decode2_l "" FLOAT64_IEEE speedgoat_test_SN5659_R2020b_CM_double 0 0 -1.7E+308 1.7E+308 ECU_ADDRESS 0x0095AD90 /end MEASUREMENT
/begin MEASUREMENT speedgoat_test_SN5659_R2020b_B.Decode2_n "" FLOAT64_IEEE speedgoat_test_SN5659_R2020b_CM_double 0 0 -1.7E+308 1.7E+308 ECU_ADDRESS 0x0095A280 /end MEASUREMENT
/begin MEASUREMENT speedgoat_test_SN5659_R2020b_B.Decode3 "" FLOAT64_IEEE speedgoat_test_SN5659_R2020b_CM_double 0 0 -1.7E+308 1.7E+308 ECU_ADDRESS 0x00959D00 /end MEASUREMENT
/begin MEASUREMENT speedgoat_test_SN5659_R2020b_B.Decode3_cq "" FLOAT64_IEEE speedgoat_test_SN5659_R2020b_CM_double 0 0 -1.7E+308 1.7E+308 ECU_ADDRESS 0x0095ABC0 /end MEASUREMENT
/begin MEASUREMENT speedgoat_test_SN5659_R2020b_B.Decode3_j "" FLOAT64_IEEE speedgoat_test_SN5659_R2020b_CM_double 0 0 -1.7E+308 1.7E+308 ECU_ADDRESS 0x0095A288 /end MEASUREMENT
/begin MEASUREMENT speedgoat_test_SN5659_R2020b_B.Decode3_k "" FLOAT64_IEEE speedgoat_test_SN5659_R2020b_CM_double 0 0 -1.7E+308 1.7E+308 ECU_ADDRESS 0x0095A460 /end MEASUREMENT
/begin MEASUREMENT speedgoat_test_SN5659_R2020b_B.Decode3_l "" FLOAT64_IEEE speedgoat_test_SN5659_R2020b_CM_double 0 0 -1.7E+308 1.7E+308 ECU_ADDRESS 0x00959ED8 /end MEASUREMENT
/begin MEASUREMENT speedgoat_test_SN5659_R2020b_B.Decode3_m "" FLOAT64_IEEE speedgoat_test_SN5659_R2020b_CM_double 0 0 -1.7E+308 1.7E+308 ECU_ADDRESS 0x0095A638 /end MEASUREMENT
/begin MEASUREMENT speedgoat_test_SN5659_R2020b_B.Decode3_n "" FLOAT64_IEEE speedgoat_test_SN5659_R2020b_CM_double 0 0 -1.7E+308 1.7E+308 ECU_ADDRESS 0x0095A9E8 /end MEASUREMENT
/begin MEASUREMENT speedgoat_test_SN5659_R2020b_B.Decode3_o "" FLOAT64_IEEE speedgoat_test_SN5659_R2020b_CM_double 0 0 -1.7E+308 1.7E+308 ECU_ADDRESS 0x0095A810 /end MEASUREMENT
/begin MEASUREMENT speedgoat_test_SN5659_R2020b_B.Decode3_ou "" FLOAT64_IEEE speedgoat_test_SN5659_R2020b_CM_double 0 0 -1.7E+308 1.7E+308 ECU_ADDRESS 0x0095AD98 /end MEASUREMENT
/begin MEASUREMENT speedgoat_test_SN5659_R2020b_B.Decode4 "" FLOAT64_IEEE speedgoat_test_SN5659_R2020b_CM_double 0 0 -1.7E+308 1.7E+308 ECU_ADDRESS 0x00959D08 /end MEASUREMENT
/begin MEASUREMENT speedgoat_test_SN5659_R2020b_B.Decode4_a "" FLOAT64_IEEE speedgoat_test_SN5659_R2020b_CM_double 0 0 -1.7E+308 1.7E+308 ECU_ADDRESS 0x0095A640 /end MEASUREMENT
/begin MEASUREMENT speedgoat_test_SN5659_R2020b_B.Decode4_b "" FLOAT64_IEEE speedgoat_test_SN5659_R2020b_CM_double 0 0 -1.7E+308 1.7E+308 ECU_ADDRESS 0x0095A818 /end MEASUREMENT
/begin MEASUREMENT speedgoat_test_SN5659_R2020b_B.Decode4_c "" FLOAT64_IEEE speedgoat_test_SN5659_R2020b_CM_double 0 0 -1.7E+308 1.7E+308 ECU_ADDRESS 0x0095A468 /end MEASUREMENT
/begin MEASUREMENT speedgoat_test_SN5659_R2020b_B.Decode4_c1 "" FLOAT64_IEEE speedgoat_test_SN5659_R2020b_CM_double 0 0 -1.7E+308 1.7E+308 ECU_ADDRESS 0x0095A9F0 /end MEASUREMENT
/begin MEASUREMENT speedgoat_test_SN5659_R2020b_B.Decode4_d "" FLOAT64_IEEE speedgoat_test_SN5659_R2020b_CM_double 0 0 -1.7E+308 1.7E+308 ECU_ADDRESS 0x00959EE0 /end MEASUREMENT
/begin MEASUREMENT speedgoat_test_SN5659_R2020b_B.Decode4_h "" FLOAT64_IEEE speedgoat_test_SN5659_R2020b_CM_double 0 0 -1.7E+308 1.7E+308 ECU_ADDRESS 0x0095A290 /end MEASUREMENT
/begin MEASUREMENT speedgoat_test_SN5659_R2020b_B.Decode4_oi "" FLOAT64_IEEE speedgoat_test_SN5659_R2020b_CM_double 0 0 -1.7E+308 1.7E+308 ECU_ADDRESS 0x0095ABC8 /end MEASUREMENT
/begin MEASUREMENT speedgoat_test_SN5659_R2020b_B.Decode4_p "" FLOAT64_IEEE speedgoat_test_SN5659_R2020b_CM_double 0 0 -1.7E+308 1.7E+308 ECU_ADDRESS 0x0095ADA0 /end MEASUREMENT
/begin MEASUREMENT speedgoat_test_SN5659_R2020b_B.Decode5 "" FLOAT64_IEEE speedgoat_test_SN5659_R2020b_CM_double 0 0 -1.7E+308 1.7E+308 ECU_ADDRESS 0x00959CF8 /end MEASUREMENT
/begin MEASUREMENT speedgoat_test_SN5659_R2020b_B.Decode5_i "" FLOAT64_IEEE speedgoat_test_SN5659_R2020b_CM_double 0 0 -1.7E+308 1.7E+308 ECU_ADDRESS 0x0095A808 /end MEASUREMENT
/begin MEASUREMENT speedgoat_test_SN5659_R2020b_B.IO682_SerialIN_CH1 "" FLOAT64_IEEE speedgoat_test_SN5659_R2020b_CM_double 0 0 -1.7E+308 1.7E+308 LAYOUT COLUMN_DIR MATRIX_DIM 4 ECU_ADDRESS 0x00959D10 /end MEASUREMENT
/begin MEASUREMENT speedgoat_test_SN5659_R2020b_B.IO682_SerialIN_CH10 "" FLOAT64_IEEE speedgoat_test_SN5659_R2020b_CM_double 0 0 -1.7E+308 1.7E+308 LAYOUT COLUMN_DIR MATRIX_DIM 4 ECU_ADDRESS 0x0095A298 /end MEASUREMENT
/begin MEASUREMENT speedgoat_test_SN5659_R2020b_B.IO682_SerialIN_CH11 "" FLOAT64_IEEE speedgoat_test_SN5659_R2020b_CM_double 0 0 -1.7E+308 1.7E+308 LAYOUT COLUMN_DIR MATRIX_DIM 4 ECU_ADDRESS 0x0095A470 /end MEASUREMENT
/begin MEASUREMENT speedgoat_test_SN5659_R2020b_B.IO682_SerialIN_CH12 "" FLOAT64_IEEE speedgoat_test_SN5659_R2020b_CM_double 0 0 -1.7E+308 1.7E+308 LAYOUT COLUMN_DIR MATRIX_DIM 4 ECU_ADDRESS 0x0095A648 /end MEASUREMENT
/begin MEASUREMENT speedgoat_test_SN5659_R2020b_B.IO682_SerialIN_CH13 "" FLOAT64_IEEE speedgoat_test_SN5659_R2020b_CM_double 0 0 -1.7E+308 1.7E+308 LAYOUT COLUMN_DIR MATRIX_DIM 4 ECU_ADDRESS 0x0095A820 /end MEASUREMENT
/begin MEASUREMENT speedgoat_test_SN5659_R2020b_B.IO682_SerialIN_CH14 "" FLOAT64_IEEE speedgoat_test_SN5659_R2020b_CM_double 0 0 -1.7E+308 1.7E+308 LAYOUT COLUMN_DIR MATRIX_DIM 4 ECU_ADDRESS 0x0095A9F8 /end MEASUREMENT
/begin MEASUREMENT speedgoat_test_SN5659_R2020b_B.IO682_SerialIN_CH15 "" FLOAT64_IEEE speedgoat_test_SN5659_R2020b_CM_double 0 0 -1.7E+308 1.7E+308 LAYOUT COLUMN_DIR MATRIX_DIM 4 ECU_ADDRESS 0x0095ABD0 /end MEASUREMENT
/begin MEASUREMENT speedgoat_test_SN5659_R2020b_B.IO682_SerialIN_CH16 "" FLOAT64_IEEE speedgoat_test_SN5659_R2020b_CM_double 0 0 -1.7E+308 1.7E+308 LAYOUT COLUMN_DIR MATRIX_DIM 4 ECU_ADDRESS 0x0095ADA8 /end MEASUREMENT
/begin MEASUREMENT speedgoat_test_SN5659_R2020b_B.IO682_SerialIN_CH2 "" FLOAT64_IEEE speedgoat_test_SN5659_R2020b_CM_double 0 0 -1.7E+308 1.7E+308 LAYOUT COLUMN_DIR MATRIX_DIM 4 ECU_ADDRESS 0x00959EE8 /end MEASUREMENT
/begin MEASUREMENT speedgoat_test_SN5659_R2020b_B.IO682_SerialIN_CH3 "" FLOAT64_IEEE speedgoat_test_SN5659_R2020b_CM_double 0 0 -1.7E+308 1.7E+308 LAYOUT COLUMN_DIR MATRIX_DIM 4 ECU_ADDRESS 0x0095AF80 /end MEASUREMENT
/begin MEASUREMENT speedgoat_test_SN5659_R2020b_B.IO682_SerialIN_CH4 "" FLOAT64_IEEE speedgoat_test_SN5659_R2020b_CM_double 0 0 -1.7E+308 1.7E+308 LAYOUT COLUMN_DIR MATRIX_DIM 4 ECU_ADDRESS 0x0095B158 /end MEASUREMENT
/begin MEASUREMENT speedgoat_test_SN5659_R2020b_B.IO682_SerialIN_CH5 "" FLOAT64_IEEE speedgoat_test_SN5659_R2020b_CM_double 0 0 -1.7E+308 1.7E+308 LAYOUT COLUMN_DIR MATRIX_DIM 4 ECU_ADDRESS 0x0095B330 /end MEASUREMENT
/begin MEASUREMENT speedgoat_test_SN5659_R2020b_B.IO682_SerialIN_CH6 "" FLOAT64_IEEE speedgoat_test_SN5659_R2020b_CM_double 0 0 -1.7E+308 1.7E+308 LAYOUT COLUMN_DIR MATRIX_DIM 4 ECU_ADDRESS 0x0095B508 /end MEASUREMENT
/begin MEASUREMENT speedgoat_test_SN5659_R2020b_B.IO682_SerialIN_CH7 "" FLOAT64_IEEE speedgoat_test_SN5659_R2020b_CM_double 0 0 -1.7E+308 1.7E+308 LAYOUT COLUMN_DIR MATRIX_DIM 4 ECU_ADDRESS 0x0095B6E0 /end MEASUREMENT
/begin MEASUREMENT speedgoat_test_SN5659_R2020b_B.IO682_SerialIN_CH8 "" FLOAT64_IEEE speedgoat_test_SN5659_R2020b_CM_double 0 0 -1.7E+308 1.7E+308 LAYOUT COLUMN_DIR MATRIX_DIM 4 ECU_ADDRESS 0x0095B8B8 /end MEASUREMENT
/begin MEASUREMENT speedgoat_test_SN5659_R2020b_B.IO682_SerialIN_CH9 "" FLOAT64_IEEE speedgoat_test_SN5659_R2020b_CM_double 0 0 -1.7E+308 1.7E+308 LAYOUT COLUMN_DIR MATRIX_DIM 4 ECU_ADDRESS 0x0095A0C0 /end MEASUREMENT
/begin MEASUREMENT speedgoat_test_SN5659_R2020b_B.Receivev2 "" FLOAT64_IEEE speedgoat_test_SN5659_R2020b_CM_double 0 0 -1.7E+308 1.7E+308 LAYOUT COLUMN_DIR MATRIX_DIM 51 ECU_ADDRESS 0x00959B58 /end MEASUREMENT
/begin MEASUREMENT speedgoat_test_SN5659_R2020b_B.Receivev21 "" FLOAT64_IEEE speedgoat_test_SN5659_R2020b_CM_double 0 0 -1.7E+308 1.7E+308 LAYOUT COLUMN_DIR MATRIX_DIM 51 ECU_ADDRESS 0x00959D30 /end MEASUREMENT
/begin MEASUREMENT speedgoat_test_SN5659_R2020b_B.Receivev210 "" FLOAT64_IEEE speedgoat_test_SN5659_R2020b_CM_double 0 0 -1.7E+308 1.7E+308 LAYOUT COLUMN_DIR MATRIX_DIM 51 ECU_ADDRESS 0x0095A2B8 /end MEASUREMENT
/begin MEASUREMENT speedgoat_test_SN5659_R2020b_B.Receivev211 "" FLOAT64_IEEE speedgoat_test_SN5659_R2020b_CM_double 0 0 -1.7E+308 1.7E+308 LAYOUT COLUMN_DIR MATRIX_DIM 51 ECU_ADDRESS 0x0095A490 /end MEASUREMENT
/begin MEASUREMENT speedgoat_test_SN5659_R2020b_B.Receivev212 "" FLOAT64_IEEE speedgoat_test_SN5659_R2020b_CM_double 0 0 -1.7E+308 1.7E+308 LAYOUT COLUMN_DIR MATRIX_DIM 51 ECU_ADDRESS 0x0095A668 /end MEASUREMENT
/begin MEASUREMENT speedgoat_test_SN5659_R2020b_B.Receivev213 "" FLOAT64_IEEE speedgoat_test_SN5659_R2020b_CM_double 0 0 -1.7E+308 1.7E+308 LAYOUT COLUMN_DIR MATRIX_DIM 51 ECU_ADDRESS 0x0095A840 /end MEASUREMENT
/begin MEASUREMENT speedgoat_test_SN5659_R2020b_B.Receivev214 "" FLOAT64_IEEE speedgoat_test_SN5659_R2020b_CM_double 0 0 -1.7E+308 1.7E+308 LAYOUT COLUMN_DIR MATRIX_DIM 51 ECU_ADDRESS 0x0095AA18 /end MEASUREMENT
/begin MEASUREMENT speedgoat_test_SN5659_R2020b_B.Receivev215 "" FLOAT64_IEEE speedgoat_test_SN5659_R2020b_CM_double 0 0 -1.7E+308 1.7E+308 LAYOUT COLUMN_DIR MATRIX_DIM 51 ECU_ADDRESS 0x0095ABF0 /end MEASUREMENT
/begin MEASUREMENT speedgoat_test_SN5659_R2020b_B.Receivev22 "" FLOAT64_IEEE speedgoat_test_SN5659_R2020b_CM_double 0 0 -1.7E+308 1.7E+308 LAYOUT COLUMN_DIR MATRIX_DIM 51 ECU_ADDRESS 0x0095ADC8 /end MEASUREMENT
/begin MEASUREMENT speedgoat_test_SN5659_R2020b_B.Receivev23 "" FLOAT64_IEEE speedgoat_test_SN5659_R2020b_CM_double 0 0 -1.7E+308 1.7E+308 LAYOUT COLUMN_DIR MATRIX_DIM 51 ECU_ADDRESS 0x0095AFA0 /end MEASUREMENT
/begin MEASUREMENT speedgoat_test_SN5659_R2020b_B.Receivev24 "" FLOAT64_IEEE speedgoat_test_SN5659_R2020b_CM_double 0 0 -1.7E+308 1.7E+308 LAYOUT COLUMN_DIR MATRIX_DIM 51 ECU_ADDRESS 0x0095B178 /end MEASUREMENT
/begin MEASUREMENT speedgoat_test_SN5659_R2020b_B.Receivev25 "" FLOAT64_IEEE speedgoat_test_SN5659_R2020b_CM_double 0 0 -1.7E+308 1.7E+308 LAYOUT COLUMN_DIR MATRIX_DIM 51 ECU_ADDRESS 0x0095B350 /end MEASUREMENT
/begin MEASUREMENT speedgoat_test_SN5659_R2020b_B.Receivev26 "" FLOAT64_IEEE speedgoat_test_SN5659_R2020b_CM_double 0 0 -1.7E+308 1.7E+308 LAYOUT COLUMN_DIR MATRIX_DIM 51 ECU_ADDRESS 0x0095B528 /end MEASUREMENT
/begin MEASUREMENT speedgoat_test_SN5659_R2020b_B.Receivev27 "" FLOAT64_IEEE speedgoat_test_SN5659_R2020b_CM_double 0 0 -1.7E+308 1.7E+308 LAYOUT COLUMN_DIR MATRIX_DIM 51 ECU_ADDRESS 0x0095B700 /end MEASUREMENT
/begin MEASUREMENT speedgoat_test_SN5659_R2020b_B.Receivev28 "" FLOAT64_IEEE speedgoat_test_SN5659_R2020b_CM_double 0 0 -1.7E+308 1.7E+308 LAYOUT COLUMN_DIR MATRIX_DIM 51 ECU_ADDRESS 0x00959F08 /end MEASUREMENT
/begin MEASUREMENT speedgoat_test_SN5659_R2020b_B.Receivev29 "" FLOAT64_IEEE speedgoat_test_SN5659_R2020b_CM_double 0 0 -1.7E+308 1.7E+308 LAYOUT COLUMN_DIR MATRIX_DIM 51 ECU_ADDRESS 0x0095A0E0 /end MEASUREMENT
/begin COMPU_METHOD speedgoat_test_SN5659_R2020b_CM_double "" IDENTICAL "%15.10" "" /end COMPU_METHOD
/begin RECORD_LAYOUT Scalar_FLOAT64_IEEE FNC_VALUES 1 FLOAT64_IEEE COLUMN_DIR DIRECT /end RECORD_LAYOUT
/begin GROUP speedgoat_test_SN5659_R2020b_IO682 "speedgoat_test_SN5659_R2020b/IO682"
 /begin SUB_GROUP speedgoat_test_SN5659_R2020b_IO682_Decode_Channel_1 speedgoat_test_SN5659_R2020b_IO682_Decode_Channel_10 speedgoat_test_SN5659_R2020b_IO682_Decode_Channel_11 speedgoat_test_SN5659_R2020b_IO682_Decode_Channel_12 speedgoat_test_SN5659_R2020b_IO682_Decode_Channel_13 speedgoat_test_SN5659_R2020b_IO682_Decode_Channel_14 speedgoat_test_SN5659_R2020b_IO682_Decode_Channel_15 speedgoat_test_SN5659_R2020b_IO682_Decode_Channel_16 speedgoat_test_SN5659_R2020b_IO682_Decode_Channel_2 speedgoat_test_SN5659_R2020b_IO682_Decode_Channel_3 speedgoat_test_SN5659_R2020b_IO682_Decode_Channel_4 speedgoat_test_SN5659_R2020b_IO682_Decode_Channel_5 speedgoat_test_SN5659_R2020b_IO682_Decode_Channel_6 speedgoat_test_SN5659_R2020b_IO682_Decode_Channel_7 speedgoat_test_SN5659_R2020b_IO682_Decode_Channel_8 speedgoat_test_SN5659_R2020b_IO682_Decode_Channel_9 speedgoat_test_SN5659_R2020b_IO682_Encode_Channel_1 speedgoat_test_SN5659_R2020b_IO682_Encode_Channel_10 speedgoat_test_SN5659_R2020b_IO682_Encode_Channel_11 speedgoat_test_SN5659_R2020b_IO682_Encode_Channel_12 speedgoat_test_SN5659_R2020b_IO682_Encode_Channel_13 speedgoat_test_SN5659_R2020b_IO682_Encode_Channel_14 speedgoat_test_SN5659_R2020b_IO682_Encode_Channel_15 speedgoat_test_SN5659_R2020b_IO682_Encode_Channel_16 speedgoat_test_SN5659_R2020b_IO682_Encode_Channel_2 speedgoat_test_SN5659_R2020b_IO682_Encode_Channel_3 speedgoat_test_SN5659_R2020b_IO682_Encode_Channel_4 speedgoat_test_SN5659_R2020b_IO682_Encode_Channel_5 speedgoat_test_SN5659_R2020b_IO682_Encode_Channel_6 speedgoat_test_SN5659_R2020b_IO682_Encode_Channel_7 speedgoat_test_SN5659_R2020b_IO682_Encode_Channel_8 speedgoat_test_SN5659_R2020b_IO682_Encode_Channel_9 /end SUB_GROUP
 /begin REF_CHARACTERISTIC speedgoat_test_SN5659__cal_impl.Receivev210_P1 speedgoat_test_SN5659__cal_impl.Receivev210_P2 speedgoat_test_SN5659__cal_impl.Receivev210_P3 speedgoat_test_SN5659__cal_impl.Receivev210_P4 speedgoat_test_SN5659__cal_impl.Receivev210_P5 speedgoat_test_SN5659__cal_impl.Receivev211_P1 speedgoat_test_SN5659__cal_impl.Receivev211_P2 speedgoat_test_SN5659__cal_impl.Receivev211_P3 speedgoat_test_SN5659__cal_impl.Receivev211_P4 speedgoat_test_SN5659__cal_impl.Receivev211_P5 speedgoat_test_SN5659__cal_impl.Receivev212_P1 speedgoat_test_SN5659__cal_impl.Receivev212_P2 speedgoat_test_SN5659__cal_impl.Receivev212_P3 speedgoat_test_SN5659__cal_impl.Receivev212_P4 speedgoat_test_SN5659__cal_impl.Receivev212_P5 speedgoat_test_SN5659__cal_impl.Receivev213_P1 speedgoat_test_SN5659__cal_impl.Receivev213_P2 speedgoat_test_SN5659__cal_impl.Receivev213_P3 speedgoat_test_SN5659__cal_impl.Receivev213_P4 speedgoat_test_SN5659__cal_impl.Receivev213_P5 speedgoat_test_SN5659__cal_impl.Receivev214_P1 speedgoat_test_SN5659__cal_impl.Receivev214_P2 speedgoat_test_SN5659__cal_impl.Receivev214_P3 speedgoat_test_SN5659__cal_impl.Receivev214_P4 speedgoat_test_SN5659__cal_impl.Receivev214_P5 speedgoat_test_SN5659__cal_impl.Receivev215_P1 speedgoat_test_SN5659__cal_impl.Receivev215_P2 speedgoat_test_SN5659__cal_impl.Receivev215_P3 speedgoat_test_SN5659__cal_impl.Receivev215_P4 speedgoat_test_SN5659__cal_impl.Receivev215_P5 speedgoat_test_SN5659__cal_impl.Receivev21_P1 speedgoat_test_SN5659__cal_impl.Receivev21_P2 speedgoat_test_SN5659__cal_impl.Receivev21_P3 speedgoat_test_SN5659__cal_impl.Receivev21_P4 speedgoat_test_SN5659__cal_impl.Receivev21_P5 speedgoat_test_SN5659__cal_impl.Receivev22_P1 speedgoat_test_SN5659__cal_impl.Receivev22_P2 speedgoat_test_SN5659__cal_impl.Receivev22_P3 speedgoat_test_SN5659__cal_impl.Receivev22_P4 speedgoat_test_SN5659__cal_impl.Receivev22_P5 speedgoat_test_SN5659__cal_impl.Receivev23_P1 speedgoat_test_SN5659__cal_impl.Receivev23_P2 speedgoat_test_SN5659__cal_impl.Receivev23_P3 speedgoat_test_SN5659__cal_impl.Receivev23_P4 speedgoat_test_SN5659__cal_impl.Receivev23_P5 speedgoat_test_SN5659__cal_impl.Receivev24_P1 speedgoat_test_SN5659__cal_impl.Receivev24_P2 speedgoat_test_SN5659__cal_impl.Receivev24_P3 speedgoat_test_SN5659__cal_impl.Receivev24_P4 speedgoat_test_SN5659__cal_impl.Receivev24_P5 speedgoat_test_SN5659__cal_impl.Receivev25_P1 speedgoat_test_SN5659__cal_impl.Receivev25_P2 speedgoat_test_SN5659__cal_impl.Receivev25_P3 speedgoat_test_SN5659__cal_impl.Receivev25_P4 speedgoat_test_SN5659__cal_impl.Receivev25_P5 speedgoat_test_SN5659__cal_impl.Receivev26_P1 speedgoat_test_SN5659__cal_impl.Receivev26_P2 speedgoat_test_SN5659__cal_impl.Receivev26_P3 speedgoat_test_SN5659__cal_impl.Receivev26_P4 speedgoat_test_SN5659__cal_impl.Receivev26_P5 speedgoat_test_SN5659__cal_impl.Receivev27_P1 speedgoat_test_SN5659__cal_impl.Receivev27_P2 speedgoat_test_SN5659__cal_impl.Receivev27_P3 speedgoat_test_SN5659__cal_impl.Receivev27_P4 speedgoat_test_SN5659__cal_impl.Receivev27_P5 speedgoat_test_SN5659__cal_impl.Receivev28_P1 speedgoat_test_SN5659__cal_impl.Receivev28_P2 speedgoat_test_SN5659__cal_impl.Receivev28_P3 speedgoat_test_SN5659__cal_impl.Receivev28_P4 speedgoat_test_SN5659__cal_impl.Receivev28_P5 speedgoat_test_SN5659__cal_impl.Receivev29_P1 speedgoat_test_SN5659__cal_impl.Receivev29_P2 speedgoat_test_SN5659__cal_impl.Receivev29_P3 speedgoat_test_SN5659__cal_impl.Receivev29_P4 speedgoat_test_SN5659__cal_impl.Receivev29_P5 speedgoat_test_SN5659__cal_impl.Receivev2_P1 speedgoat_test_SN5659__cal_impl.Receivev2_P2 speedgoat_test_SN5659__cal_impl.Receivev2_P3 speedgoat_test_SN5659__cal_impl.Receivev2_P4 speedgoat_test_SN5659__cal_impl.Receivev2_P5 speedgoat_test_SN5659__cal_impl.Sendv210_P1 speedgoat_test_SN5659__cal_impl.Sendv210_P2 speedgoat_test_SN5659__cal_impl.Sendv210_P3 speedgoat_test_SN5659__cal_impl.Sendv211_P1 speedgoat_test_SN5659__cal_impl.Sendv211_P2 speedgoat_test_SN5659__cal_impl.Sendv211_P3 speedgoat_test_SN5659__cal_impl.Sendv212_P1 speedgoat_test_SN5659__cal_impl.Sendv212_P2 speedgoat_test_SN5659__cal_impl.Sendv212_P3 speedgoat_test_SN5659__cal_impl.Sendv213_P1 speedgoat_test_SN5659__cal_impl.Sendv213_P2 speedgoat_test_SN5659__cal_impl.Sendv213_P3 speedgoat_test_SN5659__cal_impl.Sendv214_P1 speedgoat_test_SN5659__cal_impl.Sendv214_P2 speedgoat_test_SN5659__cal_impl.Sendv214_P3 speedgoat_test_SN5659__cal_impl.Sendv215_P1 speedgoat_test_SN5659__cal_impl.Sendv215_P2 speedgoat_test_SN5659__cal_impl.Sendv215_P3 speedgoat_test_SN5659__cal_impl.Sendv21_P1 speedgoat_test_SN5659__cal_impl.Sendv21_P2 speedgoat_test_SN5659__cal_impl.Sendv21_P3 speedgoat_test_SN5659__cal_impl.Sendv22_P1 speedgoat_test_SN5659__cal_impl.Sendv22_P2 speedgoat_test_SN5659__cal_impl.Sendv22_P3 speedgoat_test_SN5659__cal_impl.Sendv23_P1 speedgoat_test_SN5659__cal_impl.Sendv23_P2 speedgoat_test_SN5659__cal_impl.Sendv23_P3 speedgoat_test_SN5659__cal_impl.Sendv24_P1 speedgoat_test_SN5659__cal_impl.Sendv24_P2 speedgoat_test_SN5659__cal_impl.Sendv24_P3 speedgoat_test_SN5659__cal_impl.Sendv25_P1 speedgoat_test_SN5659__cal_impl.Sendv25_P2 speedgoat_test_SN5659__cal_impl.Sendv25_P3 speedgoat_test_SN5659__cal_impl.Sendv26_P1 speedgoat_test_SN5659__cal_impl.Sendv26_P2 speedgoat_test_SN5659__cal_impl.Sendv26_P3 speedgoat_test_SN5659__cal_impl.Sendv27_P1 speedgoat_test_SN5659__cal_impl.Sendv27_P2 speedgoat_test_SN5659__cal_impl.Sendv27_P3 speedgoat_test_SN5659__cal_impl.Sendv28_P1 speedgoat_test_SN5659__cal_impl.Sendv28_P2 speedgoat_test_SN5659__cal_impl.Sendv28_P3 speedgoat_test_SN5659__cal_impl.Sendv29_P1 speedgoat_test_SN5659__cal_impl.Sendv29_P2 speedgoat_test_SN5659__cal_impl.Sendv29_P3 speedgoat_test_SN5659__cal_impl.Sendv2_P1 speedgoat_test_SN5659__cal_impl.Sendv2_P2 speedgoat_test_SN5659__cal_impl.Sendv2_P3 speedgoat_test_SN5659__cal_impl.Setupv2_P1_p speedgoat_test_SN5659__cal_impl.Setupv2_P2_h speedgoat_test_SN5659__cal_impl.Setupv2_P3_o speedgoat_test_SN5659__cal_impl.Setupv2_P4_p speedgoat_test_SN5659__cal_impl.Setupv2_P5_p speedgoat_test_SN5659__cal_impl.Setupv2_P6_a speedgoat_test_SN5659__cal_impl.Setupv2_P7_c speedgoat_test_SN5659__cal_impl.Setupv2_P8_o /end REF_CHARACTERISTIC
 /begin REF_MEASUREMENT speedgoat_test_SN5659_R2020b_B.IO682_SerialIN_CH1 speedgoat_test_SN5659_R2020b_B.IO682_SerialIN_CH10 speedgoat_test_SN5659_R2020b_B.IO682_SerialIN_CH11 speedgoat_test_SN5659_R2020b_B.IO682_SerialIN_CH12 speedgoat_test_SN5659_R2020b_B.IO682_SerialIN_CH13 speedgoat_test_SN5659_R2020b_B.IO682_SerialIN_CH14 speedgoat_test_SN5659_R2020b_B.IO682_SerialIN_CH15 speedgoat_test_SN5659_R2020b_B.IO682_SerialIN_CH16 speedgoat_test_SN5659_R2020b_B.IO682_SerialIN_CH2 speedgoat_test_SN5659_R2020b_B.IO682_SerialIN_CH3 speedgoat_test_SN5659_R2020b_B.IO682_SerialIN_CH4 speedgoat_test_SN5659_R2020b_B.IO682_SerialIN_CH5 speedgoat_test_SN5659_R2020b_B.IO682_SerialIN_CH6 speedgoat_test_SN5659_R2020b_B.IO682_SerialIN_CH7 speedgoat_test_SN5659_R2020b_B.IO682_SerialIN_CH8 speedgoat_test_SN5659_R2020b_B.IO682_SerialIN_CH9 speedgoat_test_SN5659_R2020b_B.Receivev2 speedgoat_test_SN5659_R2020b_B.Receivev21 speedgoat_test_SN5659_R2020b_B.Receivev210 speedgoat_test_SN5659_R2020b_B.Receivev211 speedgoat_test_SN5659_R2020b_B.Receivev212 speedgoat_test_SN5659_R2020b_B.Receivev213 speedgoat_test_SN5659_R2020b_B.Receivev214 speedgoat_test_SN5659_R2020b_B.Receivev215 speedgoat_test_SN5659_R2020b_B.Receivev22 speedgoat_test_SN5659_R2020b_B.Receivev23 speedgoat_test_SN5659_R2020b_B.Receivev24 speedgoat_test_SN5659_R2020b_B.Receivev25 speedgoat_test_SN5659_R2020b_B.Receivev26 speedgoat_test_SN5659_R2020b_B.Receivev27 speedgoat_test_SN5659_R2020b_B.Receivev28 speedgoat_test_SN5659_R2020b_B.Receivev29 speedgoat_test_SN5659_R2020b_DW.Receivev210_PWORK speedgoat_test_SN5659_R2020b_DW.Receivev211_PWORK speedgoat_test_SN5659_R2020b_DW.Receivev212_PWORK speedgoat_test_SN5659_R2020b_DW.Receivev213_PWORK speedgoat_test_SN5659_R2020b_DW.Receivev214_PWORK speedgoat_test_SN5659_R2020b_DW.Receivev215_PWORK speedgoat_test_SN5659_R2020b_DW.Receivev21_PWORK speedgoat_test_SN5659_R2020b_DW.Receivev22_PWORK speedgoat_test_SN5659_R2020b_DW.Receivev23_PWORK speedgoat_test_SN5659_R2020b_DW.Receivev24_PWORK speedgoat_test_SN5659_R2020b_DW.Receivev25_PWORK speedgoat_test_SN5659_R2020b_DW.Receivev26_PWORK speedgoat_test_SN5659_R2020b_DW.Receivev27_PWORK speedgoat_test_SN5659_R2020b_DW.Receivev28_PWORK speedgoat_test_SN5659_R2020b_DW.Receivev29_PWORK speedgoat_test_SN5659_R2020b_DW.Receivev2_PWORK speedgoat_test_SN5659_R2020b_DW.Scope10_PWORK speedgoat_test_SN5659_R2020b_DW.Scope11_PWORK speedgoat_test_SN5659_R2020b_DW.Scope4_PWORK_l speedgoat_test_SN5659_R2020b_DW.Scope5_PWORK speedgoat_test_SN5659_R2020b_DW.Scope6_PWORK speedgoat_test_SN5659_R2020b_DW.Scope7_PWORK speedgoat_test_SN5659_R2020b_DW.Scope8_PWORK speedgoat_test_SN5659_R2020b_DW.Scope9_PWORK speedgoat_test_SN5659_R2020b_DW.Sendv210_PWORK speedgoat_test_SN5659_R2020b_DW.Sendv211_PWORK speedgoat_test_SN5659_R2020b_DW.Sendv212_PWORK speedgoat_test_SN5659_R2020b_DW.Sendv213_PWORK speedgoat_test_SN5659_R2020b_DW.Sendv214_PWORK speedgoat_test_SN5659_R2020b_DW.Sendv215_PWORK speedgoat_test_SN5659_R2020b_DW.Sendv21_PWORK speedgoat_test_SN5659_R2020b_DW.Sendv22_PWORK speedgoat_test_SN5659_R2020b_DW.Sendv23_PWORK speedgoat_test_SN5659_R2020b_DW.Sendv24_PWORK speedgoat_test_SN5659_R2020b_DW.Sendv25_PWORK speedgoat_test_SN5659_R2020b_DW.Sendv26_PWORK speedgoat_test_SN5659_R2020b_DW.Sendv27_PWORK speedgoat_test_SN5659_R2020b_DW.Sendv28_PWORK speedgoat_test_SN5659_R2020b_DW.Sendv29_PWORK speedgoat_test_SN5659_R2020b_DW.Sendv2_PWORK speedgoat_test_SN5659_R2020b_DW.Setupv2_PWORK /end REF_MEASUREMENT
/end GROUP
/begin GROUP speedgoat_test_SN5659_R2020b_IO682_Decode_Channel_1 "speedgoat_test_SN5659_R2020b/IO682/Decode Channel 1"
 /begin REF_CHARACTERISTIC speedgoat_test_SN5659__cal_impl.Decode1_P1 speedgoat_test_SN5659__cal_impl.Decode1_P10 speedgoat_test_SN5659__cal_impl.Decode1_P11 speedgoat_test_SN5659__cal_impl.Decode1_P12 speedgoat_test_SN5659__cal_impl.Decode1_P13 speedgoat_test_SN5659__cal_impl.Decode1_P14 speedgoat_test_SN5659__cal_impl.Decode1_P15 speedgoat_test_SN5659__cal_impl.Decode1_P16 speedgoat_test_SN5659__cal_impl.Decode1_P2 speedgoat_test_SN5659__cal_impl.Decode1_P3 speedgoat_test_SN5659__cal_impl.Decode1_P4 speedgoat_test_SN5659__cal_impl.Decode1_P5 speedgoat_test_SN5659__cal_impl.Decode1_P6 speedgoat_test_SN5659__cal_impl.Decode1_P7 speedgoat_test_SN5659__cal_impl.Decode1_P8 speedgoat_test_SN5659__cal_impl.Decode1_P9 speedgoat_test_SN5659__cal_impl.Decode3_P1 speedgoat_test_SN5659__cal_impl.Decode3_P10 speedgoat_test_SN5659__cal_impl.Decode3_P11 speedgoat_test_SN5659__cal_impl.Decode3_P12 speedgoat_test_SN5659__cal_impl.Decode3_P13 speedgoat_test_SN5659__cal_impl.Decode3_P14 speedgoat_test_SN5659__cal_impl.Decode3_P15 speedgoat_test_SN5659__cal_impl.Decode3_P16 speedgoat_test_SN5659__cal_impl.Decode3_P2 speedgoat_test_SN5659__cal_impl.Decode3_P3 speedgoat_test_SN5659__cal_impl.Decode3_P4 speedgoat_test_SN5659__cal_impl.Decode3_P5 speedgoat_test_SN5659__cal_impl.Decode3_P6 speedgoat_test_SN5659__cal_impl.Decode3_P7 speedgoat_test_SN5659__cal_impl.Decode3_P8 speedgoat_test_SN5659__cal_impl.Decode3_P9 speedgoat_test_SN5659__cal_impl.Decode4_P1 speedgoat_test_SN5659__cal_impl.Decode4_P10 speedgoat_test_SN5659__cal_impl.Decode4_P11 speedgoat_test_SN5659__cal_impl.Decode4_P12 speedgoat_test_SN5659__cal_impl.Decode4_P13 speedgoat_test_SN5659__cal_impl.Decode4_P14 speedgoat_test_SN5659__cal_impl.Decode4_P15 speedgoat_test_SN5659__cal_impl.Decode4_P16 speedgoat_test_SN5659__cal_impl.Decode4_P2 speedgoat_test_SN5659__cal_impl.Decode4_P3 speedgoat_test_SN5659__cal_impl.Decode4_P4 speedgoat_test_SN5659__cal_impl.Decode4_P5 speedgoat_test_SN5659__cal_impl.Decode4_P6 speedgoat_test_SN5659__cal_impl.Decode4_P7 speedgoat_test_SN5659__cal_impl.Decode4_P8 speedgoat_test_SN5659__cal_impl.Decode4_P9 speedgoat_test_SN5659__cal_impl.Decode5_P1 speedgoat_test_SN5659__cal_impl.Decode5_P10 speedgoat_test_SN5659__cal_impl.Decode5_P11 speedgoat_test_SN5659__cal_impl.Decode5_P12 speedgoat_test_SN5659__cal_impl.Decode5_P13 speedgoat_test_SN5659__cal_impl.Decode5_P14 speedgoat_test_SN5659__cal_impl.Decode5_P15 speedgoat_test_SN5659__cal_impl.Decode5_P16 speedgoat_test_SN5659__cal_impl.Decode5_P2 speedgoat_test_SN5659__cal_impl.Decode5_P3 speedgoat_test_SN5659__cal_impl.Decode5_P4 speedgoat_test_SN5659__cal_impl.Decode5_P5 speedgoat_test_SN5659__cal_impl.Decode5_P6 speedgoat_test_SN5659__cal_impl.Decode5_P7 speedgoat_test_SN5659__cal_impl.Decode5_P8 speedgoat_test_SN5659__cal_impl.Decode5_P9 /end REF_CHARACTERISTIC
 /begin REF_MEASUREMENT speedgoat_test_SN5659_R2020b_B.Decode1 speedgoat_test_SN5659_R2020b_B.Decode3 speedgoat_test_SN5659_R2020b_B.Decode4 speedgoat_test_SN5659_R2020b_B.Decode5 speedgoat_test_SN5659_R2020b_B.Receivev2 /end REF_MEASUREMENT
/end GROUP
/begin GROUP speedgoat_test_SN5659_R2020b_IO682_Decode_Channel_10 "speedgoat_test_SN5659_R2020b/IO682/Decode Channel 10"
 /begin REF_CHARACTERISTIC speedgoat_test_SN5659__cal_impl.Decode1_P10_h speedgoat_test_SN5659__cal_impl.Decode1_P11_p speedgoat_test_SN5659__cal_impl.Decode1_P12_h speedgoat_test_SN5659__cal_impl.Decode1_P13_l speedgoat_test_SN5659__cal_impl.Decode1_P14_g speedgoat_test_SN5659__cal_impl.Decode1_P15_g speedgoat_test_SN5659__cal_impl.Decode1_P16_e speedgoat_test_SN5659__cal_impl.Decode1_P1_n speedgoat_test_SN5659__cal_impl.Decode1_P2_o speedgoat_test_SN5659__cal_impl.Decode1_P3_o speedgoat_test_SN5659__cal_impl.Decode1_P4_l speedgoat_test_SN5659__cal_impl.Decode1_P5_k speedgoat_test_SN5659__cal_impl.Decode1_P6_d speedgoat_test_SN5659__cal_impl.Decode1_P7_a speedgoat_test_SN5659__cal_impl.Decode1_P8_g speedgoat_test_SN5659__cal_impl.Decode1_P9_o speedgoat_test_SN5659__cal_impl.Decode2_P10_h speedgoat_test_SN5659__cal_impl.Decode2_P11_j speedgoat_test_SN5659__cal_impl.Decode2_P12_g speedgoat_test_SN5659__cal_impl.Decode2_P13_i speedgoat_test_SN5659__cal_impl.Decode2_P14_e speedgoat_test_SN5659__cal_impl.Decode2_P15_a speedgoat_test_SN5659__cal_impl.Decode2_P16_c speedgoat_test_SN5659__cal_impl.Decode2_P1_d speedgoat_test_SN5659__cal_impl.Decode2_P2_m speedgoat_test_SN5659__cal_impl.Decode2_P3_a speedgoat_test_SN5659__cal_impl.Decode2_P4_g speedgoat_test_SN5659__cal_impl.Decode2_P5_g speedgoat_test_SN5659__cal_impl.Decode2_P6_l speedgoat_test_SN5659__cal_impl.Decode2_P7_g speedgoat_test_SN5659__cal_impl.Decode2_P8_l speedgoat_test_SN5659__cal_impl.Decode2_P9_l speedgoat_test_SN5659__cal_impl.Decode3_P10_l speedgoat_test_SN5659__cal_impl.Decode3_P11_i speedgoat_test_SN5659__cal_impl.Decode3_P12_a speedgoat_test_SN5659__cal_impl.Decode3_P13_b speedgoat_test_SN5659__cal_impl.Decode3_P14_px speedgoat_test_SN5659__cal_impl.Decode3_P15_j speedgoat_test_SN5659__cal_impl.Decode3_P16_b1 speedgoat_test_SN5659__cal_impl.Decode3_P1_a1 speedgoat_test_SN5659__cal_impl.Decode3_P2_p speedgoat_test_SN5659__cal_impl.Decode3_P3_h speedgoat_test_SN5659__cal_impl.Decode3_P4_d speedgoat_test_SN5659__cal_impl.Decode3_P5_m speedgoat_test_SN5659__cal_impl.Decode3_P6_o speedgoat_test_SN5659__cal_impl.Decode3_P7_kc speedgoat_test_SN5659__cal_impl.Decode3_P8_m speedgoat_test_SN5659__cal_impl.Decode3_P9_o speedgoat_test_SN5659__cal_impl.Decode4_P10_g speedgoat_test_SN5659__cal_impl.Decode4_P11_h speedgoat_test_SN5659__cal_impl.Decode4_P12_f speedgoat_test_SN5659__cal_impl.Decode4_P13_g speedgoat_test_SN5659__cal_impl.Decode4_P14_f speedgoat_test_SN5659__cal_impl.Decode4_P15_a speedgoat_test_SN5659__cal_impl.Decode4_P16_p speedgoat_test_SN5659__cal_impl.Decode4_P1_p speedgoat_test_SN5659__cal_impl.Decode4_P2_j speedgoat_test_SN5659__cal_impl.Decode4_P3_p speedgoat_test_SN5659__cal_impl.Decode4_P4_l speedgoat_test_SN5659__cal_impl.Decode4_P5_c speedgoat_test_SN5659__cal_impl.Decode4_P6_c speedgoat_test_SN5659__cal_impl.Decode4_P7_nt speedgoat_test_SN5659__cal_impl.Decode4_P8_j speedgoat_test_SN5659__cal_impl.Decode4_P9_b /end REF_CHARACTERISTIC
 /begin REF_MEASUREMENT speedgoat_test_SN5659_R2020b_B.Decode1_g speedgoat_test_SN5659_R2020b_B.Decode2_n speedgoat_test_SN5659_R2020b_B.Decode3_j speedgoat_test_SN5659_R2020b_B.Decode4_h speedgoat_test_SN5659_R2020b_B.Receivev29 /end REF_MEASUREMENT
/end GROUP
/begin GROUP speedgoat_test_SN5659_R2020b_IO682_Decode_Channel_11 "speedgoat_test_SN5659_R2020b/IO682/Decode Channel 11"
 /begin REF_CHARACTERISTIC speedgoat_test_SN5659__cal_impl.Decode1_P10_lm speedgoat_test_SN5659__cal_impl.Decode1_P11_f speedgoat_test_SN5659__cal_impl.Decode1_P12_pv speedgoat_test_SN5659__cal_impl.Decode1_P13_fg speedgoat_test_SN5659__cal_impl.Decode1_P14_gk speedgoat_test_SN5659__cal_impl.Decode1_P15_a speedgoat_test_SN5659__cal_impl.Decode1_P16_n speedgoat_test_SN5659__cal_impl.Decode1_P1_ng speedgoat_test_SN5659__cal_impl.Decode1_P2_k speedgoat_test_SN5659__cal_impl.Decode1_P3_f speedgoat_test_SN5659__cal_impl.Decode1_P4_c speedgoat_test_SN5659__cal_impl.Decode1_P5_fb speedgoat_test_SN5659__cal_impl.Decode1_P6_b speedgoat_test_SN5659__cal_impl.Decode1_P7_m speedgoat_test_SN5659__cal_impl.Decode1_P8_e speedgoat_test_SN5659__cal_impl.Decode1_P9_b speedgoat_test_SN5659__cal_impl.Decode2_P10_c speedgoat_test_SN5659__cal_impl.Decode2_P11_f speedgoat_test_SN5659__cal_impl.Decode2_P12_f speedgoat_test_SN5659__cal_impl.Decode2_P13_k speedgoat_test_SN5659__cal_impl.Decode2_P14_m speedgoat_test_SN5659__cal_impl.Decode2_P15_c speedgoat_test_SN5659__cal_impl.Decode2_P16_m speedgoat_test_SN5659__cal_impl.Decode2_P1_g speedgoat_test_SN5659__cal_impl.Decode2_P2_e speedgoat_test_SN5659__cal_impl.Decode2_P3_e speedgoat_test_SN5659__cal_impl.Decode2_P4_l speedgoat_test_SN5659__cal_impl.Decode2_P5_f speedgoat_test_SN5659__cal_impl.Decode2_P6_o speedgoat_test_SN5659__cal_impl.Decode2_P7_m speedgoat_test_SN5659__cal_impl.Decode2_P8_f speedgoat_test_SN5659__cal_impl.Decode2_P9_p speedgoat_test_SN5659__cal_impl.Decode3_P10_f speedgoat_test_SN5659__cal_impl.Decode3_P11_h speedgoat_test_SN5659__cal_impl.Decode3_P12_k speedgoat_test_SN5659__cal_impl.Decode3_P13_m speedgoat_test_SN5659__cal_impl.Decode3_P14_l speedgoat_test_SN5659__cal_impl.Decode3_P15_l speedgoat_test_SN5659__cal_impl.Decode3_P16_h speedgoat_test_SN5659__cal_impl.Decode3_P1_k speedgoat_test_SN5659__cal_impl.Decode3_P2_o speedgoat_test_SN5659__cal_impl.Decode3_P3_c speedgoat_test_SN5659__cal_impl.Decode3_P4_i speedgoat_test_SN5659__cal_impl.Decode3_P5_a speedgoat_test_SN5659__cal_impl.Decode3_P6_i speedgoat_test_SN5659__cal_impl.Decode3_P7_c speedgoat_test_SN5659__cal_impl.Decode3_P8_g0 speedgoat_test_SN5659__cal_impl.Decode3_P9_d speedgoat_test_SN5659__cal_impl.Decode4_P10_m speedgoat_test_SN5659__cal_impl.Decode4_P11_d speedgoat_test_SN5659__cal_impl.Decode4_P12_k speedgoat_test_SN5659__cal_impl.Decode4_P13_f speedgoat_test_SN5659__cal_impl.Decode4_P14_d speedgoat_test_SN5659__cal_impl.Decode4_P15_f speedgoat_test_SN5659__cal_impl.Decode4_P16_e speedgoat_test_SN5659__cal_impl.Decode4_P1_c speedgoat_test_SN5659__cal_impl.Decode4_P2_l speedgoat_test_SN5659__cal_impl.Decode4_P3_e speedgoat_test_SN5659__cal_impl.Decode4_P4_i speedgoat_test_SN5659__cal_impl.Decode4_P5_e speedgoat_test_SN5659__cal_impl.Decode4_P6_p speedgoat_test_SN5659__cal_impl.Decode4_P7_o speedgoat_test_SN5659__cal_impl.Decode4_P8_e speedgoat_test_SN5659__cal_impl.Decode4_P9_ay /end REF_CHARACTERISTIC
 /begin REF_MEASUREMENT speedgoat_test_SN5659_R2020b_B.Decode1_f speedgoat_test_SN5659_R2020b_B.Decode2_j speedgoat_test_SN5659_R2020b_B.Decode3_k speedgoat_test_SN5659_R2020b_B.Decode4_c speedgoat_test_SN5659_R2020b_B.Receivev210 /end REF_MEASUREMENT
/end GROUP
/begin GROUP speedgoat_test_SN5659_R2020b_IO682_Decode_Channel_12 "speedgoat_test_SN5659_R2020b/IO682/Decode Channel 12"
 /begin REF_CHARACTERISTIC speedgoat_test_SN5659__cal_impl.Decode1_P10_k1 speedgoat_test_SN5659__cal_impl.Decode1_P11_i speedgoat_test_SN5659__cal_impl.Decode1_P12_j speedgoat_test_SN5659__cal_impl.Decode1_P13_aa speedgoat_test_SN5659__cal_impl.Decode1_P14_d speedgoat_test_SN5659__cal_impl.Decode1_P15_h speedgoat_test_SN5659__cal_impl.Decode1_P16_m speedgoat_test_SN5659__cal_impl.Decode1_P1_e speedgoat_test_SN5659__cal_impl.Decode1_P2_ov speedgoat_test_SN5659__cal_impl.Decode1_P3_p speedgoat_test_SN5659__cal_impl.Decode1_P4_ls speedgoat_test_SN5659__cal_impl.Decode1_P5_m speedgoat_test_SN5659__cal_impl.Decode1_P6_n speedgoat_test_SN5659__cal_impl.Decode1_P7_d speedgoat_test_SN5659__cal_impl.Decode1_P8_p speedgoat_test_SN5659__cal_impl.Decode1_P9_g speedgoat_test_SN5659__cal_impl.Decode2_P10_j speedgoat_test_SN5659__cal_impl.Decode2_P11_m speedgoat_test_SN5659__cal_impl.Decode2_P12_k speedgoat_test_SN5659__cal_impl.Decode2_P13_j speedgoat_test_SN5659__cal_impl.Decode2_P14_o speedgoat_test_SN5659__cal_impl.Decode2_P15_g speedgoat_test_SN5659__cal_impl.Decode2_P16_cj speedgoat_test_SN5659__cal_impl.Decode2_P1_e speedgoat_test_SN5659__cal_impl.Decode2_P2_j speedgoat_test_SN5659__cal_impl.Decode2_P3_k speedgoat_test_SN5659__cal_impl.Decode2_P4_c speedgoat_test_SN5659__cal_impl.Decode2_P5_c speedgoat_test_SN5659__cal_impl.Decode2_P6_p speedgoat_test_SN5659__cal_impl.Decode2_P7_o speedgoat_test_SN5659__cal_impl.Decode2_P8_b speedgoat_test_SN5659__cal_impl.Decode2_P9_g speedgoat_test_SN5659__cal_impl.Decode3_P10_o speedgoat_test_SN5659__cal_impl.Decode3_P11_k speedgoat_test_SN5659__cal_impl.Decode3_P12_ku speedgoat_test_SN5659__cal_impl.Decode3_P13_e speedgoat_test_SN5659__cal_impl.Decode3_P14_jy speedgoat_test_SN5659__cal_impl.Decode3_P15_l0 speedgoat_test_SN5659__cal_impl.Decode3_P16_hp speedgoat_test_SN5659__cal_impl.Decode3_P1_cm speedgoat_test_SN5659__cal_impl.Decode3_P2_h speedgoat_test_SN5659__cal_impl.Decode3_P3_b speedgoat_test_SN5659__cal_impl.Decode3_P4_o speedgoat_test_SN5659__cal_impl.Decode3_P5_ae speedgoat_test_SN5659__cal_impl.Decode3_P6_d speedgoat_test_SN5659__cal_impl.Decode3_P7_e speedgoat_test_SN5659__cal_impl.Decode3_P8_i speedgoat_test_SN5659__cal_impl.Decode3_P9_o2 speedgoat_test_SN5659__cal_impl.Decode4_P10_f speedgoat_test_SN5659__cal_impl.Decode4_P11_p speedgoat_test_SN5659__cal_impl.Decode4_P12_g speedgoat_test_SN5659__cal_impl.Decode4_P13_a speedgoat_test_SN5659__cal_impl.Decode4_P14_n speedgoat_test_SN5659__cal_impl.Decode4_P15_d speedgoat_test_SN5659__cal_impl.Decode4_P16_d speedgoat_test_SN5659__cal_impl.Decode4_P1_k speedgoat_test_SN5659__cal_impl.Decode4_P2_p0 speedgoat_test_SN5659__cal_impl.Decode4_P3_cw speedgoat_test_SN5659__cal_impl.Decode4_P4_p speedgoat_test_SN5659__cal_impl.Decode4_P5_a speedgoat_test_SN5659__cal_impl.Decode4_P6_a speedgoat_test_SN5659__cal_impl.Decode4_P7_g speedgoat_test_SN5659__cal_impl.Decode4_P8_i speedgoat_test_SN5659__cal_impl.Decode4_P9_d /end REF_CHARACTERISTIC
 /begin REF_MEASUREMENT speedgoat_test_SN5659_R2020b_B.Decode1_a speedgoat_test_SN5659_R2020b_B.Decode2_j2 speedgoat_test_SN5659_R2020b_B.Decode3_m speedgoat_test_SN5659_R2020b_B.Decode4_a speedgoat_test_SN5659_R2020b_B.Receivev211 /end REF_MEASUREMENT
/end GROUP
/begin GROUP speedgoat_test_SN5659_R2020b_IO682_Decode_Channel_13 "speedgoat_test_SN5659_R2020b/IO682/Decode Channel 13"
 /begin REF_CHARACTERISTIC speedgoat_test_SN5659__cal_impl.Decode1_P10_lb speedgoat_test_SN5659__cal_impl.Decode1_P11_m speedgoat_test_SN5659__cal_impl.Decode1_P12_b speedgoat_test_SN5659__cal_impl.Decode1_P13_lz speedgoat_test_SN5659__cal_impl.Decode1_P14_k speedgoat_test_SN5659__cal_impl.Decode1_P15_h1 speedgoat_test_SN5659__cal_impl.Decode1_P16_f speedgoat_test_SN5659__cal_impl.Decode1_P1_e3 speedgoat_test_SN5659__cal_impl.Decode1_P2_e speedgoat_test_SN5659__cal_impl.Decode1_P3_j speedgoat_test_SN5659__cal_impl.Decode1_P4_i speedgoat_test_SN5659__cal_impl.Decode1_P5_o speedgoat_test_SN5659__cal_impl.Decode1_P6_p speedgoat_test_SN5659__cal_impl.Decode1_P7_dn speedgoat_test_SN5659__cal_impl.Decode1_P8_lr speedgoat_test_SN5659__cal_impl.Decode1_P9_i speedgoat_test_SN5659__cal_impl.Decode3_P10_b speedgoat_test_SN5659__cal_impl.Decode3_P11_a speedgoat_test_SN5659__cal_impl.Decode3_P12_pk speedgoat_test_SN5659__cal_impl.Decode3_P13_dz speedgoat_test_SN5659__cal_impl.Decode3_P14_f speedgoat_test_SN5659__cal_impl.Decode3_P15_e speedgoat_test_SN5659__cal_impl.Decode3_P16_e speedgoat_test_SN5659__cal_impl.Decode3_P1_a1u speedgoat_test_SN5659__cal_impl.Decode3_P2_of speedgoat_test_SN5659__cal_impl.Decode3_P3_pi speedgoat_test_SN5659__cal_impl.Decode3_P4_a speedgoat_test_SN5659__cal_impl.Decode3_P5_h speedgoat_test_SN5659__cal_impl.Decode3_P6_ot speedgoat_test_SN5659__cal_impl.Decode3_P7_f speedgoat_test_SN5659__cal_impl.Decode3_P8_e speedgoat_test_SN5659__cal_impl.Decode3_P9_m speedgoat_test_SN5659__cal_impl.Decode4_P10_bm speedgoat_test_SN5659__cal_impl.Decode4_P11_l speedgoat_test_SN5659__cal_impl.Decode4_P12_o speedgoat_test_SN5659__cal_impl.Decode4_P13_c speedgoat_test_SN5659__cal_impl.Decode4_P14_l speedgoat_test_SN5659__cal_impl.Decode4_P15_i speedgoat_test_SN5659__cal_impl.Decode4_P16_c speedgoat_test_SN5659__cal_impl.Decode4_P1_pt speedgoat_test_SN5659__cal_impl.Decode4_P2_c speedgoat_test_SN5659__cal_impl.Decode4_P3_m speedgoat_test_SN5659__cal_impl.Decode4_P4_h speedgoat_test_SN5659__cal_impl.Decode4_P5_cq speedgoat_test_SN5659__cal_impl.Decode4_P6_e speedgoat_test_SN5659__cal_impl.Decode4_P7_d speedgoat_test_SN5659__cal_impl.Decode4_P8_gh speedgoat_test_SN5659__cal_impl.Decode4_P9_n speedgoat_test_SN5659__cal_impl.Decode5_P10_k speedgoat_test_SN5659__cal_impl.Decode5_P11_c speedgoat_test_SN5659__cal_impl.Decode5_P12_e speedgoat_test_SN5659__cal_impl.Decode5_P13_o speedgoat_test_SN5659__cal_impl.Decode5_P14_g speedgoat_test_SN5659__cal_impl.Decode5_P15_o speedgoat_test_SN5659__cal_impl.Decode5_P16_m speedgoat_test_SN5659__cal_impl.Decode5_P1_m speedgoat_test_SN5659__cal_impl.Decode5_P2_f speedgoat_test_SN5659__cal_impl.Decode5_P3_d speedgoat_test_SN5659__cal_impl.Decode5_P4_j speedgoat_test_SN5659__cal_impl.Decode5_P5_n speedgoat_test_SN5659__cal_impl.Decode5_P6_b speedgoat_test_SN5659__cal_impl.Decode5_P7_j speedgoat_test_SN5659__cal_impl.Decode5_P8_d speedgoat_test_SN5659__cal_impl.Decode5_P9_i /end REF_CHARACTERISTIC
 /begin REF_MEASUREMENT speedgoat_test_SN5659_R2020b_B.Decode1_i speedgoat_test_SN5659_R2020b_B.Decode3_o speedgoat_test_SN5659_R2020b_B.Decode4_b speedgoat_test_SN5659_R2020b_B.Decode5_i speedgoat_test_SN5659_R2020b_B.Receivev212 /end REF_MEASUREMENT
/end GROUP
/begin GROUP speedgoat_test_SN5659_R2020b_IO682_Decode_Channel_14 "speedgoat_test_SN5659_R2020b/IO682/Decode Channel 14"
 /begin REF_CHARACTERISTIC speedgoat_test_SN5659__cal_impl.Decode1_P10_a speedgoat_test_SN5659__cal_impl.Decode1_P11_g speedgoat_test_SN5659__cal_impl.Decode1_P12_d speedgoat_test_SN5659__cal_impl.Decode1_P13_c speedgoat_test_SN5659__cal_impl.Decode1_P14_gc speedgoat_test_SN5659__cal_impl.Decode1_P15_j speedgoat_test_SN5659__cal_impl.Decode1_P16_jd speedgoat_test_SN5659__cal_impl.Decode1_P1_d speedgoat_test_SN5659__cal_impl.Decode1_P2_en speedgoat_test_SN5659__cal_impl.Decode1_P3_c speedgoat_test_SN5659__cal_impl.Decode1_P4_m speedgoat_test_SN5659__cal_impl.Decode1_P5_c speedgoat_test_SN5659__cal_impl.Decode1_P6_i speedgoat_test_SN5659__cal_impl.Decode1_P7_o speedgoat_test_SN5659__cal_impl.Decode1_P8_i speedgoat_test_SN5659__cal_impl.Decode1_P9_l speedgoat_test_SN5659__cal_impl.Decode2_P10_n speedgoat_test_SN5659__cal_impl.Decode2_P11_k speedgoat_test_SN5659__cal_impl.Decode2_P12_i speedgoat_test_SN5659__cal_impl.Decode2_P13_e speedgoat_test_SN5659__cal_impl.Decode2_P14_b speedgoat_test_SN5659__cal_impl.Decode2_P15_n speedgoat_test_SN5659__cal_impl.Decode2_P16_n speedgoat_test_SN5659__cal_impl.Decode2_P1_h speedgoat_test_SN5659__cal_impl.Decode2_P2_h speedgoat_test_SN5659__cal_impl.Decode2_P3_d speedgoat_test_SN5659__cal_impl.Decode2_P4_f speedgoat_test_SN5659__cal_impl.Decode2_P5_gd speedgoat_test_SN5659__cal_impl.Decode2_P6_oa speedgoat_test_SN5659__cal_impl.Decode2_P7_j speedgoat_test_SN5659__cal_impl.Decode2_P8_h speedgoat_test_SN5659__cal_impl.Decode2_P9_pb speedgoat_test_SN5659__cal_impl.Decode3_P10_c speedgoat_test_SN5659__cal_impl.Decode3_P11_d speedgoat_test_SN5659__cal_impl.Decode3_P12_b speedgoat_test_SN5659__cal_impl.Decode3_P13_i speedgoat_test_SN5659__cal_impl.Decode3_P14_k speedgoat_test_SN5659__cal_impl.Decode3_P15_jx speedgoat_test_SN5659__cal_impl.Decode3_P16_f speedgoat_test_SN5659__cal_impl.Decode3_P1_e speedgoat_test_SN5659__cal_impl.Decode3_P2_l2 speedgoat_test_SN5659__cal_impl.Decode3_P3_cq speedgoat_test_SN5659__cal_impl.Decode3_P4_j speedgoat_test_SN5659__cal_impl.Decode3_P5_n speedgoat_test_SN5659__cal_impl.Decode3_P6_e speedgoat_test_SN5659__cal_impl.Decode3_P7_b speedgoat_test_SN5659__cal_impl.Decode3_P8_p speedgoat_test_SN5659__cal_impl.Decode3_P9_hu speedgoat_test_SN5659__cal_impl.Decode4_P10_h speedgoat_test_SN5659__cal_impl.Decode4_P11_n speedgoat_test_SN5659__cal_impl.Decode4_P12_c speedgoat_test_SN5659__cal_impl.Decode4_P13_ct speedgoat_test_SN5659__cal_impl.Decode4_P14_j speedgoat_test_SN5659__cal_impl.Decode4_P15_dw speedgoat_test_SN5659__cal_impl.Decode4_P16_o speedgoat_test_SN5659__cal_impl.Decode4_P1_a speedgoat_test_SN5659__cal_impl.Decode4_P2_m speedgoat_test_SN5659__cal_impl.Decode4_P3_mr speedgoat_test_SN5659__cal_impl.Decode4_P4_f speedgoat_test_SN5659__cal_impl.Decode4_P5_cn speedgoat_test_SN5659__cal_impl.Decode4_P6_aw speedgoat_test_SN5659__cal_impl.Decode4_P7_b speedgoat_test_SN5659__cal_impl.Decode4_P8_m speedgoat_test_SN5659__cal_impl.Decode4_P9_o /end REF_CHARACTERISTIC
 /begin REF_MEASUREMENT speedgoat_test_SN5659_R2020b_B.Decode1_my speedgoat_test_SN5659_R2020b_B.Decode2_i speedgoat_test_SN5659_R2020b_B.Decode3_n speedgoat_test_SN5659_R2020b_B.Decode4_c1 speedgoat_test_SN5659_R2020b_B.Receivev213 /end REF_MEASUREMENT
/end GROUP
/begin GROUP speedgoat_test_SN5659_R2020b_IO682_Decode_Channel_15 "speedgoat_test_SN5659_R2020b/IO682/Decode Channel 15"
 /begin REF_CHARACTERISTIC speedgoat_test_SN5659__cal_impl.Decode1_P10_lbu speedgoat_test_SN5659__cal_impl.Decode1_P11_fz speedgoat_test_SN5659__cal_impl.Decode1_P12_k speedgoat_test_SN5659__cal_impl.Decode1_P13_d speedgoat_test_SN5659__cal_impl.Decode1_P14_i speedgoat_test_SN5659__cal_impl.Decode1_P15_n speedgoat_test_SN5659__cal_impl.Decode1_P16_js speedgoat_test_SN5659__cal_impl.Decode1_P1_l speedgoat_test_SN5659__cal_impl.Decode1_P2_f speedgoat_test_SN5659__cal_impl.Decode1_P3_j5 speedgoat_test_SN5659__cal_impl.Decode1_P4_cf speedgoat_test_SN5659__cal_impl.Decode1_P5_a speedgoat_test_SN5659__cal_impl.Decode1_P6_fp speedgoat_test_SN5659__cal_impl.Decode1_P7_b speedgoat_test_SN5659__cal_impl.Decode1_P8_pw speedgoat_test_SN5659__cal_impl.Decode1_P9_d speedgoat_test_SN5659__cal_impl.Decode2_P10_b speedgoat_test_SN5659__cal_impl.Decode2_P11_b speedgoat_test_SN5659__cal_impl.Decode2_P12_l speedgoat_test_SN5659__cal_impl.Decode2_P13_f speedgoat_test_SN5659__cal_impl.Decode2_P14_mb speedgoat_test_SN5659__cal_impl.Decode2_P15_j speedgoat_test_SN5659__cal_impl.Decode2_P16_j speedgoat_test_SN5659__cal_impl.Decode2_P1_o speedgoat_test_SN5659__cal_impl.Decode2_P2_ex speedgoat_test_SN5659__cal_impl.Decode2_P3_g speedgoat_test_SN5659__cal_impl.Decode2_P4_j speedgoat_test_SN5659__cal_impl.Decode2_P5_e speedgoat_test_SN5659__cal_impl.Decode2_P6_pp speedgoat_test_SN5659__cal_impl.Decode2_P7_mb speedgoat_test_SN5659__cal_impl.Decode2_P8_c speedgoat_test_SN5659__cal_impl.Decode2_P9_n speedgoat_test_SN5659__cal_impl.Decode3_P10_n speedgoat_test_SN5659__cal_impl.Decode3_P11_k1 speedgoat_test_SN5659__cal_impl.Decode3_P12_l speedgoat_test_SN5659__cal_impl.Decode3_P13_l speedgoat_test_SN5659__cal_impl.Decode3_P14_fx speedgoat_test_SN5659__cal_impl.Decode3_P15_p speedgoat_test_SN5659__cal_impl.Decode3_P16_o speedgoat_test_SN5659__cal_impl.Decode3_P1_b speedgoat_test_SN5659__cal_impl.Decode3_P2_ls speedgoat_test_SN5659__cal_impl.Decode3_P3_l speedgoat_test_SN5659__cal_impl.Decode3_P4_ja speedgoat_test_SN5659__cal_impl.Decode3_P5_f speedgoat_test_SN5659__cal_impl.Decode3_P6_d3 speedgoat_test_SN5659__cal_impl.Decode3_P7_i speedgoat_test_SN5659__cal_impl.Decode3_P8_m3 speedgoat_test_SN5659__cal_impl.Decode3_P9_h1 speedgoat_test_SN5659__cal_impl.Decode4_P10_e speedgoat_test_SN5659__cal_impl.Decode4_P11_gt speedgoat_test_SN5659__cal_impl.Decode4_P12_n speedgoat_test_SN5659__cal_impl.Decode4_P13_i speedgoat_test_SN5659__cal_impl.Decode4_P14_a speedgoat_test_SN5659__cal_impl.Decode4_P15_i0 speedgoat_test_SN5659__cal_impl.Decode4_P16_l speedgoat_test_SN5659__cal_impl.Decode4_P1_kt speedgoat_test_SN5659__cal_impl.Decode4_P2_lo speedgoat_test_SN5659__cal_impl.Decode4_P3_b speedgoat_test_SN5659__cal_impl.Decode4_P4_hz speedgoat_test_SN5659__cal_impl.Decode4_P5_l speedgoat_test_SN5659__cal_impl.Decode4_P6_f speedgoat_test_SN5659__cal_impl.Decode4_P7_fb speedgoat_test_SN5659__cal_impl.Decode4_P8_d speedgoat_test_SN5659__cal_impl.Decode4_P9_l /end REF_CHARACTERISTIC
 /begin REF_MEASUREMENT speedgoat_test_SN5659_R2020b_B.Decode1_n speedgoat_test_SN5659_R2020b_B.Decode2_b speedgoat_test_SN5659_R2020b_B.Decode3_cq speedgoat_test_SN5659_R2020b_B.Decode4_oi speedgoat_test_SN5659_R2020b_B.Receivev214 /end REF_MEASUREMENT
/end GROUP
/begin GROUP speedgoat_test_SN5659_R2020b_IO682_Decode_Channel_16 "speedgoat_test_SN5659_R2020b/IO682/Decode Channel 16"
 /begin REF_CHARACTERISTIC speedgoat_test_SN5659__cal_impl.Decode1_P10_e speedgoat_test_SN5659__cal_impl.Decode1_P11_a speedgoat_test_SN5659__cal_impl.Decode1_P12_a speedgoat_test_SN5659__cal_impl.Decode1_P13_k speedgoat_test_SN5659__cal_impl.Decode1_P14_o4 speedgoat_test_SN5659__cal_impl.Decode1_P15_be speedgoat_test_SN5659__cal_impl.Decode1_P16_ey speedgoat_test_SN5659__cal_impl.Decode1_P1_i speedgoat_test_SN5659__cal_impl.Decode1_P2_j speedgoat_test_SN5659__cal_impl.Decode1_P3_f2 speedgoat_test_SN5659__cal_impl.Decode1_P4_p speedgoat_test_SN5659__cal_impl.Decode1_P5_nq speedgoat_test_SN5659__cal_impl.Decode1_P6_ba speedgoat_test_SN5659__cal_impl.Decode1_P7_hm speedgoat_test_SN5659__cal_impl.Decode1_P8_gl speedgoat_test_SN5659__cal_impl.Decode1_P9_dd speedgoat_test_SN5659__cal_impl.Decode2_P10_js speedgoat_test_SN5659__cal_impl.Decode2_P11_jv speedgoat_test_SN5659__cal_impl.Decode2_P12_p speedgoat_test_SN5659__cal_impl.Decode2_P13_iy speedgoat_test_SN5659__cal_impl.Decode2_P14_f speedgoat_test_SN5659__cal_impl.Decode2_P15_cj speedgoat_test_SN5659__cal_impl.Decode2_P16_i speedgoat_test_SN5659__cal_impl.Decode2_P1_c speedgoat_test_SN5659__cal_impl.Decode2_P2_k speedgoat_test_SN5659__cal_impl.Decode2_P3_b speedgoat_test_SN5659__cal_impl.Decode2_P4_o speedgoat_test_SN5659__cal_impl.Decode2_P5_j speedgoat_test_SN5659__cal_impl.Decode2_P6_h speedgoat_test_SN5659__cal_impl.Decode2_P7_jq speedgoat_test_SN5659__cal_impl.Decode2_P8_j speedgoat_test_SN5659__cal_impl.Decode2_P9_c speedgoat_test_SN5659__cal_impl.Decode3_P10_m speedgoat_test_SN5659__cal_impl.Decode3_P11_bu speedgoat_test_SN5659__cal_impl.Decode3_P12_f speedgoat_test_SN5659__cal_impl.Decode3_P13_f speedgoat_test_SN5659__cal_impl.Decode3_P14_n speedgoat_test_SN5659__cal_impl.Decode3_P15_b speedgoat_test_SN5659__cal_impl.Decode3_P16_fl speedgoat_test_SN5659__cal_impl.Decode3_P1_kn speedgoat_test_SN5659__cal_impl.Decode3_P2_js speedgoat_test_SN5659__cal_impl.Decode3_P3_jq speedgoat_test_SN5659__cal_impl.Decode3_P4_o3 speedgoat_test_SN5659__cal_impl.Decode3_P5_g speedgoat_test_SN5659__cal_impl.Decode3_P6_ih speedgoat_test_SN5659__cal_impl.Decode3_P7_cp speedgoat_test_SN5659__cal_impl.Decode3_P8_l speedgoat_test_SN5659__cal_impl.Decode3_P9_hv speedgoat_test_SN5659__cal_impl.Decode4_P10_a speedgoat_test_SN5659__cal_impl.Decode4_P11_hn speedgoat_test_SN5659__cal_impl.Decode4_P12_ko speedgoat_test_SN5659__cal_impl.Decode4_P13_h speedgoat_test_SN5659__cal_impl.Decode4_P14_aq speedgoat_test_SN5659__cal_impl.Decode4_P15_ft speedgoat_test_SN5659__cal_impl.Decode4_P16_a speedgoat_test_SN5659__cal_impl.Decode4_P1_n speedgoat_test_SN5659__cal_impl.Decode4_P2_n speedgoat_test_SN5659__cal_impl.Decode4_P3_j speedgoat_test_SN5659__cal_impl.Decode4_P4_hj speedgoat_test_SN5659__cal_impl.Decode4_P5_k speedgoat_test_SN5659__cal_impl.Decode4_P6_aj speedgoat_test_SN5659__cal_impl.Decode4_P7_h speedgoat_test_SN5659__cal_impl.Decode4_P8_iy speedgoat_test_SN5659__cal_impl.Decode4_P9_bz /end REF_CHARACTERISTIC
 /begin REF_MEASUREMENT speedgoat_test_SN5659_R2020b_B.Decode1_al speedgoat_test_SN5659_R2020b_B.Decode2_l speedgoat_test_SN5659_R2020b_B.Decode3_ou speedgoat_test_SN5659_R2020b_B.Decode4_p speedgoat_test_SN5659_R2020b_B.Receivev215 /end REF_MEASUREMENT
/end GROUP
/begin GROUP speedgoat_test_SN5659_R2020b_IO682_Decode_Channel_2 "speedgoat_test_SN5659_R2020b/IO682/Decode Channel 2"
 /begin REF_CHARACTERISTIC speedgoat_test_SN5659__cal_impl.Decode1_P10_k speedgoat_test_SN5659__cal_impl.Decode1_P11_e speedgoat_test_SN5659__cal_impl.Decode1_P12_p speedgoat_test_SN5659__cal_impl.Decode1_P13_a speedgoat_test_SN5659__cal_impl.Decode1_P14_o speedgoat_test_SN5659__cal_impl.Decode1_P15_l speedgoat_test_SN5659__cal_impl.Decode1_P16_j speedgoat_test_SN5659__cal_impl.Decode1_P1_c speedgoat_test_SN5659__cal_impl.Decode1_P2_g speedgoat_test_SN5659__cal_impl.Decode1_P3_b speedgoat_test_SN5659__cal_impl.Decode1_P4_b speedgoat_test_SN5659__cal_impl.Decode1_P5_f speedgoat_test_SN5659__cal_impl.Decode1_P6_f speedgoat_test_SN5659__cal_impl.Decode1_P7_h speedgoat_test_SN5659__cal_impl.Decode1_P8_c speedgoat_test_SN5659__cal_impl.Decode1_P9_p speedgoat_test_SN5659__cal_impl.Decode2_P1 speedgoat_test_SN5659__cal_impl.Decode2_P10 speedgoat_test_SN5659__cal_impl.Decode2_P11 speedgoat_test_SN5659__cal_impl.Decode2_P12 speedgoat_test_SN5659__cal_impl.Decode2_P13 speedgoat_test_SN5659__cal_impl.Decode2_P14 speedgoat_test_SN5659__cal_impl.Decode2_P15 speedgoat_test_SN5659__cal_impl.Decode2_P16 speedgoat_test_SN5659__cal_impl.Decode2_P2 speedgoat_test_SN5659__cal_impl.Decode2_P3 speedgoat_test_SN5659__cal_impl.Decode2_P4 speedgoat_test_SN5659__cal_impl.Decode2_P5 speedgoat_test_SN5659__cal_impl.Decode2_P6 speedgoat_test_SN5659__cal_impl.Decode2_P7 speedgoat_test_SN5659__cal_impl.Decode2_P8 speedgoat_test_SN5659__cal_impl.Decode2_P9 speedgoat_test_SN5659__cal_impl.Decode3_P10_a speedgoat_test_SN5659__cal_impl.Decode3_P11_b speedgoat_test_SN5659__cal_impl.Decode3_P12_p speedgoat_test_SN5659__cal_impl.Decode3_P13_d speedgoat_test_SN5659__cal_impl.Decode3_P14_j speedgoat_test_SN5659__cal_impl.Decode3_P15_d speedgoat_test_SN5659__cal_impl.Decode3_P16_b speedgoat_test_SN5659__cal_impl.Decode3_P1_a speedgoat_test_SN5659__cal_impl.Decode3_P2_l speedgoat_test_SN5659__cal_impl.Decode3_P3_p speedgoat_test_SN5659__cal_impl.Decode3_P4_m speedgoat_test_SN5659__cal_impl.Decode3_P5_c speedgoat_test_SN5659__cal_impl.Decode3_P6_k speedgoat_test_SN5659__cal_impl.Decode3_P7_k speedgoat_test_SN5659__cal_impl.Decode3_P8_g speedgoat_test_SN5659__cal_impl.Decode3_P9_h speedgoat_test_SN5659__cal_impl.Decode4_P10_b speedgoat_test_SN5659__cal_impl.Decode4_P11_m speedgoat_test_SN5659__cal_impl.Decode4_P12_d speedgoat_test_SN5659__cal_impl.Decode4_P13_p speedgoat_test_SN5659__cal_impl.Decode4_P14_h speedgoat_test_SN5659__cal_impl.Decode4_P15_c speedgoat_test_SN5659__cal_impl.Decode4_P16_g speedgoat_test_SN5659__cal_impl.Decode4_P1_g speedgoat_test_SN5659__cal_impl.Decode4_P2_p speedgoat_test_SN5659__cal_impl.Decode4_P3_c speedgoat_test_SN5659__cal_impl.Decode4_P4_e speedgoat_test_SN5659__cal_impl.Decode4_P5_p speedgoat_test_SN5659__cal_impl.Decode4_P6_h speedgoat_test_SN5659__cal_impl.Decode4_P7_f speedgoat_test_SN5659__cal_impl.Decode4_P8_b speedgoat_test_SN5659__cal_impl.Decode4_P9_a /end REF_CHARACTERISTIC
 /begin REF_MEASUREMENT speedgoat_test_SN5659_R2020b_B.Decode1_m speedgoat_test_SN5659_R2020b_B.Decode2 speedgoat_test_SN5659_R2020b_B.Decode3_l speedgoat_test_SN5659_R2020b_B.Decode4_d speedgoat_test_SN5659_R2020b_B.Receivev21 /end REF_MEASUREMENT
/end GROUP
/begin GROUP speedgoat_test_SN5659_R2020b_IO682_Decode_Channel_3 "speedgoat_test_SN5659_R2020b/IO682/Decode Channel 3" /begin REF_MEASUREMENT speedgoat_test_SN5659_R2020b_B.Receivev22 /end REF_MEASUREMENT /end GROUP
/begin GROUP speedgoat_test_SN5659_R2020b_IO682_Decode_Channel_4 "speedgoat_test_SN5659_R2020b/IO682/Decode Channel 4" /begin REF_MEASUREMENT speedgoat_test_SN5659_R2020b_B.Receivev23 /end REF_MEASUREMENT /end GROUP
/begin GROUP speedgoat_test_SN5659_R2020b_IO682_Decode_Channel_5 "speedgoat_test_SN5659_R2020b/IO682/Decode Channel 5" /begin REF_MEASUREMENT speedgoat_test_SN5659_R2020b_B.Receivev24 /end REF_MEASUREMENT /end GROUP
/begin GROUP speedgoat_test_SN5659_R2020b_IO682_Decode_Channel_6 "speedgoat_test_SN5659_R2020b/IO682/Decode Channel 6" /begin REF_MEASUREMENT speedgoat_test_SN5659_R2020b_B.Receivev25 /end REF_MEASUREMENT /end GROUP
/begin GROUP speedgoat_test_SN5659_R2020b_IO682_Decode_Channel_7 "speedgoat_test_SN5659_R2020b/IO682/Decode Channel 7" /begin REF_MEASUREMENT speedgoat_test_SN5659_R2020b_B.Receivev26 /end REF_MEASUREMENT /end GROUP
/begin GROUP speedgoat_test_SN5659_R2020b_IO682_Decode_Channel_8 "speedgoat_test_SN5659_R2020b/IO682/Decode Channel 8" /begin REF_MEASUREMENT speedgoat_test_SN5659_R2020b_B.Receivev27 /end REF_MEASUREMENT /end GROUP
/begin GROUP speedgoat_test_SN5659_R2020b_IO682_Decode_Channel_9 "speedgoat_test_SN5659_R2020b/IO682/Decode Channel 9" /begin REF_MEASUREMENT speedgoat_test_SN5659_R2020b_B.Receivev28 /end REF_MEASUREMENT /end GROUP
/end MODULE
/end PROJECT
