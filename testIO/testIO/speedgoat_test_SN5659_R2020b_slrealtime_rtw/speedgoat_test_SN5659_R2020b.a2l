ASAP2_VERSION 1 71
/begin PROJECT ProjectName "Project Comment Goes Here"
/begin HEADER "Header Comments go here" /end HEADER
/begin MODULE ModuleName "Module Comment Goes Here"
/begin MOD_COMMON "Mod Common Comment Here" BYTE_ORDER MSB_LAST ALIGNMENT_BYTE 1 ALIGNMENT_WORD 2 ALIGNMENT_LONG 4 ALIGNMENT_FLOAT32_IEEE 4 ALIGNMENT_FLOAT64_IEEE 8 ALIGNMENT_INT64 8 /end MOD_COMMON
/begin CHARACTERISTIC speedgoat_test_SN5659__cal_impl.Constant_Value "" VALUE 0x008E8B48 Scalar_FLOAT64_IEEE 0 speedgoat_test_SN5659_R2020b_CM_double -1.7E+308 1.7E+308 /end CHARACTERISTIC
/begin CHARACTERISTIC speedgoat_test_SN5659__cal_impl.Constant_Value_c "" VALUE 0x008EFCAC Scalar_UWORD 0 speedgoat_test_SN5659_R2020b_CM_uint16 0 65535 /end CHARACTERISTIC
/begin CHARACTERISTIC speedgoat_test_SN5659__cal_impl.Constant_Value_dm "" VALUE 0x008EFCB2 Scalar_UWORD 0 speedgoat_test_SN5659_R2020b_CM_uint16 0 65535 /end CHARACTERISTIC
/begin CHARACTERISTIC speedgoat_test_SN5659__cal_impl.Constant_Value_i "" VALUE 0x008E9828 Scalar_FLOAT64_IEEE 0 speedgoat_test_SN5659_R2020b_CM_double -1.7E+308 1.7E+308 /end CHARACTERISTIC
/begin CHARACTERISTIC speedgoat_test_SN5659__cal_impl.Constant_Value_j "" VALUE 0x008E91B8 Scalar_FLOAT64_IEEE 0 speedgoat_test_SN5659_R2020b_CM_double -1.7E+308 1.7E+308 /end CHARACTERISTIC
/begin CHARACTERISTIC speedgoat_test_SN5659__cal_impl.CounterLimited_uplimit "" VALUE 0x008DF060 Scalar_UWORD 0 speedgoat_test_SN5659_R2020b_CM_uint16 0 65535 /end CHARACTERISTIC
/begin CHARACTERISTIC speedgoat_test_SN5659__cal_impl.CounterLimited_uplimit_d "" VALUE 0x008DF062 Scalar_UWORD 0 speedgoat_test_SN5659_R2020b_CM_uint16 0 65535 /end CHARACTERISTIC
/begin CHARACTERISTIC speedgoat_test_SN5659__cal_impl.Decode1_P10_aa "" VAL_BLK 0x008E6078 Scalar_FLOAT64_IEEE 0 speedgoat_test_SN5659_R2020b_CM_double -1.7E+308 1.7E+308 MATRIX_DIM 2 1 /end CHARACTERISTIC
/begin CHARACTERISTIC speedgoat_test_SN5659__cal_impl.Decode1_P10_d "" VAL_BLK 0x008E6710 Scalar_FLOAT64_IEEE 0 speedgoat_test_SN5659_R2020b_CM_double -1.7E+308 1.7E+308 MATRIX_DIM 2 1 /end CHARACTERISTIC
/begin CHARACTERISTIC speedgoat_test_SN5659__cal_impl.Decode1_P10_e1 "" VAL_BLK 0x008E7440 Scalar_FLOAT64_IEEE 0 speedgoat_test_SN5659_R2020b_CM_double -1.7E+308 1.7E+308 MATRIX_DIM 2 1 /end CHARACTERISTIC
/begin CHARACTERISTIC speedgoat_test_SN5659__cal_impl.Decode1_P10_g "" VAL_BLK 0x008E7AD8 Scalar_FLOAT64_IEEE 0 speedgoat_test_SN5659_R2020b_CM_double -1.7E+308 1.7E+308 MATRIX_DIM 2 1 /end CHARACTERISTIC
/begin CHARACTERISTIC speedgoat_test_SN5659__cal_impl.Decode1_P10_j "" VAL_BLK 0x008E6DA8 Scalar_FLOAT64_IEEE 0 speedgoat_test_SN5659_R2020b_CM_double -1.7E+308 1.7E+308 MATRIX_DIM 2 1 /end CHARACTERISTIC
/begin CHARACTERISTIC speedgoat_test_SN5659__cal_impl.Decode1_P10_l "" VAL_BLK 0x008E2BB8 Scalar_FLOAT64_IEEE 0 speedgoat_test_SN5659_R2020b_CM_double -1.7E+308 1.7E+308 MATRIX_DIM 2 1 /end CHARACTERISTIC
/begin CHARACTERISTIC speedgoat_test_SN5659__cal_impl.Decode1_P10_m "" VAL_BLK 0x008E8170 Scalar_FLOAT64_IEEE 0 speedgoat_test_SN5659_R2020b_CM_double -1.7E+308 1.7E+308 MATRIX_DIM 2 1 /end CHARACTERISTIC
/begin CHARACTERISTIC speedgoat_test_SN5659__cal_impl.Decode1_P11_al "" VALUE 0x008E7460 Scalar_FLOAT64_IEEE 0 speedgoat_test_SN5659_R2020b_CM_double -1.7E+308 1.7E+308 /end CHARACTERISTIC
/begin CHARACTERISTIC speedgoat_test_SN5659__cal_impl.Decode1_P11_c "" VALUE 0x008E6730 Scalar_FLOAT64_IEEE 0 speedgoat_test_SN5659_R2020b_CM_double -1.7E+308 1.7E+308 /end CHARACTERISTIC
/begin CHARACTERISTIC speedgoat_test_SN5659__cal_impl.Decode1_P11_d "" VALUE 0x008E8190 Scalar_FLOAT64_IEEE 0 speedgoat_test_SN5659_R2020b_CM_double -1.7E+308 1.7E+308 /end CHARACTERISTIC
/begin CHARACTERISTIC speedgoat_test_SN5659__cal_impl.Decode1_P11_ee "" VALUE 0x008E6DC8 Scalar_FLOAT64_IEEE 0 speedgoat_test_SN5659_R2020b_CM_double -1.7E+308 1.7E+308 /end CHARACTERISTIC
/begin CHARACTERISTIC speedgoat_test_SN5659__cal_impl.Decode1_P11_ei "" VALUE 0x008E6098 Scalar_FLOAT64_IEEE 0 speedgoat_test_SN5659_R2020b_CM_double -1.7E+308 1.7E+308 /end CHARACTERISTIC
/begin CHARACTERISTIC speedgoat_test_SN5659__cal_impl.Decode1_P11_eo "" VALUE 0x008E7AF8 Scalar_FLOAT64_IEEE 0 speedgoat_test_SN5659_R2020b_CM_double -1.7E+308 1.7E+308 /end CHARACTERISTIC
/begin CHARACTERISTIC speedgoat_test_SN5659__cal_impl.Decode1_P11_eu "" VALUE 0x008E2BD8 Scalar_FLOAT64_IEEE 0 speedgoat_test_SN5659_R2020b_CM_double -1.7E+308 1.7E+308 /end CHARACTERISTIC
/begin CHARACTERISTIC speedgoat_test_SN5659__cal_impl.Decode1_P12_d5 "" VALUE 0x008E6DE0 Scalar_FLOAT64_IEEE 0 speedgoat_test_SN5659_R2020b_CM_double -1.7E+308 1.7E+308 /end CHARACTERISTIC
/begin CHARACTERISTIC speedgoat_test_SN5659__cal_impl.Decode1_P12_jm "" VALUE 0x008E60B0 Scalar_FLOAT64_IEEE 0 speedgoat_test_SN5659_R2020b_CM_double -1.7E+308 1.7E+308 /end CHARACTERISTIC
/begin CHARACTERISTIC speedgoat_test_SN5659__cal_impl.Decode1_P12_kj "" VALUE 0x008E7478 Scalar_FLOAT64_IEEE 0 speedgoat_test_SN5659_R2020b_CM_double -1.7E+308 1.7E+308 /end CHARACTERISTIC
/begin CHARACTERISTIC speedgoat_test_SN5659__cal_impl.Decode1_P12_m "" VALUE 0x008E7B10 Scalar_FLOAT64_IEEE 0 speedgoat_test_SN5659_R2020b_CM_double -1.7E+308 1.7E+308 /end CHARACTERISTIC
/begin CHARACTERISTIC speedgoat_test_SN5659__cal_impl.Decode1_P12_n "" VALUE 0x008E81A8 Scalar_FLOAT64_IEEE 0 speedgoat_test_SN5659_R2020b_CM_double -1.7E+308 1.7E+308 /end CHARACTERISTIC
/begin CHARACTERISTIC speedgoat_test_SN5659__cal_impl.Decode1_P12_pl "" VALUE 0x008E2BF0 Scalar_FLOAT64_IEEE 0 speedgoat_test_SN5659_R2020b_CM_double -1.7E+308 1.7E+308 /end CHARACTERISTIC
/begin CHARACTERISTIC speedgoat_test_SN5659__cal_impl.Decode1_P12_po "" VALUE 0x008E6748 Scalar_FLOAT64_IEEE 0 speedgoat_test_SN5659_R2020b_CM_double -1.7E+308 1.7E+308 /end CHARACTERISTIC
/begin CHARACTERISTIC speedgoat_test_SN5659__cal_impl.Decode1_P13_ad "" VALUE 0x008E6DF8 Scalar_FLOAT64_IEEE 0 speedgoat_test_SN5659_R2020b_CM_double -1.7E+308 1.7E+308 /end CHARACTERISTIC
/begin CHARACTERISTIC speedgoat_test_SN5659__cal_impl.Decode1_P13_cn "" VALUE 0x008E81C0 Scalar_FLOAT64_IEEE 0 speedgoat_test_SN5659_R2020b_CM_double -1.7E+308 1.7E+308 /end CHARACTERISTIC
/begin CHARACTERISTIC speedgoat_test_SN5659__cal_impl.Decode1_P13_e "" VALUE 0x008E60C8 Scalar_FLOAT64_IEEE 0 speedgoat_test_SN5659_R2020b_CM_double -1.7E+308 1.7E+308 /end CHARACTERISTIC
/begin CHARACTERISTIC speedgoat_test_SN5659__cal_impl.Decode1_P13_f "" VALUE 0x008E2C08 Scalar_FLOAT64_IEEE 0 speedgoat_test_SN5659_R2020b_CM_double -1.7E+308 1.7E+308 /end CHARACTERISTIC
/begin CHARACTERISTIC speedgoat_test_SN5659__cal_impl.Decode1_P13_fl "" VALUE 0x008E7B28 Scalar_FLOAT64_IEEE 0 speedgoat_test_SN5659_R2020b_CM_double -1.7E+308 1.7E+308 /end CHARACTERISTIC
/begin CHARACTERISTIC speedgoat_test_SN5659__cal_impl.Decode1_P13_m "" VALUE 0x008E7490 Scalar_FLOAT64_IEEE 0 speedgoat_test_SN5659_R2020b_CM_double -1.7E+308 1.7E+308 /end CHARACTERISTIC
/begin CHARACTERISTIC speedgoat_test_SN5659__cal_impl.Decode1_P13_p "" VALUE 0x008E6760 Scalar_FLOAT64_IEEE 0 speedgoat_test_SN5659_R2020b_CM_double -1.7E+308 1.7E+308 /end CHARACTERISTIC
/begin CHARACTERISTIC speedgoat_test_SN5659__cal_impl.Decode1_P14_a "" VALUE 0x008E74A8 Scalar_FLOAT64_IEEE 0 speedgoat_test_SN5659_R2020b_CM_double -1.7E+308 1.7E+308 /end CHARACTERISTIC
/begin CHARACTERISTIC speedgoat_test_SN5659__cal_impl.Decode1_P14_da "" VALUE 0x008E6778 Scalar_FLOAT64_IEEE 0 speedgoat_test_SN5659_R2020b_CM_double -1.7E+308 1.7E+308 /end CHARACTERISTIC
/begin CHARACTERISTIC speedgoat_test_SN5659__cal_impl.Decode1_P14_f "" VALUE 0x008E7B40 Scalar_FLOAT64_IEEE 0 speedgoat_test_SN5659_R2020b_CM_double -1.7E+308 1.7E+308 /end CHARACTERISTIC
/begin CHARACTERISTIC speedgoat_test_SN5659__cal_impl.Decode1_P14_fq "" VALUE 0x008E81D8 Scalar_FLOAT64_IEEE 0 speedgoat_test_SN5659_R2020b_CM_double -1.7E+308 1.7E+308 /end CHARACTERISTIC
/begin CHARACTERISTIC speedgoat_test_SN5659__cal_impl.Decode1_P14_id "" VALUE 0x008E60E0 Scalar_FLOAT64_IEEE 0 speedgoat_test_SN5659_R2020b_CM_double -1.7E+308 1.7E+308 /end CHARACTERISTIC
/begin CHARACTERISTIC speedgoat_test_SN5659__cal_impl.Decode1_P14_j "" VALUE 0x008E6E10 Scalar_FLOAT64_IEEE 0 speedgoat_test_SN5659_R2020b_CM_double -1.7E+308 1.7E+308 /end CHARACTERISTIC
/begin CHARACTERISTIC speedgoat_test_SN5659__cal_impl.Decode1_P14_m "" VALUE 0x008E2C20 Scalar_FLOAT64_IEEE 0 speedgoat_test_SN5659_R2020b_CM_double -1.7E+308 1.7E+308 /end CHARACTERISTIC
/begin CHARACTERISTIC speedgoat_test_SN5659__cal_impl.Decode1_P15_au "" VALUE 0x008E6E28 Scalar_FLOAT64_IEEE 0 speedgoat_test_SN5659_R2020b_CM_double -1.7E+308 1.7E+308 /end CHARACTERISTIC
/begin CHARACTERISTIC speedgoat_test_SN5659__cal_impl.Decode1_P15_aw "" VALUE 0x008E74C0 Scalar_FLOAT64_IEEE 0 speedgoat_test_SN5659_R2020b_CM_double -1.7E+308 1.7E+308 /end CHARACTERISTIC
/begin CHARACTERISTIC speedgoat_test_SN5659__cal_impl.Decode1_P15_b "" VALUE 0x008E2C38 Scalar_FLOAT64_IEEE 0 speedgoat_test_SN5659_R2020b_CM_double -1.7E+308 1.7E+308 /end CHARACTERISTIC
/begin CHARACTERISTIC speedgoat_test_SN5659__cal_impl.Decode1_P15_gw "" VALUE 0x008E6790 Scalar_FLOAT64_IEEE 0 speedgoat_test_SN5659_R2020b_CM_double -1.7E+308 1.7E+308 /end CHARACTERISTIC
/begin CHARACTERISTIC speedgoat_test_SN5659__cal_impl.Decode1_P15_l0 "" VALUE 0x008E60F8 Scalar_FLOAT64_IEEE 0 speedgoat_test_SN5659_R2020b_CM_double -1.7E+308 1.7E+308 /end CHARACTERISTIC
/begin CHARACTERISTIC speedgoat_test_SN5659__cal_impl.Decode1_P15_nq "" VALUE 0x008E7B58 Scalar_FLOAT64_IEEE 0 speedgoat_test_SN5659_R2020b_CM_double -1.7E+308 1.7E+308 /end CHARACTERISTIC
/begin CHARACTERISTIC speedgoat_test_SN5659__cal_impl.Decode1_P15_p "" VALUE 0x008E81F0 Scalar_FLOAT64_IEEE 0 speedgoat_test_SN5659_R2020b_CM_double -1.7E+308 1.7E+308 /end CHARACTERISTIC
/begin CHARACTERISTIC speedgoat_test_SN5659__cal_impl.Decode1_P16_b "" VALUE 0x008E2C50 Scalar_FLOAT64_IEEE 0 speedgoat_test_SN5659_R2020b_CM_double -1.7E+308 1.7E+308 /end CHARACTERISTIC
/begin CHARACTERISTIC speedgoat_test_SN5659__cal_impl.Decode1_P16_be "" VALUE 0x008E67A8 Scalar_FLOAT64_IEEE 0 speedgoat_test_SN5659_R2020b_CM_double -1.7E+308 1.7E+308 /end CHARACTERISTIC
/begin CHARACTERISTIC speedgoat_test_SN5659__cal_impl.Decode1_P16_eq "" VALUE 0x008E74D8 Scalar_FLOAT64_IEEE 0 speedgoat_test_SN5659_R2020b_CM_double -1.7E+308 1.7E+308 /end CHARACTERISTIC
/begin CHARACTERISTIC speedgoat_test_SN5659__cal_impl.Decode1_P16_fi "" VALUE 0x008E8208 Scalar_FLOAT64_IEEE 0 speedgoat_test_SN5659_R2020b_CM_double -1.7E+308 1.7E+308 /end CHARACTERISTIC
/begin CHARACTERISTIC speedgoat_test_SN5659__cal_impl.Decode1_P16_g "" VALUE 0x008E6110 Scalar_FLOAT64_IEEE 0 speedgoat_test_SN5659_R2020b_CM_double -1.7E+308 1.7E+308 /end CHARACTERISTIC
/begin CHARACTERISTIC speedgoat_test_SN5659__cal_impl.Decode1_P16_ju "" VALUE 0x008E7B70 Scalar_FLOAT64_IEEE 0 speedgoat_test_SN5659_R2020b_CM_double -1.7E+308 1.7E+308 /end CHARACTERISTIC
/begin CHARACTERISTIC speedgoat_test_SN5659__cal_impl.Decode1_P16_l "" VALUE 0x008E6E40 Scalar_FLOAT64_IEEE 0 speedgoat_test_SN5659_R2020b_CM_double -1.7E+308 1.7E+308 /end CHARACTERISTIC
/begin CHARACTERISTIC speedgoat_test_SN5659__cal_impl.Decode1_P1_c2 "" VALUE 0x008E2AE0 Scalar_FLOAT64_IEEE 0 speedgoat_test_SN5659_R2020b_CM_double -1.7E+308 1.7E+308 /end CHARACTERISTIC
/begin CHARACTERISTIC speedgoat_test_SN5659__cal_impl.Decode1_P1_cw "" VALUE 0x008E7368 Scalar_FLOAT64_IEEE 0 speedgoat_test_SN5659_R2020b_CM_double -1.7E+308 1.7E+308 /end CHARACTERISTIC
/begin CHARACTERISTIC speedgoat_test_SN5659__cal_impl.Decode1_P1_h "" VALUE 0x008E6CD0 Scalar_FLOAT64_IEEE 0 speedgoat_test_SN5659_R2020b_CM_double -1.7E+308 1.7E+308 /end CHARACTERISTIC
/begin CHARACTERISTIC speedgoat_test_SN5659__cal_impl.Decode1_P1_hw "" VALUE 0x008E7A00 Scalar_FLOAT64_IEEE 0 speedgoat_test_SN5659_R2020b_CM_double -1.7E+308 1.7E+308 /end CHARACTERISTIC
/begin CHARACTERISTIC speedgoat_test_SN5659__cal_impl.Decode1_P1_k "" VALUE 0x008E6638 Scalar_FLOAT64_IEEE 0 speedgoat_test_SN5659_R2020b_CM_double -1.7E+308 1.7E+308 /end CHARACTERISTIC
/begin CHARACTERISTIC speedgoat_test_SN5659__cal_impl.Decode1_P1_p "" VALUE 0x008E5FA0 Scalar_FLOAT64_IEEE 0 speedgoat_test_SN5659_R2020b_CM_double -1.7E+308 1.7E+308 /end CHARACTERISTIC
/begin CHARACTERISTIC speedgoat_test_SN5659__cal_impl.Decode1_P1_pi "" VALUE 0x008E8098 Scalar_FLOAT64_IEEE 0 speedgoat_test_SN5659_R2020b_CM_double -1.7E+308 1.7E+308 /end CHARACTERISTIC
/begin CHARACTERISTIC speedgoat_test_SN5659__cal_impl.Decode1_P2_b "" VALUE 0x008E2AF8 Scalar_FLOAT64_IEEE 0 speedgoat_test_SN5659_R2020b_CM_double -1.7E+308 1.7E+308 /end CHARACTERISTIC
/begin CHARACTERISTIC speedgoat_test_SN5659__cal_impl.Decode1_P2_bu "" VALUE 0x008E7380 Scalar_FLOAT64_IEEE 0 speedgoat_test_SN5659_R2020b_CM_double -1.7E+308 1.7E+308 /end CHARACTERISTIC
/begin CHARACTERISTIC speedgoat_test_SN5659__cal_impl.Decode1_P2_c "" VALUE 0x008E6CE8 Scalar_FLOAT64_IEEE 0 speedgoat_test_SN5659_R2020b_CM_double -1.7E+308 1.7E+308 /end CHARACTERISTIC
/begin CHARACTERISTIC speedgoat_test_SN5659__cal_impl.Decode1_P2_d "" VALUE 0x008E5FB8 Scalar_FLOAT64_IEEE 0 speedgoat_test_SN5659_R2020b_CM_double -1.7E+308 1.7E+308 /end CHARACTERISTIC
/begin CHARACTERISTIC speedgoat_test_SN5659__cal_impl.Decode1_P2_e1 "" VALUE 0x008E6650 Scalar_FLOAT64_IEEE 0 speedgoat_test_SN5659_R2020b_CM_double -1.7E+308 1.7E+308 /end CHARACTERISTIC
/begin CHARACTERISTIC speedgoat_test_SN5659__cal_impl.Decode1_P2_m "" VALUE 0x008E7A18 Scalar_FLOAT64_IEEE 0 speedgoat_test_SN5659_R2020b_CM_double -1.7E+308 1.7E+308 /end CHARACTERISTIC
/begin CHARACTERISTIC speedgoat_test_SN5659__cal_impl.Decode1_P2_mk "" VALUE 0x008E80B0 Scalar_FLOAT64_IEEE 0 speedgoat_test_SN5659_R2020b_CM_double -1.7E+308 1.7E+308 /end CHARACTERISTIC
/begin CHARACTERISTIC speedgoat_test_SN5659__cal_impl.Decode1_P3_a "" VALUE 0x008E7398 Scalar_FLOAT64_IEEE 0 speedgoat_test_SN5659_R2020b_CM_double -1.7E+308 1.7E+308 /end CHARACTERISTIC
/begin CHARACTERISTIC speedgoat_test_SN5659__cal_impl.Decode1_P3_ci "" VALUE 0x008E7A30 Scalar_FLOAT64_IEEE 0 speedgoat_test_SN5659_R2020b_CM_double -1.7E+308 1.7E+308 /end CHARACTERISTIC
/begin CHARACTERISTIC speedgoat_test_SN5659__cal_impl.Decode1_P3_d "" VALUE 0x008E6D00 Scalar_FLOAT64_IEEE 0 speedgoat_test_SN5659_R2020b_CM_double -1.7E+308 1.7E+308 /end CHARACTERISTIC
/begin CHARACTERISTIC speedgoat_test_SN5659__cal_impl.Decode1_P3_g "" VALUE 0x008E2B10 Scalar_FLOAT64_IEEE 0 speedgoat_test_SN5659_R2020b_CM_double -1.7E+308 1.7E+308 /end CHARACTERISTIC
/begin CHARACTERISTIC speedgoat_test_SN5659__cal_impl.Decode1_P3_gr "" VALUE 0x008E80C8 Scalar_FLOAT64_IEEE 0 speedgoat_test_SN5659_R2020b_CM_double -1.7E+308 1.7E+308 /end CHARACTERISTIC
/begin CHARACTERISTIC speedgoat_test_SN5659__cal_impl.Decode1_P3_n "" VALUE 0x008E5FD0 Scalar_FLOAT64_IEEE 0 speedgoat_test_SN5659_R2020b_CM_double -1.7E+308 1.7E+308 /end CHARACTERISTIC
/begin CHARACTERISTIC speedgoat_test_SN5659__cal_impl.Decode1_P3_ng "" VALUE 0x008E6668 Scalar_FLOAT64_IEEE 0 speedgoat_test_SN5659_R2020b_CM_double -1.7E+308 1.7E+308 /end CHARACTERISTIC
/begin CHARACTERISTIC speedgoat_test_SN5659__cal_impl.Decode1_P4_bf "" VALUE 0x008E7A48 Scalar_FLOAT64_IEEE 0 speedgoat_test_SN5659_R2020b_CM_double -1.7E+308 1.7E+308 /end CHARACTERISTIC
/begin CHARACTERISTIC speedgoat_test_SN5659__cal_impl.Decode1_P4_e "" VALUE 0x008E2B28 Scalar_FLOAT64_IEEE 0 speedgoat_test_SN5659_R2020b_CM_double -1.7E+308 1.7E+308 /end CHARACTERISTIC
/begin CHARACTERISTIC speedgoat_test_SN5659__cal_impl.Decode1_P4_h "" VALUE 0x008E6680 Scalar_FLOAT64_IEEE 0 speedgoat_test_SN5659_R2020b_CM_double -1.7E+308 1.7E+308 /end CHARACTERISTIC
/begin CHARACTERISTIC speedgoat_test_SN5659__cal_impl.Decode1_P4_j "" VALUE 0x008E73B0 Scalar_FLOAT64_IEEE 0 speedgoat_test_SN5659_R2020b_CM_double -1.7E+308 1.7E+308 /end CHARACTERISTIC
/begin CHARACTERISTIC speedgoat_test_SN5659__cal_impl.Decode1_P4_me "" VALUE 0x008E6D18 Scalar_FLOAT64_IEEE 0 speedgoat_test_SN5659_R2020b_CM_double -1.7E+308 1.7E+308 /end CHARACTERISTIC
/begin CHARACTERISTIC speedgoat_test_SN5659__cal_impl.Decode1_P4_n "" VALUE 0x008E80E0 Scalar_FLOAT64_IEEE 0 speedgoat_test_SN5659_R2020b_CM_double -1.7E+308 1.7E+308 /end CHARACTERISTIC
/begin CHARACTERISTIC speedgoat_test_SN5659__cal_impl.Decode1_P4_pr "" VALUE 0x008E5FE8 Scalar_FLOAT64_IEEE 0 speedgoat_test_SN5659_R2020b_CM_double -1.7E+308 1.7E+308 /end CHARACTERISTIC
/begin CHARACTERISTIC speedgoat_test_SN5659__cal_impl.Decode1_P5_d "" VALUE 0x008E6698 Scalar_FLOAT64_IEEE 0 speedgoat_test_SN5659_R2020b_CM_double -1.7E+308 1.7E+308 /end CHARACTERISTIC
/begin CHARACTERISTIC speedgoat_test_SN5659__cal_impl.Decode1_P5_d5 "" VALUE 0x008E6D30 Scalar_FLOAT64_IEEE 0 speedgoat_test_SN5659_R2020b_CM_double -1.7E+308 1.7E+308 /end CHARACTERISTIC
/begin CHARACTERISTIC speedgoat_test_SN5659__cal_impl.Decode1_P5_h "" VALUE 0x008E80F8 Scalar_FLOAT64_IEEE 0 speedgoat_test_SN5659_R2020b_CM_double -1.7E+308 1.7E+308 /end CHARACTERISTIC
/begin CHARACTERISTIC speedgoat_test_SN5659__cal_impl.Decode1_P5_kb "" VALUE 0x008E7A60 Scalar_FLOAT64_IEEE 0 speedgoat_test_SN5659_R2020b_CM_double -1.7E+308 1.7E+308 /end CHARACTERISTIC
/begin CHARACTERISTIC speedgoat_test_SN5659__cal_impl.Decode1_P5_m3 "" VALUE 0x008E73C8 Scalar_FLOAT64_IEEE 0 speedgoat_test_SN5659_R2020b_CM_double -1.7E+308 1.7E+308 /end CHARACTERISTIC
/begin CHARACTERISTIC speedgoat_test_SN5659__cal_impl.Decode1_P5_n "" VALUE 0x008E2B40 Scalar_FLOAT64_IEEE 0 speedgoat_test_SN5659_R2020b_CM_double -1.7E+308 1.7E+308 /end CHARACTERISTIC
/begin CHARACTERISTIC speedgoat_test_SN5659__cal_impl.Decode1_P5_p "" VALUE 0x008E6000 Scalar_FLOAT64_IEEE 0 speedgoat_test_SN5659_R2020b_CM_double -1.7E+308 1.7E+308 /end CHARACTERISTIC
/begin CHARACTERISTIC speedgoat_test_SN5659__cal_impl.Decode1_P6_bi "" VALUE 0x008E73E0 Scalar_FLOAT64_IEEE 0 speedgoat_test_SN5659_R2020b_CM_double -1.7E+308 1.7E+308 /end CHARACTERISTIC
/begin CHARACTERISTIC speedgoat_test_SN5659__cal_impl.Decode1_P6_e "" VALUE 0x008E8110 Scalar_FLOAT64_IEEE 0 speedgoat_test_SN5659_R2020b_CM_double -1.7E+308 1.7E+308 /end CHARACTERISTIC
/begin CHARACTERISTIC speedgoat_test_SN5659__cal_impl.Decode1_P6_i3 "" VALUE 0x008E6D48 Scalar_FLOAT64_IEEE 0 speedgoat_test_SN5659_R2020b_CM_double -1.7E+308 1.7E+308 /end CHARACTERISTIC
/begin CHARACTERISTIC speedgoat_test_SN5659__cal_impl.Decode1_P6_j "" VALUE 0x008E2B58 Scalar_FLOAT64_IEEE 0 speedgoat_test_SN5659_R2020b_CM_double -1.7E+308 1.7E+308 /end CHARACTERISTIC
/begin CHARACTERISTIC speedgoat_test_SN5659__cal_impl.Decode1_P6_jf "" VALUE 0x008E7A78 Scalar_FLOAT64_IEEE 0 speedgoat_test_SN5659_R2020b_CM_double -1.7E+308 1.7E+308 /end CHARACTERISTIC
/begin CHARACTERISTIC speedgoat_test_SN5659__cal_impl.Decode1_P6_o "" VALUE 0x008E6018 Scalar_FLOAT64_IEEE 0 speedgoat_test_SN5659_R2020b_CM_double -1.7E+308 1.7E+308 /end CHARACTERISTIC
/begin CHARACTERISTIC speedgoat_test_SN5659__cal_impl.Decode1_P6_pa "" VALUE 0x008E66B0 Scalar_FLOAT64_IEEE 0 speedgoat_test_SN5659_R2020b_CM_double -1.7E+308 1.7E+308 /end CHARACTERISTIC
/begin CHARACTERISTIC speedgoat_test_SN5659__cal_impl.Decode1_P7_bo "" VALUE 0x008E6030 Scalar_FLOAT64_IEEE 0 speedgoat_test_SN5659_R2020b_CM_double -1.7E+308 1.7E+308 /end CHARACTERISTIC
/begin CHARACTERISTIC speedgoat_test_SN5659__cal_impl.Decode1_P7_d3 "" VALUE 0x008E6D60 Scalar_FLOAT64_IEEE 0 speedgoat_test_SN5659_R2020b_CM_double -1.7E+308 1.7E+308 /end CHARACTERISTIC
/begin CHARACTERISTIC speedgoat_test_SN5659__cal_impl.Decode1_P7_j "" VALUE 0x008E8128 Scalar_FLOAT64_IEEE 0 speedgoat_test_SN5659_R2020b_CM_double -1.7E+308 1.7E+308 /end CHARACTERISTIC
/begin CHARACTERISTIC speedgoat_test_SN5659__cal_impl.Decode1_P7_k "" VALUE 0x008E2B70 Scalar_FLOAT64_IEEE 0 speedgoat_test_SN5659_R2020b_CM_double -1.7E+308 1.7E+308 /end CHARACTERISTIC
/begin CHARACTERISTIC speedgoat_test_SN5659__cal_impl.Decode1_P7_l "" VALUE 0x008E66C8 Scalar_FLOAT64_IEEE 0 speedgoat_test_SN5659_R2020b_CM_double -1.7E+308 1.7E+308 /end CHARACTERISTIC
/begin CHARACTERISTIC speedgoat_test_SN5659__cal_impl.Decode1_P7_m1 "" VALUE 0x008E73F8 Scalar_FLOAT64_IEEE 0 speedgoat_test_SN5659_R2020b_CM_double -1.7E+308 1.7E+308 /end CHARACTERISTIC
/begin CHARACTERISTIC speedgoat_test_SN5659__cal_impl.Decode1_P7_ob "" VALUE 0x008E7A90 Scalar_FLOAT64_IEEE 0 speedgoat_test_SN5659_R2020b_CM_double -1.7E+308 1.7E+308 /end CHARACTERISTIC
/begin CHARACTERISTIC speedgoat_test_SN5659__cal_impl.Decode1_P8_a "" VALUE 0x008E7AA8 Scalar_FLOAT64_IEEE 0 speedgoat_test_SN5659_R2020b_CM_double -1.7E+308 1.7E+308 /end CHARACTERISTIC
/begin CHARACTERISTIC speedgoat_test_SN5659__cal_impl.Decode1_P8_a1 "" VALUE 0x008E8140 Scalar_FLOAT64_IEEE 0 speedgoat_test_SN5659_R2020b_CM_double -1.7E+308 1.7E+308 /end CHARACTERISTIC
/begin CHARACTERISTIC speedgoat_test_SN5659__cal_impl.Decode1_P8_c5 "" VALUE 0x008E6D78 Scalar_FLOAT64_IEEE 0 speedgoat_test_SN5659_R2020b_CM_double -1.7E+308 1.7E+308 /end CHARACTERISTIC
/begin CHARACTERISTIC speedgoat_test_SN5659__cal_impl.Decode1_P8_f "" VALUE 0x008E7410 Scalar_FLOAT64_IEEE 0 speedgoat_test_SN5659_R2020b_CM_double -1.7E+308 1.7E+308 /end CHARACTERISTIC
/begin CHARACTERISTIC speedgoat_test_SN5659__cal_impl.Decode1_P8_ga "" VALUE 0x008E6048 Scalar_FLOAT64_IEEE 0 speedgoat_test_SN5659_R2020b_CM_double -1.7E+308 1.7E+308 /end CHARACTERISTIC
/begin CHARACTERISTIC speedgoat_test_SN5659__cal_impl.Decode1_P8_l "" VALUE 0x008E2B88 Scalar_FLOAT64_IEEE 0 speedgoat_test_SN5659_R2020b_CM_double -1.7E+308 1.7E+308 /end CHARACTERISTIC
/begin CHARACTERISTIC speedgoat_test_SN5659__cal_impl.Decode1_P8_o "" VALUE 0x008E66E0 Scalar_FLOAT64_IEEE 0 speedgoat_test_SN5659_R2020b_CM_double -1.7E+308 1.7E+308 /end CHARACTERISTIC
/begin CHARACTERISTIC speedgoat_test_SN5659__cal_impl.Decode1_P9_a "" VALUE 0x008E66F8 Scalar_FLOAT64_IEEE 0 speedgoat_test_SN5659_R2020b_CM_double -1.7E+308 1.7E+308 /end CHARACTERISTIC
/begin CHARACTERISTIC speedgoat_test_SN5659__cal_impl.Decode1_P9_c "" VALUE 0x008E6060 Scalar_FLOAT64_IEEE 0 speedgoat_test_SN5659_R2020b_CM_double -1.7E+308 1.7E+308 /end CHARACTERISTIC
/begin CHARACTERISTIC speedgoat_test_SN5659__cal_impl.Decode1_P9_dz "" VALUE 0x008E8158 Scalar_FLOAT64_IEEE 0 speedgoat_test_SN5659_R2020b_CM_double -1.7E+308 1.7E+308 /end CHARACTERISTIC
/begin CHARACTERISTIC speedgoat_test_SN5659__cal_impl.Decode1_P9_ie "" VALUE 0x008E7428 Scalar_FLOAT64_IEEE 0 speedgoat_test_SN5659_R2020b_CM_double -1.7E+308 1.7E+308 /end CHARACTERISTIC
/begin CHARACTERISTIC speedgoat_test_SN5659__cal_impl.Decode1_P9_k "" VALUE 0x008E2BA0 Scalar_FLOAT64_IEEE 0 speedgoat_test_SN5659_R2020b_CM_double -1.7E+308 1.7E+308 /end CHARACTERISTIC
/begin CHARACTERISTIC speedgoat_test_SN5659__cal_impl.Decode1_P9_op "" VALUE 0x008E7AC0 Scalar_FLOAT64_IEEE 0 speedgoat_test_SN5659_R2020b_CM_double -1.7E+308 1.7E+308 /end CHARACTERISTIC
/begin CHARACTERISTIC speedgoat_test_SN5659__cal_impl.Decode1_P9_pu "" VALUE 0x008E6D90 Scalar_FLOAT64_IEEE 0 speedgoat_test_SN5659_R2020b_CM_double -1.7E+308 1.7E+308 /end CHARACTERISTIC
/begin CHARACTERISTIC speedgoat_test_SN5659__cal_impl.Decode2_P10_bf "" VAL_BLK 0x008E6200 Scalar_FLOAT64_IEEE 0 speedgoat_test_SN5659_R2020b_CM_double -1.7E+308 1.7E+308 MATRIX_DIM 2 1 /end CHARACTERISTIC
/begin CHARACTERISTIC speedgoat_test_SN5659__cal_impl.Decode2_P10_cg "" VAL_BLK 0x008E82F8 Scalar_FLOAT64_IEEE 0 speedgoat_test_SN5659_R2020b_CM_double -1.7E+308 1.7E+308 MATRIX_DIM 2 1 /end CHARACTERISTIC
/begin CHARACTERISTIC speedgoat_test_SN5659__cal_impl.Decode2_P10_e "" VAL_BLK 0x008E75C8 Scalar_FLOAT64_IEEE 0 speedgoat_test_SN5659_R2020b_CM_double -1.7E+308 1.7E+308 MATRIX_DIM 2 1 /end CHARACTERISTIC
/begin CHARACTERISTIC speedgoat_test_SN5659__cal_impl.Decode2_P10_f "" VAL_BLK 0x008E6898 Scalar_FLOAT64_IEEE 0 speedgoat_test_SN5659_R2020b_CM_double -1.7E+308 1.7E+308 MATRIX_DIM 2 1 /end CHARACTERISTIC
/begin CHARACTERISTIC speedgoat_test_SN5659__cal_impl.Decode2_P10_l "" VAL_BLK 0x008E7C60 Scalar_FLOAT64_IEEE 0 speedgoat_test_SN5659_R2020b_CM_double -1.7E+308 1.7E+308 MATRIX_DIM 2 1 /end CHARACTERISTIC
/begin CHARACTERISTIC speedgoat_test_SN5659__cal_impl.Decode2_P11_ff "" VALUE 0x008E6220 Scalar_FLOAT64_IEEE 0 speedgoat_test_SN5659_R2020b_CM_double -1.7E+308 1.7E+308 /end CHARACTERISTIC
/begin CHARACTERISTIC speedgoat_test_SN5659__cal_impl.Decode2_P11_fz "" VALUE 0x008E68B8 Scalar_FLOAT64_IEEE 0 speedgoat_test_SN5659_R2020b_CM_double -1.7E+308 1.7E+308 /end CHARACTERISTIC
/begin CHARACTERISTIC speedgoat_test_SN5659__cal_impl.Decode2_P11_h "" VALUE 0x008E7C80 Scalar_FLOAT64_IEEE 0 speedgoat_test_SN5659_R2020b_CM_double -1.7E+308 1.7E+308 /end CHARACTERISTIC
/begin CHARACTERISTIC speedgoat_test_SN5659__cal_impl.Decode2_P11_kl "" VALUE 0x008E8318 Scalar_FLOAT64_IEEE 0 speedgoat_test_SN5659_R2020b_CM_double -1.7E+308 1.7E+308 /end CHARACTERISTIC
/begin CHARACTERISTIC speedgoat_test_SN5659__cal_impl.Decode2_P11_p "" VALUE 0x008E75E8 Scalar_FLOAT64_IEEE 0 speedgoat_test_SN5659_R2020b_CM_double -1.7E+308 1.7E+308 /end CHARACTERISTIC
/begin CHARACTERISTIC speedgoat_test_SN5659__cal_impl.Decode2_P12_b "" VALUE 0x008E6238 Scalar_FLOAT64_IEEE 0 speedgoat_test_SN5659_R2020b_CM_double -1.7E+308 1.7E+308 /end CHARACTERISTIC
/begin CHARACTERISTIC speedgoat_test_SN5659__cal_impl.Decode2_P12_bf "" VALUE 0x008E68D0 Scalar_FLOAT64_IEEE 0 speedgoat_test_SN5659_R2020b_CM_double -1.7E+308 1.7E+308 /end CHARACTERISTIC
/begin CHARACTERISTIC speedgoat_test_SN5659__cal_impl.Decode2_P12_d "" VALUE 0x008E7C98 Scalar_FLOAT64_IEEE 0 speedgoat_test_SN5659_R2020b_CM_double -1.7E+308 1.7E+308 /end CHARACTERISTIC
/begin CHARACTERISTIC speedgoat_test_SN5659__cal_impl.Decode2_P12_id "" VALUE 0x008E7600 Scalar_FLOAT64_IEEE 0 speedgoat_test_SN5659_R2020b_CM_double -1.7E+308 1.7E+308 /end CHARACTERISTIC
/begin CHARACTERISTIC speedgoat_test_SN5659__cal_impl.Decode2_P12_m "" VALUE 0x008E8330 Scalar_FLOAT64_IEEE 0 speedgoat_test_SN5659_R2020b_CM_double -1.7E+308 1.7E+308 /end CHARACTERISTIC
/begin CHARACTERISTIC speedgoat_test_SN5659__cal_impl.Decode2_P13_b "" VALUE 0x008E7618 Scalar_FLOAT64_IEEE 0 speedgoat_test_SN5659_R2020b_CM_double -1.7E+308 1.7E+308 /end CHARACTERISTIC
/begin CHARACTERISTIC speedgoat_test_SN5659__cal_impl.Decode2_P13_bk "" VALUE 0x008E8348 Scalar_FLOAT64_IEEE 0 speedgoat_test_SN5659_R2020b_CM_double -1.7E+308 1.7E+308 /end CHARACTERISTIC
/begin CHARACTERISTIC speedgoat_test_SN5659__cal_impl.Decode2_P13_c "" VALUE 0x008E6250 Scalar_FLOAT64_IEEE 0 speedgoat_test_SN5659_R2020b_CM_double -1.7E+308 1.7E+308 /end CHARACTERISTIC
/begin CHARACTERISTIC speedgoat_test_SN5659__cal_impl.Decode2_P13_d "" VALUE 0x008E7CB0 Scalar_FLOAT64_IEEE 0 speedgoat_test_SN5659_R2020b_CM_double -1.7E+308 1.7E+308 /end CHARACTERISTIC
/begin CHARACTERISTIC speedgoat_test_SN5659__cal_impl.Decode2_P13_m "" VALUE 0x008E68E8 Scalar_FLOAT64_IEEE 0 speedgoat_test_SN5659_R2020b_CM_double -1.7E+308 1.7E+308 /end CHARACTERISTIC
/begin CHARACTERISTIC speedgoat_test_SN5659__cal_impl.Decode2_P14_d "" VALUE 0x008E7630 Scalar_FLOAT64_IEEE 0 speedgoat_test_SN5659_R2020b_CM_double -1.7E+308 1.7E+308 /end CHARACTERISTIC
/begin CHARACTERISTIC speedgoat_test_SN5659__cal_impl.Decode2_P14_f2 "" VALUE 0x008E6268 Scalar_FLOAT64_IEEE 0 speedgoat_test_SN5659_R2020b_CM_double -1.7E+308 1.7E+308 /end CHARACTERISTIC
/begin CHARACTERISTIC speedgoat_test_SN5659__cal_impl.Decode2_P14_j "" VALUE 0x008E6900 Scalar_FLOAT64_IEEE 0 speedgoat_test_SN5659_R2020b_CM_double -1.7E+308 1.7E+308 /end CHARACTERISTIC
/begin CHARACTERISTIC speedgoat_test_SN5659__cal_impl.Decode2_P14_k "" VALUE 0x008E7CC8 Scalar_FLOAT64_IEEE 0 speedgoat_test_SN5659_R2020b_CM_double -1.7E+308 1.7E+308 /end CHARACTERISTIC
/begin CHARACTERISTIC speedgoat_test_SN5659__cal_impl.Decode2_P14_kg "" VALUE 0x008E8360 Scalar_FLOAT64_IEEE 0 speedgoat_test_SN5659_R2020b_CM_double -1.7E+308 1.7E+308 /end CHARACTERISTIC
/begin CHARACTERISTIC speedgoat_test_SN5659__cal_impl.Decode2_P15_b "" VALUE 0x008E7648 Scalar_FLOAT64_IEEE 0 speedgoat_test_SN5659_R2020b_CM_double -1.7E+308 1.7E+308 /end CHARACTERISTIC
/begin CHARACTERISTIC speedgoat_test_SN5659__cal_impl.Decode2_P15_gh "" VALUE 0x008E8378 Scalar_FLOAT64_IEEE 0 speedgoat_test_SN5659_R2020b_CM_double -1.7E+308 1.7E+308 /end CHARACTERISTIC
/begin CHARACTERISTIC speedgoat_test_SN5659__cal_impl.Decode2_P15_go "" VALUE 0x008E6280 Scalar_FLOAT64_IEEE 0 speedgoat_test_SN5659_R2020b_CM_double -1.7E+308 1.7E+308 /end CHARACTERISTIC
/begin CHARACTERISTIC speedgoat_test_SN5659__cal_impl.Decode2_P15_jl "" VALUE 0x008E6918 Scalar_FLOAT64_IEEE 0 speedgoat_test_SN5659_R2020b_CM_double -1.7E+308 1.7E+308 /end CHARACTERISTIC
/begin CHARACTERISTIC speedgoat_test_SN5659__cal_impl.Decode2_P15_l "" VALUE 0x008E7CE0 Scalar_FLOAT64_IEEE 0 speedgoat_test_SN5659_R2020b_CM_double -1.7E+308 1.7E+308 /end CHARACTERISTIC
/begin CHARACTERISTIC speedgoat_test_SN5659__cal_impl.Decode2_P16_a "" VALUE 0x008E8390 Scalar_FLOAT64_IEEE 0 speedgoat_test_SN5659_R2020b_CM_double -1.7E+308 1.7E+308 /end CHARACTERISTIC
/begin CHARACTERISTIC speedgoat_test_SN5659__cal_impl.Decode2_P16_cw "" VALUE 0x008E6298 Scalar_FLOAT64_IEEE 0 speedgoat_test_SN5659_R2020b_CM_double -1.7E+308 1.7E+308 /end CHARACTERISTIC
/begin CHARACTERISTIC speedgoat_test_SN5659__cal_impl.Decode2_P16_d "" VALUE 0x008E7660 Scalar_FLOAT64_IEEE 0 speedgoat_test_SN5659_R2020b_CM_double -1.7E+308 1.7E+308 /end CHARACTERISTIC
/begin CHARACTERISTIC speedgoat_test_SN5659__cal_impl.Decode2_P16_f "" VALUE 0x008E6930 Scalar_FLOAT64_IEEE 0 speedgoat_test_SN5659_R2020b_CM_double -1.7E+308 1.7E+308 /end CHARACTERISTIC
/begin CHARACTERISTIC speedgoat_test_SN5659__cal_impl.Decode2_P16_h "" VALUE 0x008E7CF8 Scalar_FLOAT64_IEEE 0 speedgoat_test_SN5659_R2020b_CM_double -1.7E+308 1.7E+308 /end CHARACTERISTIC
/begin CHARACTERISTIC speedgoat_test_SN5659__cal_impl.Decode2_P1_b "" VALUE 0x008E7B88 Scalar_FLOAT64_IEEE 0 speedgoat_test_SN5659_R2020b_CM_double -1.7E+308 1.7E+308 /end CHARACTERISTIC
/begin CHARACTERISTIC speedgoat_test_SN5659__cal_impl.Decode2_P1_i "" VALUE 0x008E6128 Scalar_FLOAT64_IEEE 0 speedgoat_test_SN5659_R2020b_CM_double -1.7E+308 1.7E+308 /end CHARACTERISTIC
/begin CHARACTERISTIC speedgoat_test_SN5659__cal_impl.Decode2_P1_i0 "" VALUE 0x008E8220 Scalar_FLOAT64_IEEE 0 speedgoat_test_SN5659_R2020b_CM_double -1.7E+308 1.7E+308 /end CHARACTERISTIC
/begin CHARACTERISTIC speedgoat_test_SN5659__cal_impl.Decode2_P1_k "" VALUE 0x008E74F0 Scalar_FLOAT64_IEEE 0 speedgoat_test_SN5659_R2020b_CM_double -1.7E+308 1.7E+308 /end CHARACTERISTIC
/begin CHARACTERISTIC speedgoat_test_SN5659__cal_impl.Decode2_P1_p "" VALUE 0x008E67C0 Scalar_FLOAT64_IEEE 0 speedgoat_test_SN5659_R2020b_CM_double -1.7E+308 1.7E+308 /end CHARACTERISTIC
/begin CHARACTERISTIC speedgoat_test_SN5659__cal_impl.Decode2_P2_ef "" VALUE 0x008E6140 Scalar_FLOAT64_IEEE 0 speedgoat_test_SN5659_R2020b_CM_double -1.7E+308 1.7E+308 /end CHARACTERISTIC
/begin CHARACTERISTIC speedgoat_test_SN5659__cal_impl.Decode2_P2_jg "" VALUE 0x008E7BA0 Scalar_FLOAT64_IEEE 0 speedgoat_test_SN5659_R2020b_CM_double -1.7E+308 1.7E+308 /end CHARACTERISTIC
/begin CHARACTERISTIC speedgoat_test_SN5659__cal_impl.Decode2_P2_kc "" VALUE 0x008E67D8 Scalar_FLOAT64_IEEE 0 speedgoat_test_SN5659_R2020b_CM_double -1.7E+308 1.7E+308 /end CHARACTERISTIC
/begin CHARACTERISTIC speedgoat_test_SN5659__cal_impl.Decode2_P2_kx "" VALUE 0x008E7508 Scalar_FLOAT64_IEEE 0 speedgoat_test_SN5659_R2020b_CM_double -1.7E+308 1.7E+308 /end CHARACTERISTIC
/begin CHARACTERISTIC speedgoat_test_SN5659__cal_impl.Decode2_P2_mg "" VALUE 0x008E8238 Scalar_FLOAT64_IEEE 0 speedgoat_test_SN5659_R2020b_CM_double -1.7E+308 1.7E+308 /end CHARACTERISTIC
/begin CHARACTERISTIC speedgoat_test_SN5659__cal_impl.Decode2_P3_b5 "" VALUE 0x008E7520 Scalar_FLOAT64_IEEE 0 speedgoat_test_SN5659_R2020b_CM_double -1.7E+308 1.7E+308 /end CHARACTERISTIC
/begin CHARACTERISTIC speedgoat_test_SN5659__cal_impl.Decode2_P3_c "" VALUE 0x008E6158 Scalar_FLOAT64_IEEE 0 speedgoat_test_SN5659_R2020b_CM_double -1.7E+308 1.7E+308 /end CHARACTERISTIC
/begin CHARACTERISTIC speedgoat_test_SN5659__cal_impl.Decode2_P3_i "" VALUE 0x008E67F0 Scalar_FLOAT64_IEEE 0 speedgoat_test_SN5659_R2020b_CM_double -1.7E+308 1.7E+308 /end CHARACTERISTIC
/begin CHARACTERISTIC speedgoat_test_SN5659__cal_impl.Decode2_P3_m "" VALUE 0x008E7BB8 Scalar_FLOAT64_IEEE 0 speedgoat_test_SN5659_R2020b_CM_double -1.7E+308 1.7E+308 /end CHARACTERISTIC
/begin CHARACTERISTIC speedgoat_test_SN5659__cal_impl.Decode2_P3_p "" VALUE 0x008E8250 Scalar_FLOAT64_IEEE 0 speedgoat_test_SN5659_R2020b_CM_double -1.7E+308 1.7E+308 /end CHARACTERISTIC
/begin CHARACTERISTIC speedgoat_test_SN5659__cal_impl.Decode2_P4_a "" VALUE 0x008E7538 Scalar_FLOAT64_IEEE 0 speedgoat_test_SN5659_R2020b_CM_double -1.7E+308 1.7E+308 /end CHARACTERISTIC
/begin CHARACTERISTIC speedgoat_test_SN5659__cal_impl.Decode2_P4_b "" VALUE 0x008E6808 Scalar_FLOAT64_IEEE 0 speedgoat_test_SN5659_R2020b_CM_double -1.7E+308 1.7E+308 /end CHARACTERISTIC
/begin CHARACTERISTIC speedgoat_test_SN5659__cal_impl.Decode2_P4_bb "" VALUE 0x008E8268 Scalar_FLOAT64_IEEE 0 speedgoat_test_SN5659_R2020b_CM_double -1.7E+308 1.7E+308 /end CHARACTERISTIC
/begin CHARACTERISTIC speedgoat_test_SN5659__cal_impl.Decode2_P4_e "" VALUE 0x008E6170 Scalar_FLOAT64_IEEE 0 speedgoat_test_SN5659_R2020b_CM_double -1.7E+308 1.7E+308 /end CHARACTERISTIC
/begin CHARACTERISTIC speedgoat_test_SN5659__cal_impl.Decode2_P4_ff "" VALUE 0x008E7BD0 Scalar_FLOAT64_IEEE 0 speedgoat_test_SN5659_R2020b_CM_double -1.7E+308 1.7E+308 /end CHARACTERISTIC
/begin CHARACTERISTIC speedgoat_test_SN5659__cal_impl.Decode2_P5_d "" VALUE 0x008E6820 Scalar_FLOAT64_IEEE 0 speedgoat_test_SN5659_R2020b_CM_double -1.7E+308 1.7E+308 /end CHARACTERISTIC
/begin CHARACTERISTIC speedgoat_test_SN5659__cal_impl.Decode2_P5_h "" VALUE 0x008E7BE8 Scalar_FLOAT64_IEEE 0 speedgoat_test_SN5659_R2020b_CM_double -1.7E+308 1.7E+308 /end CHARACTERISTIC
/begin CHARACTERISTIC speedgoat_test_SN5659__cal_impl.Decode2_P5_jm "" VALUE 0x008E7550 Scalar_FLOAT64_IEEE 0 speedgoat_test_SN5659_R2020b_CM_double -1.7E+308 1.7E+308 /end CHARACTERISTIC
/begin CHARACTERISTIC speedgoat_test_SN5659__cal_impl.Decode2_P5_ju "" VALUE 0x008E8280 Scalar_FLOAT64_IEEE 0 speedgoat_test_SN5659_R2020b_CM_double -1.7E+308 1.7E+308 /end CHARACTERISTIC
/begin CHARACTERISTIC speedgoat_test_SN5659__cal_impl.Decode2_P5_l "" VALUE 0x008E6188 Scalar_FLOAT64_IEEE 0 speedgoat_test_SN5659_R2020b_CM_double -1.7E+308 1.7E+308 /end CHARACTERISTIC
/begin CHARACTERISTIC speedgoat_test_SN5659__cal_impl.Decode2_P6_b "" VALUE 0x008E7C00 Scalar_FLOAT64_IEEE 0 speedgoat_test_SN5659_R2020b_CM_double -1.7E+308 1.7E+308 /end CHARACTERISTIC
/begin CHARACTERISTIC speedgoat_test_SN5659__cal_impl.Decode2_P6_hg "" VALUE 0x008E8298 Scalar_FLOAT64_IEEE 0 speedgoat_test_SN5659_R2020b_CM_double -1.7E+308 1.7E+308 /end CHARACTERISTIC
/begin CHARACTERISTIC speedgoat_test_SN5659__cal_impl.Decode2_P6_lx "" VALUE 0x008E7568 Scalar_FLOAT64_IEEE 0 speedgoat_test_SN5659_R2020b_CM_double -1.7E+308 1.7E+308 /end CHARACTERISTIC
/begin CHARACTERISTIC speedgoat_test_SN5659__cal_impl.Decode2_P6_m "" VALUE 0x008E6838 Scalar_FLOAT64_IEEE 0 speedgoat_test_SN5659_R2020b_CM_double -1.7E+308 1.7E+308 /end CHARACTERISTIC
/begin CHARACTERISTIC speedgoat_test_SN5659__cal_impl.Decode2_P6_n "" VALUE 0x008E61A0 Scalar_FLOAT64_IEEE 0 speedgoat_test_SN5659_R2020b_CM_double -1.7E+308 1.7E+308 /end CHARACTERISTIC
/begin CHARACTERISTIC speedgoat_test_SN5659__cal_impl.Decode2_P7_c "" VALUE 0x008E7C18 Scalar_FLOAT64_IEEE 0 speedgoat_test_SN5659_R2020b_CM_double -1.7E+308 1.7E+308 /end CHARACTERISTIC
/begin CHARACTERISTIC speedgoat_test_SN5659__cal_impl.Decode2_P7_h "" VALUE 0x008E6850 Scalar_FLOAT64_IEEE 0 speedgoat_test_SN5659_R2020b_CM_double -1.7E+308 1.7E+308 /end CHARACTERISTIC
/begin CHARACTERISTIC speedgoat_test_SN5659__cal_impl.Decode2_P7_ht "" VALUE 0x008E82B0 Scalar_FLOAT64_IEEE 0 speedgoat_test_SN5659_R2020b_CM_double -1.7E+308 1.7E+308 /end CHARACTERISTIC
/begin CHARACTERISTIC speedgoat_test_SN5659__cal_impl.Decode2_P7_ja "" VALUE 0x008E61B8 Scalar_FLOAT64_IEEE 0 speedgoat_test_SN5659_R2020b_CM_double -1.7E+308 1.7E+308 /end CHARACTERISTIC
/begin CHARACTERISTIC speedgoat_test_SN5659__cal_impl.Decode2_P7_k "" VALUE 0x008E7580 Scalar_FLOAT64_IEEE 0 speedgoat_test_SN5659_R2020b_CM_double -1.7E+308 1.7E+308 /end CHARACTERISTIC
/begin CHARACTERISTIC speedgoat_test_SN5659__cal_impl.Decode2_P8_bd "" VALUE 0x008E6868 Scalar_FLOAT64_IEEE 0 speedgoat_test_SN5659_R2020b_CM_double -1.7E+308 1.7E+308 /end CHARACTERISTIC
/begin CHARACTERISTIC speedgoat_test_SN5659__cal_impl.Decode2_P8_fr "" VALUE 0x008E82C8 Scalar_FLOAT64_IEEE 0 speedgoat_test_SN5659_R2020b_CM_double -1.7E+308 1.7E+308 /end CHARACTERISTIC
/begin CHARACTERISTIC speedgoat_test_SN5659__cal_impl.Decode2_P8_g "" VALUE 0x008E61D0 Scalar_FLOAT64_IEEE 0 speedgoat_test_SN5659_R2020b_CM_double -1.7E+308 1.7E+308 /end CHARACTERISTIC
/begin CHARACTERISTIC speedgoat_test_SN5659__cal_impl.Decode2_P8_h4 "" VALUE 0x008E7598 Scalar_FLOAT64_IEEE 0 speedgoat_test_SN5659_R2020b_CM_double -1.7E+308 1.7E+308 /end CHARACTERISTIC
/begin CHARACTERISTIC speedgoat_test_SN5659__cal_impl.Decode2_P8_k "" VALUE 0x008E7C30 Scalar_FLOAT64_IEEE 0 speedgoat_test_SN5659_R2020b_CM_double -1.7E+308 1.7E+308 /end CHARACTERISTIC
/begin CHARACTERISTIC speedgoat_test_SN5659__cal_impl.Decode2_P9_e "" VALUE 0x008E61E8 Scalar_FLOAT64_IEEE 0 speedgoat_test_SN5659_R2020b_CM_double -1.7E+308 1.7E+308 /end CHARACTERISTIC
/begin CHARACTERISTIC speedgoat_test_SN5659__cal_impl.Decode2_P9_gj "" VALUE 0x008E7C48 Scalar_FLOAT64_IEEE 0 speedgoat_test_SN5659_R2020b_CM_double -1.7E+308 1.7E+308 /end CHARACTERISTIC
/begin CHARACTERISTIC speedgoat_test_SN5659__cal_impl.Decode2_P9_gq "" VALUE 0x008E75B0 Scalar_FLOAT64_IEEE 0 speedgoat_test_SN5659_R2020b_CM_double -1.7E+308 1.7E+308 /end CHARACTERISTIC
/begin CHARACTERISTIC speedgoat_test_SN5659__cal_impl.Decode2_P9_lp "" VALUE 0x008E6880 Scalar_FLOAT64_IEEE 0 speedgoat_test_SN5659_R2020b_CM_double -1.7E+308 1.7E+308 /end CHARACTERISTIC
/begin CHARACTERISTIC speedgoat_test_SN5659__cal_impl.Decode2_P9_m "" VALUE 0x008E82E0 Scalar_FLOAT64_IEEE 0 speedgoat_test_SN5659_R2020b_CM_double -1.7E+308 1.7E+308 /end CHARACTERISTIC
/begin CHARACTERISTIC speedgoat_test_SN5659__cal_impl.Decode3_P10_av "" VAL_BLK 0x008E7750 Scalar_FLOAT64_IEEE 0 speedgoat_test_SN5659_R2020b_CM_double -1.7E+308 1.7E+308 MATRIX_DIM 2 1 /end CHARACTERISTIC
/begin CHARACTERISTIC speedgoat_test_SN5659__cal_impl.Decode3_P10_g "" VAL_BLK 0x008E8480 Scalar_FLOAT64_IEEE 0 speedgoat_test_SN5659_R2020b_CM_double -1.7E+308 1.7E+308 MATRIX_DIM 2 1 /end CHARACTERISTIC
/begin CHARACTERISTIC speedgoat_test_SN5659__cal_impl.Decode3_P10_i "" VAL_BLK 0x008E6388 Scalar_FLOAT64_IEEE 0 speedgoat_test_SN5659_R2020b_CM_double -1.7E+308 1.7E+308 MATRIX_DIM 2 1 /end CHARACTERISTIC
/begin CHARACTERISTIC speedgoat_test_SN5659__cal_impl.Decode3_P10_k "" VAL_BLK 0x008E2EC8 Scalar_FLOAT64_IEEE 0 speedgoat_test_SN5659_R2020b_CM_double -1.7E+308 1.7E+308 MATRIX_DIM 2 1 /end CHARACTERISTIC
/begin CHARACTERISTIC speedgoat_test_SN5659__cal_impl.Decode3_P10_k5 "" VAL_BLK 0x008E70B8 Scalar_FLOAT64_IEEE 0 speedgoat_test_SN5659_R2020b_CM_double -1.7E+308 1.7E+308 MATRIX_DIM 2 1 /end CHARACTERISTIC
/begin CHARACTERISTIC speedgoat_test_SN5659__cal_impl.Decode3_P10_lv "" VAL_BLK 0x008E7DE8 Scalar_FLOAT64_IEEE 0 speedgoat_test_SN5659_R2020b_CM_double -1.7E+308 1.7E+308 MATRIX_DIM 2 1 /end CHARACTERISTIC
/begin CHARACTERISTIC speedgoat_test_SN5659__cal_impl.Decode3_P10_oo "" VAL_BLK 0x008E6A20 Scalar_FLOAT64_IEEE 0 speedgoat_test_SN5659_R2020b_CM_double -1.7E+308 1.7E+308 MATRIX_DIM 2 1 /end CHARACTERISTIC
/begin CHARACTERISTIC speedgoat_test_SN5659__cal_impl.Decode3_P11_bg "" VALUE 0x008E70D8 Scalar_FLOAT64_IEEE 0 speedgoat_test_SN5659_R2020b_CM_double -1.7E+308 1.7E+308 /end CHARACTERISTIC
/begin CHARACTERISTIC speedgoat_test_SN5659__cal_impl.Decode3_P11_e "" VALUE 0x008E2EE8 Scalar_FLOAT64_IEEE 0 speedgoat_test_SN5659_R2020b_CM_double -1.7E+308 1.7E+308 /end CHARACTERISTIC
/begin CHARACTERISTIC speedgoat_test_SN5659__cal_impl.Decode3_P11_ku "" VALUE 0x008E7770 Scalar_FLOAT64_IEEE 0 speedgoat_test_SN5659_R2020b_CM_double -1.7E+308 1.7E+308 /end CHARACTERISTIC
/begin CHARACTERISTIC speedgoat_test_SN5659__cal_impl.Decode3_P11_m "" VALUE 0x008E63A8 Scalar_FLOAT64_IEEE 0 speedgoat_test_SN5659_R2020b_CM_double -1.7E+308 1.7E+308 /end CHARACTERISTIC
/begin CHARACTERISTIC speedgoat_test_SN5659__cal_impl.Decode3_P11_mj "" VALUE 0x008E6A40 Scalar_FLOAT64_IEEE 0 speedgoat_test_SN5659_R2020b_CM_double -1.7E+308 1.7E+308 /end CHARACTERISTIC
/begin CHARACTERISTIC speedgoat_test_SN5659__cal_impl.Decode3_P11_n "" VALUE 0x008E7E08 Scalar_FLOAT64_IEEE 0 speedgoat_test_SN5659_R2020b_CM_double -1.7E+308 1.7E+308 /end CHARACTERISTIC
/begin CHARACTERISTIC speedgoat_test_SN5659__cal_impl.Decode3_P11_o "" VALUE 0x008E84A0 Scalar_FLOAT64_IEEE 0 speedgoat_test_SN5659_R2020b_CM_double -1.7E+308 1.7E+308 /end CHARACTERISTIC
/begin CHARACTERISTIC speedgoat_test_SN5659__cal_impl.Decode3_P12_ak "" VALUE 0x008E84B8 Scalar_FLOAT64_IEEE 0 speedgoat_test_SN5659_R2020b_CM_double -1.7E+308 1.7E+308 /end CHARACTERISTIC
/begin CHARACTERISTIC speedgoat_test_SN5659__cal_impl.Decode3_P12_e "" VALUE 0x008E7788 Scalar_FLOAT64_IEEE 0 speedgoat_test_SN5659_R2020b_CM_double -1.7E+308 1.7E+308 /end CHARACTERISTIC
/begin CHARACTERISTIC speedgoat_test_SN5659__cal_impl.Decode3_P12_i "" VALUE 0x008E2F00 Scalar_FLOAT64_IEEE 0 speedgoat_test_SN5659_R2020b_CM_double -1.7E+308 1.7E+308 /end CHARACTERISTIC
/begin CHARACTERISTIC speedgoat_test_SN5659__cal_impl.Decode3_P12_kuc "" VALUE 0x008E6A58 Scalar_FLOAT64_IEEE 0 speedgoat_test_SN5659_R2020b_CM_double -1.7E+308 1.7E+308 /end CHARACTERISTIC
/begin CHARACTERISTIC speedgoat_test_SN5659__cal_impl.Decode3_P12_ls "" VALUE 0x008E63C0 Scalar_FLOAT64_IEEE 0 speedgoat_test_SN5659_R2020b_CM_double -1.7E+308 1.7E+308 /end CHARACTERISTIC
/begin CHARACTERISTIC speedgoat_test_SN5659__cal_impl.Decode3_P12_pa "" VALUE 0x008E70F0 Scalar_FLOAT64_IEEE 0 speedgoat_test_SN5659_R2020b_CM_double -1.7E+308 1.7E+308 /end CHARACTERISTIC
/begin CHARACTERISTIC speedgoat_test_SN5659__cal_impl.Decode3_P12_pg "" VALUE 0x008E7E20 Scalar_FLOAT64_IEEE 0 speedgoat_test_SN5659_R2020b_CM_double -1.7E+308 1.7E+308 /end CHARACTERISTIC
/begin CHARACTERISTIC speedgoat_test_SN5659__cal_impl.Decode3_P13_bw "" VALUE 0x008E7E38 Scalar_FLOAT64_IEEE 0 speedgoat_test_SN5659_R2020b_CM_double -1.7E+308 1.7E+308 /end CHARACTERISTIC
/begin CHARACTERISTIC speedgoat_test_SN5659__cal_impl.Decode3_P13_e1 "" VALUE 0x008E84D0 Scalar_FLOAT64_IEEE 0 speedgoat_test_SN5659_R2020b_CM_double -1.7E+308 1.7E+308 /end CHARACTERISTIC
/begin CHARACTERISTIC speedgoat_test_SN5659__cal_impl.Decode3_P13_ez "" VALUE 0x008E63D8 Scalar_FLOAT64_IEEE 0 speedgoat_test_SN5659_R2020b_CM_double -1.7E+308 1.7E+308 /end CHARACTERISTIC
/begin CHARACTERISTIC speedgoat_test_SN5659__cal_impl.Decode3_P13_fu "" VALUE 0x008E77A0 Scalar_FLOAT64_IEEE 0 speedgoat_test_SN5659_R2020b_CM_double -1.7E+308 1.7E+308 /end CHARACTERISTIC
/begin CHARACTERISTIC speedgoat_test_SN5659__cal_impl.Decode3_P13_j "" VALUE 0x008E2F18 Scalar_FLOAT64_IEEE 0 speedgoat_test_SN5659_R2020b_CM_double -1.7E+308 1.7E+308 /end CHARACTERISTIC
/begin CHARACTERISTIC speedgoat_test_SN5659__cal_impl.Decode3_P13_k "" VALUE 0x008E7108 Scalar_FLOAT64_IEEE 0 speedgoat_test_SN5659_R2020b_CM_double -1.7E+308 1.7E+308 /end CHARACTERISTIC
/begin CHARACTERISTIC speedgoat_test_SN5659__cal_impl.Decode3_P13_my "" VALUE 0x008E6A70 Scalar_FLOAT64_IEEE 0 speedgoat_test_SN5659_R2020b_CM_double -1.7E+308 1.7E+308 /end CHARACTERISTIC
/begin CHARACTERISTIC speedgoat_test_SN5659__cal_impl.Decode3_P14_c "" VALUE 0x008E6A88 Scalar_FLOAT64_IEEE 0 speedgoat_test_SN5659_R2020b_CM_double -1.7E+308 1.7E+308 /end CHARACTERISTIC
/begin CHARACTERISTIC speedgoat_test_SN5659__cal_impl.Decode3_P14_m "" VALUE 0x008E63F0 Scalar_FLOAT64_IEEE 0 speedgoat_test_SN5659_R2020b_CM_double -1.7E+308 1.7E+308 /end CHARACTERISTIC
/begin CHARACTERISTIC speedgoat_test_SN5659__cal_impl.Decode3_P14_nc "" VALUE 0x008E7120 Scalar_FLOAT64_IEEE 0 speedgoat_test_SN5659_R2020b_CM_double -1.7E+308 1.7E+308 /end CHARACTERISTIC
/begin CHARACTERISTIC speedgoat_test_SN5659__cal_impl.Decode3_P14_o "" VALUE 0x008E7E50 Scalar_FLOAT64_IEEE 0 speedgoat_test_SN5659_R2020b_CM_double -1.7E+308 1.7E+308 /end CHARACTERISTIC
/begin CHARACTERISTIC speedgoat_test_SN5659__cal_impl.Decode3_P14_od "" VALUE 0x008E84E8 Scalar_FLOAT64_IEEE 0 speedgoat_test_SN5659_R2020b_CM_double -1.7E+308 1.7E+308 /end CHARACTERISTIC
/begin CHARACTERISTIC speedgoat_test_SN5659__cal_impl.Decode3_P14_p "" VALUE 0x008E2F30 Scalar_FLOAT64_IEEE 0 speedgoat_test_SN5659_R2020b_CM_double -1.7E+308 1.7E+308 /end CHARACTERISTIC
/begin CHARACTERISTIC speedgoat_test_SN5659__cal_impl.Decode3_P14_ph "" VALUE 0x008E77B8 Scalar_FLOAT64_IEEE 0 speedgoat_test_SN5659_R2020b_CM_double -1.7E+308 1.7E+308 /end CHARACTERISTIC
/begin CHARACTERISTIC speedgoat_test_SN5659__cal_impl.Decode3_P15_h "" VALUE 0x008E6408 Scalar_FLOAT64_IEEE 0 speedgoat_test_SN5659_R2020b_CM_double -1.7E+308 1.7E+308 /end CHARACTERISTIC
/begin CHARACTERISTIC speedgoat_test_SN5659__cal_impl.Decode3_P15_hq "" VALUE 0x008E77D0 Scalar_FLOAT64_IEEE 0 speedgoat_test_SN5659_R2020b_CM_double -1.7E+308 1.7E+308 /end CHARACTERISTIC
/begin CHARACTERISTIC speedgoat_test_SN5659__cal_impl.Decode3_P15_i "" VALUE 0x008E8500 Scalar_FLOAT64_IEEE 0 speedgoat_test_SN5659_R2020b_CM_double -1.7E+308 1.7E+308 /end CHARACTERISTIC
/begin CHARACTERISTIC speedgoat_test_SN5659__cal_impl.Decode3_P15_k "" VALUE 0x008E6AA0 Scalar_FLOAT64_IEEE 0 speedgoat_test_SN5659_R2020b_CM_double -1.7E+308 1.7E+308 /end CHARACTERISTIC
/begin CHARACTERISTIC speedgoat_test_SN5659__cal_impl.Decode3_P15_m "" VALUE 0x008E2F48 Scalar_FLOAT64_IEEE 0 speedgoat_test_SN5659_R2020b_CM_double -1.7E+308 1.7E+308 /end CHARACTERISTIC
/begin CHARACTERISTIC speedgoat_test_SN5659__cal_impl.Decode3_P15_n "" VALUE 0x008E7138 Scalar_FLOAT64_IEEE 0 speedgoat_test_SN5659_R2020b_CM_double -1.7E+308 1.7E+308 /end CHARACTERISTIC
/begin CHARACTERISTIC speedgoat_test_SN5659__cal_impl.Decode3_P15_o "" VALUE 0x008E7E68 Scalar_FLOAT64_IEEE 0 speedgoat_test_SN5659_R2020b_CM_double -1.7E+308 1.7E+308 /end CHARACTERISTIC
/begin CHARACTERISTIC speedgoat_test_SN5659__cal_impl.Decode3_P16_c "" VALUE 0x008E7E80 Scalar_FLOAT64_IEEE 0 speedgoat_test_SN5659_R2020b_CM_double -1.7E+308 1.7E+308 /end CHARACTERISTIC
/begin CHARACTERISTIC speedgoat_test_SN5659__cal_impl.Decode3_P16_g "" VALUE 0x008E6420 Scalar_FLOAT64_IEEE 0 speedgoat_test_SN5659_R2020b_CM_double -1.7E+308 1.7E+308 /end CHARACTERISTIC
/begin CHARACTERISTIC speedgoat_test_SN5659__cal_impl.Decode3_P16_i "" VALUE 0x008E7150 Scalar_FLOAT64_IEEE 0 speedgoat_test_SN5659_R2020b_CM_double -1.7E+308 1.7E+308 /end CHARACTERISTIC
/begin CHARACTERISTIC speedgoat_test_SN5659__cal_impl.Decode3_P16_iz "" VALUE 0x008E77E8 Scalar_FLOAT64_IEEE 0 speedgoat_test_SN5659_R2020b_CM_double -1.7E+308 1.7E+308 /end CHARACTERISTIC
/begin CHARACTERISTIC speedgoat_test_SN5659__cal_impl.Decode3_P16_m "" VALUE 0x008E8518 Scalar_FLOAT64_IEEE 0 speedgoat_test_SN5659_R2020b_CM_double -1.7E+308 1.7E+308 /end CHARACTERISTIC
/begin CHARACTERISTIC speedgoat_test_SN5659__cal_impl.Decode3_P16_n "" VALUE 0x008E2F60 Scalar_FLOAT64_IEEE 0 speedgoat_test_SN5659_R2020b_CM_double -1.7E+308 1.7E+308 /end CHARACTERISTIC
/begin CHARACTERISTIC speedgoat_test_SN5659__cal_impl.Decode3_P16_p "" VALUE 0x008E6AB8 Scalar_FLOAT64_IEEE 0 speedgoat_test_SN5659_R2020b_CM_double -1.7E+308 1.7E+308 /end CHARACTERISTIC
/begin CHARACTERISTIC speedgoat_test_SN5659__cal_impl.Decode3_P1_c "" VALUE 0x008E2DF0 Scalar_FLOAT64_IEEE 0 speedgoat_test_SN5659_R2020b_CM_double -1.7E+308 1.7E+308 /end CHARACTERISTIC
/begin CHARACTERISTIC speedgoat_test_SN5659__cal_impl.Decode3_P1_ew "" VALUE 0x008E7D10 Scalar_FLOAT64_IEEE 0 speedgoat_test_SN5659_R2020b_CM_double -1.7E+308 1.7E+308 /end CHARACTERISTIC
/begin CHARACTERISTIC speedgoat_test_SN5659__cal_impl.Decode3_P1_m "" VALUE 0x008E62B0 Scalar_FLOAT64_IEEE 0 speedgoat_test_SN5659_R2020b_CM_double -1.7E+308 1.7E+308 /end CHARACTERISTIC
/begin CHARACTERISTIC speedgoat_test_SN5659__cal_impl.Decode3_P1_mu "" VALUE 0x008E6948 Scalar_FLOAT64_IEEE 0 speedgoat_test_SN5659_R2020b_CM_double -1.7E+308 1.7E+308 /end CHARACTERISTIC
/begin CHARACTERISTIC speedgoat_test_SN5659__cal_impl.Decode3_P1_n "" VALUE 0x008E6FE0 Scalar_FLOAT64_IEEE 0 speedgoat_test_SN5659_R2020b_CM_double -1.7E+308 1.7E+308 /end CHARACTERISTIC
/begin CHARACTERISTIC speedgoat_test_SN5659__cal_impl.Decode3_P1_nz "" VALUE 0x008E83A8 Scalar_FLOAT64_IEEE 0 speedgoat_test_SN5659_R2020b_CM_double -1.7E+308 1.7E+308 /end CHARACTERISTIC
/begin CHARACTERISTIC speedgoat_test_SN5659__cal_impl.Decode3_P1_p "" VALUE 0x008E7678 Scalar_FLOAT64_IEEE 0 speedgoat_test_SN5659_R2020b_CM_double -1.7E+308 1.7E+308 /end CHARACTERISTIC
/begin CHARACTERISTIC speedgoat_test_SN5659__cal_impl.Decode3_P2_c "" VALUE 0x008E62C8 Scalar_FLOAT64_IEEE 0 speedgoat_test_SN5659_R2020b_CM_double -1.7E+308 1.7E+308 /end CHARACTERISTIC
/begin CHARACTERISTIC speedgoat_test_SN5659__cal_impl.Decode3_P2_f "" VALUE 0x008E7690 Scalar_FLOAT64_IEEE 0 speedgoat_test_SN5659_R2020b_CM_double -1.7E+308 1.7E+308 /end CHARACTERISTIC
/begin CHARACTERISTIC speedgoat_test_SN5659__cal_impl.Decode3_P2_j "" VALUE 0x008E2E08 Scalar_FLOAT64_IEEE 0 speedgoat_test_SN5659_R2020b_CM_double -1.7E+308 1.7E+308 /end CHARACTERISTIC
/begin CHARACTERISTIC speedgoat_test_SN5659__cal_impl.Decode3_P2_ll "" VALUE 0x008E7D28 Scalar_FLOAT64_IEEE 0 speedgoat_test_SN5659_R2020b_CM_double -1.7E+308 1.7E+308 /end CHARACTERISTIC
/begin CHARACTERISTIC speedgoat_test_SN5659__cal_impl.Decode3_P2_n "" VALUE 0x008E83C0 Scalar_FLOAT64_IEEE 0 speedgoat_test_SN5659_R2020b_CM_double -1.7E+308 1.7E+308 /end CHARACTERISTIC
/begin CHARACTERISTIC speedgoat_test_SN5659__cal_impl.Decode3_P2_ow "" VALUE 0x008E6960 Scalar_FLOAT64_IEEE 0 speedgoat_test_SN5659_R2020b_CM_double -1.7E+308 1.7E+308 /end CHARACTERISTIC
/begin CHARACTERISTIC speedgoat_test_SN5659__cal_impl.Decode3_P2_pu "" VALUE 0x008E6FF8 Scalar_FLOAT64_IEEE 0 speedgoat_test_SN5659_R2020b_CM_double -1.7E+308 1.7E+308 /end CHARACTERISTIC
/begin CHARACTERISTIC speedgoat_test_SN5659__cal_impl.Decode3_P3_a "" VALUE 0x008E83D8 Scalar_FLOAT64_IEEE 0 speedgoat_test_SN5659_R2020b_CM_double -1.7E+308 1.7E+308 /end CHARACTERISTIC
/begin CHARACTERISTIC speedgoat_test_SN5659__cal_impl.Decode3_P3_d "" VALUE 0x008E76A8 Scalar_FLOAT64_IEEE 0 speedgoat_test_SN5659_R2020b_CM_double -1.7E+308 1.7E+308 /end CHARACTERISTIC
/begin CHARACTERISTIC speedgoat_test_SN5659__cal_impl.Decode3_P3_e "" VALUE 0x008E7010 Scalar_FLOAT64_IEEE 0 speedgoat_test_SN5659_R2020b_CM_double -1.7E+308 1.7E+308 /end CHARACTERISTIC
/begin CHARACTERISTIC speedgoat_test_SN5659__cal_impl.Decode3_P3_ht "" VALUE 0x008E6978 Scalar_FLOAT64_IEEE 0 speedgoat_test_SN5659_R2020b_CM_double -1.7E+308 1.7E+308 /end CHARACTERISTIC
/begin CHARACTERISTIC speedgoat_test_SN5659__cal_impl.Decode3_P3_i "" VALUE 0x008E62E0 Scalar_FLOAT64_IEEE 0 speedgoat_test_SN5659_R2020b_CM_double -1.7E+308 1.7E+308 /end CHARACTERISTIC
/begin CHARACTERISTIC speedgoat_test_SN5659__cal_impl.Decode3_P3_j "" VALUE 0x008E2E20 Scalar_FLOAT64_IEEE 0 speedgoat_test_SN5659_R2020b_CM_double -1.7E+308 1.7E+308 /end CHARACTERISTIC
/begin CHARACTERISTIC speedgoat_test_SN5659__cal_impl.Decode3_P3_o "" VALUE 0x008E7D40 Scalar_FLOAT64_IEEE 0 speedgoat_test_SN5659_R2020b_CM_double -1.7E+308 1.7E+308 /end CHARACTERISTIC
/begin CHARACTERISTIC speedgoat_test_SN5659__cal_impl.Decode3_P4_av "" VALUE 0x008E7D58 Scalar_FLOAT64_IEEE 0 speedgoat_test_SN5659_R2020b_CM_double -1.7E+308 1.7E+308 /end CHARACTERISTIC
/begin CHARACTERISTIC speedgoat_test_SN5659__cal_impl.Decode3_P4_c "" VALUE 0x008E83F0 Scalar_FLOAT64_IEEE 0 speedgoat_test_SN5659_R2020b_CM_double -1.7E+308 1.7E+308 /end CHARACTERISTIC
/begin CHARACTERISTIC speedgoat_test_SN5659__cal_impl.Decode3_P4_dj "" VALUE 0x008E76C0 Scalar_FLOAT64_IEEE 0 speedgoat_test_SN5659_R2020b_CM_double -1.7E+308 1.7E+308 /end CHARACTERISTIC
/begin CHARACTERISTIC speedgoat_test_SN5659__cal_impl.Decode3_P4_g "" VALUE 0x008E6990 Scalar_FLOAT64_IEEE 0 speedgoat_test_SN5659_R2020b_CM_double -1.7E+308 1.7E+308 /end CHARACTERISTIC
/begin CHARACTERISTIC speedgoat_test_SN5659__cal_impl.Decode3_P4_jl "" VALUE 0x008E7028 Scalar_FLOAT64_IEEE 0 speedgoat_test_SN5659_R2020b_CM_double -1.7E+308 1.7E+308 /end CHARACTERISTIC
/begin CHARACTERISTIC speedgoat_test_SN5659__cal_impl.Decode3_P4_m4 "" VALUE 0x008E62F8 Scalar_FLOAT64_IEEE 0 speedgoat_test_SN5659_R2020b_CM_double -1.7E+308 1.7E+308 /end CHARACTERISTIC
/begin CHARACTERISTIC speedgoat_test_SN5659__cal_impl.Decode3_P4_p "" VALUE 0x008E2E38 Scalar_FLOAT64_IEEE 0 speedgoat_test_SN5659_R2020b_CM_double -1.7E+308 1.7E+308 /end CHARACTERISTIC
/begin CHARACTERISTIC speedgoat_test_SN5659__cal_impl.Decode3_P5_as "" VALUE 0x008E7D70 Scalar_FLOAT64_IEEE 0 speedgoat_test_SN5659_R2020b_CM_double -1.7E+308 1.7E+308 /end CHARACTERISTIC
/begin CHARACTERISTIC speedgoat_test_SN5659__cal_impl.Decode3_P5_b "" VALUE 0x008E2E50 Scalar_FLOAT64_IEEE 0 speedgoat_test_SN5659_R2020b_CM_double -1.7E+308 1.7E+308 /end CHARACTERISTIC
/begin CHARACTERISTIC speedgoat_test_SN5659__cal_impl.Decode3_P5_e "" VALUE 0x008E69A8 Scalar_FLOAT64_IEEE 0 speedgoat_test_SN5659_R2020b_CM_double -1.7E+308 1.7E+308 /end CHARACTERISTIC
/begin CHARACTERISTIC speedgoat_test_SN5659__cal_impl.Decode3_P5_gt "" VALUE 0x008E8408 Scalar_FLOAT64_IEEE 0 speedgoat_test_SN5659_R2020b_CM_double -1.7E+308 1.7E+308 /end CHARACTERISTIC
/begin CHARACTERISTIC speedgoat_test_SN5659__cal_impl.Decode3_P5_j "" VALUE 0x008E76D8 Scalar_FLOAT64_IEEE 0 speedgoat_test_SN5659_R2020b_CM_double -1.7E+308 1.7E+308 /end CHARACTERISTIC
/begin CHARACTERISTIC speedgoat_test_SN5659__cal_impl.Decode3_P5_nh "" VALUE 0x008E6310 Scalar_FLOAT64_IEEE 0 speedgoat_test_SN5659_R2020b_CM_double -1.7E+308 1.7E+308 /end CHARACTERISTIC
/begin CHARACTERISTIC speedgoat_test_SN5659__cal_impl.Decode3_P5_o "" VALUE 0x008E7040 Scalar_FLOAT64_IEEE 0 speedgoat_test_SN5659_R2020b_CM_double -1.7E+308 1.7E+308 /end CHARACTERISTIC
/begin CHARACTERISTIC speedgoat_test_SN5659__cal_impl.Decode3_P6_f "" VALUE 0x008E76F0 Scalar_FLOAT64_IEEE 0 speedgoat_test_SN5659_R2020b_CM_double -1.7E+308 1.7E+308 /end CHARACTERISTIC
/begin CHARACTERISTIC speedgoat_test_SN5659__cal_impl.Decode3_P6_g "" VALUE 0x008E69C0 Scalar_FLOAT64_IEEE 0 speedgoat_test_SN5659_R2020b_CM_double -1.7E+308 1.7E+308 /end CHARACTERISTIC
/begin CHARACTERISTIC speedgoat_test_SN5659__cal_impl.Decode3_P6_h "" VALUE 0x008E2E68 Scalar_FLOAT64_IEEE 0 speedgoat_test_SN5659_R2020b_CM_double -1.7E+308 1.7E+308 /end CHARACTERISTIC
/begin CHARACTERISTIC speedgoat_test_SN5659__cal_impl.Decode3_P6_ib "" VALUE 0x008E7058 Scalar_FLOAT64_IEEE 0 speedgoat_test_SN5659_R2020b_CM_double -1.7E+308 1.7E+308 /end CHARACTERISTIC
/begin CHARACTERISTIC speedgoat_test_SN5659__cal_impl.Decode3_P6_j "" VALUE 0x008E7D88 Scalar_FLOAT64_IEEE 0 speedgoat_test_SN5659_R2020b_CM_double -1.7E+308 1.7E+308 /end CHARACTERISTIC
/begin CHARACTERISTIC speedgoat_test_SN5659__cal_impl.Decode3_P6_l "" VALUE 0x008E6328 Scalar_FLOAT64_IEEE 0 speedgoat_test_SN5659_R2020b_CM_double -1.7E+308 1.7E+308 /end CHARACTERISTIC
/begin CHARACTERISTIC speedgoat_test_SN5659__cal_impl.Decode3_P6_ov "" VALUE 0x008E8420 Scalar_FLOAT64_IEEE 0 speedgoat_test_SN5659_R2020b_CM_double -1.7E+308 1.7E+308 /end CHARACTERISTIC
/begin CHARACTERISTIC speedgoat_test_SN5659__cal_impl.Decode3_P7_bv "" VALUE 0x008E6340 Scalar_FLOAT64_IEEE 0 speedgoat_test_SN5659_R2020b_CM_double -1.7E+308 1.7E+308 /end CHARACTERISTIC
/begin CHARACTERISTIC speedgoat_test_SN5659__cal_impl.Decode3_P7_d "" VALUE 0x008E2E80 Scalar_FLOAT64_IEEE 0 speedgoat_test_SN5659_R2020b_CM_double -1.7E+308 1.7E+308 /end CHARACTERISTIC
/begin CHARACTERISTIC speedgoat_test_SN5659__cal_impl.Decode3_P7_fb "" VALUE 0x008E7DA0 Scalar_FLOAT64_IEEE 0 speedgoat_test_SN5659_R2020b_CM_double -1.7E+308 1.7E+308 /end CHARACTERISTIC
/begin CHARACTERISTIC speedgoat_test_SN5659__cal_impl.Decode3_P7_fx "" VALUE 0x008E7070 Scalar_FLOAT64_IEEE 0 speedgoat_test_SN5659_R2020b_CM_double -1.7E+308 1.7E+308 /end CHARACTERISTIC
/begin CHARACTERISTIC speedgoat_test_SN5659__cal_impl.Decode3_P7_ix "" VALUE 0x008E8438 Scalar_FLOAT64_IEEE 0 speedgoat_test_SN5659_R2020b_CM_double -1.7E+308 1.7E+308 /end CHARACTERISTIC
/begin CHARACTERISTIC speedgoat_test_SN5659__cal_impl.Decode3_P7_m "" VALUE 0x008E69D8 Scalar_FLOAT64_IEEE 0 speedgoat_test_SN5659_R2020b_CM_double -1.7E+308 1.7E+308 /end CHARACTERISTIC
/begin CHARACTERISTIC speedgoat_test_SN5659__cal_impl.Decode3_P7_p "" VALUE 0x008E7708 Scalar_FLOAT64_IEEE 0 speedgoat_test_SN5659_R2020b_CM_double -1.7E+308 1.7E+308 /end CHARACTERISTIC
/begin CHARACTERISTIC speedgoat_test_SN5659__cal_impl.Decode3_P8_a "" VALUE 0x008E69F0 Scalar_FLOAT64_IEEE 0 speedgoat_test_SN5659_R2020b_CM_double -1.7E+308 1.7E+308 /end CHARACTERISTIC
/begin CHARACTERISTIC speedgoat_test_SN5659__cal_impl.Decode3_P8_b "" VALUE 0x008E7088 Scalar_FLOAT64_IEEE 0 speedgoat_test_SN5659_R2020b_CM_double -1.7E+308 1.7E+308 /end CHARACTERISTIC
/begin CHARACTERISTIC speedgoat_test_SN5659__cal_impl.Decode3_P8_d "" VALUE 0x008E7DB8 Scalar_FLOAT64_IEEE 0 speedgoat_test_SN5659_R2020b_CM_double -1.7E+308 1.7E+308 /end CHARACTERISTIC
/begin CHARACTERISTIC speedgoat_test_SN5659__cal_impl.Decode3_P8_f "" VALUE 0x008E7720 Scalar_FLOAT64_IEEE 0 speedgoat_test_SN5659_R2020b_CM_double -1.7E+308 1.7E+308 /end CHARACTERISTIC
/begin CHARACTERISTIC speedgoat_test_SN5659__cal_impl.Decode3_P8_h "" VALUE 0x008E2E98 Scalar_FLOAT64_IEEE 0 speedgoat_test_SN5659_R2020b_CM_double -1.7E+308 1.7E+308 /end CHARACTERISTIC
/begin CHARACTERISTIC speedgoat_test_SN5659__cal_impl.Decode3_P8_ig "" VALUE 0x008E6358 Scalar_FLOAT64_IEEE 0 speedgoat_test_SN5659_R2020b_CM_double -1.7E+308 1.7E+308 /end CHARACTERISTIC
/begin CHARACTERISTIC speedgoat_test_SN5659__cal_impl.Decode3_P8_n "" VALUE 0x008E8450 Scalar_FLOAT64_IEEE 0 speedgoat_test_SN5659_R2020b_CM_double -1.7E+308 1.7E+308 /end CHARACTERISTIC
/begin CHARACTERISTIC speedgoat_test_SN5659__cal_impl.Decode3_P9_dw "" VALUE 0x008E6A08 Scalar_FLOAT64_IEEE 0 speedgoat_test_SN5659_R2020b_CM_double -1.7E+308 1.7E+308 /end CHARACTERISTIC
/begin CHARACTERISTIC speedgoat_test_SN5659__cal_impl.Decode3_P9_dy "" VALUE 0x008E70A0 Scalar_FLOAT64_IEEE 0 speedgoat_test_SN5659_R2020b_CM_double -1.7E+308 1.7E+308 /end CHARACTERISTIC
/begin CHARACTERISTIC speedgoat_test_SN5659__cal_impl.Decode3_P9_f "" VALUE 0x008E7DD0 Scalar_FLOAT64_IEEE 0 speedgoat_test_SN5659_R2020b_CM_double -1.7E+308 1.7E+308 /end CHARACTERISTIC
/begin CHARACTERISTIC speedgoat_test_SN5659__cal_impl.Decode3_P9_i "" VALUE 0x008E2EB0 Scalar_FLOAT64_IEEE 0 speedgoat_test_SN5659_R2020b_CM_double -1.7E+308 1.7E+308 /end CHARACTERISTIC
/begin CHARACTERISTIC speedgoat_test_SN5659__cal_impl.Decode3_P9_ig "" VALUE 0x008E7738 Scalar_FLOAT64_IEEE 0 speedgoat_test_SN5659_R2020b_CM_double -1.7E+308 1.7E+308 /end CHARACTERISTIC
/begin CHARACTERISTIC speedgoat_test_SN5659__cal_impl.Decode3_P9_m5 "" VALUE 0x008E6370 Scalar_FLOAT64_IEEE 0 speedgoat_test_SN5659_R2020b_CM_double -1.7E+308 1.7E+308 /end CHARACTERISTIC
/begin CHARACTERISTIC speedgoat_test_SN5659__cal_impl.Decode3_P9_p "" VALUE 0x008E8468 Scalar_FLOAT64_IEEE 0 speedgoat_test_SN5659_R2020b_CM_double -1.7E+308 1.7E+308 /end CHARACTERISTIC
/begin CHARACTERISTIC speedgoat_test_SN5659__cal_impl.Decode4_P10_ax "" VAL_BLK 0x008E7F70 Scalar_FLOAT64_IEEE 0 speedgoat_test_SN5659_R2020b_CM_double -1.7E+308 1.7E+308 MATRIX_DIM 2 1 /end CHARACTERISTIC
/begin CHARACTERISTIC speedgoat_test_SN5659__cal_impl.Decode4_P10_bv "" VAL_BLK 0x008E6BA8 Scalar_FLOAT64_IEEE 0 speedgoat_test_SN5659_R2020b_CM_double -1.7E+308 1.7E+308 MATRIX_DIM 2 1 /end CHARACTERISTIC
/begin CHARACTERISTIC speedgoat_test_SN5659__cal_impl.Decode4_P10_d "" VAL_BLK 0x008E3050 Scalar_FLOAT64_IEEE 0 speedgoat_test_SN5659_R2020b_CM_double -1.7E+308 1.7E+308 MATRIX_DIM 2 1 /end CHARACTERISTIC
/begin CHARACTERISTIC speedgoat_test_SN5659__cal_impl.Decode4_P10_k "" VAL_BLK 0x008E8608 Scalar_FLOAT64_IEEE 0 speedgoat_test_SN5659_R2020b_CM_double -1.7E+308 1.7E+308 MATRIX_DIM 2 1 /end CHARACTERISTIC
/begin CHARACTERISTIC speedgoat_test_SN5659__cal_impl.Decode4_P10_l "" VAL_BLK 0x008E78D8 Scalar_FLOAT64_IEEE 0 speedgoat_test_SN5659_R2020b_CM_double -1.7E+308 1.7E+308 MATRIX_DIM 2 1 /end CHARACTERISTIC
/begin CHARACTERISTIC speedgoat_test_SN5659__cal_impl.Decode4_P10_mz "" VAL_BLK 0x008E7240 Scalar_FLOAT64_IEEE 0 speedgoat_test_SN5659_R2020b_CM_double -1.7E+308 1.7E+308 MATRIX_DIM 2 1 /end CHARACTERISTIC
/begin CHARACTERISTIC speedgoat_test_SN5659__cal_impl.Decode4_P10_o "" VAL_BLK 0x008E6510 Scalar_FLOAT64_IEEE 0 speedgoat_test_SN5659_R2020b_CM_double -1.7E+308 1.7E+308 MATRIX_DIM 2 1 /end CHARACTERISTIC
/begin CHARACTERISTIC speedgoat_test_SN5659__cal_impl.Decode4_P11_a "" VALUE 0x008E6BC8 Scalar_FLOAT64_IEEE 0 speedgoat_test_SN5659_R2020b_CM_double -1.7E+308 1.7E+308 /end CHARACTERISTIC
/begin CHARACTERISTIC speedgoat_test_SN5659__cal_impl.Decode4_P11_c "" VALUE 0x008E7260 Scalar_FLOAT64_IEEE 0 speedgoat_test_SN5659_R2020b_CM_double -1.7E+308 1.7E+308 /end CHARACTERISTIC
/begin CHARACTERISTIC speedgoat_test_SN5659__cal_impl.Decode4_P11_dk "" VALUE 0x008E78F8 Scalar_FLOAT64_IEEE 0 speedgoat_test_SN5659_R2020b_CM_double -1.7E+308 1.7E+308 /end CHARACTERISTIC
/begin CHARACTERISTIC speedgoat_test_SN5659__cal_impl.Decode4_P11_g "" VALUE 0x008E3070 Scalar_FLOAT64_IEEE 0 speedgoat_test_SN5659_R2020b_CM_double -1.7E+308 1.7E+308 /end CHARACTERISTIC
/begin CHARACTERISTIC speedgoat_test_SN5659__cal_impl.Decode4_P11_j "" VALUE 0x008E6530 Scalar_FLOAT64_IEEE 0 speedgoat_test_SN5659_R2020b_CM_double -1.7E+308 1.7E+308 /end CHARACTERISTIC
/begin CHARACTERISTIC speedgoat_test_SN5659__cal_impl.Decode4_P11_mg "" VALUE 0x008E8628 Scalar_FLOAT64_IEEE 0 speedgoat_test_SN5659_R2020b_CM_double -1.7E+308 1.7E+308 /end CHARACTERISTIC
/begin CHARACTERISTIC speedgoat_test_SN5659__cal_impl.Decode4_P11_mt "" VALUE 0x008E7F90 Scalar_FLOAT64_IEEE 0 speedgoat_test_SN5659_R2020b_CM_double -1.7E+308 1.7E+308 /end CHARACTERISTIC
/begin CHARACTERISTIC speedgoat_test_SN5659__cal_impl.Decode4_P12_ci "" VALUE 0x008E8640 Scalar_FLOAT64_IEEE 0 speedgoat_test_SN5659_R2020b_CM_double -1.7E+308 1.7E+308 /end CHARACTERISTIC
/begin CHARACTERISTIC speedgoat_test_SN5659__cal_impl.Decode4_P12_e "" VALUE 0x008E3088 Scalar_FLOAT64_IEEE 0 speedgoat_test_SN5659_R2020b_CM_double -1.7E+308 1.7E+308 /end CHARACTERISTIC
/begin CHARACTERISTIC speedgoat_test_SN5659__cal_impl.Decode4_P12_ff "" VALUE 0x008E7278 Scalar_FLOAT64_IEEE 0 speedgoat_test_SN5659_R2020b_CM_double -1.7E+308 1.7E+308 /end CHARACTERISTIC
/begin CHARACTERISTIC speedgoat_test_SN5659__cal_impl.Decode4_P12_i "" VALUE 0x008E7910 Scalar_FLOAT64_IEEE 0 speedgoat_test_SN5659_R2020b_CM_double -1.7E+308 1.7E+308 /end CHARACTERISTIC
/begin CHARACTERISTIC speedgoat_test_SN5659__cal_impl.Decode4_P12_ik "" VALUE 0x008E7FA8 Scalar_FLOAT64_IEEE 0 speedgoat_test_SN5659_R2020b_CM_double -1.7E+308 1.7E+308 /end CHARACTERISTIC
/begin CHARACTERISTIC speedgoat_test_SN5659__cal_impl.Decode4_P12_j "" VALUE 0x008E6548 Scalar_FLOAT64_IEEE 0 speedgoat_test_SN5659_R2020b_CM_double -1.7E+308 1.7E+308 /end CHARACTERISTIC
/begin CHARACTERISTIC speedgoat_test_SN5659__cal_impl.Decode4_P12_nu "" VALUE 0x008E6BE0 Scalar_FLOAT64_IEEE 0 speedgoat_test_SN5659_R2020b_CM_double -1.7E+308 1.7E+308 /end CHARACTERISTIC
/begin CHARACTERISTIC speedgoat_test_SN5659__cal_impl.Decode4_P13_aq "" VALUE 0x008E6BF8 Scalar_FLOAT64_IEEE 0 speedgoat_test_SN5659_R2020b_CM_double -1.7E+308 1.7E+308 /end CHARACTERISTIC
/begin CHARACTERISTIC speedgoat_test_SN5659__cal_impl.Decode4_P13_cn "" VALUE 0x008E7FC0 Scalar_FLOAT64_IEEE 0 speedgoat_test_SN5659_R2020b_CM_double -1.7E+308 1.7E+308 /end CHARACTERISTIC
/begin CHARACTERISTIC speedgoat_test_SN5659__cal_impl.Decode4_P13_gv "" VALUE 0x008E7928 Scalar_FLOAT64_IEEE 0 speedgoat_test_SN5659_R2020b_CM_double -1.7E+308 1.7E+308 /end CHARACTERISTIC
/begin CHARACTERISTIC speedgoat_test_SN5659__cal_impl.Decode4_P13_io "" VALUE 0x008E6560 Scalar_FLOAT64_IEEE 0 speedgoat_test_SN5659_R2020b_CM_double -1.7E+308 1.7E+308 /end CHARACTERISTIC
/begin CHARACTERISTIC speedgoat_test_SN5659__cal_impl.Decode4_P13_l "" VALUE 0x008E8658 Scalar_FLOAT64_IEEE 0 speedgoat_test_SN5659_R2020b_CM_double -1.7E+308 1.7E+308 /end CHARACTERISTIC
/begin CHARACTERISTIC speedgoat_test_SN5659__cal_impl.Decode4_P13_n "" VALUE 0x008E7290 Scalar_FLOAT64_IEEE 0 speedgoat_test_SN5659_R2020b_CM_double -1.7E+308 1.7E+308 /end CHARACTERISTIC
/begin CHARACTERISTIC speedgoat_test_SN5659__cal_impl.Decode4_P13_o "" VALUE 0x008E30A0 Scalar_FLOAT64_IEEE 0 speedgoat_test_SN5659_R2020b_CM_double -1.7E+308 1.7E+308 /end CHARACTERISTIC
/begin CHARACTERISTIC speedgoat_test_SN5659__cal_impl.Decode4_P14_b "" VALUE 0x008E8670 Scalar_FLOAT64_IEEE 0 speedgoat_test_SN5659_R2020b_CM_double -1.7E+308 1.7E+308 /end CHARACTERISTIC
/begin CHARACTERISTIC speedgoat_test_SN5659__cal_impl.Decode4_P14_dy "" VALUE 0x008E6C10 Scalar_FLOAT64_IEEE 0 speedgoat_test_SN5659_R2020b_CM_double -1.7E+308 1.7E+308 /end CHARACTERISTIC
/begin CHARACTERISTIC speedgoat_test_SN5659__cal_impl.Decode4_P14_fz "" VALUE 0x008E7FD8 Scalar_FLOAT64_IEEE 0 speedgoat_test_SN5659_R2020b_CM_double -1.7E+308 1.7E+308 /end CHARACTERISTIC
/begin CHARACTERISTIC speedgoat_test_SN5659__cal_impl.Decode4_P14_k "" VALUE 0x008E30B8 Scalar_FLOAT64_IEEE 0 speedgoat_test_SN5659_R2020b_CM_double -1.7E+308 1.7E+308 /end CHARACTERISTIC
/begin CHARACTERISTIC speedgoat_test_SN5659__cal_impl.Decode4_P14_l4 "" VALUE 0x008E6578 Scalar_FLOAT64_IEEE 0 speedgoat_test_SN5659_R2020b_CM_double -1.7E+308 1.7E+308 /end CHARACTERISTIC
/begin CHARACTERISTIC speedgoat_test_SN5659__cal_impl.Decode4_P14_lo "" VALUE 0x008E72A8 Scalar_FLOAT64_IEEE 0 speedgoat_test_SN5659_R2020b_CM_double -1.7E+308 1.7E+308 /end CHARACTERISTIC
/begin CHARACTERISTIC speedgoat_test_SN5659__cal_impl.Decode4_P14_m "" VALUE 0x008E7940 Scalar_FLOAT64_IEEE 0 speedgoat_test_SN5659_R2020b_CM_double -1.7E+308 1.7E+308 /end CHARACTERISTIC
/begin CHARACTERISTIC speedgoat_test_SN5659__cal_impl.Decode4_P15_dv "" VALUE 0x008E6590 Scalar_FLOAT64_IEEE 0 speedgoat_test_SN5659_R2020b_CM_double -1.7E+308 1.7E+308 /end CHARACTERISTIC
/begin CHARACTERISTIC speedgoat_test_SN5659__cal_impl.Decode4_P15_h "" VALUE 0x008E8688 Scalar_FLOAT64_IEEE 0 speedgoat_test_SN5659_R2020b_CM_double -1.7E+308 1.7E+308 /end CHARACTERISTIC
/begin CHARACTERISTIC speedgoat_test_SN5659__cal_impl.Decode4_P15_j "" VALUE 0x008E30D0 Scalar_FLOAT64_IEEE 0 speedgoat_test_SN5659_R2020b_CM_double -1.7E+308 1.7E+308 /end CHARACTERISTIC
/begin CHARACTERISTIC speedgoat_test_SN5659__cal_impl.Decode4_P15_l "" VALUE 0x008E7FF0 Scalar_FLOAT64_IEEE 0 speedgoat_test_SN5659_R2020b_CM_double -1.7E+308 1.7E+308 /end CHARACTERISTIC
/begin CHARACTERISTIC speedgoat_test_SN5659__cal_impl.Decode4_P15_n "" VALUE 0x008E6C28 Scalar_FLOAT64_IEEE 0 speedgoat_test_SN5659_R2020b_CM_double -1.7E+308 1.7E+308 /end CHARACTERISTIC
/begin CHARACTERISTIC speedgoat_test_SN5659__cal_impl.Decode4_P15_p "" VALUE 0x008E72C0 Scalar_FLOAT64_IEEE 0 speedgoat_test_SN5659_R2020b_CM_double -1.7E+308 1.7E+308 /end CHARACTERISTIC
/begin CHARACTERISTIC speedgoat_test_SN5659__cal_impl.Decode4_P15_pv "" VALUE 0x008E7958 Scalar_FLOAT64_IEEE 0 speedgoat_test_SN5659_R2020b_CM_double -1.7E+308 1.7E+308 /end CHARACTERISTIC
/begin CHARACTERISTIC speedgoat_test_SN5659__cal_impl.Decode4_P16_ad "" VALUE 0x008E7970 Scalar_FLOAT64_IEEE 0 speedgoat_test_SN5659_R2020b_CM_double -1.7E+308 1.7E+308 /end CHARACTERISTIC
/begin CHARACTERISTIC speedgoat_test_SN5659__cal_impl.Decode4_P16_b "" VALUE 0x008E30E8 Scalar_FLOAT64_IEEE 0 speedgoat_test_SN5659_R2020b_CM_double -1.7E+308 1.7E+308 /end CHARACTERISTIC
/begin CHARACTERISTIC speedgoat_test_SN5659__cal_impl.Decode4_P16_du "" VALUE 0x008E8008 Scalar_FLOAT64_IEEE 0 speedgoat_test_SN5659_R2020b_CM_double -1.7E+308 1.7E+308 /end CHARACTERISTIC
/begin CHARACTERISTIC speedgoat_test_SN5659__cal_impl.Decode4_P16_ec "" VALUE 0x008E72D8 Scalar_FLOAT64_IEEE 0 speedgoat_test_SN5659_R2020b_CM_double -1.7E+308 1.7E+308 /end CHARACTERISTIC
/begin CHARACTERISTIC speedgoat_test_SN5659__cal_impl.Decode4_P16_gq "" VALUE 0x008E6C40 Scalar_FLOAT64_IEEE 0 speedgoat_test_SN5659_R2020b_CM_double -1.7E+308 1.7E+308 /end CHARACTERISTIC
/begin CHARACTERISTIC speedgoat_test_SN5659__cal_impl.Decode4_P16_j "" VALUE 0x008E65A8 Scalar_FLOAT64_IEEE 0 speedgoat_test_SN5659_R2020b_CM_double -1.7E+308 1.7E+308 /end CHARACTERISTIC
/begin CHARACTERISTIC speedgoat_test_SN5659__cal_impl.Decode4_P16_n "" VALUE 0x008E86A0 Scalar_FLOAT64_IEEE 0 speedgoat_test_SN5659_R2020b_CM_double -1.7E+308 1.7E+308 /end CHARACTERISTIC
/begin CHARACTERISTIC speedgoat_test_SN5659__cal_impl.Decode4_P1_d "" VALUE 0x008E7E98 Scalar_FLOAT64_IEEE 0 speedgoat_test_SN5659_R2020b_CM_double -1.7E+308 1.7E+308 /end CHARACTERISTIC
/begin CHARACTERISTIC speedgoat_test_SN5659__cal_impl.Decode4_P1_f "" VALUE 0x008E6438 Scalar_FLOAT64_IEEE 0 speedgoat_test_SN5659_R2020b_CM_double -1.7E+308 1.7E+308 /end CHARACTERISTIC
/begin CHARACTERISTIC speedgoat_test_SN5659__cal_impl.Decode4_P1_fa "" VALUE 0x008E7800 Scalar_FLOAT64_IEEE 0 speedgoat_test_SN5659_R2020b_CM_double -1.7E+308 1.7E+308 /end CHARACTERISTIC
/begin CHARACTERISTIC speedgoat_test_SN5659__cal_impl.Decode4_P1_i "" VALUE 0x008E2F78 Scalar_FLOAT64_IEEE 0 speedgoat_test_SN5659_R2020b_CM_double -1.7E+308 1.7E+308 /end CHARACTERISTIC
/begin CHARACTERISTIC speedgoat_test_SN5659__cal_impl.Decode4_P1_m "" VALUE 0x008E7168 Scalar_FLOAT64_IEEE 0 speedgoat_test_SN5659_R2020b_CM_double -1.7E+308 1.7E+308 /end CHARACTERISTIC
/begin CHARACTERISTIC speedgoat_test_SN5659__cal_impl.Decode4_P1_ml "" VALUE 0x008E8530 Scalar_FLOAT64_IEEE 0 speedgoat_test_SN5659_R2020b_CM_double -1.7E+308 1.7E+308 /end CHARACTERISTIC
/begin CHARACTERISTIC speedgoat_test_SN5659__cal_impl.Decode4_P1_px "" VALUE 0x008E6AD0 Scalar_FLOAT64_IEEE 0 speedgoat_test_SN5659_R2020b_CM_double -1.7E+308 1.7E+308 /end CHARACTERISTIC
/begin CHARACTERISTIC speedgoat_test_SN5659__cal_impl.Decode4_P2_b "" VALUE 0x008E7EB0 Scalar_FLOAT64_IEEE 0 speedgoat_test_SN5659_R2020b_CM_double -1.7E+308 1.7E+308 /end CHARACTERISTIC
/begin CHARACTERISTIC speedgoat_test_SN5659__cal_impl.Decode4_P2_e "" VALUE 0x008E6AE8 Scalar_FLOAT64_IEEE 0 speedgoat_test_SN5659_R2020b_CM_double -1.7E+308 1.7E+308 /end CHARACTERISTIC
/begin CHARACTERISTIC speedgoat_test_SN5659__cal_impl.Decode4_P2_e5 "" VALUE 0x008E7818 Scalar_FLOAT64_IEEE 0 speedgoat_test_SN5659_R2020b_CM_double -1.7E+308 1.7E+308 /end CHARACTERISTIC
/begin CHARACTERISTIC speedgoat_test_SN5659__cal_impl.Decode4_P2_h "" VALUE 0x008E7180 Scalar_FLOAT64_IEEE 0 speedgoat_test_SN5659_R2020b_CM_double -1.7E+308 1.7E+308 /end CHARACTERISTIC
/begin CHARACTERISTIC speedgoat_test_SN5659__cal_impl.Decode4_P2_k "" VALUE 0x008E2F90 Scalar_FLOAT64_IEEE 0 speedgoat_test_SN5659_R2020b_CM_double -1.7E+308 1.7E+308 /end CHARACTERISTIC
/begin CHARACTERISTIC speedgoat_test_SN5659__cal_impl.Decode4_P2_l1 "" VALUE 0x008E8548 Scalar_FLOAT64_IEEE 0 speedgoat_test_SN5659_R2020b_CM_double -1.7E+308 1.7E+308 /end CHARACTERISTIC
/begin CHARACTERISTIC speedgoat_test_SN5659__cal_impl.Decode4_P2_pq "" VALUE 0x008E6450 Scalar_FLOAT64_IEEE 0 speedgoat_test_SN5659_R2020b_CM_double -1.7E+308 1.7E+308 /end CHARACTERISTIC
/begin CHARACTERISTIC speedgoat_test_SN5659__cal_impl.Decode4_P3_g "" VALUE 0x008E6B00 Scalar_FLOAT64_IEEE 0 speedgoat_test_SN5659_R2020b_CM_double -1.7E+308 1.7E+308 /end CHARACTERISTIC
/begin CHARACTERISTIC speedgoat_test_SN5659__cal_impl.Decode4_P3_i "" VALUE 0x008E8560 Scalar_FLOAT64_IEEE 0 speedgoat_test_SN5659_R2020b_CM_double -1.7E+308 1.7E+308 /end CHARACTERISTIC
/begin CHARACTERISTIC speedgoat_test_SN5659__cal_impl.Decode4_P3_k "" VALUE 0x008E6468 Scalar_FLOAT64_IEEE 0 speedgoat_test_SN5659_R2020b_CM_double -1.7E+308 1.7E+308 /end CHARACTERISTIC
/begin CHARACTERISTIC speedgoat_test_SN5659__cal_impl.Decode4_P3_l "" VALUE 0x008E2FA8 Scalar_FLOAT64_IEEE 0 speedgoat_test_SN5659_R2020b_CM_double -1.7E+308 1.7E+308 /end CHARACTERISTIC
/begin CHARACTERISTIC speedgoat_test_SN5659__cal_impl.Decode4_P3_mv "" VALUE 0x008E7EC8 Scalar_FLOAT64_IEEE 0 speedgoat_test_SN5659_R2020b_CM_double -1.7E+308 1.7E+308 /end CHARACTERISTIC
/begin CHARACTERISTIC speedgoat_test_SN5659__cal_impl.Decode4_P3_n "" VALUE 0x008E7198 Scalar_FLOAT64_IEEE 0 speedgoat_test_SN5659_R2020b_CM_double -1.7E+308 1.7E+308 /end CHARACTERISTIC
/begin CHARACTERISTIC speedgoat_test_SN5659__cal_impl.Decode4_P3_p4 "" VALUE 0x008E7830 Scalar_FLOAT64_IEEE 0 speedgoat_test_SN5659_R2020b_CM_double -1.7E+308 1.7E+308 /end CHARACTERISTIC
/begin CHARACTERISTIC speedgoat_test_SN5659__cal_impl.Decode4_P4_b "" VALUE 0x008E71B0 Scalar_FLOAT64_IEEE 0 speedgoat_test_SN5659_R2020b_CM_double -1.7E+308 1.7E+308 /end CHARACTERISTIC
/begin CHARACTERISTIC speedgoat_test_SN5659__cal_impl.Decode4_P4_f1 "" VALUE 0x008E8578 Scalar_FLOAT64_IEEE 0 speedgoat_test_SN5659_R2020b_CM_double -1.7E+308 1.7E+308 /end CHARACTERISTIC
/begin CHARACTERISTIC speedgoat_test_SN5659__cal_impl.Decode4_P4_ft "" VALUE 0x008E6480 Scalar_FLOAT64_IEEE 0 speedgoat_test_SN5659_R2020b_CM_double -1.7E+308 1.7E+308 /end CHARACTERISTIC
/begin CHARACTERISTIC speedgoat_test_SN5659__cal_impl.Decode4_P4_g "" VALUE 0x008E6B18 Scalar_FLOAT64_IEEE 0 speedgoat_test_SN5659_R2020b_CM_double -1.7E+308 1.7E+308 /end CHARACTERISTIC
/begin CHARACTERISTIC speedgoat_test_SN5659__cal_impl.Decode4_P4_k "" VALUE 0x008E2FC0 Scalar_FLOAT64_IEEE 0 speedgoat_test_SN5659_R2020b_CM_double -1.7E+308 1.7E+308 /end CHARACTERISTIC
/begin CHARACTERISTIC speedgoat_test_SN5659__cal_impl.Decode4_P4_kx "" VALUE 0x008E7EE0 Scalar_FLOAT64_IEEE 0 speedgoat_test_SN5659_R2020b_CM_double -1.7E+308 1.7E+308 /end CHARACTERISTIC
/begin CHARACTERISTIC speedgoat_test_SN5659__cal_impl.Decode4_P4_p2 "" VALUE 0x008E7848 Scalar_FLOAT64_IEEE 0 speedgoat_test_SN5659_R2020b_CM_double -1.7E+308 1.7E+308 /end CHARACTERISTIC
/begin CHARACTERISTIC speedgoat_test_SN5659__cal_impl.Decode4_P5_cd "" VALUE 0x008E7860 Scalar_FLOAT64_IEEE 0 speedgoat_test_SN5659_R2020b_CM_double -1.7E+308 1.7E+308 /end CHARACTERISTIC
/begin CHARACTERISTIC speedgoat_test_SN5659__cal_impl.Decode4_P5_cm "" VALUE 0x008E6B30 Scalar_FLOAT64_IEEE 0 speedgoat_test_SN5659_R2020b_CM_double -1.7E+308 1.7E+308 /end CHARACTERISTIC
/begin CHARACTERISTIC speedgoat_test_SN5659__cal_impl.Decode4_P5_d "" VALUE 0x008E6498 Scalar_FLOAT64_IEEE 0 speedgoat_test_SN5659_R2020b_CM_double -1.7E+308 1.7E+308 /end CHARACTERISTIC
/begin CHARACTERISTIC speedgoat_test_SN5659__cal_impl.Decode4_P5_h "" VALUE 0x008E8590 Scalar_FLOAT64_IEEE 0 speedgoat_test_SN5659_R2020b_CM_double -1.7E+308 1.7E+308 /end CHARACTERISTIC
/begin CHARACTERISTIC speedgoat_test_SN5659__cal_impl.Decode4_P5_i "" VALUE 0x008E2FD8 Scalar_FLOAT64_IEEE 0 speedgoat_test_SN5659_R2020b_CM_double -1.7E+308 1.7E+308 /end CHARACTERISTIC
/begin CHARACTERISTIC speedgoat_test_SN5659__cal_impl.Decode4_P5_ia "" VALUE 0x008E7EF8 Scalar_FLOAT64_IEEE 0 speedgoat_test_SN5659_R2020b_CM_double -1.7E+308 1.7E+308 /end CHARACTERISTIC
/begin CHARACTERISTIC speedgoat_test_SN5659__cal_impl.Decode4_P5_m "" VALUE 0x008E71C8 Scalar_FLOAT64_IEEE 0 speedgoat_test_SN5659_R2020b_CM_double -1.7E+308 1.7E+308 /end CHARACTERISTIC
/begin CHARACTERISTIC speedgoat_test_SN5659__cal_impl.Decode4_P6_an "" VALUE 0x008E7F10 Scalar_FLOAT64_IEEE 0 speedgoat_test_SN5659_R2020b_CM_double -1.7E+308 1.7E+308 /end CHARACTERISTIC
/begin CHARACTERISTIC speedgoat_test_SN5659__cal_impl.Decode4_P6_awi "" VALUE 0x008E6B48 Scalar_FLOAT64_IEEE 0 speedgoat_test_SN5659_R2020b_CM_double -1.7E+308 1.7E+308 /end CHARACTERISTIC
/begin CHARACTERISTIC speedgoat_test_SN5659__cal_impl.Decode4_P6_d "" VALUE 0x008E71E0 Scalar_FLOAT64_IEEE 0 speedgoat_test_SN5659_R2020b_CM_double -1.7E+308 1.7E+308 /end CHARACTERISTIC
/begin CHARACTERISTIC speedgoat_test_SN5659__cal_impl.Decode4_P6_fd "" VALUE 0x008E7878 Scalar_FLOAT64_IEEE 0 speedgoat_test_SN5659_R2020b_CM_double -1.7E+308 1.7E+308 /end CHARACTERISTIC
/begin CHARACTERISTIC speedgoat_test_SN5659__cal_impl.Decode4_P6_g "" VALUE 0x008E85A8 Scalar_FLOAT64_IEEE 0 speedgoat_test_SN5659_R2020b_CM_double -1.7E+308 1.7E+308 /end CHARACTERISTIC
/begin CHARACTERISTIC speedgoat_test_SN5659__cal_impl.Decode4_P6_m "" VALUE 0x008E64B0 Scalar_FLOAT64_IEEE 0 speedgoat_test_SN5659_R2020b_CM_double -1.7E+308 1.7E+308 /end CHARACTERISTIC
/begin CHARACTERISTIC speedgoat_test_SN5659__cal_impl.Decode4_P6_n "" VALUE 0x008E2FF0 Scalar_FLOAT64_IEEE 0 speedgoat_test_SN5659_R2020b_CM_double -1.7E+308 1.7E+308 /end CHARACTERISTIC
/begin CHARACTERISTIC speedgoat_test_SN5659__cal_impl.Decode4_P7_a "" VALUE 0x008E71F8 Scalar_FLOAT64_IEEE 0 speedgoat_test_SN5659_R2020b_CM_double -1.7E+308 1.7E+308 /end CHARACTERISTIC
/begin CHARACTERISTIC speedgoat_test_SN5659__cal_impl.Decode4_P7_c "" VALUE 0x008E7F28 Scalar_FLOAT64_IEEE 0 speedgoat_test_SN5659_R2020b_CM_double -1.7E+308 1.7E+308 /end CHARACTERISTIC
/begin CHARACTERISTIC speedgoat_test_SN5659__cal_impl.Decode4_P7_g2 "" VALUE 0x008E7890 Scalar_FLOAT64_IEEE 0 speedgoat_test_SN5659_R2020b_CM_double -1.7E+308 1.7E+308 /end CHARACTERISTIC
/begin CHARACTERISTIC speedgoat_test_SN5659__cal_impl.Decode4_P7_h0 "" VALUE 0x008E6B60 Scalar_FLOAT64_IEEE 0 speedgoat_test_SN5659_R2020b_CM_double -1.7E+308 1.7E+308 /end CHARACTERISTIC
/begin CHARACTERISTIC speedgoat_test_SN5659__cal_impl.Decode4_P7_j "" VALUE 0x008E85C0 Scalar_FLOAT64_IEEE 0 speedgoat_test_SN5659_R2020b_CM_double -1.7E+308 1.7E+308 /end CHARACTERISTIC
/begin CHARACTERISTIC speedgoat_test_SN5659__cal_impl.Decode4_P7_n "" VALUE 0x008E3008 Scalar_FLOAT64_IEEE 0 speedgoat_test_SN5659_R2020b_CM_double -1.7E+308 1.7E+308 /end CHARACTERISTIC
/begin CHARACTERISTIC speedgoat_test_SN5659__cal_impl.Decode4_P7_nw "" VALUE 0x008E64C8 Scalar_FLOAT64_IEEE 0 speedgoat_test_SN5659_R2020b_CM_double -1.7E+308 1.7E+308 /end CHARACTERISTIC
/begin CHARACTERISTIC speedgoat_test_SN5659__cal_impl.Decode4_P8_g "" VALUE 0x008E3020 Scalar_FLOAT64_IEEE 0 speedgoat_test_SN5659_R2020b_CM_double -1.7E+308 1.7E+308 /end CHARACTERISTIC
/begin CHARACTERISTIC speedgoat_test_SN5659__cal_impl.Decode4_P8_l "" VALUE 0x008E7210 Scalar_FLOAT64_IEEE 0 speedgoat_test_SN5659_R2020b_CM_double -1.7E+308 1.7E+308 /end CHARACTERISTIC
/begin CHARACTERISTIC speedgoat_test_SN5659__cal_impl.Decode4_P8_lu "" VALUE 0x008E78A8 Scalar_FLOAT64_IEEE 0 speedgoat_test_SN5659_R2020b_CM_double -1.7E+308 1.7E+308 /end CHARACTERISTIC
/begin CHARACTERISTIC speedgoat_test_SN5659__cal_impl.Decode4_P8_mv "" VALUE 0x008E85D8 Scalar_FLOAT64_IEEE 0 speedgoat_test_SN5659_R2020b_CM_double -1.7E+308 1.7E+308 /end CHARACTERISTIC
/begin CHARACTERISTIC speedgoat_test_SN5659__cal_impl.Decode4_P8_n "" VALUE 0x008E64E0 Scalar_FLOAT64_IEEE 0 speedgoat_test_SN5659_R2020b_CM_double -1.7E+308 1.7E+308 /end CHARACTERISTIC
/begin CHARACTERISTIC speedgoat_test_SN5659__cal_impl.Decode4_P8_o "" VALUE 0x008E7F40 Scalar_FLOAT64_IEEE 0 speedgoat_test_SN5659_R2020b_CM_double -1.7E+308 1.7E+308 /end CHARACTERISTIC
/begin CHARACTERISTIC speedgoat_test_SN5659__cal_impl.Decode4_P8_p "" VALUE 0x008E6B78 Scalar_FLOAT64_IEEE 0 speedgoat_test_SN5659_R2020b_CM_double -1.7E+308 1.7E+308 /end CHARACTERISTIC
/begin CHARACTERISTIC speedgoat_test_SN5659__cal_impl.Decode4_P9_c "" VALUE 0x008E7F58 Scalar_FLOAT64_IEEE 0 speedgoat_test_SN5659_R2020b_CM_double -1.7E+308 1.7E+308 /end CHARACTERISTIC
/begin CHARACTERISTIC speedgoat_test_SN5659__cal_impl.Decode4_P9_dp "" VALUE 0x008E64F8 Scalar_FLOAT64_IEEE 0 speedgoat_test_SN5659_R2020b_CM_double -1.7E+308 1.7E+308 /end CHARACTERISTIC
/begin CHARACTERISTIC speedgoat_test_SN5659__cal_impl.Decode4_P9_e "" VALUE 0x008E3038 Scalar_FLOAT64_IEEE 0 speedgoat_test_SN5659_R2020b_CM_double -1.7E+308 1.7E+308 /end CHARACTERISTIC
/begin CHARACTERISTIC speedgoat_test_SN5659__cal_impl.Decode4_P9_g "" VALUE 0x008E85F0 Scalar_FLOAT64_IEEE 0 speedgoat_test_SN5659_R2020b_CM_double -1.7E+308 1.7E+308 /end CHARACTERISTIC
/begin CHARACTERISTIC speedgoat_test_SN5659__cal_impl.Decode4_P9_j "" VALUE 0x008E78C0 Scalar_FLOAT64_IEEE 0 speedgoat_test_SN5659_R2020b_CM_double -1.7E+308 1.7E+308 /end CHARACTERISTIC
/begin CHARACTERISTIC speedgoat_test_SN5659__cal_impl.Decode4_P9_p "" VALUE 0x008E6B90 Scalar_FLOAT64_IEEE 0 speedgoat_test_SN5659_R2020b_CM_double -1.7E+308 1.7E+308 /end CHARACTERISTIC
/begin CHARACTERISTIC speedgoat_test_SN5659__cal_impl.Decode4_P9_p0 "" VALUE 0x008E7228 Scalar_FLOAT64_IEEE 0 speedgoat_test_SN5659_R2020b_CM_double -1.7E+308 1.7E+308 /end CHARACTERISTIC
/begin CHARACTERISTIC speedgoat_test_SN5659__cal_impl.Decode5_P10_k2 "" VAL_BLK 0x008E6F30 Scalar_FLOAT64_IEEE 0 speedgoat_test_SN5659_R2020b_CM_double -1.7E+308 1.7E+308 MATRIX_DIM 2 1 /end CHARACTERISTIC
/begin CHARACTERISTIC speedgoat_test_SN5659__cal_impl.Decode5_P10_m "" VAL_BLK 0x008E2D40 Scalar_FLOAT64_IEEE 0 speedgoat_test_SN5659_R2020b_CM_double -1.7E+308 1.7E+308 MATRIX_DIM 2 1 /end CHARACTERISTIC
/begin CHARACTERISTIC speedgoat_test_SN5659__cal_impl.Decode5_P11_g "" VALUE 0x008E2D60 Scalar_FLOAT64_IEEE 0 speedgoat_test_SN5659_R2020b_CM_double -1.7E+308 1.7E+308 /end CHARACTERISTIC
/begin CHARACTERISTIC speedgoat_test_SN5659__cal_impl.Decode5_P11_i "" VALUE 0x008E6F50 Scalar_FLOAT64_IEEE 0 speedgoat_test_SN5659_R2020b_CM_double -1.7E+308 1.7E+308 /end CHARACTERISTIC
/begin CHARACTERISTIC speedgoat_test_SN5659__cal_impl.Decode5_P12_h "" VALUE 0x008E6F68 Scalar_FLOAT64_IEEE 0 speedgoat_test_SN5659_R2020b_CM_double -1.7E+308 1.7E+308 /end CHARACTERISTIC
/begin CHARACTERISTIC speedgoat_test_SN5659__cal_impl.Decode5_P12_m "" VALUE 0x008E2D78 Scalar_FLOAT64_IEEE 0 speedgoat_test_SN5659_R2020b_CM_double -1.7E+308 1.7E+308 /end CHARACTERISTIC
/begin CHARACTERISTIC speedgoat_test_SN5659__cal_impl.Decode5_P13_c "" VALUE 0x008E2D90 Scalar_FLOAT64_IEEE 0 speedgoat_test_SN5659_R2020b_CM_double -1.7E+308 1.7E+308 /end CHARACTERISTIC
/begin CHARACTERISTIC speedgoat_test_SN5659__cal_impl.Decode5_P13_p "" VALUE 0x008E6F80 Scalar_FLOAT64_IEEE 0 speedgoat_test_SN5659_R2020b_CM_double -1.7E+308 1.7E+308 /end CHARACTERISTIC
/begin CHARACTERISTIC speedgoat_test_SN5659__cal_impl.Decode5_P14_c "" VALUE 0x008E2DA8 Scalar_FLOAT64_IEEE 0 speedgoat_test_SN5659_R2020b_CM_double -1.7E+308 1.7E+308 /end CHARACTERISTIC
/begin CHARACTERISTIC speedgoat_test_SN5659__cal_impl.Decode5_P14_cm "" VALUE 0x008E6F98 Scalar_FLOAT64_IEEE 0 speedgoat_test_SN5659_R2020b_CM_double -1.7E+308 1.7E+308 /end CHARACTERISTIC
/begin CHARACTERISTIC speedgoat_test_SN5659__cal_impl.Decode5_P15_b "" VALUE 0x008E6FB0 Scalar_FLOAT64_IEEE 0 speedgoat_test_SN5659_R2020b_CM_double -1.7E+308 1.7E+308 /end CHARACTERISTIC
/begin CHARACTERISTIC speedgoat_test_SN5659__cal_impl.Decode5_P15_j "" VALUE 0x008E2DC0 Scalar_FLOAT64_IEEE 0 speedgoat_test_SN5659_R2020b_CM_double -1.7E+308 1.7E+308 /end CHARACTERISTIC
/begin CHARACTERISTIC speedgoat_test_SN5659__cal_impl.Decode5_P16_a "" VALUE 0x008E2DD8 Scalar_FLOAT64_IEEE 0 speedgoat_test_SN5659_R2020b_CM_double -1.7E+308 1.7E+308 /end CHARACTERISTIC
/begin CHARACTERISTIC speedgoat_test_SN5659__cal_impl.Decode5_P16_o "" VALUE 0x008E6FC8 Scalar_FLOAT64_IEEE 0 speedgoat_test_SN5659_R2020b_CM_double -1.7E+308 1.7E+308 /end CHARACTERISTIC
/begin CHARACTERISTIC speedgoat_test_SN5659__cal_impl.Decode5_P1_n "" VALUE 0x008E2C68 Scalar_FLOAT64_IEEE 0 speedgoat_test_SN5659_R2020b_CM_double -1.7E+308 1.7E+308 /end CHARACTERISTIC
/begin CHARACTERISTIC speedgoat_test_SN5659__cal_impl.Decode5_P1_p "" VALUE 0x008E6E58 Scalar_FLOAT64_IEEE 0 speedgoat_test_SN5659_R2020b_CM_double -1.7E+308 1.7E+308 /end CHARACTERISTIC
/begin CHARACTERISTIC speedgoat_test_SN5659__cal_impl.Decode5_P2_f0 "" VALUE 0x008E6E70 Scalar_FLOAT64_IEEE 0 speedgoat_test_SN5659_R2020b_CM_double -1.7E+308 1.7E+308 /end CHARACTERISTIC
/begin CHARACTERISTIC speedgoat_test_SN5659__cal_impl.Decode5_P2_m "" VALUE 0x008E2C80 Scalar_FLOAT64_IEEE 0 speedgoat_test_SN5659_R2020b_CM_double -1.7E+308 1.7E+308 /end CHARACTERISTIC
/begin CHARACTERISTIC speedgoat_test_SN5659__cal_impl.Decode5_P3_i "" VALUE 0x008E2C98 Scalar_FLOAT64_IEEE 0 speedgoat_test_SN5659_R2020b_CM_double -1.7E+308 1.7E+308 /end CHARACTERISTIC
/begin CHARACTERISTIC speedgoat_test_SN5659__cal_impl.Decode5_P3_o "" VALUE 0x008E6E88 Scalar_FLOAT64_IEEE 0 speedgoat_test_SN5659_R2020b_CM_double -1.7E+308 1.7E+308 /end CHARACTERISTIC
/begin CHARACTERISTIC speedgoat_test_SN5659__cal_impl.Decode5_P4_f "" VALUE 0x008E2CB0 Scalar_FLOAT64_IEEE 0 speedgoat_test_SN5659_R2020b_CM_double -1.7E+308 1.7E+308 /end CHARACTERISTIC
/begin CHARACTERISTIC speedgoat_test_SN5659__cal_impl.Decode5_P4_f5 "" VALUE 0x008E6EA0 Scalar_FLOAT64_IEEE 0 speedgoat_test_SN5659_R2020b_CM_double -1.7E+308 1.7E+308 /end CHARACTERISTIC
/begin CHARACTERISTIC speedgoat_test_SN5659__cal_impl.Decode5_P5_d "" VALUE 0x008E6EB8 Scalar_FLOAT64_IEEE 0 speedgoat_test_SN5659_R2020b_CM_double -1.7E+308 1.7E+308 /end CHARACTERISTIC
/begin CHARACTERISTIC speedgoat_test_SN5659__cal_impl.Decode5_P5_m "" VALUE 0x008E2CC8 Scalar_FLOAT64_IEEE 0 speedgoat_test_SN5659_R2020b_CM_double -1.7E+308 1.7E+308 /end CHARACTERISTIC
/begin CHARACTERISTIC speedgoat_test_SN5659__cal_impl.Decode5_P6_c "" VALUE 0x008E6ED0 Scalar_FLOAT64_IEEE 0 speedgoat_test_SN5659_R2020b_CM_double -1.7E+308 1.7E+308 /end CHARACTERISTIC
/begin CHARACTERISTIC speedgoat_test_SN5659__cal_impl.Decode5_P6_m "" VALUE 0x008E2CE0 Scalar_FLOAT64_IEEE 0 speedgoat_test_SN5659_R2020b_CM_double -1.7E+308 1.7E+308 /end CHARACTERISTIC
/begin CHARACTERISTIC speedgoat_test_SN5659__cal_impl.Decode5_P7_m "" VALUE 0x008E6EE8 Scalar_FLOAT64_IEEE 0 speedgoat_test_SN5659_R2020b_CM_double -1.7E+308 1.7E+308 /end CHARACTERISTIC
/begin CHARACTERISTIC speedgoat_test_SN5659__cal_impl.Decode5_P7_n "" VALUE 0x008E2CF8 Scalar_FLOAT64_IEEE 0 speedgoat_test_SN5659_R2020b_CM_double -1.7E+308 1.7E+308 /end CHARACTERISTIC
/begin CHARACTERISTIC speedgoat_test_SN5659__cal_impl.Decode5_P8_b "" VALUE 0x008E2D10 Scalar_FLOAT64_IEEE 0 speedgoat_test_SN5659_R2020b_CM_double -1.7E+308 1.7E+308 /end CHARACTERISTIC
/begin CHARACTERISTIC speedgoat_test_SN5659__cal_impl.Decode5_P8_c "" VALUE 0x008E6F00 Scalar_FLOAT64_IEEE 0 speedgoat_test_SN5659_R2020b_CM_double -1.7E+308 1.7E+308 /end CHARACTERISTIC
/begin CHARACTERISTIC speedgoat_test_SN5659__cal_impl.Decode5_P9_h "" VALUE 0x008E6F18 Scalar_FLOAT64_IEEE 0 speedgoat_test_SN5659_R2020b_CM_double -1.7E+308 1.7E+308 /end CHARACTERISTIC
/begin CHARACTERISTIC speedgoat_test_SN5659__cal_impl.Decode5_P9_n "" VALUE 0x008E2D28 Scalar_FLOAT64_IEEE 0 speedgoat_test_SN5659_R2020b_CM_double -1.7E+308 1.7E+308 /end CHARACTERISTIC
/begin CHARACTERISTIC speedgoat_test_SN5659__cal_impl.Encode1_P1 "" VALUE 0x008E86D0 Scalar_FLOAT64_IEEE 0 speedgoat_test_SN5659_R2020b_CM_double -1.7E+308 1.7E+308 /end CHARACTERISTIC
/begin CHARACTERISTIC speedgoat_test_SN5659__cal_impl.Encode1_P10 "" VALUE 0x008E87A8 Scalar_FLOAT64_IEEE 0 speedgoat_test_SN5659_R2020b_CM_double -1.7E+308 1.7E+308 /end CHARACTERISTIC
/begin CHARACTERISTIC speedgoat_test_SN5659__cal_impl.Encode1_P10_a "" VALUE 0x008E8E18 Scalar_FLOAT64_IEEE 0 speedgoat_test_SN5659_R2020b_CM_double -1.7E+308 1.7E+308 /end CHARACTERISTIC
/begin CHARACTERISTIC speedgoat_test_SN5659__cal_impl.Encode1_P10_i "" VALUE 0x008E9488 Scalar_FLOAT64_IEEE 0 speedgoat_test_SN5659_R2020b_CM_double -1.7E+308 1.7E+308 /end CHARACTERISTIC
/begin CHARACTERISTIC speedgoat_test_SN5659__cal_impl.Encode1_P11 "" VAL_BLK 0x008E87C0 Scalar_FLOAT64_IEEE 0 speedgoat_test_SN5659_R2020b_CM_double -1.7E+308 1.7E+308 MATRIX_DIM 2 1 /end CHARACTERISTIC
/begin CHARACTERISTIC speedgoat_test_SN5659__cal_impl.Encode1_P11_g "" VAL_BLK 0x008E8E30 Scalar_FLOAT64_IEEE 0 speedgoat_test_SN5659_R2020b_CM_double -1.7E+308 1.7E+308 MATRIX_DIM 2 1 /end CHARACTERISTIC
/begin CHARACTERISTIC speedgoat_test_SN5659__cal_impl.Encode1_P11_l "" VAL_BLK 0x008E94A0 Scalar_FLOAT64_IEEE 0 speedgoat_test_SN5659_R2020b_CM_double -1.7E+308 1.7E+308 MATRIX_DIM 2 1 /end CHARACTERISTIC
/begin CHARACTERISTIC speedgoat_test_SN5659__cal_impl.Encode1_P12 "" VALUE 0x008E87E0 Scalar_FLOAT64_IEEE 0 speedgoat_test_SN5659_R2020b_CM_double -1.7E+308 1.7E+308 /end CHARACTERISTIC
/begin CHARACTERISTIC speedgoat_test_SN5659__cal_impl.Encode1_P12_k "" VALUE 0x008E94C0 Scalar_FLOAT64_IEEE 0 speedgoat_test_SN5659_R2020b_CM_double -1.7E+308 1.7E+308 /end CHARACTERISTIC
/begin CHARACTERISTIC speedgoat_test_SN5659__cal_impl.Encode1_P12_n "" VALUE 0x008E8E50 Scalar_FLOAT64_IEEE 0 speedgoat_test_SN5659_R2020b_CM_double -1.7E+308 1.7E+308 /end CHARACTERISTIC
/begin CHARACTERISTIC speedgoat_test_SN5659__cal_impl.Encode1_P13 "" VALUE 0x008E87F8 Scalar_FLOAT64_IEEE 0 speedgoat_test_SN5659_R2020b_CM_double -1.7E+308 1.7E+308 /end CHARACTERISTIC
/begin CHARACTERISTIC speedgoat_test_SN5659__cal_impl.Encode1_P13_i "" VALUE 0x008E94D8 Scalar_FLOAT64_IEEE 0 speedgoat_test_SN5659_R2020b_CM_double -1.7E+308 1.7E+308 /end CHARACTERISTIC
/begin CHARACTERISTIC speedgoat_test_SN5659__cal_impl.Encode1_P13_j "" VALUE 0x008E8E68 Scalar_FLOAT64_IEEE 0 speedgoat_test_SN5659_R2020b_CM_double -1.7E+308 1.7E+308 /end CHARACTERISTIC
/begin CHARACTERISTIC speedgoat_test_SN5659__cal_impl.Encode1_P14 "" VALUE 0x008E8810 Scalar_FLOAT64_IEEE 0 speedgoat_test_SN5659_R2020b_CM_double -1.7E+308 1.7E+308 /end CHARACTERISTIC
/begin CHARACTERISTIC speedgoat_test_SN5659__cal_impl.Encode1_P14_h "" VALUE 0x008E8E80 Scalar_FLOAT64_IEEE 0 speedgoat_test_SN5659_R2020b_CM_double -1.7E+308 1.7E+308 /end CHARACTERISTIC
/begin CHARACTERISTIC speedgoat_test_SN5659__cal_impl.Encode1_P14_o "" VALUE 0x008E94F0 Scalar_FLOAT64_IEEE 0 speedgoat_test_SN5659_R2020b_CM_double -1.7E+308 1.7E+308 /end CHARACTERISTIC
/begin CHARACTERISTIC speedgoat_test_SN5659__cal_impl.Encode1_P15 "" VALUE 0x008E8828 Scalar_FLOAT64_IEEE 0 speedgoat_test_SN5659_R2020b_CM_double -1.7E+308 1.7E+308 /end CHARACTERISTIC
/begin CHARACTERISTIC speedgoat_test_SN5659__cal_impl.Encode1_P15_b "" VALUE 0x008E9508 Scalar_FLOAT64_IEEE 0 speedgoat_test_SN5659_R2020b_CM_double -1.7E+308 1.7E+308 /end CHARACTERISTIC
/begin CHARACTERISTIC speedgoat_test_SN5659__cal_impl.Encode1_P15_h "" VALUE 0x008E8E98 Scalar_FLOAT64_IEEE 0 speedgoat_test_SN5659_R2020b_CM_double -1.7E+308 1.7E+308 /end CHARACTERISTIC
/begin CHARACTERISTIC speedgoat_test_SN5659__cal_impl.Encode1_P1_a "" VALUE 0x008E8D40 Scalar_FLOAT64_IEEE 0 speedgoat_test_SN5659_R2020b_CM_double -1.7E+308 1.7E+308 /end CHARACTERISTIC
/begin CHARACTERISTIC speedgoat_test_SN5659__cal_impl.Encode1_P1_c "" VALUE 0x008E93B0 Scalar_FLOAT64_IEEE 0 speedgoat_test_SN5659_R2020b_CM_double -1.7E+308 1.7E+308 /end CHARACTERISTIC
/begin CHARACTERISTIC speedgoat_test_SN5659__cal_impl.Encode1_P2 "" VALUE 0x008E86E8 Scalar_FLOAT64_IEEE 0 speedgoat_test_SN5659_R2020b_CM_double -1.7E+308 1.7E+308 /end CHARACTERISTIC
/begin CHARACTERISTIC speedgoat_test_SN5659__cal_impl.Encode1_P2_g "" VALUE 0x008E93C8 Scalar_FLOAT64_IEEE 0 speedgoat_test_SN5659_R2020b_CM_double -1.7E+308 1.7E+308 /end CHARACTERISTIC
/begin CHARACTERISTIC speedgoat_test_SN5659__cal_impl.Encode1_P2_h "" VALUE 0x008E8D58 Scalar_FLOAT64_IEEE 0 speedgoat_test_SN5659_R2020b_CM_double -1.7E+308 1.7E+308 /end CHARACTERISTIC
/begin CHARACTERISTIC speedgoat_test_SN5659__cal_impl.Encode1_P3 "" VALUE 0x008E8700 Scalar_FLOAT64_IEEE 0 speedgoat_test_SN5659_R2020b_CM_double -1.7E+308 1.7E+308 /end CHARACTERISTIC
/begin CHARACTERISTIC speedgoat_test_SN5659__cal_impl.Encode1_P3_l "" VALUE 0x008E93E0 Scalar_FLOAT64_IEEE 0 speedgoat_test_SN5659_R2020b_CM_double -1.7E+308 1.7E+308 /end CHARACTERISTIC
/begin CHARACTERISTIC speedgoat_test_SN5659__cal_impl.Encode1_P3_o "" VALUE 0x008E8D70 Scalar_FLOAT64_IEEE 0 speedgoat_test_SN5659_R2020b_CM_double -1.7E+308 1.7E+308 /end CHARACTERISTIC
/begin CHARACTERISTIC speedgoat_test_SN5659__cal_impl.Encode1_P4 "" VALUE 0x008E8718 Scalar_FLOAT64_IEEE 0 speedgoat_test_SN5659_R2020b_CM_double -1.7E+308 1.7E+308 /end CHARACTERISTIC
/begin CHARACTERISTIC speedgoat_test_SN5659__cal_impl.Encode1_P4_d "" VALUE 0x008E8D88 Scalar_FLOAT64_IEEE 0 speedgoat_test_SN5659_R2020b_CM_double -1.7E+308 1.7E+308 /end CHARACTERISTIC
/begin CHARACTERISTIC speedgoat_test_SN5659__cal_impl.Encode1_P4_e "" VALUE 0x008E93F8 Scalar_FLOAT64_IEEE 0 speedgoat_test_SN5659_R2020b_CM_double -1.7E+308 1.7E+308 /end CHARACTERISTIC
/begin CHARACTERISTIC speedgoat_test_SN5659__cal_impl.Encode1_P5 "" VALUE 0x008E8730 Scalar_FLOAT64_IEEE 0 speedgoat_test_SN5659_R2020b_CM_double -1.7E+308 1.7E+308 /end CHARACTERISTIC
/begin CHARACTERISTIC speedgoat_test_SN5659__cal_impl.Encode1_P5_i "" VALUE 0x008E9410 Scalar_FLOAT64_IEEE 0 speedgoat_test_SN5659_R2020b_CM_double -1.7E+308 1.7E+308 /end CHARACTERISTIC
/begin CHARACTERISTIC speedgoat_test_SN5659__cal_impl.Encode1_P5_o "" VALUE 0x008E8DA0 Scalar_FLOAT64_IEEE 0 speedgoat_test_SN5659_R2020b_CM_double -1.7E+308 1.7E+308 /end CHARACTERISTIC
/begin CHARACTERISTIC speedgoat_test_SN5659__cal_impl.Encode1_P6 "" VALUE 0x008E8748 Scalar_FLOAT64_IEEE 0 speedgoat_test_SN5659_R2020b_CM_double -1.7E+308 1.7E+308 /end CHARACTERISTIC
/begin CHARACTERISTIC speedgoat_test_SN5659__cal_impl.Encode1_P6_n "" VALUE 0x008E8DB8 Scalar_FLOAT64_IEEE 0 speedgoat_test_SN5659_R2020b_CM_double -1.7E+308 1.7E+308 /end CHARACTERISTIC
/begin CHARACTERISTIC speedgoat_test_SN5659__cal_impl.Encode1_P6_p "" VALUE 0x008E9428 Scalar_FLOAT64_IEEE 0 speedgoat_test_SN5659_R2020b_CM_double -1.7E+308 1.7E+308 /end CHARACTERISTIC
/begin CHARACTERISTIC speedgoat_test_SN5659__cal_impl.Encode1_P7 "" VALUE 0x008E8760 Scalar_FLOAT64_IEEE 0 speedgoat_test_SN5659_R2020b_CM_double -1.7E+308 1.7E+308 /end CHARACTERISTIC
/begin CHARACTERISTIC speedgoat_test_SN5659__cal_impl.Encode1_P7_d "" VALUE 0x008E9440 Scalar_FLOAT64_IEEE 0 speedgoat_test_SN5659_R2020b_CM_double -1.7E+308 1.7E+308 /end CHARACTERISTIC
/begin CHARACTERISTIC speedgoat_test_SN5659__cal_impl.Encode1_P7_g "" VALUE 0x008E8DD0 Scalar_FLOAT64_IEEE 0 speedgoat_test_SN5659_R2020b_CM_double -1.7E+308 1.7E+308 /end CHARACTERISTIC
/begin CHARACTERISTIC speedgoat_test_SN5659__cal_impl.Encode1_P8 "" VALUE 0x008E8778 Scalar_FLOAT64_IEEE 0 speedgoat_test_SN5659_R2020b_CM_double -1.7E+308 1.7E+308 /end CHARACTERISTIC
/begin CHARACTERISTIC speedgoat_test_SN5659__cal_impl.Encode1_P8_c "" VALUE 0x008E9458 Scalar_FLOAT64_IEEE 0 speedgoat_test_SN5659_R2020b_CM_double -1.7E+308 1.7E+308 /end CHARACTERISTIC
/begin CHARACTERISTIC speedgoat_test_SN5659__cal_impl.Encode1_P8_p "" VALUE 0x008E8DE8 Scalar_FLOAT64_IEEE 0 speedgoat_test_SN5659_R2020b_CM_double -1.7E+308 1.7E+308 /end CHARACTERISTIC
/begin CHARACTERISTIC speedgoat_test_SN5659__cal_impl.Encode1_P9 "" VALUE 0x008E8790 Scalar_FLOAT64_IEEE 0 speedgoat_test_SN5659_R2020b_CM_double -1.7E+308 1.7E+308 /end CHARACTERISTIC
/begin CHARACTERISTIC speedgoat_test_SN5659__cal_impl.Encode1_P9_m "" VALUE 0x008E8E00 Scalar_FLOAT64_IEEE 0 speedgoat_test_SN5659_R2020b_CM_double -1.7E+308 1.7E+308 /end CHARACTERISTIC
/begin CHARACTERISTIC speedgoat_test_SN5659__cal_impl.Encode1_P9_n "" VALUE 0x008E9470 Scalar_FLOAT64_IEEE 0 speedgoat_test_SN5659_R2020b_CM_double -1.7E+308 1.7E+308 /end CHARACTERISTIC
/begin CHARACTERISTIC speedgoat_test_SN5659__cal_impl.Encode2_P1 "" VALUE 0x008E8B70 Scalar_FLOAT64_IEEE 0 speedgoat_test_SN5659_R2020b_CM_double -1.7E+308 1.7E+308 /end CHARACTERISTIC
/begin CHARACTERISTIC speedgoat_test_SN5659__cal_impl.Encode2_P10 "" VALUE 0x008E8C48 Scalar_FLOAT64_IEEE 0 speedgoat_test_SN5659_R2020b_CM_double -1.7E+308 1.7E+308 /end CHARACTERISTIC
/begin CHARACTERISTIC speedgoat_test_SN5659__cal_impl.Encode2_P10_c "" VALUE 0x008E95F8 Scalar_FLOAT64_IEEE 0 speedgoat_test_SN5659_R2020b_CM_double -1.7E+308 1.7E+308 /end CHARACTERISTIC
/begin CHARACTERISTIC speedgoat_test_SN5659__cal_impl.Encode2_P10_n "" VALUE 0x008E8F88 Scalar_FLOAT64_IEEE 0 speedgoat_test_SN5659_R2020b_CM_double -1.7E+308 1.7E+308 /end CHARACTERISTIC
/begin CHARACTERISTIC speedgoat_test_SN5659__cal_impl.Encode2_P11 "" VAL_BLK 0x008E8C60 Scalar_FLOAT64_IEEE 0 speedgoat_test_SN5659_R2020b_CM_double -1.7E+308 1.7E+308 MATRIX_DIM 2 1 /end CHARACTERISTIC
/begin CHARACTERISTIC speedgoat_test_SN5659__cal_impl.Encode2_P11_g "" VAL_BLK 0x008E9610 Scalar_FLOAT64_IEEE 0 speedgoat_test_SN5659_R2020b_CM_double -1.7E+308 1.7E+308 MATRIX_DIM 2 1 /end CHARACTERISTIC
/begin CHARACTERISTIC speedgoat_test_SN5659__cal_impl.Encode2_P11_j "" VAL_BLK 0x008E8FA0 Scalar_FLOAT64_IEEE 0 speedgoat_test_SN5659_R2020b_CM_double -1.7E+308 1.7E+308 MATRIX_DIM 2 1 /end CHARACTERISTIC
/begin CHARACTERISTIC speedgoat_test_SN5659__cal_impl.Encode2_P12 "" VALUE 0x008E8C80 Scalar_FLOAT64_IEEE 0 speedgoat_test_SN5659_R2020b_CM_double -1.7E+308 1.7E+308 /end CHARACTERISTIC
/begin CHARACTERISTIC speedgoat_test_SN5659__cal_impl.Encode2_P12_b "" VALUE 0x008E8FC0 Scalar_FLOAT64_IEEE 0 speedgoat_test_SN5659_R2020b_CM_double -1.7E+308 1.7E+308 /end CHARACTERISTIC
/begin CHARACTERISTIC speedgoat_test_SN5659__cal_impl.Encode2_P12_m "" VALUE 0x008E9630 Scalar_FLOAT64_IEEE 0 speedgoat_test_SN5659_R2020b_CM_double -1.7E+308 1.7E+308 /end CHARACTERISTIC
/begin CHARACTERISTIC speedgoat_test_SN5659__cal_impl.Encode2_P13 "" VALUE 0x008E8C98 Scalar_FLOAT64_IEEE 0 speedgoat_test_SN5659_R2020b_CM_double -1.7E+308 1.7E+308 /end CHARACTERISTIC
/begin CHARACTERISTIC speedgoat_test_SN5659__cal_impl.Encode2_P13_j "" VALUE 0x008E8FD8 Scalar_FLOAT64_IEEE 0 speedgoat_test_SN5659_R2020b_CM_double -1.7E+308 1.7E+308 /end CHARACTERISTIC
/begin CHARACTERISTIC speedgoat_test_SN5659__cal_impl.Encode2_P13_p "" VALUE 0x008E9648 Scalar_FLOAT64_IEEE 0 speedgoat_test_SN5659_R2020b_CM_double -1.7E+308 1.7E+308 /end CHARACTERISTIC
/begin CHARACTERISTIC speedgoat_test_SN5659__cal_impl.Encode2_P14 "" VALUE 0x008E8CB0 Scalar_FLOAT64_IEEE 0 speedgoat_test_SN5659_R2020b_CM_double -1.7E+308 1.7E+308 /end CHARACTERISTIC
/begin CHARACTERISTIC speedgoat_test_SN5659__cal_impl.Encode2_P14_c "" VALUE 0x008E8FF0 Scalar_FLOAT64_IEEE 0 speedgoat_test_SN5659_R2020b_CM_double -1.7E+308 1.7E+308 /end CHARACTERISTIC
/begin CHARACTERISTIC speedgoat_test_SN5659__cal_impl.Encode2_P14_p "" VALUE 0x008E9660 Scalar_FLOAT64_IEEE 0 speedgoat_test_SN5659_R2020b_CM_double -1.7E+308 1.7E+308 /end CHARACTERISTIC
/begin CHARACTERISTIC speedgoat_test_SN5659__cal_impl.Encode2_P15 "" VALUE 0x008E8CC8 Scalar_FLOAT64_IEEE 0 speedgoat_test_SN5659_R2020b_CM_double -1.7E+308 1.7E+308 /end CHARACTERISTIC
/begin CHARACTERISTIC speedgoat_test_SN5659__cal_impl.Encode2_P15_c "" VALUE 0x008E9678 Scalar_FLOAT64_IEEE 0 speedgoat_test_SN5659_R2020b_CM_double -1.7E+308 1.7E+308 /end CHARACTERISTIC
/begin CHARACTERISTIC speedgoat_test_SN5659__cal_impl.Encode2_P15_j "" VALUE 0x008E9008 Scalar_FLOAT64_IEEE 0 speedgoat_test_SN5659_R2020b_CM_double -1.7E+308 1.7E+308 /end CHARACTERISTIC
/begin CHARACTERISTIC speedgoat_test_SN5659__cal_impl.Encode2_P1_a "" VALUE 0x008E9520 Scalar_FLOAT64_IEEE 0 speedgoat_test_SN5659_R2020b_CM_double -1.7E+308 1.7E+308 /end CHARACTERISTIC
/begin CHARACTERISTIC speedgoat_test_SN5659__cal_impl.Encode2_P1_h "" VALUE 0x008E8EB0 Scalar_FLOAT64_IEEE 0 speedgoat_test_SN5659_R2020b_CM_double -1.7E+308 1.7E+308 /end CHARACTERISTIC
/begin CHARACTERISTIC speedgoat_test_SN5659__cal_impl.Encode2_P2 "" VALUE 0x008E8B88 Scalar_FLOAT64_IEEE 0 speedgoat_test_SN5659_R2020b_CM_double -1.7E+308 1.7E+308 /end CHARACTERISTIC
/begin CHARACTERISTIC speedgoat_test_SN5659__cal_impl.Encode2_P2_i "" VALUE 0x008E9538 Scalar_FLOAT64_IEEE 0 speedgoat_test_SN5659_R2020b_CM_double -1.7E+308 1.7E+308 /end CHARACTERISTIC
/begin CHARACTERISTIC speedgoat_test_SN5659__cal_impl.Encode2_P2_m "" VALUE 0x008E8EC8 Scalar_FLOAT64_IEEE 0 speedgoat_test_SN5659_R2020b_CM_double -1.7E+308 1.7E+308 /end CHARACTERISTIC
/begin CHARACTERISTIC speedgoat_test_SN5659__cal_impl.Encode2_P3 "" VALUE 0x008E8BA0 Scalar_FLOAT64_IEEE 0 speedgoat_test_SN5659_R2020b_CM_double -1.7E+308 1.7E+308 /end CHARACTERISTIC
/begin CHARACTERISTIC speedgoat_test_SN5659__cal_impl.Encode2_P3_k "" VALUE 0x008E9550 Scalar_FLOAT64_IEEE 0 speedgoat_test_SN5659_R2020b_CM_double -1.7E+308 1.7E+308 /end CHARACTERISTIC
/begin CHARACTERISTIC speedgoat_test_SN5659__cal_impl.Encode2_P3_o "" VALUE 0x008E8EE0 Scalar_FLOAT64_IEEE 0 speedgoat_test_SN5659_R2020b_CM_double -1.7E+308 1.7E+308 /end CHARACTERISTIC
/begin CHARACTERISTIC speedgoat_test_SN5659__cal_impl.Encode2_P4 "" VALUE 0x008E8BB8 Scalar_FLOAT64_IEEE 0 speedgoat_test_SN5659_R2020b_CM_double -1.7E+308 1.7E+308 /end CHARACTERISTIC
/begin CHARACTERISTIC speedgoat_test_SN5659__cal_impl.Encode2_P4_g "" VALUE 0x008E8EF8 Scalar_FLOAT64_IEEE 0 speedgoat_test_SN5659_R2020b_CM_double -1.7E+308 1.7E+308 /end CHARACTERISTIC
/begin CHARACTERISTIC speedgoat_test_SN5659__cal_impl.Encode2_P4_o "" VALUE 0x008E9568 Scalar_FLOAT64_IEEE 0 speedgoat_test_SN5659_R2020b_CM_double -1.7E+308 1.7E+308 /end CHARACTERISTIC
/begin CHARACTERISTIC speedgoat_test_SN5659__cal_impl.Encode2_P5 "" VALUE 0x008E8BD0 Scalar_FLOAT64_IEEE 0 speedgoat_test_SN5659_R2020b_CM_double -1.7E+308 1.7E+308 /end CHARACTERISTIC
/begin CHARACTERISTIC speedgoat_test_SN5659__cal_impl.Encode2_P5_g "" VALUE 0x008E8F10 Scalar_FLOAT64_IEEE 0 speedgoat_test_SN5659_R2020b_CM_double -1.7E+308 1.7E+308 /end CHARACTERISTIC
/begin CHARACTERISTIC speedgoat_test_SN5659__cal_impl.Encode2_P5_l "" VALUE 0x008E9580 Scalar_FLOAT64_IEEE 0 speedgoat_test_SN5659_R2020b_CM_double -1.7E+308 1.7E+308 /end CHARACTERISTIC
/begin CHARACTERISTIC speedgoat_test_SN5659__cal_impl.Encode2_P6 "" VALUE 0x008E8BE8 Scalar_FLOAT64_IEEE 0 speedgoat_test_SN5659_R2020b_CM_double -1.7E+308 1.7E+308 /end CHARACTERISTIC
/begin CHARACTERISTIC speedgoat_test_SN5659__cal_impl.Encode2_P6_j "" VALUE 0x008E8F28 Scalar_FLOAT64_IEEE 0 speedgoat_test_SN5659_R2020b_CM_double -1.7E+308 1.7E+308 /end CHARACTERISTIC
/begin CHARACTERISTIC speedgoat_test_SN5659__cal_impl.Encode2_P6_n "" VALUE 0x008E9598 Scalar_FLOAT64_IEEE 0 speedgoat_test_SN5659_R2020b_CM_double -1.7E+308 1.7E+308 /end CHARACTERISTIC
/begin CHARACTERISTIC speedgoat_test_SN5659__cal_impl.Encode2_P7 "" VALUE 0x008E8C00 Scalar_FLOAT64_IEEE 0 speedgoat_test_SN5659_R2020b_CM_double -1.7E+308 1.7E+308 /end CHARACTERISTIC
/begin CHARACTERISTIC speedgoat_test_SN5659__cal_impl.Encode2_P7_b "" VALUE 0x008E95B0 Scalar_FLOAT64_IEEE 0 speedgoat_test_SN5659_R2020b_CM_double -1.7E+308 1.7E+308 /end CHARACTERISTIC
/begin CHARACTERISTIC speedgoat_test_SN5659__cal_impl.Encode2_P7_d "" VALUE 0x008E8F40 Scalar_FLOAT64_IEEE 0 speedgoat_test_SN5659_R2020b_CM_double -1.7E+308 1.7E+308 /end CHARACTERISTIC
/begin CHARACTERISTIC speedgoat_test_SN5659__cal_impl.Encode2_P8 "" VALUE 0x008E8C18 Scalar_FLOAT64_IEEE 0 speedgoat_test_SN5659_R2020b_CM_double -1.7E+308 1.7E+308 /end CHARACTERISTIC
/begin CHARACTERISTIC speedgoat_test_SN5659__cal_impl.Encode2_P8_f "" VALUE 0x008E8F58 Scalar_FLOAT64_IEEE 0 speedgoat_test_SN5659_R2020b_CM_double -1.7E+308 1.7E+308 /end CHARACTERISTIC
/begin CHARACTERISTIC speedgoat_test_SN5659__cal_impl.Encode2_P8_h "" VALUE 0x008E95C8 Scalar_FLOAT64_IEEE 0 speedgoat_test_SN5659_R2020b_CM_double -1.7E+308 1.7E+308 /end CHARACTERISTIC
/begin CHARACTERISTIC speedgoat_test_SN5659__cal_impl.Encode2_P9 "" VALUE 0x008E8C30 Scalar_FLOAT64_IEEE 0 speedgoat_test_SN5659_R2020b_CM_double -1.7E+308 1.7E+308 /end CHARACTERISTIC
/begin CHARACTERISTIC speedgoat_test_SN5659__cal_impl.Encode2_P9_m "" VALUE 0x008E95E0 Scalar_FLOAT64_IEEE 0 speedgoat_test_SN5659_R2020b_CM_double -1.7E+308 1.7E+308 /end CHARACTERISTIC
/begin CHARACTERISTIC speedgoat_test_SN5659__cal_impl.Encode2_P9_p "" VALUE 0x008E8F70 Scalar_FLOAT64_IEEE 0 speedgoat_test_SN5659_R2020b_CM_double -1.7E+308 1.7E+308 /end CHARACTERISTIC
/begin CHARACTERISTIC speedgoat_test_SN5659__cal_impl.Encode3_P1 "" VALUE 0x008E89E8 Scalar_FLOAT64_IEEE 0 speedgoat_test_SN5659_R2020b_CM_double -1.7E+308 1.7E+308 /end CHARACTERISTIC
/begin CHARACTERISTIC speedgoat_test_SN5659__cal_impl.Encode3_P10 "" VALUE 0x008E8AC0 Scalar_FLOAT64_IEEE 0 speedgoat_test_SN5659_R2020b_CM_double -1.7E+308 1.7E+308 /end CHARACTERISTIC
/begin CHARACTERISTIC speedgoat_test_SN5659__cal_impl.Encode3_P10_j "" VALUE 0x008E97A0 Scalar_FLOAT64_IEEE 0 speedgoat_test_SN5659_R2020b_CM_double -1.7E+308 1.7E+308 /end CHARACTERISTIC
/begin CHARACTERISTIC speedgoat_test_SN5659__cal_impl.Encode3_P10_n "" VALUE 0x008E9130 Scalar_FLOAT64_IEEE 0 speedgoat_test_SN5659_R2020b_CM_double -1.7E+308 1.7E+308 /end CHARACTERISTIC
/begin CHARACTERISTIC speedgoat_test_SN5659__cal_impl.Encode3_P11 "" VAL_BLK 0x008E8AD8 Scalar_FLOAT64_IEEE 0 speedgoat_test_SN5659_R2020b_CM_double -1.7E+308 1.7E+308 MATRIX_DIM 2 1 /end CHARACTERISTIC
/begin CHARACTERISTIC speedgoat_test_SN5659__cal_impl.Encode3_P11_j "" VAL_BLK 0x008E97B8 Scalar_FLOAT64_IEEE 0 speedgoat_test_SN5659_R2020b_CM_double -1.7E+308 1.7E+308 MATRIX_DIM 2 1 /end CHARACTERISTIC
/begin CHARACTERISTIC speedgoat_test_SN5659__cal_impl.Encode3_P11_l "" VAL_BLK 0x008E9148 Scalar_FLOAT64_IEEE 0 speedgoat_test_SN5659_R2020b_CM_double -1.7E+308 1.7E+308 MATRIX_DIM 2 1 /end CHARACTERISTIC
/begin CHARACTERISTIC speedgoat_test_SN5659__cal_impl.Encode3_P12 "" VALUE 0x008E8AF8 Scalar_FLOAT64_IEEE 0 speedgoat_test_SN5659_R2020b_CM_double -1.7E+308 1.7E+308 /end CHARACTERISTIC
/begin CHARACTERISTIC speedgoat_test_SN5659__cal_impl.Encode3_P12_e "" VALUE 0x008E9168 Scalar_FLOAT64_IEEE 0 speedgoat_test_SN5659_R2020b_CM_double -1.7E+308 1.7E+308 /end CHARACTERISTIC
/begin CHARACTERISTIC speedgoat_test_SN5659__cal_impl.Encode3_P12_j "" VALUE 0x008E97D8 Scalar_FLOAT64_IEEE 0 speedgoat_test_SN5659_R2020b_CM_double -1.7E+308 1.7E+308 /end CHARACTERISTIC
/begin CHARACTERISTIC speedgoat_test_SN5659__cal_impl.Encode3_P13 "" VALUE 0x008E8B10 Scalar_FLOAT64_IEEE 0 speedgoat_test_SN5659_R2020b_CM_double -1.7E+308 1.7E+308 /end CHARACTERISTIC
/begin CHARACTERISTIC speedgoat_test_SN5659__cal_impl.Encode3_P13_i "" VALUE 0x008E97F0 Scalar_FLOAT64_IEEE 0 speedgoat_test_SN5659_R2020b_CM_double -1.7E+308 1.7E+308 /end CHARACTERISTIC
/begin CHARACTERISTIC speedgoat_test_SN5659__cal_impl.Encode3_P13_o "" VALUE 0x008E9180 Scalar_FLOAT64_IEEE 0 speedgoat_test_SN5659_R2020b_CM_double -1.7E+308 1.7E+308 /end CHARACTERISTIC
/begin CHARACTERISTIC speedgoat_test_SN5659__cal_impl.Encode3_P14 "" VALUE 0x008E8B28 Scalar_FLOAT64_IEEE 0 speedgoat_test_SN5659_R2020b_CM_double -1.7E+308 1.7E+308 /end CHARACTERISTIC
/begin CHARACTERISTIC speedgoat_test_SN5659__cal_impl.Encode3_P14_d "" VALUE 0x008E9808 Scalar_FLOAT64_IEEE 0 speedgoat_test_SN5659_R2020b_CM_double -1.7E+308 1.7E+308 /end CHARACTERISTIC
/begin CHARACTERISTIC speedgoat_test_SN5659__cal_impl.Encode3_P14_e "" VALUE 0x008E9198 Scalar_FLOAT64_IEEE 0 speedgoat_test_SN5659_R2020b_CM_double -1.7E+308 1.7E+308 /end CHARACTERISTIC
/begin CHARACTERISTIC speedgoat_test_SN5659__cal_impl.Encode3_P15 "" VALUE 0x008E8B40 Scalar_FLOAT64_IEEE 0 speedgoat_test_SN5659_R2020b_CM_double -1.7E+308 1.7E+308 /end CHARACTERISTIC
/begin CHARACTERISTIC speedgoat_test_SN5659__cal_impl.Encode3_P15_h "" VALUE 0x008E9820 Scalar_FLOAT64_IEEE 0 speedgoat_test_SN5659_R2020b_CM_double -1.7E+308 1.7E+308 /end CHARACTERISTIC
/begin CHARACTERISTIC speedgoat_test_SN5659__cal_impl.Encode3_P15_p "" VALUE 0x008E91B0 Scalar_FLOAT64_IEEE 0 speedgoat_test_SN5659_R2020b_CM_double -1.7E+308 1.7E+308 /end CHARACTERISTIC
/begin CHARACTERISTIC speedgoat_test_SN5659__cal_impl.Encode3_P1_e "" VALUE 0x008E96C8 Scalar_FLOAT64_IEEE 0 speedgoat_test_SN5659_R2020b_CM_double -1.7E+308 1.7E+308 /end CHARACTERISTIC
/begin CHARACTERISTIC speedgoat_test_SN5659__cal_impl.Encode3_P1_l "" VALUE 0x008E9058 Scalar_FLOAT64_IEEE 0 speedgoat_test_SN5659_R2020b_CM_double -1.7E+308 1.7E+308 /end CHARACTERISTIC
/begin CHARACTERISTIC speedgoat_test_SN5659__cal_impl.Encode3_P2 "" VALUE 0x008E8A00 Scalar_FLOAT64_IEEE 0 speedgoat_test_SN5659_R2020b_CM_double -1.7E+308 1.7E+308 /end CHARACTERISTIC
/begin CHARACTERISTIC speedgoat_test_SN5659__cal_impl.Encode3_P2_f "" VALUE 0x008E96E0 Scalar_FLOAT64_IEEE 0 speedgoat_test_SN5659_R2020b_CM_double -1.7E+308 1.7E+308 /end CHARACTERISTIC
/begin CHARACTERISTIC speedgoat_test_SN5659__cal_impl.Encode3_P2_j "" VALUE 0x008E9070 Scalar_FLOAT64_IEEE 0 speedgoat_test_SN5659_R2020b_CM_double -1.7E+308 1.7E+308 /end CHARACTERISTIC
/begin CHARACTERISTIC speedgoat_test_SN5659__cal_impl.Encode3_P3 "" VALUE 0x008E8A18 Scalar_FLOAT64_IEEE 0 speedgoat_test_SN5659_R2020b_CM_double -1.7E+308 1.7E+308 /end CHARACTERISTIC
/begin CHARACTERISTIC speedgoat_test_SN5659__cal_impl.Encode3_P3_b "" VALUE 0x008E96F8 Scalar_FLOAT64_IEEE 0 speedgoat_test_SN5659_R2020b_CM_double -1.7E+308 1.7E+308 /end CHARACTERISTIC
/begin CHARACTERISTIC speedgoat_test_SN5659__cal_impl.Encode3_P3_n "" VALUE 0x008E9088 Scalar_FLOAT64_IEEE 0 speedgoat_test_SN5659_R2020b_CM_double -1.7E+308 1.7E+308 /end CHARACTERISTIC
/begin CHARACTERISTIC speedgoat_test_SN5659__cal_impl.Encode3_P4 "" VALUE 0x008E8A30 Scalar_FLOAT64_IEEE 0 speedgoat_test_SN5659_R2020b_CM_double -1.7E+308 1.7E+308 /end CHARACTERISTIC
/begin CHARACTERISTIC speedgoat_test_SN5659__cal_impl.Encode3_P4_d "" VALUE 0x008E9710 Scalar_FLOAT64_IEEE 0 speedgoat_test_SN5659_R2020b_CM_double -1.7E+308 1.7E+308 /end CHARACTERISTIC
/begin CHARACTERISTIC speedgoat_test_SN5659__cal_impl.Encode3_P4_g "" VALUE 0x008E90A0 Scalar_FLOAT64_IEEE 0 speedgoat_test_SN5659_R2020b_CM_double -1.7E+308 1.7E+308 /end CHARACTERISTIC
/begin CHARACTERISTIC speedgoat_test_SN5659__cal_impl.Encode3_P5 "" VALUE 0x008E8A48 Scalar_FLOAT64_IEEE 0 speedgoat_test_SN5659_R2020b_CM_double -1.7E+308 1.7E+308 /end CHARACTERISTIC
/begin CHARACTERISTIC speedgoat_test_SN5659__cal_impl.Encode3_P5_i "" VALUE 0x008E9728 Scalar_FLOAT64_IEEE 0 speedgoat_test_SN5659_R2020b_CM_double -1.7E+308 1.7E+308 /end CHARACTERISTIC
/begin CHARACTERISTIC speedgoat_test_SN5659__cal_impl.Encode3_P5_k "" VALUE 0x008E90B8 Scalar_FLOAT64_IEEE 0 speedgoat_test_SN5659_R2020b_CM_double -1.7E+308 1.7E+308 /end CHARACTERISTIC
/begin CHARACTERISTIC speedgoat_test_SN5659__cal_impl.Encode3_P6 "" VALUE 0x008E8A60 Scalar_FLOAT64_IEEE 0 speedgoat_test_SN5659_R2020b_CM_double -1.7E+308 1.7E+308 /end CHARACTERISTIC
/begin CHARACTERISTIC speedgoat_test_SN5659__cal_impl.Encode3_P6_e "" VALUE 0x008E9740 Scalar_FLOAT64_IEEE 0 speedgoat_test_SN5659_R2020b_CM_double -1.7E+308 1.7E+308 /end CHARACTERISTIC
/begin CHARACTERISTIC speedgoat_test_SN5659__cal_impl.Encode3_P6_h "" VALUE 0x008E90D0 Scalar_FLOAT64_IEEE 0 speedgoat_test_SN5659_R2020b_CM_double -1.7E+308 1.7E+308 /end CHARACTERISTIC
/begin CHARACTERISTIC speedgoat_test_SN5659__cal_impl.Encode3_P7 "" VALUE 0x008E8A78 Scalar_FLOAT64_IEEE 0 speedgoat_test_SN5659_R2020b_CM_double -1.7E+308 1.7E+308 /end CHARACTERISTIC
/begin CHARACTERISTIC speedgoat_test_SN5659__cal_impl.Encode3_P7_b "" VALUE 0x008E90E8 Scalar_FLOAT64_IEEE 0 speedgoat_test_SN5659_R2020b_CM_double -1.7E+308 1.7E+308 /end CHARACTERISTIC
/begin CHARACTERISTIC speedgoat_test_SN5659__cal_impl.Encode3_P7_h "" VALUE 0x008E9758 Scalar_FLOAT64_IEEE 0 speedgoat_test_SN5659_R2020b_CM_double -1.7E+308 1.7E+308 /end CHARACTERISTIC
/begin CHARACTERISTIC speedgoat_test_SN5659__cal_impl.Encode3_P8 "" VALUE 0x008E8A90 Scalar_FLOAT64_IEEE 0 speedgoat_test_SN5659_R2020b_CM_double -1.7E+308 1.7E+308 /end CHARACTERISTIC
/begin CHARACTERISTIC speedgoat_test_SN5659__cal_impl.Encode3_P8_e "" VALUE 0x008E9100 Scalar_FLOAT64_IEEE 0 speedgoat_test_SN5659_R2020b_CM_double -1.7E+308 1.7E+308 /end CHARACTERISTIC
/begin CHARACTERISTIC speedgoat_test_SN5659__cal_impl.Encode3_P8_f "" VALUE 0x008E9770 Scalar_FLOAT64_IEEE 0 speedgoat_test_SN5659_R2020b_CM_double -1.7E+308 1.7E+308 /end CHARACTERISTIC
/begin CHARACTERISTIC speedgoat_test_SN5659__cal_impl.Encode3_P9 "" VALUE 0x008E8AA8 Scalar_FLOAT64_IEEE 0 speedgoat_test_SN5659_R2020b_CM_double -1.7E+308 1.7E+308 /end CHARACTERISTIC
/begin CHARACTERISTIC speedgoat_test_SN5659__cal_impl.Encode3_P9_g "" VALUE 0x008E9118 Scalar_FLOAT64_IEEE 0 speedgoat_test_SN5659_R2020b_CM_double -1.7E+308 1.7E+308 /end CHARACTERISTIC
/begin CHARACTERISTIC speedgoat_test_SN5659__cal_impl.Encode3_P9_k "" VALUE 0x008E9788 Scalar_FLOAT64_IEEE 0 speedgoat_test_SN5659_R2020b_CM_double -1.7E+308 1.7E+308 /end CHARACTERISTIC
/begin CHARACTERISTIC speedgoat_test_SN5659__cal_impl.Encode4_P1 "" VALUE 0x008E91E0 Scalar_FLOAT64_IEEE 0 speedgoat_test_SN5659_R2020b_CM_double -1.7E+308 1.7E+308 /end CHARACTERISTIC
/begin CHARACTERISTIC speedgoat_test_SN5659__cal_impl.Encode4_P10 "" VALUE 0x008E92B8 Scalar_FLOAT64_IEEE 0 speedgoat_test_SN5659_R2020b_CM_double -1.7E+308 1.7E+308 /end CHARACTERISTIC
/begin CHARACTERISTIC speedgoat_test_SN5659__cal_impl.Encode4_P10_h "" VALUE 0x008E9928 Scalar_FLOAT64_IEEE 0 speedgoat_test_SN5659_R2020b_CM_double -1.7E+308 1.7E+308 /end CHARACTERISTIC
/begin CHARACTERISTIC speedgoat_test_SN5659__cal_impl.Encode4_P11 "" VAL_BLK 0x008E92D0 Scalar_FLOAT64_IEEE 0 speedgoat_test_SN5659_R2020b_CM_double -1.7E+308 1.7E+308 MATRIX_DIM 2 1 /end CHARACTERISTIC
/begin CHARACTERISTIC speedgoat_test_SN5659__cal_impl.Encode4_P11_j "" VAL_BLK 0x008E9940 Scalar_FLOAT64_IEEE 0 speedgoat_test_SN5659_R2020b_CM_double -1.7E+308 1.7E+308 MATRIX_DIM 2 1 /end CHARACTERISTIC
/begin CHARACTERISTIC speedgoat_test_SN5659__cal_impl.Encode4_P12 "" VALUE 0x008E92F0 Scalar_FLOAT64_IEEE 0 speedgoat_test_SN5659_R2020b_CM_double -1.7E+308 1.7E+308 /end CHARACTERISTIC
/begin CHARACTERISTIC speedgoat_test_SN5659__cal_impl.Encode4_P12_l "" VALUE 0x008E9960 Scalar_FLOAT64_IEEE 0 speedgoat_test_SN5659_R2020b_CM_double -1.7E+308 1.7E+308 /end CHARACTERISTIC
/begin CHARACTERISTIC speedgoat_test_SN5659__cal_impl.Encode4_P13 "" VALUE 0x008E9308 Scalar_FLOAT64_IEEE 0 speedgoat_test_SN5659_R2020b_CM_double -1.7E+308 1.7E+308 /end CHARACTERISTIC
/begin CHARACTERISTIC speedgoat_test_SN5659__cal_impl.Encode4_P13_a "" VALUE 0x008E9978 Scalar_FLOAT64_IEEE 0 speedgoat_test_SN5659_R2020b_CM_double -1.7E+308 1.7E+308 /end CHARACTERISTIC
/begin CHARACTERISTIC speedgoat_test_SN5659__cal_impl.Encode4_P14 "" VALUE 0x008E9320 Scalar_FLOAT64_IEEE 0 speedgoat_test_SN5659_R2020b_CM_double -1.7E+308 1.7E+308 /end CHARACTERISTIC
/begin CHARACTERISTIC speedgoat_test_SN5659__cal_impl.Encode4_P14_l "" VALUE 0x008E9990 Scalar_FLOAT64_IEEE 0 speedgoat_test_SN5659_R2020b_CM_double -1.7E+308 1.7E+308 /end CHARACTERISTIC
/begin CHARACTERISTIC speedgoat_test_SN5659__cal_impl.Encode4_P15 "" VALUE 0x008E9338 Scalar_FLOAT64_IEEE 0 speedgoat_test_SN5659_R2020b_CM_double -1.7E+308 1.7E+308 /end CHARACTERISTIC
/begin CHARACTERISTIC speedgoat_test_SN5659__cal_impl.Encode4_P15_i "" VALUE 0x008E99A8 Scalar_FLOAT64_IEEE 0 speedgoat_test_SN5659_R2020b_CM_double -1.7E+308 1.7E+308 /end CHARACTERISTIC
/begin CHARACTERISTIC speedgoat_test_SN5659__cal_impl.Encode4_P1_e "" VALUE 0x008E9850 Scalar_FLOAT64_IEEE 0 speedgoat_test_SN5659_R2020b_CM_double -1.7E+308 1.7E+308 /end CHARACTERISTIC
/begin CHARACTERISTIC speedgoat_test_SN5659__cal_impl.Encode4_P2 "" VALUE 0x008E91F8 Scalar_FLOAT64_IEEE 0 speedgoat_test_SN5659_R2020b_CM_double -1.7E+308 1.7E+308 /end CHARACTERISTIC
/begin CHARACTERISTIC speedgoat_test_SN5659__cal_impl.Encode4_P2_d "" VALUE 0x008E9868 Scalar_FLOAT64_IEEE 0 speedgoat_test_SN5659_R2020b_CM_double -1.7E+308 1.7E+308 /end CHARACTERISTIC
/begin CHARACTERISTIC speedgoat_test_SN5659__cal_impl.Encode4_P3 "" VALUE 0x008E9210 Scalar_FLOAT64_IEEE 0 speedgoat_test_SN5659_R2020b_CM_double -1.7E+308 1.7E+308 /end CHARACTERISTIC
/begin CHARACTERISTIC speedgoat_test_SN5659__cal_impl.Encode4_P3_o "" VALUE 0x008E9880 Scalar_FLOAT64_IEEE 0 speedgoat_test_SN5659_R2020b_CM_double -1.7E+308 1.7E+308 /end CHARACTERISTIC
/begin CHARACTERISTIC speedgoat_test_SN5659__cal_impl.Encode4_P4 "" VALUE 0x008E9228 Scalar_FLOAT64_IEEE 0 speedgoat_test_SN5659_R2020b_CM_double -1.7E+308 1.7E+308 /end CHARACTERISTIC
/begin CHARACTERISTIC speedgoat_test_SN5659__cal_impl.Encode4_P4_a "" VALUE 0x008E9898 Scalar_FLOAT64_IEEE 0 speedgoat_test_SN5659_R2020b_CM_double -1.7E+308 1.7E+308 /end CHARACTERISTIC
/begin CHARACTERISTIC speedgoat_test_SN5659__cal_impl.Encode4_P5 "" VALUE 0x008E9240 Scalar_FLOAT64_IEEE 0 speedgoat_test_SN5659_R2020b_CM_double -1.7E+308 1.7E+308 /end CHARACTERISTIC
/begin CHARACTERISTIC speedgoat_test_SN5659__cal_impl.Encode4_P5_a "" VALUE 0x008E98B0 Scalar_FLOAT64_IEEE 0 speedgoat_test_SN5659_R2020b_CM_double -1.7E+308 1.7E+308 /end CHARACTERISTIC
/begin CHARACTERISTIC speedgoat_test_SN5659__cal_impl.Encode4_P6 "" VALUE 0x008E9258 Scalar_FLOAT64_IEEE 0 speedgoat_test_SN5659_R2020b_CM_double -1.7E+308 1.7E+308 /end CHARACTERISTIC
/begin CHARACTERISTIC speedgoat_test_SN5659__cal_impl.Encode4_P6_a "" VALUE 0x008E98C8 Scalar_FLOAT64_IEEE 0 speedgoat_test_SN5659_R2020b_CM_double -1.7E+308 1.7E+308 /end CHARACTERISTIC
/begin CHARACTERISTIC speedgoat_test_SN5659__cal_impl.Encode4_P7 "" VALUE 0x008E9270 Scalar_FLOAT64_IEEE 0 speedgoat_test_SN5659_R2020b_CM_double -1.7E+308 1.7E+308 /end CHARACTERISTIC
/begin CHARACTERISTIC speedgoat_test_SN5659__cal_impl.Encode4_P7_p "" VALUE 0x008E98E0 Scalar_FLOAT64_IEEE 0 speedgoat_test_SN5659_R2020b_CM_double -1.7E+308 1.7E+308 /end CHARACTERISTIC
/begin CHARACTERISTIC speedgoat_test_SN5659__cal_impl.Encode4_P8 "" VALUE 0x008E9288 Scalar_FLOAT64_IEEE 0 speedgoat_test_SN5659_R2020b_CM_double -1.7E+308 1.7E+308 /end CHARACTERISTIC
/begin CHARACTERISTIC speedgoat_test_SN5659__cal_impl.Encode4_P8_o "" VALUE 0x008E98F8 Scalar_FLOAT64_IEEE 0 speedgoat_test_SN5659_R2020b_CM_double -1.7E+308 1.7E+308 /end CHARACTERISTIC
/begin CHARACTERISTIC speedgoat_test_SN5659__cal_impl.Encode4_P9 "" VALUE 0x008E92A0 Scalar_FLOAT64_IEEE 0 speedgoat_test_SN5659_R2020b_CM_double -1.7E+308 1.7E+308 /end CHARACTERISTIC
/begin CHARACTERISTIC speedgoat_test_SN5659__cal_impl.Encode4_P9_i "" VALUE 0x008E9910 Scalar_FLOAT64_IEEE 0 speedgoat_test_SN5659_R2020b_CM_double -1.7E+308 1.7E+308 /end CHARACTERISTIC
/begin CHARACTERISTIC speedgoat_test_SN5659__cal_impl.Encode5_P1 "" VALUE 0x008E8840 Scalar_FLOAT64_IEEE 0 speedgoat_test_SN5659_R2020b_CM_double -1.7E+308 1.7E+308 /end CHARACTERISTIC
/begin CHARACTERISTIC speedgoat_test_SN5659__cal_impl.Encode5_P10 "" VALUE 0x008E8918 Scalar_FLOAT64_IEEE 0 speedgoat_test_SN5659_R2020b_CM_double -1.7E+308 1.7E+308 /end CHARACTERISTIC
/begin CHARACTERISTIC speedgoat_test_SN5659__cal_impl.Encode5_P11 "" VAL_BLK 0x008E8930 Scalar_FLOAT64_IEEE 0 speedgoat_test_SN5659_R2020b_CM_double -1.7E+308 1.7E+308 MATRIX_DIM 2 1 /end CHARACTERISTIC
/begin CHARACTERISTIC speedgoat_test_SN5659__cal_impl.Encode5_P12 "" VALUE 0x008E8950 Scalar_FLOAT64_IEEE 0 speedgoat_test_SN5659_R2020b_CM_double -1.7E+308 1.7E+308 /end CHARACTERISTIC
/begin CHARACTERISTIC speedgoat_test_SN5659__cal_impl.Encode5_P13 "" VALUE 0x008E8968 Scalar_FLOAT64_IEEE 0 speedgoat_test_SN5659_R2020b_CM_double -1.7E+308 1.7E+308 /end CHARACTERISTIC
/begin CHARACTERISTIC speedgoat_test_SN5659__cal_impl.Encode5_P14 "" VALUE 0x008E8980 Scalar_FLOAT64_IEEE 0 speedgoat_test_SN5659_R2020b_CM_double -1.7E+308 1.7E+308 /end CHARACTERISTIC
/begin CHARACTERISTIC speedgoat_test_SN5659__cal_impl.Encode5_P15 "" VALUE 0x008E8998 Scalar_FLOAT64_IEEE 0 speedgoat_test_SN5659_R2020b_CM_double -1.7E+308 1.7E+308 /end CHARACTERISTIC
/begin CHARACTERISTIC speedgoat_test_SN5659__cal_impl.Encode5_P2 "" VALUE 0x008E8858 Scalar_FLOAT64_IEEE 0 speedgoat_test_SN5659_R2020b_CM_double -1.7E+308 1.7E+308 /end CHARACTERISTIC
/begin CHARACTERISTIC speedgoat_test_SN5659__cal_impl.Encode5_P3 "" VALUE 0x008E8870 Scalar_FLOAT64_IEEE 0 speedgoat_test_SN5659_R2020b_CM_double -1.7E+308 1.7E+308 /end CHARACTERISTIC
/begin CHARACTERISTIC speedgoat_test_SN5659__cal_impl.Encode5_P4 "" VALUE 0x008E8888 Scalar_FLOAT64_IEEE 0 speedgoat_test_SN5659_R2020b_CM_double -1.7E+308 1.7E+308 /end CHARACTERISTIC
/begin CHARACTERISTIC speedgoat_test_SN5659__cal_impl.Encode5_P5 "" VALUE 0x008E88A0 Scalar_FLOAT64_IEEE 0 speedgoat_test_SN5659_R2020b_CM_double -1.7E+308 1.7E+308 /end CHARACTERISTIC
/begin CHARACTERISTIC speedgoat_test_SN5659__cal_impl.Encode5_P6 "" VALUE 0x008E88B8 Scalar_FLOAT64_IEEE 0 speedgoat_test_SN5659_R2020b_CM_double -1.7E+308 1.7E+308 /end CHARACTERISTIC
/begin CHARACTERISTIC speedgoat_test_SN5659__cal_impl.Encode5_P7 "" VALUE 0x008E88D0 Scalar_FLOAT64_IEEE 0 speedgoat_test_SN5659_R2020b_CM_double -1.7E+308 1.7E+308 /end CHARACTERISTIC
/begin CHARACTERISTIC speedgoat_test_SN5659__cal_impl.Encode5_P8 "" VALUE 0x008E88E8 Scalar_FLOAT64_IEEE 0 speedgoat_test_SN5659_R2020b_CM_double -1.7E+308 1.7E+308 /end CHARACTERISTIC
/begin CHARACTERISTIC speedgoat_test_SN5659__cal_impl.Encode5_P9 "" VALUE 0x008E8900 Scalar_FLOAT64_IEEE 0 speedgoat_test_SN5659_R2020b_CM_double -1.7E+308 1.7E+308 /end CHARACTERISTIC
/begin CHARACTERISTIC speedgoat_test_SN5659__cal_impl.FixPtConstant_Value "" VALUE 0x008EFCAA Scalar_UWORD 0 speedgoat_test_SN5659_R2020b_CM_uint16 0 65535 /end CHARACTERISTIC
/begin CHARACTERISTIC speedgoat_test_SN5659__cal_impl.FixPtConstant_Value_a "" VALUE 0x008EFCB0 Scalar_UWORD 0 speedgoat_test_SN5659_R2020b_CM_uint16 0 65535 /end CHARACTERISTIC
/begin CHARACTERISTIC speedgoat_test_SN5659__cal_impl.Label_Value_d "" VALUE 0x008EFBFC Scalar_ULONG 0 speedgoat_test_SN5659_R2020b_CM_uint32 0 2147483646 /end CHARACTERISTIC
/begin CHARACTERISTIC speedgoat_test_SN5659__cal_impl.Label_Value_e "" VALUE 0x008EFC08 Scalar_ULONG 0 speedgoat_test_SN5659_R2020b_CM_uint32 0 2147483646 /end CHARACTERISTIC
/begin CHARACTERISTIC speedgoat_test_SN5659__cal_impl.Mask_BitMask_h "" VALUE 0x008DF024 Scalar_ULONG 0 speedgoat_test_SN5659_R2020b_CM_uint32 0 2147483646 /end CHARACTERISTIC
/begin CHARACTERISTIC speedgoat_test_SN5659__cal_impl.Mask_BitMask_k "" VALUE 0x008DF028 Scalar_ULONG 0 speedgoat_test_SN5659_R2020b_CM_uint32 0 2147483646 /end CHARACTERISTIC
/begin CHARACTERISTIC speedgoat_test_SN5659__cal_impl.Output_InitialCondition "" VALUE 0x008EFCA8 Scalar_UWORD 0 speedgoat_test_SN5659_R2020b_CM_uint16 0 65535 /end CHARACTERISTIC
/begin CHARACTERISTIC speedgoat_test_SN5659__cal_impl.Output_InitialCondition_n "" VALUE 0x008EFCAE Scalar_UWORD 0 speedgoat_test_SN5659_R2020b_CM_uint16 0 65535 /end CHARACTERISTIC
/begin CHARACTERISTIC speedgoat_test_SN5659__cal_impl.Randomnumber_Mean "" VALUE 0x008E86A8 Scalar_FLOAT64_IEEE 0 speedgoat_test_SN5659_R2020b_CM_double -1.7E+308 1.7E+308 /end CHARACTERISTIC
/begin CHARACTERISTIC speedgoat_test_SN5659__cal_impl.Randomnumber_Mean_f "" VALUE 0x008E8D18 Scalar_FLOAT64_IEEE 0 speedgoat_test_SN5659_R2020b_CM_double -1.7E+308 1.7E+308 /end CHARACTERISTIC
/begin CHARACTERISTIC speedgoat_test_SN5659__cal_impl.Randomnumber_Mean_k "" VALUE 0x008E9388 Scalar_FLOAT64_IEEE 0 speedgoat_test_SN5659_R2020b_CM_double -1.7E+308 1.7E+308 /end CHARACTERISTIC
/begin CHARACTERISTIC speedgoat_test_SN5659__cal_impl.Randomnumber_Seed "" VALUE 0x008E86B8 Scalar_FLOAT64_IEEE 0 speedgoat_test_SN5659_R2020b_CM_double -1.7E+308 1.7E+308 /end CHARACTERISTIC
/begin CHARACTERISTIC speedgoat_test_SN5659__cal_impl.Randomnumber_Seed_h "" VALUE 0x008E9398 Scalar_FLOAT64_IEEE 0 speedgoat_test_SN5659_R2020b_CM_double -1.7E+308 1.7E+308 /end CHARACTERISTIC
/begin CHARACTERISTIC speedgoat_test_SN5659__cal_impl.Randomnumber_Seed_n "" VALUE 0x008E8D28 Scalar_FLOAT64_IEEE 0 speedgoat_test_SN5659_R2020b_CM_double -1.7E+308 1.7E+308 /end CHARACTERISTIC
/begin CHARACTERISTIC speedgoat_test_SN5659__cal_impl.Randomnumber_StdDev "" VALUE 0x008E86B0 Scalar_FLOAT64_IEEE 0 speedgoat_test_SN5659_R2020b_CM_double -1.7E+308 1.7E+308 /end CHARACTERISTIC
/begin CHARACTERISTIC speedgoat_test_SN5659__cal_impl.Randomnumber_StdDev_a "" VALUE 0x008E8D20 Scalar_FLOAT64_IEEE 0 speedgoat_test_SN5659_R2020b_CM_double -1.7E+308 1.7E+308 /end CHARACTERISTIC
/begin CHARACTERISTIC speedgoat_test_SN5659__cal_impl.Randomnumber_StdDev_l "" VALUE 0x008E9390 Scalar_FLOAT64_IEEE 0 speedgoat_test_SN5659_R2020b_CM_double -1.7E+308 1.7E+308 /end CHARACTERISTIC
/begin CHARACTERISTIC speedgoat_test_SN5659__cal_impl.SDI_Value_d "" VALUE 0x008EFBF8 Scalar_ULONG 0 speedgoat_test_SN5659_R2020b_CM_uint32 0 2147483646 /end CHARACTERISTIC
/begin CHARACTERISTIC speedgoat_test_SN5659__cal_impl.SDI_Value_m "" VALUE 0x008EFC04 Scalar_ULONG 0 speedgoat_test_SN5659_R2020b_CM_uint32 0 2147483646 /end CHARACTERISTIC
/begin CHARACTERISTIC speedgoat_test_SN5659__cal_impl.SSM_Value_l "" VALUE 0x008EFC00 Scalar_ULONG 0 speedgoat_test_SN5659_R2020b_CM_uint32 0 2147483646 /end CHARACTERISTIC
/begin CHARACTERISTIC speedgoat_test_SN5659__cal_impl.SSM_Value_o "" VALUE 0x008EFBF4 Scalar_ULONG 0 speedgoat_test_SN5659_R2020b_CM_uint32 0 2147483646 /end CHARACTERISTIC
/begin CHARACTERISTIC speedgoat_test_SN5659__cal_impl.Scale_Value_a "" VALUE 0x008E9830 Scalar_FLOAT64_IEEE 0 speedgoat_test_SN5659_R2020b_CM_double -1.7E+308 1.7E+308 /end CHARACTERISTIC
/begin CHARACTERISTIC speedgoat_test_SN5659__cal_impl.Scale_Value_l "" VALUE 0x008E91C0 Scalar_FLOAT64_IEEE 0 speedgoat_test_SN5659_R2020b_CM_double -1.7E+308 1.7E+308 /end CHARACTERISTIC
/begin CHARACTERISTIC speedgoat_test_SN5659__cal_impl.Sinewave_Amp "" VALUE 0x008E89A0 Scalar_FLOAT64_IEEE 0 speedgoat_test_SN5659_R2020b_CM_double -1.7E+308 1.7E+308 /end CHARACTERISTIC
/begin CHARACTERISTIC speedgoat_test_SN5659__cal_impl.Sinewave_Amp_i "" VALUE 0x008E9680 Scalar_FLOAT64_IEEE 0 speedgoat_test_SN5659_R2020b_CM_double -1.7E+308 1.7E+308 /end CHARACTERISTIC
/begin CHARACTERISTIC speedgoat_test_SN5659__cal_impl.Sinewave_Amp_o "" VALUE 0x008E9010 Scalar_FLOAT64_IEEE 0 speedgoat_test_SN5659_R2020b_CM_double -1.7E+308 1.7E+308 /end CHARACTERISTIC
/begin CHARACTERISTIC speedgoat_test_SN5659__cal_impl.Sinewave_Bias "" VALUE 0x008E89A8 Scalar_FLOAT64_IEEE 0 speedgoat_test_SN5659_R2020b_CM_double -1.7E+308 1.7E+308 /end CHARACTERISTIC
/begin CHARACTERISTIC speedgoat_test_SN5659__cal_impl.Sinewave_Bias_c "" VALUE 0x008E9688 Scalar_FLOAT64_IEEE 0 speedgoat_test_SN5659_R2020b_CM_double -1.7E+308 1.7E+308 /end CHARACTERISTIC
/begin CHARACTERISTIC speedgoat_test_SN5659__cal_impl.Sinewave_Bias_k "" VALUE 0x008E9018 Scalar_FLOAT64_IEEE 0 speedgoat_test_SN5659_R2020b_CM_double -1.7E+308 1.7E+308 /end CHARACTERISTIC
/begin CHARACTERISTIC speedgoat_test_SN5659__cal_impl.Sinewave_Freq "" VALUE 0x008E89B0 Scalar_FLOAT64_IEEE 0 speedgoat_test_SN5659_R2020b_CM_double -1.7E+308 1.7E+308 /end CHARACTERISTIC
/begin CHARACTERISTIC speedgoat_test_SN5659__cal_impl.Sinewave_Freq_g "" VALUE 0x008E9690 Scalar_FLOAT64_IEEE 0 speedgoat_test_SN5659_R2020b_CM_double -1.7E+308 1.7E+308 /end CHARACTERISTIC
/begin CHARACTERISTIC speedgoat_test_SN5659__cal_impl.Sinewave_Freq_p "" VALUE 0x008E9020 Scalar_FLOAT64_IEEE 0 speedgoat_test_SN5659_R2020b_CM_double -1.7E+308 1.7E+308 /end CHARACTERISTIC
/begin CHARACTERISTIC speedgoat_test_SN5659__cal_impl.Sinewave_HCos "" VALUE 0x008E89C0 Scalar_FLOAT64_IEEE 0 speedgoat_test_SN5659_R2020b_CM_double -1.7E+308 1.7E+308 /end CHARACTERISTIC
/begin CHARACTERISTIC speedgoat_test_SN5659__cal_impl.Sinewave_HCos_j "" VALUE 0x008E96A0 Scalar_FLOAT64_IEEE 0 speedgoat_test_SN5659_R2020b_CM_double -1.7E+308 1.7E+308 /end CHARACTERISTIC
/begin CHARACTERISTIC speedgoat_test_SN5659__cal_impl.Sinewave_HCos_l "" VALUE 0x008E9030 Scalar_FLOAT64_IEEE 0 speedgoat_test_SN5659_R2020b_CM_double -1.7E+308 1.7E+308 /end CHARACTERISTIC
/begin CHARACTERISTIC speedgoat_test_SN5659__cal_impl.Sinewave_Hsin "" VALUE 0x008E89B8 Scalar_FLOAT64_IEEE 0 speedgoat_test_SN5659_R2020b_CM_double -1.7E+308 1.7E+308 /end CHARACTERISTIC
/begin CHARACTERISTIC speedgoat_test_SN5659__cal_impl.Sinewave_Hsin_j "" VALUE 0x008E9028 Scalar_FLOAT64_IEEE 0 speedgoat_test_SN5659_R2020b_CM_double -1.7E+308 1.7E+308 /end CHARACTERISTIC
/begin CHARACTERISTIC speedgoat_test_SN5659__cal_impl.Sinewave_Hsin_n "" VALUE 0x008E9698 Scalar_FLOAT64_IEEE 0 speedgoat_test_SN5659_R2020b_CM_double -1.7E+308 1.7E+308 /end CHARACTERISTIC
/begin CHARACTERISTIC speedgoat_test_SN5659__cal_impl.Sinewave_PCos "" VALUE 0x008E89D0 Scalar_FLOAT64_IEEE 0 speedgoat_test_SN5659_R2020b_CM_double -1.7E+308 1.7E+308 /end CHARACTERISTIC
/begin CHARACTERISTIC speedgoat_test_SN5659__cal_impl.Sinewave_PCos_c "" VALUE 0x008E9040 Scalar_FLOAT64_IEEE 0 speedgoat_test_SN5659_R2020b_CM_double -1.7E+308 1.7E+308 /end CHARACTERISTIC
/begin CHARACTERISTIC speedgoat_test_SN5659__cal_impl.Sinewave_PCos_j "" VALUE 0x008E96B0 Scalar_FLOAT64_IEEE 0 speedgoat_test_SN5659_R2020b_CM_double -1.7E+308 1.7E+308 /end CHARACTERISTIC
/begin CHARACTERISTIC speedgoat_test_SN5659__cal_impl.Sinewave_PSin "" VALUE 0x008E89C8 Scalar_FLOAT64_IEEE 0 speedgoat_test_SN5659_R2020b_CM_double -1.7E+308 1.7E+308 /end CHARACTERISTIC
/begin CHARACTERISTIC speedgoat_test_SN5659__cal_impl.Sinewave_PSin_h "" VALUE 0x008E96A8 Scalar_FLOAT64_IEEE 0 speedgoat_test_SN5659_R2020b_CM_double -1.7E+308 1.7E+308 /end CHARACTERISTIC
/begin CHARACTERISTIC speedgoat_test_SN5659__cal_impl.Sinewave_PSin_p "" VALUE 0x008E9038 Scalar_FLOAT64_IEEE 0 speedgoat_test_SN5659_R2020b_CM_double -1.7E+308 1.7E+308 /end CHARACTERISTIC
/begin CHARACTERISTIC speedgoat_test_SN5659__cal_impl.shiftthedoublevalue27bitsleft_o "" VALUE 0x008E91C8 Scalar_FLOAT64_IEEE 0 speedgoat_test_SN5659_R2020b_CM_double -1.7E+308 1.7E+308 /end CHARACTERISTIC
/begin CHARACTERISTIC speedgoat_test_SN5659__cal_impl.shiftthedoublevalue27bitsleft_p "" VALUE 0x008E9838 Scalar_FLOAT64_IEEE 0 speedgoat_test_SN5659_R2020b_CM_double -1.7E+308 1.7E+308 /end CHARACTERISTIC
/begin MEASUREMENT speedgoat_test_SN5659_R2020b_B.BitwiseOperator_a "" ULONG speedgoat_test_SN5659_R2020b_CM_uint32 0 0 0 2147483646 ECU_ADDRESS 0x0095BE88 /end MEASUREMENT
/begin MEASUREMENT speedgoat_test_SN5659_R2020b_B.BitwiseOperator_m "" ULONG speedgoat_test_SN5659_R2020b_CM_uint32 0 0 0 2147483646 ECU_ADDRESS 0x0095BE74 /end MEASUREMENT
/begin MEASUREMENT speedgoat_test_SN5659_R2020b_B.DataTypeConversion "" FLOAT64_IEEE speedgoat_test_SN5659_R2020b_CM_double 0 0 -1.7E+308 1.7E+308 ECU_ADDRESS 0x0095B8E8 /end MEASUREMENT
/begin MEASUREMENT speedgoat_test_SN5659_R2020b_B.DataTypeConversion1 "" FLOAT64_IEEE speedgoat_test_SN5659_R2020b_CM_double 0 0 -1.7E+308 1.7E+308 ECU_ADDRESS 0x0095B918 /end MEASUREMENT
/begin MEASUREMENT speedgoat_test_SN5659_R2020b_B.DataTypeConversion1_g "" FLOAT64_IEEE speedgoat_test_SN5659_R2020b_CM_double 0 0 -1.7E+308 1.7E+308 ECU_ADDRESS 0x0095B968 /end MEASUREMENT
/begin MEASUREMENT speedgoat_test_SN5659_R2020b_B.DataTypeConversion1_i "" FLOAT64_IEEE speedgoat_test_SN5659_R2020b_CM_double 0 0 -1.7E+308 1.7E+308 ECU_ADDRESS 0x0095B9B8 /end MEASUREMENT
/begin MEASUREMENT speedgoat_test_SN5659_R2020b_B.DataTypeConversion_c "" ULONG speedgoat_test_SN5659_R2020b_CM_uint32 0 0 0 2147483646 ECU_ADDRESS 0x0095BE64 /end MEASUREMENT
/begin MEASUREMENT speedgoat_test_SN5659_R2020b_B.DataTypeConversion_e "" FLOAT64_IEEE speedgoat_test_SN5659_R2020b_CM_double 0 0 -1.7E+308 1.7E+308 ECU_ADDRESS 0x0095B988 /end MEASUREMENT
/begin MEASUREMENT speedgoat_test_SN5659_R2020b_B.DataTypeConversion_ec "" ULONG speedgoat_test_SN5659_R2020b_CM_uint32 0 0 0 2147483646 ECU_ADDRESS 0x0095BE78 /end MEASUREMENT
/begin MEASUREMENT speedgoat_test_SN5659_R2020b_B.DataTypeConversion_h "" FLOAT64_IEEE speedgoat_test_SN5659_R2020b_CM_double 0 0 -1.7E+308 1.7E+308 ECU_ADDRESS 0x0095B938 /end MEASUREMENT
/begin MEASUREMENT speedgoat_test_SN5659_R2020b_B.Decode1_b "" FLOAT64_IEEE speedgoat_test_SN5659_R2020b_CM_double 0 0 -1.7E+308 1.7E+308 ECU_ADDRESS 0x0095B898 /end MEASUREMENT
/begin MEASUREMENT speedgoat_test_SN5659_R2020b_B.Decode1_d "" FLOAT64_IEEE speedgoat_test_SN5659_R2020b_CM_double 0 0 -1.7E+308 1.7E+308 ECU_ADDRESS 0x0095A0A0 /end MEASUREMENT
/begin MEASUREMENT speedgoat_test_SN5659_R2020b_B.Decode1_gi "" FLOAT64_IEEE speedgoat_test_SN5659_R2020b_CM_double 0 0 -1.7E+308 1.7E+308 ECU_ADDRESS 0x0095B4E8 /end MEASUREMENT
/begin MEASUREMENT speedgoat_test_SN5659_R2020b_B.Decode1_io "" FLOAT64_IEEE speedgoat_test_SN5659_R2020b_CM_double 0 0 -1.7E+308 1.7E+308 ECU_ADDRESS 0x0095B310 /end MEASUREMENT
/begin MEASUREMENT speedgoat_test_SN5659_R2020b_B.Decode1_p "" FLOAT64_IEEE speedgoat_test_SN5659_R2020b_CM_double 0 0 -1.7E+308 1.7E+308 ECU_ADDRESS 0x0095AF60 /end MEASUREMENT
/begin MEASUREMENT speedgoat_test_SN5659_R2020b_B.Decode1_p1 "" FLOAT64_IEEE speedgoat_test_SN5659_R2020b_CM_double 0 0 -1.7E+308 1.7E+308 ECU_ADDRESS 0x0095B6C0 /end MEASUREMENT
/begin MEASUREMENT speedgoat_test_SN5659_R2020b_B.Decode1_pf "" FLOAT64_IEEE speedgoat_test_SN5659_R2020b_CM_double 0 0 -1.7E+308 1.7E+308 ECU_ADDRESS 0x0095B138 /end MEASUREMENT
/begin MEASUREMENT speedgoat_test_SN5659_R2020b_B.Decode2_ba "" FLOAT64_IEEE speedgoat_test_SN5659_R2020b_CM_double 0 0 -1.7E+308 1.7E+308 ECU_ADDRESS 0x0095AF68 /end MEASUREMENT
/begin MEASUREMENT speedgoat_test_SN5659_R2020b_B.Decode2_f "" FLOAT64_IEEE speedgoat_test_SN5659_R2020b_CM_double 0 0 -1.7E+308 1.7E+308 ECU_ADDRESS 0x0095B4F0 /end MEASUREMENT
/begin MEASUREMENT speedgoat_test_SN5659_R2020b_B.Decode2_h "" FLOAT64_IEEE speedgoat_test_SN5659_R2020b_CM_double 0 0 -1.7E+308 1.7E+308 ECU_ADDRESS 0x0095B6C8 /end MEASUREMENT
/begin MEASUREMENT speedgoat_test_SN5659_R2020b_B.Decode2_k "" FLOAT64_IEEE speedgoat_test_SN5659_R2020b_CM_double 0 0 -1.7E+308 1.7E+308 ECU_ADDRESS 0x0095B140 /end MEASUREMENT
/begin MEASUREMENT speedgoat_test_SN5659_R2020b_B.Decode2_nz "" FLOAT64_IEEE speedgoat_test_SN5659_R2020b_CM_double 0 0 -1.7E+308 1.7E+308 ECU_ADDRESS 0x0095B8A0 /end MEASUREMENT
/begin MEASUREMENT speedgoat_test_SN5659_R2020b_B.Decode3_a "" FLOAT64_IEEE speedgoat_test_SN5659_R2020b_CM_double 0 0 -1.7E+308 1.7E+308 ECU_ADDRESS 0x0095AF70 /end MEASUREMENT
/begin MEASUREMENT speedgoat_test_SN5659_R2020b_B.Decode3_b "" FLOAT64_IEEE speedgoat_test_SN5659_R2020b_CM_double 0 0 -1.7E+308 1.7E+308 ECU_ADDRESS 0x0095B148 /end MEASUREMENT
/begin MEASUREMENT speedgoat_test_SN5659_R2020b_B.Decode3_c "" FLOAT64_IEEE speedgoat_test_SN5659_R2020b_CM_double 0 0 -1.7E+308 1.7E+308 ECU_ADDRESS 0x0095A0B0 /end MEASUREMENT
/begin MEASUREMENT speedgoat_test_SN5659_R2020b_B.Decode3_lc "" FLOAT64_IEEE speedgoat_test_SN5659_R2020b_CM_double 0 0 -1.7E+308 1.7E+308 ECU_ADDRESS 0x0095B6D0 /end MEASUREMENT
/begin MEASUREMENT speedgoat_test_SN5659_R2020b_B.Decode3_mj "" FLOAT64_IEEE speedgoat_test_SN5659_R2020b_CM_double 0 0 -1.7E+308 1.7E+308 ECU_ADDRESS 0x0095B8A8 /end MEASUREMENT
/begin MEASUREMENT speedgoat_test_SN5659_R2020b_B.Decode3_ny "" FLOAT64_IEEE speedgoat_test_SN5659_R2020b_CM_double 0 0 -1.7E+308 1.7E+308 ECU_ADDRESS 0x0095B320 /end MEASUREMENT
/begin MEASUREMENT speedgoat_test_SN5659_R2020b_B.Decode3_o4 "" FLOAT64_IEEE speedgoat_test_SN5659_R2020b_CM_double 0 0 -1.7E+308 1.7E+308 ECU_ADDRESS 0x0095B4F8 /end MEASUREMENT
/begin MEASUREMENT speedgoat_test_SN5659_R2020b_B.Decode4_f "" FLOAT64_IEEE speedgoat_test_SN5659_R2020b_CM_double 0 0 -1.7E+308 1.7E+308 ECU_ADDRESS 0x0095AF78 /end MEASUREMENT
/begin MEASUREMENT speedgoat_test_SN5659_R2020b_B.Decode4_f4 "" FLOAT64_IEEE speedgoat_test_SN5659_R2020b_CM_double 0 0 -1.7E+308 1.7E+308 ECU_ADDRESS 0x0095B500 /end MEASUREMENT
/begin MEASUREMENT speedgoat_test_SN5659_R2020b_B.Decode4_ff "" FLOAT64_IEEE speedgoat_test_SN5659_R2020b_CM_double 0 0 -1.7E+308 1.7E+308 ECU_ADDRESS 0x0095B150 /end MEASUREMENT
/begin MEASUREMENT speedgoat_test_SN5659_R2020b_B.Decode4_j "" FLOAT64_IEEE speedgoat_test_SN5659_R2020b_CM_double 0 0 -1.7E+308 1.7E+308 ECU_ADDRESS 0x0095B328 /end MEASUREMENT
/begin MEASUREMENT speedgoat_test_SN5659_R2020b_B.Decode4_l "" FLOAT64_IEEE speedgoat_test_SN5659_R2020b_CM_double 0 0 -1.7E+308 1.7E+308 ECU_ADDRESS 0x0095B6D8 /end MEASUREMENT
/begin MEASUREMENT speedgoat_test_SN5659_R2020b_B.Decode4_m "" FLOAT64_IEEE speedgoat_test_SN5659_R2020b_CM_double 0 0 -1.7E+308 1.7E+308 ECU_ADDRESS 0x0095B8B0 /end MEASUREMENT
/begin MEASUREMENT speedgoat_test_SN5659_R2020b_B.Decode4_o "" FLOAT64_IEEE speedgoat_test_SN5659_R2020b_CM_double 0 0 -1.7E+308 1.7E+308 ECU_ADDRESS 0x0095A0B8 /end MEASUREMENT
/begin MEASUREMENT speedgoat_test_SN5659_R2020b_B.Decode5_b "" FLOAT64_IEEE speedgoat_test_SN5659_R2020b_CM_double 0 0 -1.7E+308 1.7E+308 ECU_ADDRESS 0x0095B318 /end MEASUREMENT
/begin MEASUREMENT speedgoat_test_SN5659_R2020b_B.Decode5_p "" FLOAT64_IEEE speedgoat_test_SN5659_R2020b_CM_double 0 0 -1.7E+308 1.7E+308 ECU_ADDRESS 0x0095A0A8 /end MEASUREMENT
/begin MEASUREMENT speedgoat_test_SN5659_R2020b_B.Divide_h "" FLOAT64_IEEE speedgoat_test_SN5659_R2020b_CM_double 0 0 -1.7E+308 1.7E+308 ECU_ADDRESS 0x0095B9A8 /end MEASUREMENT
/begin MEASUREMENT speedgoat_test_SN5659_R2020b_B.Divide_k "" FLOAT64_IEEE speedgoat_test_SN5659_R2020b_CM_double 0 0 -1.7E+308 1.7E+308 ECU_ADDRESS 0x0095B958 /end MEASUREMENT
/begin MEASUREMENT speedgoat_test_SN5659_R2020b_B.Encode1 "" FLOAT64_IEEE speedgoat_test_SN5659_R2020b_CM_double 0 0 -1.7E+308 1.7E+308 ECU_ADDRESS 0x0095B8E0 /end MEASUREMENT
/begin MEASUREMENT speedgoat_test_SN5659_R2020b_B.Encode1_b "" FLOAT64_IEEE speedgoat_test_SN5659_R2020b_CM_double 0 0 -1.7E+308 1.7E+308 ECU_ADDRESS 0x0095B930 /end MEASUREMENT
/begin MEASUREMENT speedgoat_test_SN5659_R2020b_B.Encode1_f "" FLOAT64_IEEE speedgoat_test_SN5659_R2020b_CM_double 0 0 -1.7E+308 1.7E+308 ECU_ADDRESS 0x0095B980 /end MEASUREMENT
/begin MEASUREMENT speedgoat_test_SN5659_R2020b_B.Encode2 "" FLOAT64_IEEE speedgoat_test_SN5659_R2020b_CM_double 0 0 -1.7E+308 1.7E+308 ECU_ADDRESS 0x0095B920 /end MEASUREMENT
/begin MEASUREMENT speedgoat_test_SN5659_R2020b_B.Encode2_f "" FLOAT64_IEEE speedgoat_test_SN5659_R2020b_CM_double 0 0 -1.7E+308 1.7E+308 ECU_ADDRESS 0x0095B990 /end MEASUREMENT
/begin MEASUREMENT speedgoat_test_SN5659_R2020b_B.Encode2_p "" FLOAT64_IEEE speedgoat_test_SN5659_R2020b_CM_double 0 0 -1.7E+308 1.7E+308 ECU_ADDRESS 0x0095B940 /end MEASUREMENT
/begin MEASUREMENT speedgoat_test_SN5659_R2020b_B.Encode3 "" FLOAT64_IEEE speedgoat_test_SN5659_R2020b_CM_double 0 0 -1.7E+308 1.7E+308 ECU_ADDRESS 0x0095B900 /end MEASUREMENT
/begin MEASUREMENT speedgoat_test_SN5659_R2020b_B.Encode3_b "" FLOAT64_IEEE speedgoat_test_SN5659_R2020b_CM_double 0 0 -1.7E+308 1.7E+308 ECU_ADDRESS 0x0095B9A0 /end MEASUREMENT
/begin MEASUREMENT speedgoat_test_SN5659_R2020b_B.Encode3_i "" FLOAT64_IEEE speedgoat_test_SN5659_R2020b_CM_double 0 0 -1.7E+308 1.7E+308 ECU_ADDRESS 0x0095B950 /end MEASUREMENT
/begin MEASUREMENT speedgoat_test_SN5659_R2020b_B.Encode4 "" FLOAT64_IEEE speedgoat_test_SN5659_R2020b_CM_double 0 0 -1.7E+308 1.7E+308 ECU_ADDRESS 0x0095B970 /end MEASUREMENT
/begin MEASUREMENT speedgoat_test_SN5659_R2020b_B.Encode4_i "" FLOAT64_IEEE speedgoat_test_SN5659_R2020b_CM_double 0 0 -1.7E+308 1.7E+308 ECU_ADDRESS 0x0095B9C0 /end MEASUREMENT
/begin MEASUREMENT speedgoat_test_SN5659_R2020b_B.Encode5 "" FLOAT64_IEEE speedgoat_test_SN5659_R2020b_CM_double 0 0 -1.7E+308 1.7E+308 ECU_ADDRESS 0x0095B8F0 /end MEASUREMENT
/begin MEASUREMENT speedgoat_test_SN5659_R2020b_B.FixPtSum1 "" UWORD speedgoat_test_SN5659_R2020b_CM_uint16 0 0 0 65535 ECU_ADDRESS 0x0095C3A2 /end MEASUREMENT
/begin MEASUREMENT speedgoat_test_SN5659_R2020b_B.FixPtSum1_n "" UWORD speedgoat_test_SN5659_R2020b_CM_uint16 0 0 0 65535 ECU_ADDRESS 0x0095C3A8 /end MEASUREMENT
/begin MEASUREMENT speedgoat_test_SN5659_R2020b_B.FixPtSwitch "" UWORD speedgoat_test_SN5659_R2020b_CM_uint16 0 0 0 65535 ECU_ADDRESS 0x0095C3A4 /end MEASUREMENT
/begin MEASUREMENT speedgoat_test_SN5659_R2020b_B.FixPtSwitch_h "" UWORD speedgoat_test_SN5659_R2020b_CM_uint16 0 0 0 65535 ECU_ADDRESS 0x0095C3AA /end MEASUREMENT
/begin MEASUREMENT speedgoat_test_SN5659_R2020b_B.Mask_a "" ULONG speedgoat_test_SN5659_R2020b_CM_uint32 0 0 0 2147483646 ECU_ADDRESS 0x0095BE68 /end MEASUREMENT
/begin MEASUREMENT speedgoat_test_SN5659_R2020b_B.Mask_n "" ULONG speedgoat_test_SN5659_R2020b_CM_uint32 0 0 0 2147483646 ECU_ADDRESS 0x0095BE7C /end MEASUREMENT
/begin MEASUREMENT speedgoat_test_SN5659_R2020b_B.Multiply_a "" FLOAT64_IEEE speedgoat_test_SN5659_R2020b_CM_double 0 0 -1.7E+308 1.7E+308 ECU_ADDRESS 0x0095B9B0 /end MEASUREMENT
/begin MEASUREMENT speedgoat_test_SN5659_R2020b_B.Multiply_h "" FLOAT64_IEEE speedgoat_test_SN5659_R2020b_CM_double 0 0 -1.7E+308 1.7E+308 ECU_ADDRESS 0x0095B960 /end MEASUREMENT
/begin MEASUREMENT speedgoat_test_SN5659_R2020b_B.Output "" UWORD speedgoat_test_SN5659_R2020b_CM_uint16 0 0 0 65535 ECU_ADDRESS 0x0095C3A0 /end MEASUREMENT
/begin MEASUREMENT speedgoat_test_SN5659_R2020b_B.Output_b "" UWORD speedgoat_test_SN5659_R2020b_CM_uint16 0 0 0 65535 ECU_ADDRESS 0x0095C3A6 /end MEASUREMENT
/begin MEASUREMENT speedgoat_test_SN5659_R2020b_B.Output_o "" UBYTE speedgoat_test_SN5659_R2020b_CM_uint8 0 0 0 255 ECU_ADDRESS 0x0095C3F4 /end MEASUREMENT
/begin MEASUREMENT speedgoat_test_SN5659_R2020b_B.Randomnumber "" FLOAT64_IEEE speedgoat_test_SN5659_R2020b_CM_double 0 0 -1.7E+308 1.7E+308 ECU_ADDRESS 0x0095B8D8 /end MEASUREMENT
/begin MEASUREMENT speedgoat_test_SN5659_R2020b_B.Randomnumber_c "" FLOAT64_IEEE speedgoat_test_SN5659_R2020b_CM_double 0 0 -1.7E+308 1.7E+308 ECU_ADDRESS 0x0095B928 /end MEASUREMENT
/begin MEASUREMENT speedgoat_test_SN5659_R2020b_B.Randomnumber_p "" FLOAT64_IEEE speedgoat_test_SN5659_R2020b_CM_double 0 0 -1.7E+308 1.7E+308 ECU_ADDRESS 0x0095B978 /end MEASUREMENT
/begin MEASUREMENT speedgoat_test_SN5659_R2020b_B.ShifttoSDIslot_a "" ULONG speedgoat_test_SN5659_R2020b_CM_uint32 0 0 0 2147483646 ECU_ADDRESS 0x0095BE84 /end MEASUREMENT
/begin MEASUREMENT speedgoat_test_SN5659_R2020b_B.ShifttoSDIslot_l "" ULONG speedgoat_test_SN5659_R2020b_CM_uint32 0 0 0 2147483646 ECU_ADDRESS 0x0095BE70 /end MEASUREMENT
/begin MEASUREMENT speedgoat_test_SN5659_R2020b_B.ShifttoSSMslot_h "" ULONG speedgoat_test_SN5659_R2020b_CM_uint32 0 0 0 2147483646 ECU_ADDRESS 0x0095BE6C /end MEASUREMENT
/begin MEASUREMENT speedgoat_test_SN5659_R2020b_B.ShifttoSSMslot_m "" ULONG speedgoat_test_SN5659_R2020b_CM_uint32 0 0 0 2147483646 ECU_ADDRESS 0x0095BE80 /end MEASUREMENT
/begin MEASUREMENT speedgoat_test_SN5659_R2020b_B.Sinewave "" FLOAT64_IEEE speedgoat_test_SN5659_R2020b_CM_double 0 0 -1.7E+308 1.7E+308 ECU_ADDRESS 0x0095B8F8 /end MEASUREMENT
/begin MEASUREMENT speedgoat_test_SN5659_R2020b_B.Sinewave_f "" FLOAT64_IEEE speedgoat_test_SN5659_R2020b_CM_double 0 0 -1.7E+308 1.7E+308 ECU_ADDRESS 0x0095B998 /end MEASUREMENT
/begin MEASUREMENT speedgoat_test_SN5659_R2020b_B.Sinewave_o "" FLOAT64_IEEE speedgoat_test_SN5659_R2020b_CM_double 0 0 -1.7E+308 1.7E+308 ECU_ADDRESS 0x0095B948 /end MEASUREMENT
/begin MEASUREMENT speedgoat_test_SN5659_R2020b_DW.NextOutput "" FLOAT64_IEEE speedgoat_test_SN5659_R2020b_CM_double 0 0 -1.7E+308 1.7E+308 ECU_ADDRESS 0x009588A0 /end MEASUREMENT
/begin MEASUREMENT speedgoat_test_SN5659_R2020b_DW.NextOutput_a "" FLOAT64_IEEE speedgoat_test_SN5659_R2020b_CM_double 0 0 -1.7E+308 1.7E+308 ECU_ADDRESS 0x009588B8 /end MEASUREMENT
/begin MEASUREMENT speedgoat_test_SN5659_R2020b_DW.NextOutput_n "" FLOAT64_IEEE speedgoat_test_SN5659_R2020b_CM_double 0 0 -1.7E+308 1.7E+308 ECU_ADDRESS 0x009588D0 /end MEASUREMENT
/begin MEASUREMENT speedgoat_test_SN5659_R2020b_DW.Output_DSTATE "" UWORD speedgoat_test_SN5659_R2020b_CM_uint16 0 0 0 65535 ECU_ADDRESS 0x009598D0 /end MEASUREMENT
/begin MEASUREMENT speedgoat_test_SN5659_R2020b_DW.Output_DSTATE_o "" UWORD speedgoat_test_SN5659_R2020b_CM_uint16 0 0 0 65535 ECU_ADDRESS 0x009598D2 /end MEASUREMENT
/begin MEASUREMENT speedgoat_test_SN5659_R2020b_DW.RandSeed "" ULONG speedgoat_test_SN5659_R2020b_CM_uint32 0 0 0 2147483646 ECU_ADDRESS 0x009594D0 /end MEASUREMENT
/begin MEASUREMENT speedgoat_test_SN5659_R2020b_DW.RandSeed_h "" ULONG speedgoat_test_SN5659_R2020b_CM_uint32 0 0 0 2147483646 ECU_ADDRESS 0x009594D8 /end MEASUREMENT
/begin MEASUREMENT speedgoat_test_SN5659_R2020b_DW.RandSeed_m "" ULONG speedgoat_test_SN5659_R2020b_CM_uint32 0 0 0 2147483646 ECU_ADDRESS 0x009594D4 /end MEASUREMENT
/begin MEASUREMENT speedgoat_test_SN5659_R2020b_DW.lastCos_h "" FLOAT64_IEEE speedgoat_test_SN5659_R2020b_CM_double 0 0 -1.7E+308 1.7E+308 ECU_ADDRESS 0x009588B0 /end MEASUREMENT
/begin MEASUREMENT speedgoat_test_SN5659_R2020b_DW.lastCos_m "" FLOAT64_IEEE speedgoat_test_SN5659_R2020b_CM_double 0 0 -1.7E+308 1.7E+308 ECU_ADDRESS 0x009588E0 /end MEASUREMENT
/begin MEASUREMENT speedgoat_test_SN5659_R2020b_DW.lastCos_p "" FLOAT64_IEEE speedgoat_test_SN5659_R2020b_CM_double 0 0 -1.7E+308 1.7E+308 ECU_ADDRESS 0x009588C8 /end MEASUREMENT
/begin MEASUREMENT speedgoat_test_SN5659_R2020b_DW.lastSin_cq "" FLOAT64_IEEE speedgoat_test_SN5659_R2020b_CM_double 0 0 -1.7E+308 1.7E+308 ECU_ADDRESS 0x009588C0 /end MEASUREMENT
/begin MEASUREMENT speedgoat_test_SN5659_R2020b_DW.lastSin_m "" FLOAT64_IEEE speedgoat_test_SN5659_R2020b_CM_double 0 0 -1.7E+308 1.7E+308 ECU_ADDRESS 0x009588D8 /end MEASUREMENT
/begin MEASUREMENT speedgoat_test_SN5659_R2020b_DW.lastSin_o "" FLOAT64_IEEE speedgoat_test_SN5659_R2020b_CM_double 0 0 -1.7E+308 1.7E+308 ECU_ADDRESS 0x009588A8 /end MEASUREMENT
/begin MEASUREMENT speedgoat_test_SN5659_R2020b_DW.systemEnable_bt "" SLONG speedgoat_test_SN5659_R2020b_CM_int32 0 0 -2147483648 2147483647 ECU_ADDRESS 0x00959484 /end MEASUREMENT
/begin MEASUREMENT speedgoat_test_SN5659_R2020b_DW.systemEnable_i2 "" SLONG speedgoat_test_SN5659_R2020b_CM_int32 0 0 -2147483648 2147483647 ECU_ADDRESS 0x0095947C /end MEASUREMENT
/begin MEASUREMENT speedgoat_test_SN5659_R2020b_DW.systemEnable_n "" SLONG speedgoat_test_SN5659_R2020b_CM_int32 0 0 -2147483648 2147483647 ECU_ADDRESS 0x00959480 /end MEASUREMENT
/begin COMPU_METHOD speedgoat_test_SN5659_R2020b_CM_double "" IDENTICAL "%15.10" "" /end COMPU_METHOD
/begin COMPU_METHOD speedgoat_test_SN5659_R2020b_CM_int32 "" IDENTICAL "%10.0" "" /end COMPU_METHOD
/begin COMPU_METHOD speedgoat_test_SN5659_R2020b_CM_uint16 "" IDENTICAL "%5.0" "" /end COMPU_METHOD
/begin COMPU_METHOD speedgoat_test_SN5659_R2020b_CM_uint32 "" IDENTICAL "%10.0" "" /end COMPU_METHOD
/begin COMPU_METHOD speedgoat_test_SN5659_R2020b_CM_uint8 "" IDENTICAL "%3.0" "" /end COMPU_METHOD
/begin RECORD_LAYOUT Scalar_FLOAT64_IEEE FNC_VALUES 1 FLOAT64_IEEE COLUMN_DIR DIRECT /end RECORD_LAYOUT
/begin RECORD_LAYOUT Scalar_ULONG FNC_VALUES 1 ULONG COLUMN_DIR DIRECT /end RECORD_LAYOUT
/begin RECORD_LAYOUT Scalar_UWORD FNC_VALUES 1 UWORD COLUMN_DIR DIRECT /end RECORD_LAYOUT
/begin GROUP speedgoat_test_SN5659_R2020b_IO682_Decode_Channel_3 "speedgoat_test_SN5659_R2020b/IO682/Decode Channel 3"
 /begin REF_CHARACTERISTIC speedgoat_test_SN5659__cal_impl.Decode1_P10_aa speedgoat_test_SN5659__cal_impl.Decode1_P11_ei speedgoat_test_SN5659__cal_impl.Decode1_P12_jm speedgoat_test_SN5659__cal_impl.Decode1_P13_e speedgoat_test_SN5659__cal_impl.Decode1_P14_id speedgoat_test_SN5659__cal_impl.Decode1_P15_l0 speedgoat_test_SN5659__cal_impl.Decode1_P16_g speedgoat_test_SN5659__cal_impl.Decode1_P1_p speedgoat_test_SN5659__cal_impl.Decode1_P2_d speedgoat_test_SN5659__cal_impl.Decode1_P3_n speedgoat_test_SN5659__cal_impl.Decode1_P4_pr speedgoat_test_SN5659__cal_impl.Decode1_P5_p speedgoat_test_SN5659__cal_impl.Decode1_P6_o speedgoat_test_SN5659__cal_impl.Decode1_P7_bo speedgoat_test_SN5659__cal_impl.Decode1_P8_ga speedgoat_test_SN5659__cal_impl.Decode1_P9_c speedgoat_test_SN5659__cal_impl.Decode2_P10_bf speedgoat_test_SN5659__cal_impl.Decode2_P11_ff speedgoat_test_SN5659__cal_impl.Decode2_P12_b speedgoat_test_SN5659__cal_impl.Decode2_P13_c speedgoat_test_SN5659__cal_impl.Decode2_P14_f2 speedgoat_test_SN5659__cal_impl.Decode2_P15_go speedgoat_test_SN5659__cal_impl.Decode2_P16_cw speedgoat_test_SN5659__cal_impl.Decode2_P1_i speedgoat_test_SN5659__cal_impl.Decode2_P2_ef speedgoat_test_SN5659__cal_impl.Decode2_P3_c speedgoat_test_SN5659__cal_impl.Decode2_P4_e speedgoat_test_SN5659__cal_impl.Decode2_P5_l speedgoat_test_SN5659__cal_impl.Decode2_P6_n speedgoat_test_SN5659__cal_impl.Decode2_P7_ja speedgoat_test_SN5659__cal_impl.Decode2_P8_g speedgoat_test_SN5659__cal_impl.Decode2_P9_e speedgoat_test_SN5659__cal_impl.Decode3_P10_i speedgoat_test_SN5659__cal_impl.Decode3_P11_m speedgoat_test_SN5659__cal_impl.Decode3_P12_ls speedgoat_test_SN5659__cal_impl.Decode3_P13_ez speedgoat_test_SN5659__cal_impl.Decode3_P14_m speedgoat_test_SN5659__cal_impl.Decode3_P15_h speedgoat_test_SN5659__cal_impl.Decode3_P16_g speedgoat_test_SN5659__cal_impl.Decode3_P1_m speedgoat_test_SN5659__cal_impl.Decode3_P2_c speedgoat_test_SN5659__cal_impl.Decode3_P3_i speedgoat_test_SN5659__cal_impl.Decode3_P4_m4 speedgoat_test_SN5659__cal_impl.Decode3_P5_nh speedgoat_test_SN5659__cal_impl.Decode3_P6_l speedgoat_test_SN5659__cal_impl.Decode3_P7_bv speedgoat_test_SN5659__cal_impl.Decode3_P8_ig speedgoat_test_SN5659__cal_impl.Decode3_P9_m5 speedgoat_test_SN5659__cal_impl.Decode4_P10_o speedgoat_test_SN5659__cal_impl.Decode4_P11_j speedgoat_test_SN5659__cal_impl.Decode4_P12_j speedgoat_test_SN5659__cal_impl.Decode4_P13_io speedgoat_test_SN5659__cal_impl.Decode4_P14_l4 speedgoat_test_SN5659__cal_impl.Decode4_P15_dv speedgoat_test_SN5659__cal_impl.Decode4_P16_j speedgoat_test_SN5659__cal_impl.Decode4_P1_f speedgoat_test_SN5659__cal_impl.Decode4_P2_pq speedgoat_test_SN5659__cal_impl.Decode4_P3_k speedgoat_test_SN5659__cal_impl.Decode4_P4_ft speedgoat_test_SN5659__cal_impl.Decode4_P5_d speedgoat_test_SN5659__cal_impl.Decode4_P6_m speedgoat_test_SN5659__cal_impl.Decode4_P7_nw speedgoat_test_SN5659__cal_impl.Decode4_P8_n speedgoat_test_SN5659__cal_impl.Decode4_P9_dp /end REF_CHARACTERISTIC
 /begin REF_MEASUREMENT speedgoat_test_SN5659_R2020b_B.Decode1_p speedgoat_test_SN5659_R2020b_B.Decode2_ba speedgoat_test_SN5659_R2020b_B.Decode3_a speedgoat_test_SN5659_R2020b_B.Decode4_f /end REF_MEASUREMENT
/end GROUP
/begin GROUP speedgoat_test_SN5659_R2020b_IO682_Decode_Channel_4 "speedgoat_test_SN5659_R2020b/IO682/Decode Channel 4"
 /begin REF_CHARACTERISTIC speedgoat_test_SN5659__cal_impl.Decode1_P10_d speedgoat_test_SN5659__cal_impl.Decode1_P11_c speedgoat_test_SN5659__cal_impl.Decode1_P12_po speedgoat_test_SN5659__cal_impl.Decode1_P13_p speedgoat_test_SN5659__cal_impl.Decode1_P14_da speedgoat_test_SN5659__cal_impl.Decode1_P15_gw speedgoat_test_SN5659__cal_impl.Decode1_P16_be speedgoat_test_SN5659__cal_impl.Decode1_P1_k speedgoat_test_SN5659__cal_impl.Decode1_P2_e1 speedgoat_test_SN5659__cal_impl.Decode1_P3_ng speedgoat_test_SN5659__cal_impl.Decode1_P4_h speedgoat_test_SN5659__cal_impl.Decode1_P5_d speedgoat_test_SN5659__cal_impl.Decode1_P6_pa speedgoat_test_SN5659__cal_impl.Decode1_P7_l speedgoat_test_SN5659__cal_impl.Decode1_P8_o speedgoat_test_SN5659__cal_impl.Decode1_P9_a speedgoat_test_SN5659__cal_impl.Decode2_P10_f speedgoat_test_SN5659__cal_impl.Decode2_P11_fz speedgoat_test_SN5659__cal_impl.Decode2_P12_bf speedgoat_test_SN5659__cal_impl.Decode2_P13_m speedgoat_test_SN5659__cal_impl.Decode2_P14_j speedgoat_test_SN5659__cal_impl.Decode2_P15_jl speedgoat_test_SN5659__cal_impl.Decode2_P16_f speedgoat_test_SN5659__cal_impl.Decode2_P1_p speedgoat_test_SN5659__cal_impl.Decode2_P2_kc speedgoat_test_SN5659__cal_impl.Decode2_P3_i speedgoat_test_SN5659__cal_impl.Decode2_P4_b speedgoat_test_SN5659__cal_impl.Decode2_P5_d speedgoat_test_SN5659__cal_impl.Decode2_P6_m speedgoat_test_SN5659__cal_impl.Decode2_P7_h speedgoat_test_SN5659__cal_impl.Decode2_P8_bd speedgoat_test_SN5659__cal_impl.Decode2_P9_lp speedgoat_test_SN5659__cal_impl.Decode3_P10_oo speedgoat_test_SN5659__cal_impl.Decode3_P11_mj speedgoat_test_SN5659__cal_impl.Decode3_P12_kuc speedgoat_test_SN5659__cal_impl.Decode3_P13_my speedgoat_test_SN5659__cal_impl.Decode3_P14_c speedgoat_test_SN5659__cal_impl.Decode3_P15_k speedgoat_test_SN5659__cal_impl.Decode3_P16_p speedgoat_test_SN5659__cal_impl.Decode3_P1_mu speedgoat_test_SN5659__cal_impl.Decode3_P2_ow speedgoat_test_SN5659__cal_impl.Decode3_P3_ht speedgoat_test_SN5659__cal_impl.Decode3_P4_g speedgoat_test_SN5659__cal_impl.Decode3_P5_e speedgoat_test_SN5659__cal_impl.Decode3_P6_g speedgoat_test_SN5659__cal_impl.Decode3_P7_m speedgoat_test_SN5659__cal_impl.Decode3_P8_a speedgoat_test_SN5659__cal_impl.Decode3_P9_dw speedgoat_test_SN5659__cal_impl.Decode4_P10_bv speedgoat_test_SN5659__cal_impl.Decode4_P11_a speedgoat_test_SN5659__cal_impl.Decode4_P12_nu speedgoat_test_SN5659__cal_impl.Decode4_P13_aq speedgoat_test_SN5659__cal_impl.Decode4_P14_dy speedgoat_test_SN5659__cal_impl.Decode4_P15_n speedgoat_test_SN5659__cal_impl.Decode4_P16_gq speedgoat_test_SN5659__cal_impl.Decode4_P1_px speedgoat_test_SN5659__cal_impl.Decode4_P2_e speedgoat_test_SN5659__cal_impl.Decode4_P3_g speedgoat_test_SN5659__cal_impl.Decode4_P4_g speedgoat_test_SN5659__cal_impl.Decode4_P5_cm speedgoat_test_SN5659__cal_impl.Decode4_P6_awi speedgoat_test_SN5659__cal_impl.Decode4_P7_h0 speedgoat_test_SN5659__cal_impl.Decode4_P8_p speedgoat_test_SN5659__cal_impl.Decode4_P9_p /end REF_CHARACTERISTIC
 /begin REF_MEASUREMENT speedgoat_test_SN5659_R2020b_B.Decode1_pf speedgoat_test_SN5659_R2020b_B.Decode2_k speedgoat_test_SN5659_R2020b_B.Decode3_b speedgoat_test_SN5659_R2020b_B.Decode4_ff /end REF_MEASUREMENT
/end GROUP
/begin GROUP speedgoat_test_SN5659_R2020b_IO682_Decode_Channel_5 "speedgoat_test_SN5659_R2020b/IO682/Decode Channel 5"
 /begin REF_CHARACTERISTIC speedgoat_test_SN5659__cal_impl.Decode1_P10_j speedgoat_test_SN5659__cal_impl.Decode1_P11_ee speedgoat_test_SN5659__cal_impl.Decode1_P12_d5 speedgoat_test_SN5659__cal_impl.Decode1_P13_ad speedgoat_test_SN5659__cal_impl.Decode1_P14_j speedgoat_test_SN5659__cal_impl.Decode1_P15_au speedgoat_test_SN5659__cal_impl.Decode1_P16_l speedgoat_test_SN5659__cal_impl.Decode1_P1_h speedgoat_test_SN5659__cal_impl.Decode1_P2_c speedgoat_test_SN5659__cal_impl.Decode1_P3_d speedgoat_test_SN5659__cal_impl.Decode1_P4_me speedgoat_test_SN5659__cal_impl.Decode1_P5_d5 speedgoat_test_SN5659__cal_impl.Decode1_P6_i3 speedgoat_test_SN5659__cal_impl.Decode1_P7_d3 speedgoat_test_SN5659__cal_impl.Decode1_P8_c5 speedgoat_test_SN5659__cal_impl.Decode1_P9_pu speedgoat_test_SN5659__cal_impl.Decode3_P10_k5 speedgoat_test_SN5659__cal_impl.Decode3_P11_bg speedgoat_test_SN5659__cal_impl.Decode3_P12_pa speedgoat_test_SN5659__cal_impl.Decode3_P13_k speedgoat_test_SN5659__cal_impl.Decode3_P14_nc speedgoat_test_SN5659__cal_impl.Decode3_P15_n speedgoat_test_SN5659__cal_impl.Decode3_P16_i speedgoat_test_SN5659__cal_impl.Decode3_P1_n speedgoat_test_SN5659__cal_impl.Decode3_P2_pu speedgoat_test_SN5659__cal_impl.Decode3_P3_e speedgoat_test_SN5659__cal_impl.Decode3_P4_jl speedgoat_test_SN5659__cal_impl.Decode3_P5_o speedgoat_test_SN5659__cal_impl.Decode3_P6_ib speedgoat_test_SN5659__cal_impl.Decode3_P7_fx speedgoat_test_SN5659__cal_impl.Decode3_P8_b speedgoat_test_SN5659__cal_impl.Decode3_P9_dy speedgoat_test_SN5659__cal_impl.Decode4_P10_mz speedgoat_test_SN5659__cal_impl.Decode4_P11_c speedgoat_test_SN5659__cal_impl.Decode4_P12_ff speedgoat_test_SN5659__cal_impl.Decode4_P13_n speedgoat_test_SN5659__cal_impl.Decode4_P14_lo speedgoat_test_SN5659__cal_impl.Decode4_P15_p speedgoat_test_SN5659__cal_impl.Decode4_P16_ec speedgoat_test_SN5659__cal_impl.Decode4_P1_m speedgoat_test_SN5659__cal_impl.Decode4_P2_h speedgoat_test_SN5659__cal_impl.Decode4_P3_n speedgoat_test_SN5659__cal_impl.Decode4_P4_b speedgoat_test_SN5659__cal_impl.Decode4_P5_m speedgoat_test_SN5659__cal_impl.Decode4_P6_d speedgoat_test_SN5659__cal_impl.Decode4_P7_a speedgoat_test_SN5659__cal_impl.Decode4_P8_l speedgoat_test_SN5659__cal_impl.Decode4_P9_p0 speedgoat_test_SN5659__cal_impl.Decode5_P10_k2 speedgoat_test_SN5659__cal_impl.Decode5_P11_i speedgoat_test_SN5659__cal_impl.Decode5_P12_h speedgoat_test_SN5659__cal_impl.Decode5_P13_p speedgoat_test_SN5659__cal_impl.Decode5_P14_cm speedgoat_test_SN5659__cal_impl.Decode5_P15_b speedgoat_test_SN5659__cal_impl.Decode5_P16_o speedgoat_test_SN5659__cal_impl.Decode5_P1_p speedgoat_test_SN5659__cal_impl.Decode5_P2_f0 speedgoat_test_SN5659__cal_impl.Decode5_P3_o speedgoat_test_SN5659__cal_impl.Decode5_P4_f5 speedgoat_test_SN5659__cal_impl.Decode5_P5_d speedgoat_test_SN5659__cal_impl.Decode5_P6_c speedgoat_test_SN5659__cal_impl.Decode5_P7_m speedgoat_test_SN5659__cal_impl.Decode5_P8_c speedgoat_test_SN5659__cal_impl.Decode5_P9_h /end REF_CHARACTERISTIC
 /begin REF_MEASUREMENT speedgoat_test_SN5659_R2020b_B.Decode1_io speedgoat_test_SN5659_R2020b_B.Decode3_ny speedgoat_test_SN5659_R2020b_B.Decode4_j speedgoat_test_SN5659_R2020b_B.Decode5_b /end REF_MEASUREMENT
/end GROUP
/begin GROUP speedgoat_test_SN5659_R2020b_IO682_Decode_Channel_6 "speedgoat_test_SN5659_R2020b/IO682/Decode Channel 6"
 /begin REF_CHARACTERISTIC speedgoat_test_SN5659__cal_impl.Decode1_P10_e1 speedgoat_test_SN5659__cal_impl.Decode1_P11_al speedgoat_test_SN5659__cal_impl.Decode1_P12_kj speedgoat_test_SN5659__cal_impl.Decode1_P13_m speedgoat_test_SN5659__cal_impl.Decode1_P14_a speedgoat_test_SN5659__cal_impl.Decode1_P15_aw speedgoat_test_SN5659__cal_impl.Decode1_P16_eq speedgoat_test_SN5659__cal_impl.Decode1_P1_cw speedgoat_test_SN5659__cal_impl.Decode1_P2_bu speedgoat_test_SN5659__cal_impl.Decode1_P3_a speedgoat_test_SN5659__cal_impl.Decode1_P4_j speedgoat_test_SN5659__cal_impl.Decode1_P5_m3 speedgoat_test_SN5659__cal_impl.Decode1_P6_bi speedgoat_test_SN5659__cal_impl.Decode1_P7_m1 speedgoat_test_SN5659__cal_impl.Decode1_P8_f speedgoat_test_SN5659__cal_impl.Decode1_P9_ie speedgoat_test_SN5659__cal_impl.Decode2_P10_e speedgoat_test_SN5659__cal_impl.Decode2_P11_p speedgoat_test_SN5659__cal_impl.Decode2_P12_id speedgoat_test_SN5659__cal_impl.Decode2_P13_b speedgoat_test_SN5659__cal_impl.Decode2_P14_d speedgoat_test_SN5659__cal_impl.Decode2_P15_b speedgoat_test_SN5659__cal_impl.Decode2_P16_d speedgoat_test_SN5659__cal_impl.Decode2_P1_k speedgoat_test_SN5659__cal_impl.Decode2_P2_kx speedgoat_test_SN5659__cal_impl.Decode2_P3_b5 speedgoat_test_SN5659__cal_impl.Decode2_P4_a speedgoat_test_SN5659__cal_impl.Decode2_P5_jm speedgoat_test_SN5659__cal_impl.Decode2_P6_lx speedgoat_test_SN5659__cal_impl.Decode2_P7_k speedgoat_test_SN5659__cal_impl.Decode2_P8_h4 speedgoat_test_SN5659__cal_impl.Decode2_P9_gq speedgoat_test_SN5659__cal_impl.Decode3_P10_av speedgoat_test_SN5659__cal_impl.Decode3_P11_ku speedgoat_test_SN5659__cal_impl.Decode3_P12_e speedgoat_test_SN5659__cal_impl.Decode3_P13_fu speedgoat_test_SN5659__cal_impl.Decode3_P14_ph speedgoat_test_SN5659__cal_impl.Decode3_P15_hq speedgoat_test_SN5659__cal_impl.Decode3_P16_iz speedgoat_test_SN5659__cal_impl.Decode3_P1_p speedgoat_test_SN5659__cal_impl.Decode3_P2_f speedgoat_test_SN5659__cal_impl.Decode3_P3_d speedgoat_test_SN5659__cal_impl.Decode3_P4_dj speedgoat_test_SN5659__cal_impl.Decode3_P5_j speedgoat_test_SN5659__cal_impl.Decode3_P6_f speedgoat_test_SN5659__cal_impl.Decode3_P7_p speedgoat_test_SN5659__cal_impl.Decode3_P8_f speedgoat_test_SN5659__cal_impl.Decode3_P9_ig speedgoat_test_SN5659__cal_impl.Decode4_P10_l speedgoat_test_SN5659__cal_impl.Decode4_P11_dk speedgoat_test_SN5659__cal_impl.Decode4_P12_i speedgoat_test_SN5659__cal_impl.Decode4_P13_gv speedgoat_test_SN5659__cal_impl.Decode4_P14_m speedgoat_test_SN5659__cal_impl.Decode4_P15_pv speedgoat_test_SN5659__cal_impl.Decode4_P16_ad speedgoat_test_SN5659__cal_impl.Decode4_P1_fa speedgoat_test_SN5659__cal_impl.Decode4_P2_e5 speedgoat_test_SN5659__cal_impl.Decode4_P3_p4 speedgoat_test_SN5659__cal_impl.Decode4_P4_p2 speedgoat_test_SN5659__cal_impl.Decode4_P5_cd speedgoat_test_SN5659__cal_impl.Decode4_P6_fd speedgoat_test_SN5659__cal_impl.Decode4_P7_g2 speedgoat_test_SN5659__cal_impl.Decode4_P8_lu speedgoat_test_SN5659__cal_impl.Decode4_P9_j /end REF_CHARACTERISTIC
 /begin REF_MEASUREMENT speedgoat_test_SN5659_R2020b_B.Decode1_gi speedgoat_test_SN5659_R2020b_B.Decode2_f speedgoat_test_SN5659_R2020b_B.Decode3_o4 speedgoat_test_SN5659_R2020b_B.Decode4_f4 /end REF_MEASUREMENT
/end GROUP
/begin GROUP speedgoat_test_SN5659_R2020b_IO682_Decode_Channel_7 "speedgoat_test_SN5659_R2020b/IO682/Decode Channel 7"
 /begin REF_CHARACTERISTIC speedgoat_test_SN5659__cal_impl.Decode1_P10_g speedgoat_test_SN5659__cal_impl.Decode1_P11_eo speedgoat_test_SN5659__cal_impl.Decode1_P12_m speedgoat_test_SN5659__cal_impl.Decode1_P13_fl speedgoat_test_SN5659__cal_impl.Decode1_P14_f speedgoat_test_SN5659__cal_impl.Decode1_P15_nq speedgoat_test_SN5659__cal_impl.Decode1_P16_ju speedgoat_test_SN5659__cal_impl.Decode1_P1_hw speedgoat_test_SN5659__cal_impl.Decode1_P2_m speedgoat_test_SN5659__cal_impl.Decode1_P3_ci speedgoat_test_SN5659__cal_impl.Decode1_P4_bf speedgoat_test_SN5659__cal_impl.Decode1_P5_kb speedgoat_test_SN5659__cal_impl.Decode1_P6_jf speedgoat_test_SN5659__cal_impl.Decode1_P7_ob speedgoat_test_SN5659__cal_impl.Decode1_P8_a speedgoat_test_SN5659__cal_impl.Decode1_P9_op speedgoat_test_SN5659__cal_impl.Decode2_P10_l speedgoat_test_SN5659__cal_impl.Decode2_P11_h speedgoat_test_SN5659__cal_impl.Decode2_P12_d speedgoat_test_SN5659__cal_impl.Decode2_P13_d speedgoat_test_SN5659__cal_impl.Decode2_P14_k speedgoat_test_SN5659__cal_impl.Decode2_P15_l speedgoat_test_SN5659__cal_impl.Decode2_P16_h speedgoat_test_SN5659__cal_impl.Decode2_P1_b speedgoat_test_SN5659__cal_impl.Decode2_P2_jg speedgoat_test_SN5659__cal_impl.Decode2_P3_m speedgoat_test_SN5659__cal_impl.Decode2_P4_ff speedgoat_test_SN5659__cal_impl.Decode2_P5_h speedgoat_test_SN5659__cal_impl.Decode2_P6_b speedgoat_test_SN5659__cal_impl.Decode2_P7_c speedgoat_test_SN5659__cal_impl.Decode2_P8_k speedgoat_test_SN5659__cal_impl.Decode2_P9_gj speedgoat_test_SN5659__cal_impl.Decode3_P10_lv speedgoat_test_SN5659__cal_impl.Decode3_P11_n speedgoat_test_SN5659__cal_impl.Decode3_P12_pg speedgoat_test_SN5659__cal_impl.Decode3_P13_bw speedgoat_test_SN5659__cal_impl.Decode3_P14_o speedgoat_test_SN5659__cal_impl.Decode3_P15_o speedgoat_test_SN5659__cal_impl.Decode3_P16_c speedgoat_test_SN5659__cal_impl.Decode3_P1_ew speedgoat_test_SN5659__cal_impl.Decode3_P2_ll speedgoat_test_SN5659__cal_impl.Decode3_P3_o speedgoat_test_SN5659__cal_impl.Decode3_P4_av speedgoat_test_SN5659__cal_impl.Decode3_P5_as speedgoat_test_SN5659__cal_impl.Decode3_P6_j speedgoat_test_SN5659__cal_impl.Decode3_P7_fb speedgoat_test_SN5659__cal_impl.Decode3_P8_d speedgoat_test_SN5659__cal_impl.Decode3_P9_f speedgoat_test_SN5659__cal_impl.Decode4_P10_ax speedgoat_test_SN5659__cal_impl.Decode4_P11_mt speedgoat_test_SN5659__cal_impl.Decode4_P12_ik speedgoat_test_SN5659__cal_impl.Decode4_P13_cn speedgoat_test_SN5659__cal_impl.Decode4_P14_fz speedgoat_test_SN5659__cal_impl.Decode4_P15_l speedgoat_test_SN5659__cal_impl.Decode4_P16_du speedgoat_test_SN5659__cal_impl.Decode4_P1_d speedgoat_test_SN5659__cal_impl.Decode4_P2_b speedgoat_test_SN5659__cal_impl.Decode4_P3_mv speedgoat_test_SN5659__cal_impl.Decode4_P4_kx speedgoat_test_SN5659__cal_impl.Decode4_P5_ia speedgoat_test_SN5659__cal_impl.Decode4_P6_an speedgoat_test_SN5659__cal_impl.Decode4_P7_c speedgoat_test_SN5659__cal_impl.Decode4_P8_o speedgoat_test_SN5659__cal_impl.Decode4_P9_c /end REF_CHARACTERISTIC
 /begin REF_MEASUREMENT speedgoat_test_SN5659_R2020b_B.Decode1_p1 speedgoat_test_SN5659_R2020b_B.Decode2_h speedgoat_test_SN5659_R2020b_B.Decode3_lc speedgoat_test_SN5659_R2020b_B.Decode4_l /end REF_MEASUREMENT
/end GROUP
/begin GROUP speedgoat_test_SN5659_R2020b_IO682_Decode_Channel_8 "speedgoat_test_SN5659_R2020b/IO682/Decode Channel 8"
 /begin REF_CHARACTERISTIC speedgoat_test_SN5659__cal_impl.Decode1_P10_m speedgoat_test_SN5659__cal_impl.Decode1_P11_d speedgoat_test_SN5659__cal_impl.Decode1_P12_n speedgoat_test_SN5659__cal_impl.Decode1_P13_cn speedgoat_test_SN5659__cal_impl.Decode1_P14_fq speedgoat_test_SN5659__cal_impl.Decode1_P15_p speedgoat_test_SN5659__cal_impl.Decode1_P16_fi speedgoat_test_SN5659__cal_impl.Decode1_P1_pi speedgoat_test_SN5659__cal_impl.Decode1_P2_mk speedgoat_test_SN5659__cal_impl.Decode1_P3_gr speedgoat_test_SN5659__cal_impl.Decode1_P4_n speedgoat_test_SN5659__cal_impl.Decode1_P5_h speedgoat_test_SN5659__cal_impl.Decode1_P6_e speedgoat_test_SN5659__cal_impl.Decode1_P7_j speedgoat_test_SN5659__cal_impl.Decode1_P8_a1 speedgoat_test_SN5659__cal_impl.Decode1_P9_dz speedgoat_test_SN5659__cal_impl.Decode2_P10_cg speedgoat_test_SN5659__cal_impl.Decode2_P11_kl speedgoat_test_SN5659__cal_impl.Decode2_P12_m speedgoat_test_SN5659__cal_impl.Decode2_P13_bk speedgoat_test_SN5659__cal_impl.Decode2_P14_kg speedgoat_test_SN5659__cal_impl.Decode2_P15_gh speedgoat_test_SN5659__cal_impl.Decode2_P16_a speedgoat_test_SN5659__cal_impl.Decode2_P1_i0 speedgoat_test_SN5659__cal_impl.Decode2_P2_mg speedgoat_test_SN5659__cal_impl.Decode2_P3_p speedgoat_test_SN5659__cal_impl.Decode2_P4_bb speedgoat_test_SN5659__cal_impl.Decode2_P5_ju speedgoat_test_SN5659__cal_impl.Decode2_P6_hg speedgoat_test_SN5659__cal_impl.Decode2_P7_ht speedgoat_test_SN5659__cal_impl.Decode2_P8_fr speedgoat_test_SN5659__cal_impl.Decode2_P9_m speedgoat_test_SN5659__cal_impl.Decode3_P10_g speedgoat_test_SN5659__cal_impl.Decode3_P11_o speedgoat_test_SN5659__cal_impl.Decode3_P12_ak speedgoat_test_SN5659__cal_impl.Decode3_P13_e1 speedgoat_test_SN5659__cal_impl.Decode3_P14_od speedgoat_test_SN5659__cal_impl.Decode3_P15_i speedgoat_test_SN5659__cal_impl.Decode3_P16_m speedgoat_test_SN5659__cal_impl.Decode3_P1_nz speedgoat_test_SN5659__cal_impl.Decode3_P2_n speedgoat_test_SN5659__cal_impl.Decode3_P3_a speedgoat_test_SN5659__cal_impl.Decode3_P4_c speedgoat_test_SN5659__cal_impl.Decode3_P5_gt speedgoat_test_SN5659__cal_impl.Decode3_P6_ov speedgoat_test_SN5659__cal_impl.Decode3_P7_ix speedgoat_test_SN5659__cal_impl.Decode3_P8_n speedgoat_test_SN5659__cal_impl.Decode3_P9_p speedgoat_test_SN5659__cal_impl.Decode4_P10_k speedgoat_test_SN5659__cal_impl.Decode4_P11_mg speedgoat_test_SN5659__cal_impl.Decode4_P12_ci speedgoat_test_SN5659__cal_impl.Decode4_P13_l speedgoat_test_SN5659__cal_impl.Decode4_P14_b speedgoat_test_SN5659__cal_impl.Decode4_P15_h speedgoat_test_SN5659__cal_impl.Decode4_P16_n speedgoat_test_SN5659__cal_impl.Decode4_P1_ml speedgoat_test_SN5659__cal_impl.Decode4_P2_l1 speedgoat_test_SN5659__cal_impl.Decode4_P3_i speedgoat_test_SN5659__cal_impl.Decode4_P4_f1 speedgoat_test_SN5659__cal_impl.Decode4_P5_h speedgoat_test_SN5659__cal_impl.Decode4_P6_g speedgoat_test_SN5659__cal_impl.Decode4_P7_j speedgoat_test_SN5659__cal_impl.Decode4_P8_mv speedgoat_test_SN5659__cal_impl.Decode4_P9_g /end REF_CHARACTERISTIC
 /begin REF_MEASUREMENT speedgoat_test_SN5659_R2020b_B.Decode1_b speedgoat_test_SN5659_R2020b_B.Decode2_nz speedgoat_test_SN5659_R2020b_B.Decode3_mj speedgoat_test_SN5659_R2020b_B.Decode4_m /end REF_MEASUREMENT
/end GROUP
/begin GROUP speedgoat_test_SN5659_R2020b_IO682_Decode_Channel_9 "speedgoat_test_SN5659_R2020b/IO682/Decode Channel 9"
 /begin REF_CHARACTERISTIC speedgoat_test_SN5659__cal_impl.Decode1_P10_l speedgoat_test_SN5659__cal_impl.Decode1_P11_eu speedgoat_test_SN5659__cal_impl.Decode1_P12_pl speedgoat_test_SN5659__cal_impl.Decode1_P13_f speedgoat_test_SN5659__cal_impl.Decode1_P14_m speedgoat_test_SN5659__cal_impl.Decode1_P15_b speedgoat_test_SN5659__cal_impl.Decode1_P16_b speedgoat_test_SN5659__cal_impl.Decode1_P1_c2 speedgoat_test_SN5659__cal_impl.Decode1_P2_b speedgoat_test_SN5659__cal_impl.Decode1_P3_g speedgoat_test_SN5659__cal_impl.Decode1_P4_e speedgoat_test_SN5659__cal_impl.Decode1_P5_n speedgoat_test_SN5659__cal_impl.Decode1_P6_j speedgoat_test_SN5659__cal_impl.Decode1_P7_k speedgoat_test_SN5659__cal_impl.Decode1_P8_l speedgoat_test_SN5659__cal_impl.Decode1_P9_k speedgoat_test_SN5659__cal_impl.Decode3_P10_k speedgoat_test_SN5659__cal_impl.Decode3_P11_e speedgoat_test_SN5659__cal_impl.Decode3_P12_i speedgoat_test_SN5659__cal_impl.Decode3_P13_j speedgoat_test_SN5659__cal_impl.Decode3_P14_p speedgoat_test_SN5659__cal_impl.Decode3_P15_m speedgoat_test_SN5659__cal_impl.Decode3_P16_n speedgoat_test_SN5659__cal_impl.Decode3_P1_c speedgoat_test_SN5659__cal_impl.Decode3_P2_j speedgoat_test_SN5659__cal_impl.Decode3_P3_j speedgoat_test_SN5659__cal_impl.Decode3_P4_p speedgoat_test_SN5659__cal_impl.Decode3_P5_b speedgoat_test_SN5659__cal_impl.Decode3_P6_h speedgoat_test_SN5659__cal_impl.Decode3_P7_d speedgoat_test_SN5659__cal_impl.Decode3_P8_h speedgoat_test_SN5659__cal_impl.Decode3_P9_i speedgoat_test_SN5659__cal_impl.Decode4_P10_d speedgoat_test_SN5659__cal_impl.Decode4_P11_g speedgoat_test_SN5659__cal_impl.Decode4_P12_e speedgoat_test_SN5659__cal_impl.Decode4_P13_o speedgoat_test_SN5659__cal_impl.Decode4_P14_k speedgoat_test_SN5659__cal_impl.Decode4_P15_j speedgoat_test_SN5659__cal_impl.Decode4_P16_b speedgoat_test_SN5659__cal_impl.Decode4_P1_i speedgoat_test_SN5659__cal_impl.Decode4_P2_k speedgoat_test_SN5659__cal_impl.Decode4_P3_l speedgoat_test_SN5659__cal_impl.Decode4_P4_k speedgoat_test_SN5659__cal_impl.Decode4_P5_i speedgoat_test_SN5659__cal_impl.Decode4_P6_n speedgoat_test_SN5659__cal_impl.Decode4_P7_n speedgoat_test_SN5659__cal_impl.Decode4_P8_g speedgoat_test_SN5659__cal_impl.Decode4_P9_e speedgoat_test_SN5659__cal_impl.Decode5_P10_m speedgoat_test_SN5659__cal_impl.Decode5_P11_g speedgoat_test_SN5659__cal_impl.Decode5_P12_m speedgoat_test_SN5659__cal_impl.Decode5_P13_c speedgoat_test_SN5659__cal_impl.Decode5_P14_c speedgoat_test_SN5659__cal_impl.Decode5_P15_j speedgoat_test_SN5659__cal_impl.Decode5_P16_a speedgoat_test_SN5659__cal_impl.Decode5_P1_n speedgoat_test_SN5659__cal_impl.Decode5_P2_m speedgoat_test_SN5659__cal_impl.Decode5_P3_i speedgoat_test_SN5659__cal_impl.Decode5_P4_f speedgoat_test_SN5659__cal_impl.Decode5_P5_m speedgoat_test_SN5659__cal_impl.Decode5_P6_m speedgoat_test_SN5659__cal_impl.Decode5_P7_n speedgoat_test_SN5659__cal_impl.Decode5_P8_b speedgoat_test_SN5659__cal_impl.Decode5_P9_n /end REF_CHARACTERISTIC
 /begin REF_MEASUREMENT speedgoat_test_SN5659_R2020b_B.Decode1_d speedgoat_test_SN5659_R2020b_B.Decode3_c speedgoat_test_SN5659_R2020b_B.Decode4_o speedgoat_test_SN5659_R2020b_B.Decode5_p /end REF_MEASUREMENT
/end GROUP
/begin GROUP speedgoat_test_SN5659_R2020b_IO682_Encode_Channel_1 "speedgoat_test_SN5659_R2020b/IO682/Encode Channel 1"
 /begin SUB_GROUP speedgoat_test_SN5659_R2020b_IO682_Encode_Channel_1_Counter_Limited speedgoat_test_SN5659_R2020b_IO682_Encode_Channel_1_Prepare_RAW_value /end SUB_GROUP
 /begin REF_CHARACTERISTIC speedgoat_test_SN5659__cal_impl.Constant_Value speedgoat_test_SN5659__cal_impl.Encode1_P1 speedgoat_test_SN5659__cal_impl.Encode1_P10 speedgoat_test_SN5659__cal_impl.Encode1_P11 speedgoat_test_SN5659__cal_impl.Encode1_P12 speedgoat_test_SN5659__cal_impl.Encode1_P13 speedgoat_test_SN5659__cal_impl.Encode1_P14 speedgoat_test_SN5659__cal_impl.Encode1_P15 speedgoat_test_SN5659__cal_impl.Encode1_P2 speedgoat_test_SN5659__cal_impl.Encode1_P3 speedgoat_test_SN5659__cal_impl.Encode1_P4 speedgoat_test_SN5659__cal_impl.Encode1_P5 speedgoat_test_SN5659__cal_impl.Encode1_P6 speedgoat_test_SN5659__cal_impl.Encode1_P7 speedgoat_test_SN5659__cal_impl.Encode1_P8 speedgoat_test_SN5659__cal_impl.Encode1_P9 speedgoat_test_SN5659__cal_impl.Encode2_P1 speedgoat_test_SN5659__cal_impl.Encode2_P10 speedgoat_test_SN5659__cal_impl.Encode2_P11 speedgoat_test_SN5659__cal_impl.Encode2_P12 speedgoat_test_SN5659__cal_impl.Encode2_P13 speedgoat_test_SN5659__cal_impl.Encode2_P14 speedgoat_test_SN5659__cal_impl.Encode2_P15 speedgoat_test_SN5659__cal_impl.Encode2_P2 speedgoat_test_SN5659__cal_impl.Encode2_P3 speedgoat_test_SN5659__cal_impl.Encode2_P4 speedgoat_test_SN5659__cal_impl.Encode2_P5 speedgoat_test_SN5659__cal_impl.Encode2_P6 speedgoat_test_SN5659__cal_impl.Encode2_P7 speedgoat_test_SN5659__cal_impl.Encode2_P8 speedgoat_test_SN5659__cal_impl.Encode2_P9 speedgoat_test_SN5659__cal_impl.Encode3_P1 speedgoat_test_SN5659__cal_impl.Encode3_P10 speedgoat_test_SN5659__cal_impl.Encode3_P11 speedgoat_test_SN5659__cal_impl.Encode3_P12 speedgoat_test_SN5659__cal_impl.Encode3_P13 speedgoat_test_SN5659__cal_impl.Encode3_P14 speedgoat_test_SN5659__cal_impl.Encode3_P15 speedgoat_test_SN5659__cal_impl.Encode3_P2 speedgoat_test_SN5659__cal_impl.Encode3_P3 speedgoat_test_SN5659__cal_impl.Encode3_P4 speedgoat_test_SN5659__cal_impl.Encode3_P5 speedgoat_test_SN5659__cal_impl.Encode3_P6 speedgoat_test_SN5659__cal_impl.Encode3_P7 speedgoat_test_SN5659__cal_impl.Encode3_P8 speedgoat_test_SN5659__cal_impl.Encode3_P9 speedgoat_test_SN5659__cal_impl.Encode5_P1 speedgoat_test_SN5659__cal_impl.Encode5_P10 speedgoat_test_SN5659__cal_impl.Encode5_P11 speedgoat_test_SN5659__cal_impl.Encode5_P12 speedgoat_test_SN5659__cal_impl.Encode5_P13 speedgoat_test_SN5659__cal_impl.Encode5_P14 speedgoat_test_SN5659__cal_impl.Encode5_P15 speedgoat_test_SN5659__cal_impl.Encode5_P2 speedgoat_test_SN5659__cal_impl.Encode5_P3 speedgoat_test_SN5659__cal_impl.Encode5_P4 speedgoat_test_SN5659__cal_impl.Encode5_P5 speedgoat_test_SN5659__cal_impl.Encode5_P6 speedgoat_test_SN5659__cal_impl.Encode5_P7 speedgoat_test_SN5659__cal_impl.Encode5_P8 speedgoat_test_SN5659__cal_impl.Encode5_P9 speedgoat_test_SN5659__cal_impl.Randomnumber_Mean speedgoat_test_SN5659__cal_impl.Randomnumber_Seed speedgoat_test_SN5659__cal_impl.Randomnumber_StdDev speedgoat_test_SN5659__cal_impl.Sinewave_Amp speedgoat_test_SN5659__cal_impl.Sinewave_Bias speedgoat_test_SN5659__cal_impl.Sinewave_Freq speedgoat_test_SN5659__cal_impl.Sinewave_HCos speedgoat_test_SN5659__cal_impl.Sinewave_Hsin speedgoat_test_SN5659__cal_impl.Sinewave_PCos speedgoat_test_SN5659__cal_impl.Sinewave_PSin /end REF_CHARACTERISTIC
 /begin REF_MEASUREMENT speedgoat_test_SN5659_R2020b_B.DataTypeConversion speedgoat_test_SN5659_R2020b_B.DataTypeConversion1 speedgoat_test_SN5659_R2020b_B.Encode1 speedgoat_test_SN5659_R2020b_B.Encode2 speedgoat_test_SN5659_R2020b_B.Encode3 speedgoat_test_SN5659_R2020b_B.Encode5 speedgoat_test_SN5659_R2020b_B.Output_o speedgoat_test_SN5659_R2020b_B.Randomnumber speedgoat_test_SN5659_R2020b_B.Sinewave speedgoat_test_SN5659_R2020b_DW.NextOutput speedgoat_test_SN5659_R2020b_DW.RandSeed speedgoat_test_SN5659_R2020b_DW.lastCos_h speedgoat_test_SN5659_R2020b_DW.lastSin_o speedgoat_test_SN5659_R2020b_DW.systemEnable_i2 /end REF_MEASUREMENT
/end GROUP
/begin GROUP speedgoat_test_SN5659_R2020b_IO682_Encode_Channel_10 "speedgoat_test_SN5659_R2020b/IO682/Encode Channel 10"
 /begin SUB_GROUP speedgoat_test_SN5659_R2020b_IO682_Encode_Channel_10_Counter_Limited speedgoat_test_SN5659_R2020b_IO682_Encode_Channel_10_Prepare_RAW_value /end SUB_GROUP
 /begin REF_CHARACTERISTIC speedgoat_test_SN5659__cal_impl.Constant_Value_j speedgoat_test_SN5659__cal_impl.Encode1_P10_a speedgoat_test_SN5659__cal_impl.Encode1_P11_g speedgoat_test_SN5659__cal_impl.Encode1_P12_n speedgoat_test_SN5659__cal_impl.Encode1_P13_j speedgoat_test_SN5659__cal_impl.Encode1_P14_h speedgoat_test_SN5659__cal_impl.Encode1_P15_h speedgoat_test_SN5659__cal_impl.Encode1_P1_a speedgoat_test_SN5659__cal_impl.Encode1_P2_h speedgoat_test_SN5659__cal_impl.Encode1_P3_o speedgoat_test_SN5659__cal_impl.Encode1_P4_d speedgoat_test_SN5659__cal_impl.Encode1_P5_o speedgoat_test_SN5659__cal_impl.Encode1_P6_n speedgoat_test_SN5659__cal_impl.Encode1_P7_g speedgoat_test_SN5659__cal_impl.Encode1_P8_p speedgoat_test_SN5659__cal_impl.Encode1_P9_m speedgoat_test_SN5659__cal_impl.Encode2_P10_n speedgoat_test_SN5659__cal_impl.Encode2_P11_j speedgoat_test_SN5659__cal_impl.Encode2_P12_b speedgoat_test_SN5659__cal_impl.Encode2_P13_j speedgoat_test_SN5659__cal_impl.Encode2_P14_c speedgoat_test_SN5659__cal_impl.Encode2_P15_j speedgoat_test_SN5659__cal_impl.Encode2_P1_h speedgoat_test_SN5659__cal_impl.Encode2_P2_m speedgoat_test_SN5659__cal_impl.Encode2_P3_o speedgoat_test_SN5659__cal_impl.Encode2_P4_g speedgoat_test_SN5659__cal_impl.Encode2_P5_g speedgoat_test_SN5659__cal_impl.Encode2_P6_j speedgoat_test_SN5659__cal_impl.Encode2_P7_d speedgoat_test_SN5659__cal_impl.Encode2_P8_f speedgoat_test_SN5659__cal_impl.Encode2_P9_p speedgoat_test_SN5659__cal_impl.Encode3_P10_n speedgoat_test_SN5659__cal_impl.Encode3_P11_l speedgoat_test_SN5659__cal_impl.Encode3_P12_e speedgoat_test_SN5659__cal_impl.Encode3_P13_o speedgoat_test_SN5659__cal_impl.Encode3_P14_e speedgoat_test_SN5659__cal_impl.Encode3_P15_p speedgoat_test_SN5659__cal_impl.Encode3_P1_l speedgoat_test_SN5659__cal_impl.Encode3_P2_j speedgoat_test_SN5659__cal_impl.Encode3_P3_n speedgoat_test_SN5659__cal_impl.Encode3_P4_g speedgoat_test_SN5659__cal_impl.Encode3_P5_k speedgoat_test_SN5659__cal_impl.Encode3_P6_h speedgoat_test_SN5659__cal_impl.Encode3_P7_b speedgoat_test_SN5659__cal_impl.Encode3_P8_e speedgoat_test_SN5659__cal_impl.Encode3_P9_g speedgoat_test_SN5659__cal_impl.Encode4_P1 speedgoat_test_SN5659__cal_impl.Encode4_P10 speedgoat_test_SN5659__cal_impl.Encode4_P11 speedgoat_test_SN5659__cal_impl.Encode4_P12 speedgoat_test_SN5659__cal_impl.Encode4_P13 speedgoat_test_SN5659__cal_impl.Encode4_P14 speedgoat_test_SN5659__cal_impl.Encode4_P15 speedgoat_test_SN5659__cal_impl.Encode4_P2 speedgoat_test_SN5659__cal_impl.Encode4_P3 speedgoat_test_SN5659__cal_impl.Encode4_P4 speedgoat_test_SN5659__cal_impl.Encode4_P5 speedgoat_test_SN5659__cal_impl.Encode4_P6 speedgoat_test_SN5659__cal_impl.Encode4_P7 speedgoat_test_SN5659__cal_impl.Encode4_P8 speedgoat_test_SN5659__cal_impl.Encode4_P9 speedgoat_test_SN5659__cal_impl.Randomnumber_Mean_f speedgoat_test_SN5659__cal_impl.Randomnumber_Seed_n speedgoat_test_SN5659__cal_impl.Randomnumber_StdDev_a speedgoat_test_SN5659__cal_impl.Sinewave_Amp_o speedgoat_test_SN5659__cal_impl.Sinewave_Bias_k speedgoat_test_SN5659__cal_impl.Sinewave_Freq_p speedgoat_test_SN5659__cal_impl.Sinewave_HCos_l speedgoat_test_SN5659__cal_impl.Sinewave_Hsin_j speedgoat_test_SN5659__cal_impl.Sinewave_PCos_c speedgoat_test_SN5659__cal_impl.Sinewave_PSin_p /end REF_CHARACTERISTIC
 /begin REF_MEASUREMENT speedgoat_test_SN5659_R2020b_B.DataTypeConversion1_g speedgoat_test_SN5659_R2020b_B.DataTypeConversion_h speedgoat_test_SN5659_R2020b_B.Encode1_b speedgoat_test_SN5659_R2020b_B.Encode2_p speedgoat_test_SN5659_R2020b_B.Encode3_i speedgoat_test_SN5659_R2020b_B.Encode4 speedgoat_test_SN5659_R2020b_B.Output speedgoat_test_SN5659_R2020b_B.Randomnumber_c speedgoat_test_SN5659_R2020b_B.Sinewave_o speedgoat_test_SN5659_R2020b_DW.NextOutput_a speedgoat_test_SN5659_R2020b_DW.RandSeed_m speedgoat_test_SN5659_R2020b_DW.lastCos_p speedgoat_test_SN5659_R2020b_DW.lastSin_cq speedgoat_test_SN5659_R2020b_DW.systemEnable_n /end REF_MEASUREMENT
/end GROUP
/begin GROUP speedgoat_test_SN5659_R2020b_IO682_Encode_Channel_10_Counter_Limited "speedgoat_test_SN5659_R2020b/IO682/Encode Channel 10/Counter
Limited"
 /begin SUB_GROUP speedgoat_test_SN5659_R2020b_IO682_Encode_Channel_10_Counter_Limited_Increment_Real_World speedgoat_test_SN5659_R2020b_IO682_Encode_Channel_10_Counter_Limited_Wrap_To_Zero /end SUB_GROUP
 /begin REF_CHARACTERISTIC speedgoat_test_SN5659__cal_impl.Output_InitialCondition /end REF_CHARACTERISTIC
 /begin REF_MEASUREMENT speedgoat_test_SN5659_R2020b_B.FixPtSwitch speedgoat_test_SN5659_R2020b_B.Output speedgoat_test_SN5659_R2020b_DW.Output_DSTATE /end REF_MEASUREMENT
/end GROUP
/begin GROUP speedgoat_test_SN5659_R2020b_IO682_Encode_Channel_10_Counter_Limited_Increment_Real_World "speedgoat_test_SN5659_R2020b/IO682/Encode Channel 10/Counter
Limited/Increment
Real World" /begin REF_CHARACTERISTIC speedgoat_test_SN5659__cal_impl.FixPtConstant_Value /end REF_CHARACTERISTIC
 /begin REF_MEASUREMENT speedgoat_test_SN5659_R2020b_B.FixPtSum1 speedgoat_test_SN5659_R2020b_B.Output /end REF_MEASUREMENT
/end GROUP
/begin GROUP speedgoat_test_SN5659_R2020b_IO682_Encode_Channel_10_Counter_Limited_Wrap_To_Zero "speedgoat_test_SN5659_R2020b/IO682/Encode Channel 10/Counter
Limited/Wrap To Zero"
 /begin REF_CHARACTERISTIC speedgoat_test_SN5659__cal_impl.Constant_Value_c speedgoat_test_SN5659__cal_impl.CounterLimited_uplimit /end REF_CHARACTERISTIC
 /begin REF_MEASUREMENT speedgoat_test_SN5659_R2020b_B.FixPtSum1 speedgoat_test_SN5659_R2020b_B.FixPtSwitch /end REF_MEASUREMENT
/end GROUP
/begin GROUP speedgoat_test_SN5659_R2020b_IO682_Encode_Channel_10_Prepare_RAW_value "speedgoat_test_SN5659_R2020b/IO682/Encode Channel 10/Prepare RAW value"
 /begin REF_CHARACTERISTIC speedgoat_test_SN5659__cal_impl.Label_Value_d speedgoat_test_SN5659__cal_impl.Mask_BitMask_h speedgoat_test_SN5659__cal_impl.SDI_Value_d speedgoat_test_SN5659__cal_impl.SSM_Value_o speedgoat_test_SN5659__cal_impl.Scale_Value_l speedgoat_test_SN5659__cal_impl.shiftthedoublevalue27bitsleft_o /end REF_CHARACTERISTIC
 /begin REF_MEASUREMENT speedgoat_test_SN5659_R2020b_B.BitwiseOperator_m speedgoat_test_SN5659_R2020b_B.DataTypeConversion1_g speedgoat_test_SN5659_R2020b_B.DataTypeConversion_c speedgoat_test_SN5659_R2020b_B.Divide_k speedgoat_test_SN5659_R2020b_B.Mask_a speedgoat_test_SN5659_R2020b_B.Multiply_h speedgoat_test_SN5659_R2020b_B.ShifttoSDIslot_l speedgoat_test_SN5659_R2020b_B.ShifttoSSMslot_h /end REF_MEASUREMENT
/end GROUP
/begin GROUP speedgoat_test_SN5659_R2020b_IO682_Encode_Channel_11 "speedgoat_test_SN5659_R2020b/IO682/Encode Channel 11"
 /begin SUB_GROUP speedgoat_test_SN5659_R2020b_IO682_Encode_Channel_11_Counter_Limited speedgoat_test_SN5659_R2020b_IO682_Encode_Channel_11_Prepare_RAW_value /end SUB_GROUP
 /begin REF_CHARACTERISTIC speedgoat_test_SN5659__cal_impl.Constant_Value_i speedgoat_test_SN5659__cal_impl.Encode1_P10_i speedgoat_test_SN5659__cal_impl.Encode1_P11_l speedgoat_test_SN5659__cal_impl.Encode1_P12_k speedgoat_test_SN5659__cal_impl.Encode1_P13_i speedgoat_test_SN5659__cal_impl.Encode1_P14_o speedgoat_test_SN5659__cal_impl.Encode1_P15_b speedgoat_test_SN5659__cal_impl.Encode1_P1_c speedgoat_test_SN5659__cal_impl.Encode1_P2_g speedgoat_test_SN5659__cal_impl.Encode1_P3_l speedgoat_test_SN5659__cal_impl.Encode1_P4_e speedgoat_test_SN5659__cal_impl.Encode1_P5_i speedgoat_test_SN5659__cal_impl.Encode1_P6_p speedgoat_test_SN5659__cal_impl.Encode1_P7_d speedgoat_test_SN5659__cal_impl.Encode1_P8_c speedgoat_test_SN5659__cal_impl.Encode1_P9_n speedgoat_test_SN5659__cal_impl.Encode2_P10_c speedgoat_test_SN5659__cal_impl.Encode2_P11_g speedgoat_test_SN5659__cal_impl.Encode2_P12_m speedgoat_test_SN5659__cal_impl.Encode2_P13_p speedgoat_test_SN5659__cal_impl.Encode2_P14_p speedgoat_test_SN5659__cal_impl.Encode2_P15_c speedgoat_test_SN5659__cal_impl.Encode2_P1_a speedgoat_test_SN5659__cal_impl.Encode2_P2_i speedgoat_test_SN5659__cal_impl.Encode2_P3_k speedgoat_test_SN5659__cal_impl.Encode2_P4_o speedgoat_test_SN5659__cal_impl.Encode2_P5_l speedgoat_test_SN5659__cal_impl.Encode2_P6_n speedgoat_test_SN5659__cal_impl.Encode2_P7_b speedgoat_test_SN5659__cal_impl.Encode2_P8_h speedgoat_test_SN5659__cal_impl.Encode2_P9_m speedgoat_test_SN5659__cal_impl.Encode3_P10_j speedgoat_test_SN5659__cal_impl.Encode3_P11_j speedgoat_test_SN5659__cal_impl.Encode3_P12_j speedgoat_test_SN5659__cal_impl.Encode3_P13_i speedgoat_test_SN5659__cal_impl.Encode3_P14_d speedgoat_test_SN5659__cal_impl.Encode3_P15_h speedgoat_test_SN5659__cal_impl.Encode3_P1_e speedgoat_test_SN5659__cal_impl.Encode3_P2_f speedgoat_test_SN5659__cal_impl.Encode3_P3_b speedgoat_test_SN5659__cal_impl.Encode3_P4_d speedgoat_test_SN5659__cal_impl.Encode3_P5_i speedgoat_test_SN5659__cal_impl.Encode3_P6_e speedgoat_test_SN5659__cal_impl.Encode3_P7_h speedgoat_test_SN5659__cal_impl.Encode3_P8_f speedgoat_test_SN5659__cal_impl.Encode3_P9_k speedgoat_test_SN5659__cal_impl.Encode4_P10_h speedgoat_test_SN5659__cal_impl.Encode4_P11_j speedgoat_test_SN5659__cal_impl.Encode4_P12_l speedgoat_test_SN5659__cal_impl.Encode4_P13_a speedgoat_test_SN5659__cal_impl.Encode4_P14_l speedgoat_test_SN5659__cal_impl.Encode4_P15_i speedgoat_test_SN5659__cal_impl.Encode4_P1_e speedgoat_test_SN5659__cal_impl.Encode4_P2_d speedgoat_test_SN5659__cal_impl.Encode4_P3_o speedgoat_test_SN5659__cal_impl.Encode4_P4_a speedgoat_test_SN5659__cal_impl.Encode4_P5_a speedgoat_test_SN5659__cal_impl.Encode4_P6_a speedgoat_test_SN5659__cal_impl.Encode4_P7_p speedgoat_test_SN5659__cal_impl.Encode4_P8_o speedgoat_test_SN5659__cal_impl.Encode4_P9_i speedgoat_test_SN5659__cal_impl.Randomnumber_Mean_k speedgoat_test_SN5659__cal_impl.Randomnumber_Seed_h speedgoat_test_SN5659__cal_impl.Randomnumber_StdDev_l speedgoat_test_SN5659__cal_impl.Sinewave_Amp_i speedgoat_test_SN5659__cal_impl.Sinewave_Bias_c speedgoat_test_SN5659__cal_impl.Sinewave_Freq_g speedgoat_test_SN5659__cal_impl.Sinewave_HCos_j speedgoat_test_SN5659__cal_impl.Sinewave_Hsin_n speedgoat_test_SN5659__cal_impl.Sinewave_PCos_j speedgoat_test_SN5659__cal_impl.Sinewave_PSin_h /end REF_CHARACTERISTIC
 /begin REF_MEASUREMENT speedgoat_test_SN5659_R2020b_B.DataTypeConversion1_i speedgoat_test_SN5659_R2020b_B.DataTypeConversion_e speedgoat_test_SN5659_R2020b_B.Encode1_f speedgoat_test_SN5659_R2020b_B.Encode2_f speedgoat_test_SN5659_R2020b_B.Encode3_b speedgoat_test_SN5659_R2020b_B.Encode4_i speedgoat_test_SN5659_R2020b_B.Output_b speedgoat_test_SN5659_R2020b_B.Randomnumber_p speedgoat_test_SN5659_R2020b_B.Sinewave_f speedgoat_test_SN5659_R2020b_DW.NextOutput_n speedgoat_test_SN5659_R2020b_DW.RandSeed_h speedgoat_test_SN5659_R2020b_DW.lastCos_m speedgoat_test_SN5659_R2020b_DW.lastSin_m speedgoat_test_SN5659_R2020b_DW.systemEnable_bt /end REF_MEASUREMENT
/end GROUP
/begin GROUP speedgoat_test_SN5659_R2020b_IO682_Encode_Channel_11_Counter_Limited "speedgoat_test_SN5659_R2020b/IO682/Encode Channel 11/Counter
Limited"
 /begin SUB_GROUP speedgoat_test_SN5659_R2020b_IO682_Encode_Channel_11_Counter_Limited_Increment_Real_World speedgoat_test_SN5659_R2020b_IO682_Encode_Channel_11_Counter_Limited_Wrap_To_Zero /end SUB_GROUP
 /begin REF_CHARACTERISTIC speedgoat_test_SN5659__cal_impl.Output_InitialCondition_n /end REF_CHARACTERISTIC
 /begin REF_MEASUREMENT speedgoat_test_SN5659_R2020b_B.FixPtSwitch_h speedgoat_test_SN5659_R2020b_B.Output_b speedgoat_test_SN5659_R2020b_DW.Output_DSTATE_o /end REF_MEASUREMENT
/end GROUP
/begin GROUP speedgoat_test_SN5659_R2020b_IO682_Encode_Channel_11_Counter_Limited_Increment_Real_World "speedgoat_test_SN5659_R2020b/IO682/Encode Channel 11/Counter
Limited/Increment
Real World" /begin REF_CHARACTERISTIC speedgoat_test_SN5659__cal_impl.FixPtConstant_Value_a /end REF_CHARACTERISTIC
 /begin REF_MEASUREMENT speedgoat_test_SN5659_R2020b_B.FixPtSum1_n speedgoat_test_SN5659_R2020b_B.Output_b /end REF_MEASUREMENT
/end GROUP
/begin GROUP speedgoat_test_SN5659_R2020b_IO682_Encode_Channel_11_Counter_Limited_Wrap_To_Zero "speedgoat_test_SN5659_R2020b/IO682/Encode Channel 11/Counter
Limited/Wrap To Zero"
 /begin REF_CHARACTERISTIC speedgoat_test_SN5659__cal_impl.Constant_Value_dm speedgoat_test_SN5659__cal_impl.CounterLimited_uplimit_d /end REF_CHARACTERISTIC
 /begin REF_MEASUREMENT speedgoat_test_SN5659_R2020b_B.FixPtSum1_n speedgoat_test_SN5659_R2020b_B.FixPtSwitch_h /end REF_MEASUREMENT
/end GROUP
/begin GROUP speedgoat_test_SN5659_R2020b_IO682_Encode_Channel_11_Prepare_RAW_value "speedgoat_test_SN5659_R2020b/IO682/Encode Channel 11/Prepare RAW value"
 /begin REF_CHARACTERISTIC speedgoat_test_SN5659__cal_impl.Label_Value_e speedgoat_test_SN5659__cal_impl.Mask_BitMask_k speedgoat_test_SN5659__cal_impl.SDI_Value_m speedgoat_test_SN5659__cal_impl.SSM_Value_l speedgoat_test_SN5659__cal_impl.Scale_Value_a speedgoat_test_SN5659__cal_impl.shiftthedoublevalue27bitsleft_p /end REF_CHARACTERISTIC
 /begin REF_MEASUREMENT speedgoat_test_SN5659_R2020b_B.BitwiseOperator_a speedgoat_test_SN5659_R2020b_B.DataTypeConversion1_i speedgoat_test_SN5659_R2020b_B.DataTypeConversion_ec speedgoat_test_SN5659_R2020b_B.Divide_h speedgoat_test_SN5659_R2020b_B.Mask_n speedgoat_test_SN5659_R2020b_B.Multiply_a speedgoat_test_SN5659_R2020b_B.ShifttoSDIslot_a speedgoat_test_SN5659_R2020b_B.ShifttoSSMslot_m /end REF_MEASUREMENT
/end GROUP
/begin GROUP speedgoat_test_SN5659_R2020b_IO682_Encode_Channel_1_Counter_Limited "speedgoat_test_SN5659_R2020b/IO682/Encode Channel 1/Counter
Limited" /begin REF_MEASUREMENT speedgoat_test_SN5659_R2020b_B.Output_o /end REF_MEASUREMENT /end GROUP
/begin GROUP speedgoat_test_SN5659_R2020b_IO682_Encode_Channel_1_Counter_Limited_Increment_Real_World "speedgoat_test_SN5659_R2020b/IO682/Encode Channel 1/Counter
Limited/Increment
Real World" /begin REF_MEASUREMENT speedgoat_test_SN5659_R2020b_B.Output_o /end REF_MEASUREMENT /end GROUP
/begin GROUP speedgoat_test_SN5659_R2020b_IO682_Encode_Channel_1_Prepare_RAW_value "speedgoat_test_SN5659_R2020b/IO682/Encode Channel 1/Prepare RAW value" /begin REF_MEASUREMENT speedgoat_test_SN5659_R2020b_B.DataTypeConversion1 /end REF_MEASUREMENT /end GROUP
/end MODULE
/end PROJECT
