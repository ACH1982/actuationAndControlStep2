ASAP2_VERSION 1 71
/begin PROJECT ProjectName "Project Comment Goes Here"
/begin HEADER "Header Comments go here" /end HEADER
/begin MODULE ModuleName "Module Comment Goes Here"
/begin MOD_COMMON "Mod Common Comment Here" BYTE_ORDER MSB_LAST ALIGNMENT_BYTE 1 ALIGNMENT_WORD 2 ALIGNMENT_LONG 4 ALIGNMENT_FLOAT32_IEEE 4 ALIGNMENT_FLOAT64_IEEE 8 ALIGNMENT_INT64 8 /end MOD_COMMON
/begin CHARACTERISTIC speedgoat_test_SN5659__cal_impl.Constant_Value_a "" VALUE 0x008EFCBE Scalar_UWORD 0 speedgoat_test_SN5659_R2020b_CM_uint16 0 65535 /end CHARACTERISTIC
/begin CHARACTERISTIC speedgoat_test_SN5659__cal_impl.Constant_Value_aq "" VALUE 0x008EFCCA Scalar_UWORD 0 speedgoat_test_SN5659_R2020b_CM_uint16 0 65535 /end CHARACTERISTIC
/begin CHARACTERISTIC speedgoat_test_SN5659__cal_impl.Constant_Value_av "" VALUE 0x008EFCFE Scalar_UBYTE 0 speedgoat_test_SN5659_R2020b_CM_uint8 0 255 /end CHARACTERISTIC
/begin CHARACTERISTIC speedgoat_test_SN5659__cal_impl.Constant_Value_b "" VALUE 0x008EBEC8 Scalar_FLOAT64_IEEE 0 speedgoat_test_SN5659_R2020b_CM_double -1.7E+308 1.7E+308 /end CHARACTERISTIC
/begin CHARACTERISTIC speedgoat_test_SN5659__cal_impl.Constant_Value_d "" VALUE 0x008EA508 Scalar_FLOAT64_IEEE 0 speedgoat_test_SN5659_R2020b_CM_double -1.7E+308 1.7E+308 /end CHARACTERISTIC
/begin CHARACTERISTIC speedgoat_test_SN5659__cal_impl.Constant_Value_e "" VALUE 0x008E9E98 Scalar_FLOAT64_IEEE 0 speedgoat_test_SN5659_R2020b_CM_double -1.7E+308 1.7E+308 /end CHARACTERISTIC
/begin CHARACTERISTIC speedgoat_test_SN5659__cal_impl.Constant_Value_ee "" VALUE 0x008EFD01 Scalar_UBYTE 0 speedgoat_test_SN5659_R2020b_CM_uint8 0 255 /end CHARACTERISTIC
/begin CHARACTERISTIC speedgoat_test_SN5659__cal_impl.Constant_Value_ek "" VALUE 0x008EC538 Scalar_FLOAT64_IEEE 0 speedgoat_test_SN5659_R2020b_CM_double -1.7E+308 1.7E+308 /end CHARACTERISTIC
/begin CHARACTERISTIC speedgoat_test_SN5659__cal_impl.Constant_Value_g "" VALUE 0x008EAB78 Scalar_FLOAT64_IEEE 0 speedgoat_test_SN5659_R2020b_CM_double -1.7E+308 1.7E+308 /end CHARACTERISTIC
/begin CHARACTERISTIC speedgoat_test_SN5659__cal_impl.Constant_Value_j5 "" VALUE 0x008EFCD6 Scalar_UWORD 0 speedgoat_test_SN5659_R2020b_CM_uint16 0 65535 /end CHARACTERISTIC
/begin CHARACTERISTIC speedgoat_test_SN5659__cal_impl.Constant_Value_k "" VALUE 0x008EFCC4 Scalar_UWORD 0 speedgoat_test_SN5659_R2020b_CM_uint16 0 65535 /end CHARACTERISTIC
/begin CHARACTERISTIC speedgoat_test_SN5659__cal_impl.Constant_Value_l "" VALUE 0x008EB1E8 Scalar_FLOAT64_IEEE 0 speedgoat_test_SN5659_R2020b_CM_double -1.7E+308 1.7E+308 /end CHARACTERISTIC
/begin CHARACTERISTIC speedgoat_test_SN5659__cal_impl.Constant_Value_n "" VALUE 0x008EFCB8 Scalar_UWORD 0 speedgoat_test_SN5659_R2020b_CM_uint16 0 65535 /end CHARACTERISTIC
/begin CHARACTERISTIC speedgoat_test_SN5659__cal_impl.Constant_Value_o "" VALUE 0x008EB858 Scalar_FLOAT64_IEEE 0 speedgoat_test_SN5659_R2020b_CM_double -1.7E+308 1.7E+308 /end CHARACTERISTIC
/begin CHARACTERISTIC speedgoat_test_SN5659__cal_impl.Constant_Value_p "" VALUE 0x008EFCD0 Scalar_UWORD 0 speedgoat_test_SN5659_R2020b_CM_uint16 0 65535 /end CHARACTERISTIC
/begin CHARACTERISTIC speedgoat_test_SN5659__cal_impl.CounterLimited_uplimit_be "" VALUE 0x008DF07D Scalar_UBYTE 0 speedgoat_test_SN5659_R2020b_CM_uint8 0 255 /end CHARACTERISTIC
/begin CHARACTERISTIC speedgoat_test_SN5659__cal_impl.CounterLimited_uplimit_c "" VALUE 0x008DF066 Scalar_UWORD 0 speedgoat_test_SN5659_R2020b_CM_uint16 0 65535 /end CHARACTERISTIC
/begin CHARACTERISTIC speedgoat_test_SN5659__cal_impl.CounterLimited_uplimit_cp "" VALUE 0x008DF06A Scalar_UWORD 0 speedgoat_test_SN5659_R2020b_CM_uint16 0 65535 /end CHARACTERISTIC
/begin CHARACTERISTIC speedgoat_test_SN5659__cal_impl.CounterLimited_uplimit_e "" VALUE 0x008DF06E Scalar_UWORD 0 speedgoat_test_SN5659_R2020b_CM_uint16 0 65535 /end CHARACTERISTIC
/begin CHARACTERISTIC speedgoat_test_SN5659__cal_impl.CounterLimited_uplimit_g "" VALUE 0x008DF06C Scalar_UWORD 0 speedgoat_test_SN5659_R2020b_CM_uint16 0 65535 /end CHARACTERISTIC
/begin CHARACTERISTIC speedgoat_test_SN5659__cal_impl.CounterLimited_uplimit_i "" VALUE 0x008DF07C Scalar_UBYTE 0 speedgoat_test_SN5659_R2020b_CM_uint8 0 255 /end CHARACTERISTIC
/begin CHARACTERISTIC speedgoat_test_SN5659__cal_impl.CounterLimited_uplimit_k "" VALUE 0x008DF064 Scalar_UWORD 0 speedgoat_test_SN5659_R2020b_CM_uint16 0 65535 /end CHARACTERISTIC
/begin CHARACTERISTIC speedgoat_test_SN5659__cal_impl.CounterLimited_uplimit_n "" VALUE 0x008DF068 Scalar_UWORD 0 speedgoat_test_SN5659_R2020b_CM_uint16 0 65535 /end CHARACTERISTIC
/begin CHARACTERISTIC speedgoat_test_SN5659__cal_impl.Encode1_P10_e "" VALUE 0x008EB4B8 Scalar_FLOAT64_IEEE 0 speedgoat_test_SN5659_R2020b_CM_double -1.7E+308 1.7E+308 /end CHARACTERISTIC
/begin CHARACTERISTIC speedgoat_test_SN5659__cal_impl.Encode1_P10_f "" VALUE 0x008EBB28 Scalar_FLOAT64_IEEE 0 speedgoat_test_SN5659_R2020b_CM_double -1.7E+308 1.7E+308 /end CHARACTERISTIC
/begin CHARACTERISTIC speedgoat_test_SN5659__cal_impl.Encode1_P10_k "" VALUE 0x008EAE48 Scalar_FLOAT64_IEEE 0 speedgoat_test_SN5659_R2020b_CM_double -1.7E+308 1.7E+308 /end CHARACTERISTIC
/begin CHARACTERISTIC speedgoat_test_SN5659__cal_impl.Encode1_P10_l "" VALUE 0x008EA168 Scalar_FLOAT64_IEEE 0 speedgoat_test_SN5659_R2020b_CM_double -1.7E+308 1.7E+308 /end CHARACTERISTIC
/begin CHARACTERISTIC speedgoat_test_SN5659__cal_impl.Encode1_P10_l0 "" VALUE 0x008EC198 Scalar_FLOAT64_IEEE 0 speedgoat_test_SN5659_R2020b_CM_double -1.7E+308 1.7E+308 /end CHARACTERISTIC
/begin CHARACTERISTIC speedgoat_test_SN5659__cal_impl.Encode1_P10_p "" VALUE 0x008E9AF8 Scalar_FLOAT64_IEEE 0 speedgoat_test_SN5659_R2020b_CM_double -1.7E+308 1.7E+308 /end CHARACTERISTIC
/begin CHARACTERISTIC speedgoat_test_SN5659__cal_impl.Encode1_P10_pc "" VALUE 0x008EA7D8 Scalar_FLOAT64_IEEE 0 speedgoat_test_SN5659_R2020b_CM_double -1.7E+308 1.7E+308 /end CHARACTERISTIC
/begin CHARACTERISTIC speedgoat_test_SN5659__cal_impl.Encode1_P11_a "" VAL_BLK 0x008EA7F0 Scalar_FLOAT64_IEEE 0 speedgoat_test_SN5659_R2020b_CM_double -1.7E+308 1.7E+308 MATRIX_DIM 2 1 /end CHARACTERISTIC
/begin CHARACTERISTIC speedgoat_test_SN5659__cal_impl.Encode1_P11_b "" VAL_BLK 0x008E9B10 Scalar_FLOAT64_IEEE 0 speedgoat_test_SN5659_R2020b_CM_double -1.7E+308 1.7E+308 MATRIX_DIM 2 1 /end CHARACTERISTIC
/begin CHARACTERISTIC speedgoat_test_SN5659__cal_impl.Encode1_P11_bk "" VAL_BLK 0x008EA180 Scalar_FLOAT64_IEEE 0 speedgoat_test_SN5659_R2020b_CM_double -1.7E+308 1.7E+308 MATRIX_DIM 2 1 /end CHARACTERISTIC
/begin CHARACTERISTIC speedgoat_test_SN5659__cal_impl.Encode1_P11_e "" VAL_BLK 0x008EBB40 Scalar_FLOAT64_IEEE 0 speedgoat_test_SN5659_R2020b_CM_double -1.7E+308 1.7E+308 MATRIX_DIM 2 1 /end CHARACTERISTIC
/begin CHARACTERISTIC speedgoat_test_SN5659__cal_impl.Encode1_P11_f "" VAL_BLK 0x008EC1B0 Scalar_FLOAT64_IEEE 0 speedgoat_test_SN5659_R2020b_CM_double -1.7E+308 1.7E+308 MATRIX_DIM 2 1 /end CHARACTERISTIC
/begin CHARACTERISTIC speedgoat_test_SN5659__cal_impl.Encode1_P11_n "" VAL_BLK 0x008EAE60 Scalar_FLOAT64_IEEE 0 speedgoat_test_SN5659_R2020b_CM_double -1.7E+308 1.7E+308 MATRIX_DIM 2 1 /end CHARACTERISTIC
/begin CHARACTERISTIC speedgoat_test_SN5659__cal_impl.Encode1_P11_o "" VAL_BLK 0x008EB4D0 Scalar_FLOAT64_IEEE 0 speedgoat_test_SN5659_R2020b_CM_double -1.7E+308 1.7E+308 MATRIX_DIM 2 1 /end CHARACTERISTIC
/begin CHARACTERISTIC speedgoat_test_SN5659__cal_impl.Encode1_P12_a "" VALUE 0x008EC1D0 Scalar_FLOAT64_IEEE 0 speedgoat_test_SN5659_R2020b_CM_double -1.7E+308 1.7E+308 /end CHARACTERISTIC
/begin CHARACTERISTIC speedgoat_test_SN5659__cal_impl.Encode1_P12_g "" VALUE 0x008EBB60 Scalar_FLOAT64_IEEE 0 speedgoat_test_SN5659_R2020b_CM_double -1.7E+308 1.7E+308 /end CHARACTERISTIC
/begin CHARACTERISTIC speedgoat_test_SN5659__cal_impl.Encode1_P12_h "" VALUE 0x008EA810 Scalar_FLOAT64_IEEE 0 speedgoat_test_SN5659_R2020b_CM_double -1.7E+308 1.7E+308 /end CHARACTERISTIC
/begin CHARACTERISTIC speedgoat_test_SN5659__cal_impl.Encode1_P12_j "" VALUE 0x008EAE80 Scalar_FLOAT64_IEEE 0 speedgoat_test_SN5659_R2020b_CM_double -1.7E+308 1.7E+308 /end CHARACTERISTIC
/begin CHARACTERISTIC speedgoat_test_SN5659__cal_impl.Encode1_P12_m "" VALUE 0x008EB4F0 Scalar_FLOAT64_IEEE 0 speedgoat_test_SN5659_R2020b_CM_double -1.7E+308 1.7E+308 /end CHARACTERISTIC
/begin CHARACTERISTIC speedgoat_test_SN5659__cal_impl.Encode1_P12_no "" VALUE 0x008E9B30 Scalar_FLOAT64_IEEE 0 speedgoat_test_SN5659_R2020b_CM_double -1.7E+308 1.7E+308 /end CHARACTERISTIC
/begin CHARACTERISTIC speedgoat_test_SN5659__cal_impl.Encode1_P12_o "" VALUE 0x008EA1A0 Scalar_FLOAT64_IEEE 0 speedgoat_test_SN5659_R2020b_CM_double -1.7E+308 1.7E+308 /end CHARACTERISTIC
/begin CHARACTERISTIC speedgoat_test_SN5659__cal_impl.Encode1_P13_f "" VALUE 0x008EAE98 Scalar_FLOAT64_IEEE 0 speedgoat_test_SN5659_R2020b_CM_double -1.7E+308 1.7E+308 /end CHARACTERISTIC
/begin CHARACTERISTIC speedgoat_test_SN5659__cal_impl.Encode1_P13_fj "" VALUE 0x008EB508 Scalar_FLOAT64_IEEE 0 speedgoat_test_SN5659_R2020b_CM_double -1.7E+308 1.7E+308 /end CHARACTERISTIC
/begin CHARACTERISTIC speedgoat_test_SN5659__cal_impl.Encode1_P13_it "" VALUE 0x008E9B48 Scalar_FLOAT64_IEEE 0 speedgoat_test_SN5659_R2020b_CM_double -1.7E+308 1.7E+308 /end CHARACTERISTIC
/begin CHARACTERISTIC speedgoat_test_SN5659__cal_impl.Encode1_P13_k "" VALUE 0x008EBB78 Scalar_FLOAT64_IEEE 0 speedgoat_test_SN5659_R2020b_CM_double -1.7E+308 1.7E+308 /end CHARACTERISTIC
/begin CHARACTERISTIC speedgoat_test_SN5659__cal_impl.Encode1_P13_l "" VALUE 0x008EA828 Scalar_FLOAT64_IEEE 0 speedgoat_test_SN5659_R2020b_CM_double -1.7E+308 1.7E+308 /end CHARACTERISTIC
/begin CHARACTERISTIC speedgoat_test_SN5659__cal_impl.Encode1_P13_n "" VALUE 0x008EC1E8 Scalar_FLOAT64_IEEE 0 speedgoat_test_SN5659_R2020b_CM_double -1.7E+308 1.7E+308 /end CHARACTERISTIC
/begin CHARACTERISTIC speedgoat_test_SN5659__cal_impl.Encode1_P13_o "" VALUE 0x008EA1B8 Scalar_FLOAT64_IEEE 0 speedgoat_test_SN5659_R2020b_CM_double -1.7E+308 1.7E+308 /end CHARACTERISTIC
/begin CHARACTERISTIC speedgoat_test_SN5659__cal_impl.Encode1_P14_a "" VALUE 0x008EBB90 Scalar_FLOAT64_IEEE 0 speedgoat_test_SN5659_R2020b_CM_double -1.7E+308 1.7E+308 /end CHARACTERISTIC
/begin CHARACTERISTIC speedgoat_test_SN5659__cal_impl.Encode1_P14_c "" VALUE 0x008EAEB0 Scalar_FLOAT64_IEEE 0 speedgoat_test_SN5659_R2020b_CM_double -1.7E+308 1.7E+308 /end CHARACTERISTIC
/begin CHARACTERISTIC speedgoat_test_SN5659__cal_impl.Encode1_P14_d "" VALUE 0x008EB520 Scalar_FLOAT64_IEEE 0 speedgoat_test_SN5659_R2020b_CM_double -1.7E+308 1.7E+308 /end CHARACTERISTIC
/begin CHARACTERISTIC speedgoat_test_SN5659__cal_impl.Encode1_P14_e "" VALUE 0x008EA840 Scalar_FLOAT64_IEEE 0 speedgoat_test_SN5659_R2020b_CM_double -1.7E+308 1.7E+308 /end CHARACTERISTIC
/begin CHARACTERISTIC speedgoat_test_SN5659__cal_impl.Encode1_P14_g "" VALUE 0x008EA1D0 Scalar_FLOAT64_IEEE 0 speedgoat_test_SN5659_R2020b_CM_double -1.7E+308 1.7E+308 /end CHARACTERISTIC
/begin CHARACTERISTIC speedgoat_test_SN5659__cal_impl.Encode1_P14_ho "" VALUE 0x008E9B60 Scalar_FLOAT64_IEEE 0 speedgoat_test_SN5659_R2020b_CM_double -1.7E+308 1.7E+308 /end CHARACTERISTIC
/begin CHARACTERISTIC speedgoat_test_SN5659__cal_impl.Encode1_P14_on "" VALUE 0x008EC200 Scalar_FLOAT64_IEEE 0 speedgoat_test_SN5659_R2020b_CM_double -1.7E+308 1.7E+308 /end CHARACTERISTIC
/begin CHARACTERISTIC speedgoat_test_SN5659__cal_impl.Encode1_P15_a "" VALUE 0x008EAEC8 Scalar_FLOAT64_IEEE 0 speedgoat_test_SN5659_R2020b_CM_double -1.7E+308 1.7E+308 /end CHARACTERISTIC
/begin CHARACTERISTIC speedgoat_test_SN5659__cal_impl.Encode1_P15_i "" VALUE 0x008EB538 Scalar_FLOAT64_IEEE 0 speedgoat_test_SN5659_R2020b_CM_double -1.7E+308 1.7E+308 /end CHARACTERISTIC
/begin CHARACTERISTIC speedgoat_test_SN5659__cal_impl.Encode1_P15_j "" VALUE 0x008EA1E8 Scalar_FLOAT64_IEEE 0 speedgoat_test_SN5659_R2020b_CM_double -1.7E+308 1.7E+308 /end CHARACTERISTIC
/begin CHARACTERISTIC speedgoat_test_SN5659__cal_impl.Encode1_P15_k "" VALUE 0x008E9B78 Scalar_FLOAT64_IEEE 0 speedgoat_test_SN5659_R2020b_CM_double -1.7E+308 1.7E+308 /end CHARACTERISTIC
/begin CHARACTERISTIC speedgoat_test_SN5659__cal_impl.Encode1_P15_m "" VALUE 0x008EA858 Scalar_FLOAT64_IEEE 0 speedgoat_test_SN5659_R2020b_CM_double -1.7E+308 1.7E+308 /end CHARACTERISTIC
/begin CHARACTERISTIC speedgoat_test_SN5659__cal_impl.Encode1_P15_p "" VALUE 0x008EBBA8 Scalar_FLOAT64_IEEE 0 speedgoat_test_SN5659_R2020b_CM_double -1.7E+308 1.7E+308 /end CHARACTERISTIC
/begin CHARACTERISTIC speedgoat_test_SN5659__cal_impl.Encode1_P15_pw "" VALUE 0x008EC218 Scalar_FLOAT64_IEEE 0 speedgoat_test_SN5659_R2020b_CM_double -1.7E+308 1.7E+308 /end CHARACTERISTIC
/begin CHARACTERISTIC speedgoat_test_SN5659__cal_impl.Encode1_P1_f "" VALUE 0x008EA700 Scalar_FLOAT64_IEEE 0 speedgoat_test_SN5659_R2020b_CM_double -1.7E+308 1.7E+308 /end CHARACTERISTIC
/begin CHARACTERISTIC speedgoat_test_SN5659__cal_impl.Encode1_P1_ft "" VALUE 0x008EBA50 Scalar_FLOAT64_IEEE 0 speedgoat_test_SN5659_R2020b_CM_double -1.7E+308 1.7E+308 /end CHARACTERISTIC
/begin CHARACTERISTIC speedgoat_test_SN5659__cal_impl.Encode1_P1_g "" VALUE 0x008EA090 Scalar_FLOAT64_IEEE 0 speedgoat_test_SN5659_R2020b_CM_double -1.7E+308 1.7E+308 /end CHARACTERISTIC
/begin CHARACTERISTIC speedgoat_test_SN5659__cal_impl.Encode1_P1_h "" VALUE 0x008EAD70 Scalar_FLOAT64_IEEE 0 speedgoat_test_SN5659_R2020b_CM_double -1.7E+308 1.7E+308 /end CHARACTERISTIC
/begin CHARACTERISTIC speedgoat_test_SN5659__cal_impl.Encode1_P1_i "" VALUE 0x008E9A20 Scalar_FLOAT64_IEEE 0 speedgoat_test_SN5659_R2020b_CM_double -1.7E+308 1.7E+308 /end CHARACTERISTIC
/begin CHARACTERISTIC speedgoat_test_SN5659__cal_impl.Encode1_P1_j "" VALUE 0x008EB3E0 Scalar_FLOAT64_IEEE 0 speedgoat_test_SN5659_R2020b_CM_double -1.7E+308 1.7E+308 /end CHARACTERISTIC
/begin CHARACTERISTIC speedgoat_test_SN5659__cal_impl.Encode1_P1_m "" VALUE 0x008EC0C0 Scalar_FLOAT64_IEEE 0 speedgoat_test_SN5659_R2020b_CM_double -1.7E+308 1.7E+308 /end CHARACTERISTIC
/begin CHARACTERISTIC speedgoat_test_SN5659__cal_impl.Encode1_P2_e "" VALUE 0x008EAD88 Scalar_FLOAT64_IEEE 0 speedgoat_test_SN5659_R2020b_CM_double -1.7E+308 1.7E+308 /end CHARACTERISTIC
/begin CHARACTERISTIC speedgoat_test_SN5659__cal_impl.Encode1_P2_hw "" VALUE 0x008EBA68 Scalar_FLOAT64_IEEE 0 speedgoat_test_SN5659_R2020b_CM_double -1.7E+308 1.7E+308 /end CHARACTERISTIC
/begin CHARACTERISTIC speedgoat_test_SN5659__cal_impl.Encode1_P2_i "" VALUE 0x008EC0D8 Scalar_FLOAT64_IEEE 0 speedgoat_test_SN5659_R2020b_CM_double -1.7E+308 1.7E+308 /end CHARACTERISTIC
/begin CHARACTERISTIC speedgoat_test_SN5659__cal_impl.Encode1_P2_l "" VALUE 0x008E9A38 Scalar_FLOAT64_IEEE 0 speedgoat_test_SN5659_R2020b_CM_double -1.7E+308 1.7E+308 /end CHARACTERISTIC
/begin CHARACTERISTIC speedgoat_test_SN5659__cal_impl.Encode1_P2_n "" VALUE 0x008EB3F8 Scalar_FLOAT64_IEEE 0 speedgoat_test_SN5659_R2020b_CM_double -1.7E+308 1.7E+308 /end CHARACTERISTIC
/begin CHARACTERISTIC speedgoat_test_SN5659__cal_impl.Encode1_P2_p "" VALUE 0x008EA0A8 Scalar_FLOAT64_IEEE 0 speedgoat_test_SN5659_R2020b_CM_double -1.7E+308 1.7E+308 /end CHARACTERISTIC
/begin CHARACTERISTIC speedgoat_test_SN5659__cal_impl.Encode1_P2_pf "" VALUE 0x008EA718 Scalar_FLOAT64_IEEE 0 speedgoat_test_SN5659_R2020b_CM_double -1.7E+308 1.7E+308 /end CHARACTERISTIC
/begin CHARACTERISTIC speedgoat_test_SN5659__cal_impl.Encode1_P3_b "" VALUE 0x008E9A50 Scalar_FLOAT64_IEEE 0 speedgoat_test_SN5659_R2020b_CM_double -1.7E+308 1.7E+308 /end CHARACTERISTIC
/begin CHARACTERISTIC speedgoat_test_SN5659__cal_impl.Encode1_P3_e "" VALUE 0x008EC0F0 Scalar_FLOAT64_IEEE 0 speedgoat_test_SN5659_R2020b_CM_double -1.7E+308 1.7E+308 /end CHARACTERISTIC
/begin CHARACTERISTIC speedgoat_test_SN5659__cal_impl.Encode1_P3_h "" VALUE 0x008EA730 Scalar_FLOAT64_IEEE 0 speedgoat_test_SN5659_R2020b_CM_double -1.7E+308 1.7E+308 /end CHARACTERISTIC
/begin CHARACTERISTIC speedgoat_test_SN5659__cal_impl.Encode1_P3_hu "" VALUE 0x008EB410 Scalar_FLOAT64_IEEE 0 speedgoat_test_SN5659_R2020b_CM_double -1.7E+308 1.7E+308 /end CHARACTERISTIC
/begin CHARACTERISTIC speedgoat_test_SN5659__cal_impl.Encode1_P3_i "" VALUE 0x008EADA0 Scalar_FLOAT64_IEEE 0 speedgoat_test_SN5659_R2020b_CM_double -1.7E+308 1.7E+308 /end CHARACTERISTIC
/begin CHARACTERISTIC speedgoat_test_SN5659__cal_impl.Encode1_P3_j "" VALUE 0x008EBA80 Scalar_FLOAT64_IEEE 0 speedgoat_test_SN5659_R2020b_CM_double -1.7E+308 1.7E+308 /end CHARACTERISTIC
/begin CHARACTERISTIC speedgoat_test_SN5659__cal_impl.Encode1_P3_o0 "" VALUE 0x008EA0C0 Scalar_FLOAT64_IEEE 0 speedgoat_test_SN5659_R2020b_CM_double -1.7E+308 1.7E+308 /end CHARACTERISTIC
/begin CHARACTERISTIC speedgoat_test_SN5659__cal_impl.Encode1_P4_a "" VALUE 0x008E9A68 Scalar_FLOAT64_IEEE 0 speedgoat_test_SN5659_R2020b_CM_double -1.7E+308 1.7E+308 /end CHARACTERISTIC
/begin CHARACTERISTIC speedgoat_test_SN5659__cal_impl.Encode1_P4_c "" VALUE 0x008EA0D8 Scalar_FLOAT64_IEEE 0 speedgoat_test_SN5659_R2020b_CM_double -1.7E+308 1.7E+308 /end CHARACTERISTIC
/begin CHARACTERISTIC speedgoat_test_SN5659__cal_impl.Encode1_P4_d2 "" VALUE 0x008EC108 Scalar_FLOAT64_IEEE 0 speedgoat_test_SN5659_R2020b_CM_double -1.7E+308 1.7E+308 /end CHARACTERISTIC
/begin CHARACTERISTIC speedgoat_test_SN5659__cal_impl.Encode1_P4_el "" VALUE 0x008EADB8 Scalar_FLOAT64_IEEE 0 speedgoat_test_SN5659_R2020b_CM_double -1.7E+308 1.7E+308 /end CHARACTERISTIC
/begin CHARACTERISTIC speedgoat_test_SN5659__cal_impl.Encode1_P4_g "" VALUE 0x008EBA98 Scalar_FLOAT64_IEEE 0 speedgoat_test_SN5659_R2020b_CM_double -1.7E+308 1.7E+308 /end CHARACTERISTIC
/begin CHARACTERISTIC speedgoat_test_SN5659__cal_impl.Encode1_P4_o "" VALUE 0x008EA748 Scalar_FLOAT64_IEEE 0 speedgoat_test_SN5659_R2020b_CM_double -1.7E+308 1.7E+308 /end CHARACTERISTIC
/begin CHARACTERISTIC speedgoat_test_SN5659__cal_impl.Encode1_P4_p "" VALUE 0x008EB428 Scalar_FLOAT64_IEEE 0 speedgoat_test_SN5659_R2020b_CM_double -1.7E+308 1.7E+308 /end CHARACTERISTIC
/begin CHARACTERISTIC speedgoat_test_SN5659__cal_impl.Encode1_P5_e "" VALUE 0x008EB440 Scalar_FLOAT64_IEEE 0 speedgoat_test_SN5659_R2020b_CM_double -1.7E+308 1.7E+308 /end CHARACTERISTIC
/begin CHARACTERISTIC speedgoat_test_SN5659__cal_impl.Encode1_P5_g "" VALUE 0x008EADD0 Scalar_FLOAT64_IEEE 0 speedgoat_test_SN5659_R2020b_CM_double -1.7E+308 1.7E+308 /end CHARACTERISTIC
/begin CHARACTERISTIC speedgoat_test_SN5659__cal_impl.Encode1_P5_h "" VALUE 0x008EC120 Scalar_FLOAT64_IEEE 0 speedgoat_test_SN5659_R2020b_CM_double -1.7E+308 1.7E+308 /end CHARACTERISTIC
/begin CHARACTERISTIC speedgoat_test_SN5659__cal_impl.Encode1_P5_j "" VALUE 0x008E9A80 Scalar_FLOAT64_IEEE 0 speedgoat_test_SN5659_R2020b_CM_double -1.7E+308 1.7E+308 /end CHARACTERISTIC
/begin CHARACTERISTIC speedgoat_test_SN5659__cal_impl.Encode1_P5_l "" VALUE 0x008EA760 Scalar_FLOAT64_IEEE 0 speedgoat_test_SN5659_R2020b_CM_double -1.7E+308 1.7E+308 /end CHARACTERISTIC
/begin CHARACTERISTIC speedgoat_test_SN5659__cal_impl.Encode1_P5_ov "" VALUE 0x008EBAB0 Scalar_FLOAT64_IEEE 0 speedgoat_test_SN5659_R2020b_CM_double -1.7E+308 1.7E+308 /end CHARACTERISTIC
/begin CHARACTERISTIC speedgoat_test_SN5659__cal_impl.Encode1_P5_oz "" VALUE 0x008EA0F0 Scalar_FLOAT64_IEEE 0 speedgoat_test_SN5659_R2020b_CM_double -1.7E+308 1.7E+308 /end CHARACTERISTIC
/begin CHARACTERISTIC speedgoat_test_SN5659__cal_impl.Encode1_P6_a "" VALUE 0x008EADE8 Scalar_FLOAT64_IEEE 0 speedgoat_test_SN5659_R2020b_CM_double -1.7E+308 1.7E+308 /end CHARACTERISTIC
/begin CHARACTERISTIC speedgoat_test_SN5659__cal_impl.Encode1_P6_d "" VALUE 0x008EA778 Scalar_FLOAT64_IEEE 0 speedgoat_test_SN5659_R2020b_CM_double -1.7E+308 1.7E+308 /end CHARACTERISTIC
/begin CHARACTERISTIC speedgoat_test_SN5659__cal_impl.Encode1_P6_e "" VALUE 0x008E9A98 Scalar_FLOAT64_IEEE 0 speedgoat_test_SN5659_R2020b_CM_double -1.7E+308 1.7E+308 /end CHARACTERISTIC
/begin CHARACTERISTIC speedgoat_test_SN5659__cal_impl.Encode1_P6_i "" VALUE 0x008EC138 Scalar_FLOAT64_IEEE 0 speedgoat_test_SN5659_R2020b_CM_double -1.7E+308 1.7E+308 /end CHARACTERISTIC
/begin CHARACTERISTIC speedgoat_test_SN5659__cal_impl.Encode1_P6_m "" VALUE 0x008EB458 Scalar_FLOAT64_IEEE 0 speedgoat_test_SN5659_R2020b_CM_double -1.7E+308 1.7E+308 /end CHARACTERISTIC
/begin CHARACTERISTIC speedgoat_test_SN5659__cal_impl.Encode1_P6_n5 "" VALUE 0x008EA108 Scalar_FLOAT64_IEEE 0 speedgoat_test_SN5659_R2020b_CM_double -1.7E+308 1.7E+308 /end CHARACTERISTIC
/begin CHARACTERISTIC speedgoat_test_SN5659__cal_impl.Encode1_P6_pe "" VALUE 0x008EBAC8 Scalar_FLOAT64_IEEE 0 speedgoat_test_SN5659_R2020b_CM_double -1.7E+308 1.7E+308 /end CHARACTERISTIC
/begin CHARACTERISTIC speedgoat_test_SN5659__cal_impl.Encode1_P7_a "" VALUE 0x008EAE00 Scalar_FLOAT64_IEEE 0 speedgoat_test_SN5659_R2020b_CM_double -1.7E+308 1.7E+308 /end CHARACTERISTIC
/begin CHARACTERISTIC speedgoat_test_SN5659__cal_impl.Encode1_P7_b "" VALUE 0x008EA790 Scalar_FLOAT64_IEEE 0 speedgoat_test_SN5659_R2020b_CM_double -1.7E+308 1.7E+308 /end CHARACTERISTIC
/begin CHARACTERISTIC speedgoat_test_SN5659__cal_impl.Encode1_P7_db "" VALUE 0x008E9AB0 Scalar_FLOAT64_IEEE 0 speedgoat_test_SN5659_R2020b_CM_double -1.7E+308 1.7E+308 /end CHARACTERISTIC
/begin CHARACTERISTIC speedgoat_test_SN5659__cal_impl.Encode1_P7_dz "" VALUE 0x008EA120 Scalar_FLOAT64_IEEE 0 speedgoat_test_SN5659_R2020b_CM_double -1.7E+308 1.7E+308 /end CHARACTERISTIC
/begin CHARACTERISTIC speedgoat_test_SN5659__cal_impl.Encode1_P7_e "" VALUE 0x008EB470 Scalar_FLOAT64_IEEE 0 speedgoat_test_SN5659_R2020b_CM_double -1.7E+308 1.7E+308 /end CHARACTERISTIC
/begin CHARACTERISTIC speedgoat_test_SN5659__cal_impl.Encode1_P7_gj "" VALUE 0x008EC150 Scalar_FLOAT64_IEEE 0 speedgoat_test_SN5659_R2020b_CM_double -1.7E+308 1.7E+308 /end CHARACTERISTIC
/begin CHARACTERISTIC speedgoat_test_SN5659__cal_impl.Encode1_P7_m "" VALUE 0x008EBAE0 Scalar_FLOAT64_IEEE 0 speedgoat_test_SN5659_R2020b_CM_double -1.7E+308 1.7E+308 /end CHARACTERISTIC
/begin CHARACTERISTIC speedgoat_test_SN5659__cal_impl.Encode1_P8_b "" VALUE 0x008E9AC8 Scalar_FLOAT64_IEEE 0 speedgoat_test_SN5659_R2020b_CM_double -1.7E+308 1.7E+308 /end CHARACTERISTIC
/begin CHARACTERISTIC speedgoat_test_SN5659__cal_impl.Encode1_P8_ck "" VALUE 0x008EBAF8 Scalar_FLOAT64_IEEE 0 speedgoat_test_SN5659_R2020b_CM_double -1.7E+308 1.7E+308 /end CHARACTERISTIC
/begin CHARACTERISTIC speedgoat_test_SN5659__cal_impl.Encode1_P8_ct "" VALUE 0x008EC168 Scalar_FLOAT64_IEEE 0 speedgoat_test_SN5659_R2020b_CM_double -1.7E+308 1.7E+308 /end CHARACTERISTIC
/begin CHARACTERISTIC speedgoat_test_SN5659__cal_impl.Encode1_P8_d "" VALUE 0x008EA138 Scalar_FLOAT64_IEEE 0 speedgoat_test_SN5659_R2020b_CM_double -1.7E+308 1.7E+308 /end CHARACTERISTIC
/begin CHARACTERISTIC speedgoat_test_SN5659__cal_impl.Encode1_P8_dh "" VALUE 0x008EAE18 Scalar_FLOAT64_IEEE 0 speedgoat_test_SN5659_R2020b_CM_double -1.7E+308 1.7E+308 /end CHARACTERISTIC
/begin CHARACTERISTIC speedgoat_test_SN5659__cal_impl.Encode1_P8_f "" VALUE 0x008EA7A8 Scalar_FLOAT64_IEEE 0 speedgoat_test_SN5659_R2020b_CM_double -1.7E+308 1.7E+308 /end CHARACTERISTIC
/begin CHARACTERISTIC speedgoat_test_SN5659__cal_impl.Encode1_P8_fq "" VALUE 0x008EB488 Scalar_FLOAT64_IEEE 0 speedgoat_test_SN5659_R2020b_CM_double -1.7E+308 1.7E+308 /end CHARACTERISTIC
/begin CHARACTERISTIC speedgoat_test_SN5659__cal_impl.Encode1_P9_a "" VALUE 0x008EA150 Scalar_FLOAT64_IEEE 0 speedgoat_test_SN5659_R2020b_CM_double -1.7E+308 1.7E+308 /end CHARACTERISTIC
/begin CHARACTERISTIC speedgoat_test_SN5659__cal_impl.Encode1_P9_j "" VALUE 0x008EC180 Scalar_FLOAT64_IEEE 0 speedgoat_test_SN5659_R2020b_CM_double -1.7E+308 1.7E+308 /end CHARACTERISTIC
/begin CHARACTERISTIC speedgoat_test_SN5659__cal_impl.Encode1_P9_k "" VALUE 0x008EAE30 Scalar_FLOAT64_IEEE 0 speedgoat_test_SN5659_R2020b_CM_double -1.7E+308 1.7E+308 /end CHARACTERISTIC
/begin CHARACTERISTIC speedgoat_test_SN5659__cal_impl.Encode1_P9_md "" VALUE 0x008E9AE0 Scalar_FLOAT64_IEEE 0 speedgoat_test_SN5659_R2020b_CM_double -1.7E+308 1.7E+308 /end CHARACTERISTIC
/begin CHARACTERISTIC speedgoat_test_SN5659__cal_impl.Encode1_P9_ng "" VALUE 0x008EA7C0 Scalar_FLOAT64_IEEE 0 speedgoat_test_SN5659_R2020b_CM_double -1.7E+308 1.7E+308 /end CHARACTERISTIC
/begin CHARACTERISTIC speedgoat_test_SN5659__cal_impl.Encode1_P9_o "" VALUE 0x008EB4A0 Scalar_FLOAT64_IEEE 0 speedgoat_test_SN5659_R2020b_CM_double -1.7E+308 1.7E+308 /end CHARACTERISTIC
/begin CHARACTERISTIC speedgoat_test_SN5659__cal_impl.Encode1_P9_ol "" VALUE 0x008EBB10 Scalar_FLOAT64_IEEE 0 speedgoat_test_SN5659_R2020b_CM_double -1.7E+308 1.7E+308 /end CHARACTERISTIC
/begin CHARACTERISTIC speedgoat_test_SN5659__cal_impl.Encode2_P10_a "" VALUE 0x008EA948 Scalar_FLOAT64_IEEE 0 speedgoat_test_SN5659_R2020b_CM_double -1.7E+308 1.7E+308 /end CHARACTERISTIC
/begin CHARACTERISTIC speedgoat_test_SN5659__cal_impl.Encode2_P10_ab "" VALUE 0x008EAFB8 Scalar_FLOAT64_IEEE 0 speedgoat_test_SN5659_R2020b_CM_double -1.7E+308 1.7E+308 /end CHARACTERISTIC
/begin CHARACTERISTIC speedgoat_test_SN5659__cal_impl.Encode2_P10_f "" VALUE 0x008EC308 Scalar_FLOAT64_IEEE 0 speedgoat_test_SN5659_R2020b_CM_double -1.7E+308 1.7E+308 /end CHARACTERISTIC
/begin CHARACTERISTIC speedgoat_test_SN5659__cal_impl.Encode2_P10_g "" VALUE 0x008EA608 Scalar_FLOAT64_IEEE 0 speedgoat_test_SN5659_R2020b_CM_double -1.7E+308 1.7E+308 /end CHARACTERISTIC
/begin CHARACTERISTIC speedgoat_test_SN5659__cal_impl.Encode2_P10_gm "" VALUE 0x008EBC98 Scalar_FLOAT64_IEEE 0 speedgoat_test_SN5659_R2020b_CM_double -1.7E+308 1.7E+308 /end CHARACTERISTIC
/begin CHARACTERISTIC speedgoat_test_SN5659__cal_impl.Encode2_P10_i "" VALUE 0x008E9C68 Scalar_FLOAT64_IEEE 0 speedgoat_test_SN5659_R2020b_CM_double -1.7E+308 1.7E+308 /end CHARACTERISTIC
/begin CHARACTERISTIC speedgoat_test_SN5659__cal_impl.Encode2_P10_o "" VALUE 0x008EB628 Scalar_FLOAT64_IEEE 0 speedgoat_test_SN5659_R2020b_CM_double -1.7E+308 1.7E+308 /end CHARACTERISTIC
/begin CHARACTERISTIC speedgoat_test_SN5659__cal_impl.Encode2_P11_d "" VAL_BLK 0x008EBCB0 Scalar_FLOAT64_IEEE 0 speedgoat_test_SN5659_R2020b_CM_double -1.7E+308 1.7E+308 MATRIX_DIM 2 1 /end CHARACTERISTIC
/begin CHARACTERISTIC speedgoat_test_SN5659__cal_impl.Encode2_P11_e "" VAL_BLK 0x008EB640 Scalar_FLOAT64_IEEE 0 speedgoat_test_SN5659_R2020b_CM_double -1.7E+308 1.7E+308 MATRIX_DIM 2 1 /end CHARACTERISTIC
/begin CHARACTERISTIC speedgoat_test_SN5659__cal_impl.Encode2_P11_ga "" VAL_BLK 0x008EA960 Scalar_FLOAT64_IEEE 0 speedgoat_test_SN5659_R2020b_CM_double -1.7E+308 1.7E+308 MATRIX_DIM 2 1 /end CHARACTERISTIC
/begin CHARACTERISTIC speedgoat_test_SN5659__cal_impl.Encode2_P11_gc "" VAL_BLK 0x008EA620 Scalar_FLOAT64_IEEE 0 speedgoat_test_SN5659_R2020b_CM_double -1.7E+308 1.7E+308 MATRIX_DIM 2 1 /end CHARACTERISTIC
/begin CHARACTERISTIC speedgoat_test_SN5659__cal_impl.Encode2_P11_h "" VAL_BLK 0x008E9C80 Scalar_FLOAT64_IEEE 0 speedgoat_test_SN5659_R2020b_CM_double -1.7E+308 1.7E+308 MATRIX_DIM 2 1 /end CHARACTERISTIC
/begin CHARACTERISTIC speedgoat_test_SN5659__cal_impl.Encode2_P11_k "" VAL_BLK 0x008EAFD0 Scalar_FLOAT64_IEEE 0 speedgoat_test_SN5659_R2020b_CM_double -1.7E+308 1.7E+308 MATRIX_DIM 2 1 /end CHARACTERISTIC
/begin CHARACTERISTIC speedgoat_test_SN5659__cal_impl.Encode2_P11_m "" VAL_BLK 0x008EC320 Scalar_FLOAT64_IEEE 0 speedgoat_test_SN5659_R2020b_CM_double -1.7E+308 1.7E+308 MATRIX_DIM 2 1 /end CHARACTERISTIC
/begin CHARACTERISTIC speedgoat_test_SN5659__cal_impl.Encode2_P12_a "" VALUE 0x008EBCD0 Scalar_FLOAT64_IEEE 0 speedgoat_test_SN5659_R2020b_CM_double -1.7E+308 1.7E+308 /end CHARACTERISTIC
/begin CHARACTERISTIC speedgoat_test_SN5659__cal_impl.Encode2_P12_d "" VALUE 0x008EAFF0 Scalar_FLOAT64_IEEE 0 speedgoat_test_SN5659_R2020b_CM_double -1.7E+308 1.7E+308 /end CHARACTERISTIC
/begin CHARACTERISTIC speedgoat_test_SN5659__cal_impl.Encode2_P12_e "" VALUE 0x008EC340 Scalar_FLOAT64_IEEE 0 speedgoat_test_SN5659_R2020b_CM_double -1.7E+308 1.7E+308 /end CHARACTERISTIC
/begin CHARACTERISTIC speedgoat_test_SN5659__cal_impl.Encode2_P12_f "" VALUE 0x008EA980 Scalar_FLOAT64_IEEE 0 speedgoat_test_SN5659_R2020b_CM_double -1.7E+308 1.7E+308 /end CHARACTERISTIC
/begin CHARACTERISTIC speedgoat_test_SN5659__cal_impl.Encode2_P12_fa "" VALUE 0x008EB660 Scalar_FLOAT64_IEEE 0 speedgoat_test_SN5659_R2020b_CM_double -1.7E+308 1.7E+308 /end CHARACTERISTIC
/begin CHARACTERISTIC speedgoat_test_SN5659__cal_impl.Encode2_P12_k "" VALUE 0x008E9CA0 Scalar_FLOAT64_IEEE 0 speedgoat_test_SN5659_R2020b_CM_double -1.7E+308 1.7E+308 /end CHARACTERISTIC
/begin CHARACTERISTIC speedgoat_test_SN5659__cal_impl.Encode2_P12_me "" VALUE 0x008EA640 Scalar_FLOAT64_IEEE 0 speedgoat_test_SN5659_R2020b_CM_double -1.7E+308 1.7E+308 /end CHARACTERISTIC
/begin CHARACTERISTIC speedgoat_test_SN5659__cal_impl.Encode2_P13_d "" VALUE 0x008EB678 Scalar_FLOAT64_IEEE 0 speedgoat_test_SN5659_R2020b_CM_double -1.7E+308 1.7E+308 /end CHARACTERISTIC
/begin CHARACTERISTIC speedgoat_test_SN5659__cal_impl.Encode2_P13_e "" VALUE 0x008EA658 Scalar_FLOAT64_IEEE 0 speedgoat_test_SN5659_R2020b_CM_double -1.7E+308 1.7E+308 /end CHARACTERISTIC
/begin CHARACTERISTIC speedgoat_test_SN5659__cal_impl.Encode2_P13_f "" VALUE 0x008E9CB8 Scalar_FLOAT64_IEEE 0 speedgoat_test_SN5659_R2020b_CM_double -1.7E+308 1.7E+308 /end CHARACTERISTIC
/begin CHARACTERISTIC speedgoat_test_SN5659__cal_impl.Encode2_P13_fx "" VALUE 0x008EC358 Scalar_FLOAT64_IEEE 0 speedgoat_test_SN5659_R2020b_CM_double -1.7E+308 1.7E+308 /end CHARACTERISTIC
/begin CHARACTERISTIC speedgoat_test_SN5659__cal_impl.Encode2_P13_fz "" VALUE 0x008EBCE8 Scalar_FLOAT64_IEEE 0 speedgoat_test_SN5659_R2020b_CM_double -1.7E+308 1.7E+308 /end CHARACTERISTIC
/begin CHARACTERISTIC speedgoat_test_SN5659__cal_impl.Encode2_P13_n "" VALUE 0x008EB008 Scalar_FLOAT64_IEEE 0 speedgoat_test_SN5659_R2020b_CM_double -1.7E+308 1.7E+308 /end CHARACTERISTIC
/begin CHARACTERISTIC speedgoat_test_SN5659__cal_impl.Encode2_P13_o "" VALUE 0x008EA998 Scalar_FLOAT64_IEEE 0 speedgoat_test_SN5659_R2020b_CM_double -1.7E+308 1.7E+308 /end CHARACTERISTIC
/begin CHARACTERISTIC speedgoat_test_SN5659__cal_impl.Encode2_P14_b "" VALUE 0x008EA670 Scalar_FLOAT64_IEEE 0 speedgoat_test_SN5659_R2020b_CM_double -1.7E+308 1.7E+308 /end CHARACTERISTIC
/begin CHARACTERISTIC speedgoat_test_SN5659__cal_impl.Encode2_P14_ck "" VALUE 0x008EB690 Scalar_FLOAT64_IEEE 0 speedgoat_test_SN5659_R2020b_CM_double -1.7E+308 1.7E+308 /end CHARACTERISTIC
/begin CHARACTERISTIC speedgoat_test_SN5659__cal_impl.Encode2_P14_d "" VALUE 0x008EC370 Scalar_FLOAT64_IEEE 0 speedgoat_test_SN5659_R2020b_CM_double -1.7E+308 1.7E+308 /end CHARACTERISTIC
/begin CHARACTERISTIC speedgoat_test_SN5659__cal_impl.Encode2_P14_f "" VALUE 0x008E9CD0 Scalar_FLOAT64_IEEE 0 speedgoat_test_SN5659_R2020b_CM_double -1.7E+308 1.7E+308 /end CHARACTERISTIC
/begin CHARACTERISTIC speedgoat_test_SN5659__cal_impl.Encode2_P14_i "" VALUE 0x008EBD00 Scalar_FLOAT64_IEEE 0 speedgoat_test_SN5659_R2020b_CM_double -1.7E+308 1.7E+308 /end CHARACTERISTIC
/begin CHARACTERISTIC speedgoat_test_SN5659__cal_impl.Encode2_P14_n "" VALUE 0x008EB020 Scalar_FLOAT64_IEEE 0 speedgoat_test_SN5659_R2020b_CM_double -1.7E+308 1.7E+308 /end CHARACTERISTIC
/begin CHARACTERISTIC speedgoat_test_SN5659__cal_impl.Encode2_P14_po "" VALUE 0x008EA9B0 Scalar_FLOAT64_IEEE 0 speedgoat_test_SN5659_R2020b_CM_double -1.7E+308 1.7E+308 /end CHARACTERISTIC
/begin CHARACTERISTIC speedgoat_test_SN5659__cal_impl.Encode2_P15_ck "" VALUE 0x008EC388 Scalar_FLOAT64_IEEE 0 speedgoat_test_SN5659_R2020b_CM_double -1.7E+308 1.7E+308 /end CHARACTERISTIC
/begin CHARACTERISTIC speedgoat_test_SN5659__cal_impl.Encode2_P15_e "" VALUE 0x008EB6A8 Scalar_FLOAT64_IEEE 0 speedgoat_test_SN5659_R2020b_CM_double -1.7E+308 1.7E+308 /end CHARACTERISTIC
/begin CHARACTERISTIC speedgoat_test_SN5659__cal_impl.Encode2_P15_h "" VALUE 0x008EA9C8 Scalar_FLOAT64_IEEE 0 speedgoat_test_SN5659_R2020b_CM_double -1.7E+308 1.7E+308 /end CHARACTERISTIC
/begin CHARACTERISTIC speedgoat_test_SN5659__cal_impl.Encode2_P15_js "" VALUE 0x008EB038 Scalar_FLOAT64_IEEE 0 speedgoat_test_SN5659_R2020b_CM_double -1.7E+308 1.7E+308 /end CHARACTERISTIC
/begin CHARACTERISTIC speedgoat_test_SN5659__cal_impl.Encode2_P15_k "" VALUE 0x008EA688 Scalar_FLOAT64_IEEE 0 speedgoat_test_SN5659_R2020b_CM_double -1.7E+308 1.7E+308 /end CHARACTERISTIC
/begin CHARACTERISTIC speedgoat_test_SN5659__cal_impl.Encode2_P15_m "" VALUE 0x008EBD18 Scalar_FLOAT64_IEEE 0 speedgoat_test_SN5659_R2020b_CM_double -1.7E+308 1.7E+308 /end CHARACTERISTIC
/begin CHARACTERISTIC speedgoat_test_SN5659__cal_impl.Encode2_P15_o "" VALUE 0x008E9CE8 Scalar_FLOAT64_IEEE 0 speedgoat_test_SN5659_R2020b_CM_double -1.7E+308 1.7E+308 /end CHARACTERISTIC
/begin CHARACTERISTIC speedgoat_test_SN5659__cal_impl.Encode2_P1_az "" VALUE 0x008EC230 Scalar_FLOAT64_IEEE 0 speedgoat_test_SN5659_R2020b_CM_double -1.7E+308 1.7E+308 /end CHARACTERISTIC
/begin CHARACTERISTIC speedgoat_test_SN5659__cal_impl.Encode2_P1_e "" VALUE 0x008EA870 Scalar_FLOAT64_IEEE 0 speedgoat_test_SN5659_R2020b_CM_double -1.7E+308 1.7E+308 /end CHARACTERISTIC
/begin CHARACTERISTIC speedgoat_test_SN5659__cal_impl.Encode2_P1_g "" VALUE 0x008EB550 Scalar_FLOAT64_IEEE 0 speedgoat_test_SN5659_R2020b_CM_double -1.7E+308 1.7E+308 /end CHARACTERISTIC
/begin CHARACTERISTIC speedgoat_test_SN5659__cal_impl.Encode2_P1_hz "" VALUE 0x008EBBC0 Scalar_FLOAT64_IEEE 0 speedgoat_test_SN5659_R2020b_CM_double -1.7E+308 1.7E+308 /end CHARACTERISTIC
/begin CHARACTERISTIC speedgoat_test_SN5659__cal_impl.Encode2_P1_m "" VALUE 0x008EA530 Scalar_FLOAT64_IEEE 0 speedgoat_test_SN5659_R2020b_CM_double -1.7E+308 1.7E+308 /end CHARACTERISTIC
/begin CHARACTERISTIC speedgoat_test_SN5659__cal_impl.Encode2_P1_n "" VALUE 0x008EAEE0 Scalar_FLOAT64_IEEE 0 speedgoat_test_SN5659_R2020b_CM_double -1.7E+308 1.7E+308 /end CHARACTERISTIC
/begin CHARACTERISTIC speedgoat_test_SN5659__cal_impl.Encode2_P1_p "" VALUE 0x008E9B90 Scalar_FLOAT64_IEEE 0 speedgoat_test_SN5659_R2020b_CM_double -1.7E+308 1.7E+308 /end CHARACTERISTIC
/begin CHARACTERISTIC speedgoat_test_SN5659__cal_impl.Encode2_P2_d "" VALUE 0x008EB568 Scalar_FLOAT64_IEEE 0 speedgoat_test_SN5659_R2020b_CM_double -1.7E+308 1.7E+308 /end CHARACTERISTIC
/begin CHARACTERISTIC speedgoat_test_SN5659__cal_impl.Encode2_P2_f "" VALUE 0x008EA548 Scalar_FLOAT64_IEEE 0 speedgoat_test_SN5659_R2020b_CM_double -1.7E+308 1.7E+308 /end CHARACTERISTIC
/begin CHARACTERISTIC speedgoat_test_SN5659__cal_impl.Encode2_P2_f0 "" VALUE 0x008EC248 Scalar_FLOAT64_IEEE 0 speedgoat_test_SN5659_R2020b_CM_double -1.7E+308 1.7E+308 /end CHARACTERISTIC
/begin CHARACTERISTIC speedgoat_test_SN5659__cal_impl.Encode2_P2_h "" VALUE 0x008EA888 Scalar_FLOAT64_IEEE 0 speedgoat_test_SN5659_R2020b_CM_double -1.7E+308 1.7E+308 /end CHARACTERISTIC
/begin CHARACTERISTIC speedgoat_test_SN5659__cal_impl.Encode2_P2_k "" VALUE 0x008E9BA8 Scalar_FLOAT64_IEEE 0 speedgoat_test_SN5659_R2020b_CM_double -1.7E+308 1.7E+308 /end CHARACTERISTIC
/begin CHARACTERISTIC speedgoat_test_SN5659__cal_impl.Encode2_P2_kr "" VALUE 0x008EAEF8 Scalar_FLOAT64_IEEE 0 speedgoat_test_SN5659_R2020b_CM_double -1.7E+308 1.7E+308 /end CHARACTERISTIC
/begin CHARACTERISTIC speedgoat_test_SN5659__cal_impl.Encode2_P2_mu "" VALUE 0x008EBBD8 Scalar_FLOAT64_IEEE 0 speedgoat_test_SN5659_R2020b_CM_double -1.7E+308 1.7E+308 /end CHARACTERISTIC
/begin CHARACTERISTIC speedgoat_test_SN5659__cal_impl.Encode2_P3_f "" VALUE 0x008EA8A0 Scalar_FLOAT64_IEEE 0 speedgoat_test_SN5659_R2020b_CM_double -1.7E+308 1.7E+308 /end CHARACTERISTIC
/begin CHARACTERISTIC speedgoat_test_SN5659__cal_impl.Encode2_P3_g "" VALUE 0x008EA560 Scalar_FLOAT64_IEEE 0 speedgoat_test_SN5659_R2020b_CM_double -1.7E+308 1.7E+308 /end CHARACTERISTIC
/begin CHARACTERISTIC speedgoat_test_SN5659__cal_impl.Encode2_P3_i "" VALUE 0x008EB580 Scalar_FLOAT64_IEEE 0 speedgoat_test_SN5659_R2020b_CM_double -1.7E+308 1.7E+308 /end CHARACTERISTIC
/begin CHARACTERISTIC speedgoat_test_SN5659__cal_impl.Encode2_P3_j "" VALUE 0x008EAF10 Scalar_FLOAT64_IEEE 0 speedgoat_test_SN5659_R2020b_CM_double -1.7E+308 1.7E+308 /end CHARACTERISTIC
/begin CHARACTERISTIC speedgoat_test_SN5659__cal_impl.Encode2_P3_jd "" VALUE 0x008EBBF0 Scalar_FLOAT64_IEEE 0 speedgoat_test_SN5659_R2020b_CM_double -1.7E+308 1.7E+308 /end CHARACTERISTIC
/begin CHARACTERISTIC speedgoat_test_SN5659__cal_impl.Encode2_P3_l "" VALUE 0x008E9BC0 Scalar_FLOAT64_IEEE 0 speedgoat_test_SN5659_R2020b_CM_double -1.7E+308 1.7E+308 /end CHARACTERISTIC
/begin CHARACTERISTIC speedgoat_test_SN5659__cal_impl.Encode2_P3_o2 "" VALUE 0x008EC260 Scalar_FLOAT64_IEEE 0 speedgoat_test_SN5659_R2020b_CM_double -1.7E+308 1.7E+308 /end CHARACTERISTIC
/begin CHARACTERISTIC speedgoat_test_SN5659__cal_impl.Encode2_P4_b "" VALUE 0x008EA8B8 Scalar_FLOAT64_IEEE 0 speedgoat_test_SN5659_R2020b_CM_double -1.7E+308 1.7E+308 /end CHARACTERISTIC
/begin CHARACTERISTIC speedgoat_test_SN5659__cal_impl.Encode2_P4_g0 "" VALUE 0x008EBC08 Scalar_FLOAT64_IEEE 0 speedgoat_test_SN5659_R2020b_CM_double -1.7E+308 1.7E+308 /end CHARACTERISTIC
/begin CHARACTERISTIC speedgoat_test_SN5659__cal_impl.Encode2_P4_h "" VALUE 0x008EC278 Scalar_FLOAT64_IEEE 0 speedgoat_test_SN5659_R2020b_CM_double -1.7E+308 1.7E+308 /end CHARACTERISTIC
/begin CHARACTERISTIC speedgoat_test_SN5659__cal_impl.Encode2_P4_j "" VALUE 0x008E9BD8 Scalar_FLOAT64_IEEE 0 speedgoat_test_SN5659_R2020b_CM_double -1.7E+308 1.7E+308 /end CHARACTERISTIC
/begin CHARACTERISTIC speedgoat_test_SN5659__cal_impl.Encode2_P4_l "" VALUE 0x008EB598 Scalar_FLOAT64_IEEE 0 speedgoat_test_SN5659_R2020b_CM_double -1.7E+308 1.7E+308 /end CHARACTERISTIC
/begin CHARACTERISTIC speedgoat_test_SN5659__cal_impl.Encode2_P4_m "" VALUE 0x008EA578 Scalar_FLOAT64_IEEE 0 speedgoat_test_SN5659_R2020b_CM_double -1.7E+308 1.7E+308 /end CHARACTERISTIC
/begin CHARACTERISTIC speedgoat_test_SN5659__cal_impl.Encode2_P4_o0 "" VALUE 0x008EAF28 Scalar_FLOAT64_IEEE 0 speedgoat_test_SN5659_R2020b_CM_double -1.7E+308 1.7E+308 /end CHARACTERISTIC
/begin CHARACTERISTIC speedgoat_test_SN5659__cal_impl.Encode2_P5_d "" VALUE 0x008E9BF0 Scalar_FLOAT64_IEEE 0 speedgoat_test_SN5659_R2020b_CM_double -1.7E+308 1.7E+308 /end CHARACTERISTIC
/begin CHARACTERISTIC speedgoat_test_SN5659__cal_impl.Encode2_P5_h "" VALUE 0x008EBC20 Scalar_FLOAT64_IEEE 0 speedgoat_test_SN5659_R2020b_CM_double -1.7E+308 1.7E+308 /end CHARACTERISTIC
/begin CHARACTERISTIC speedgoat_test_SN5659__cal_impl.Encode2_P5_i "" VALUE 0x008EC290 Scalar_FLOAT64_IEEE 0 speedgoat_test_SN5659_R2020b_CM_double -1.7E+308 1.7E+308 /end CHARACTERISTIC
/begin CHARACTERISTIC speedgoat_test_SN5659__cal_impl.Encode2_P5_j "" VALUE 0x008EA590 Scalar_FLOAT64_IEEE 0 speedgoat_test_SN5659_R2020b_CM_double -1.7E+308 1.7E+308 /end CHARACTERISTIC
/begin CHARACTERISTIC speedgoat_test_SN5659__cal_impl.Encode2_P5_m "" VALUE 0x008EAF40 Scalar_FLOAT64_IEEE 0 speedgoat_test_SN5659_R2020b_CM_double -1.7E+308 1.7E+308 /end CHARACTERISTIC
/begin CHARACTERISTIC speedgoat_test_SN5659__cal_impl.Encode2_P5_p "" VALUE 0x008EA8D0 Scalar_FLOAT64_IEEE 0 speedgoat_test_SN5659_R2020b_CM_double -1.7E+308 1.7E+308 /end CHARACTERISTIC
/begin CHARACTERISTIC speedgoat_test_SN5659__cal_impl.Encode2_P5_p4 "" VALUE 0x008EB5B0 Scalar_FLOAT64_IEEE 0 speedgoat_test_SN5659_R2020b_CM_double -1.7E+308 1.7E+308 /end CHARACTERISTIC
/begin CHARACTERISTIC speedgoat_test_SN5659__cal_impl.Encode2_P6_d "" VALUE 0x008EB5C8 Scalar_FLOAT64_IEEE 0 speedgoat_test_SN5659_R2020b_CM_double -1.7E+308 1.7E+308 /end CHARACTERISTIC
/begin CHARACTERISTIC speedgoat_test_SN5659__cal_impl.Encode2_P6_d2 "" VALUE 0x008EBC38 Scalar_FLOAT64_IEEE 0 speedgoat_test_SN5659_R2020b_CM_double -1.7E+308 1.7E+308 /end CHARACTERISTIC
/begin CHARACTERISTIC speedgoat_test_SN5659__cal_impl.Encode2_P6_e "" VALUE 0x008E9C08 Scalar_FLOAT64_IEEE 0 speedgoat_test_SN5659_R2020b_CM_double -1.7E+308 1.7E+308 /end CHARACTERISTIC
/begin CHARACTERISTIC speedgoat_test_SN5659__cal_impl.Encode2_P6_i "" VALUE 0x008EAF58 Scalar_FLOAT64_IEEE 0 speedgoat_test_SN5659_R2020b_CM_double -1.7E+308 1.7E+308 /end CHARACTERISTIC
/begin CHARACTERISTIC speedgoat_test_SN5659__cal_impl.Encode2_P6_l "" VALUE 0x008EA8E8 Scalar_FLOAT64_IEEE 0 speedgoat_test_SN5659_R2020b_CM_double -1.7E+308 1.7E+308 /end CHARACTERISTIC
/begin CHARACTERISTIC speedgoat_test_SN5659__cal_impl.Encode2_P6_m "" VALUE 0x008EA5A8 Scalar_FLOAT64_IEEE 0 speedgoat_test_SN5659_R2020b_CM_double -1.7E+308 1.7E+308 /end CHARACTERISTIC
/begin CHARACTERISTIC speedgoat_test_SN5659__cal_impl.Encode2_P6_o "" VALUE 0x008EC2A8 Scalar_FLOAT64_IEEE 0 speedgoat_test_SN5659_R2020b_CM_double -1.7E+308 1.7E+308 /end CHARACTERISTIC
/begin CHARACTERISTIC speedgoat_test_SN5659__cal_impl.Encode2_P7_bh "" VALUE 0x008EB5E0 Scalar_FLOAT64_IEEE 0 speedgoat_test_SN5659_R2020b_CM_double -1.7E+308 1.7E+308 /end CHARACTERISTIC
/begin CHARACTERISTIC speedgoat_test_SN5659__cal_impl.Encode2_P7_f "" VALUE 0x008E9C20 Scalar_FLOAT64_IEEE 0 speedgoat_test_SN5659_R2020b_CM_double -1.7E+308 1.7E+308 /end CHARACTERISTIC
/begin CHARACTERISTIC speedgoat_test_SN5659__cal_impl.Encode2_P7_i "" VALUE 0x008EBC50 Scalar_FLOAT64_IEEE 0 speedgoat_test_SN5659_R2020b_CM_double -1.7E+308 1.7E+308 /end CHARACTERISTIC
/begin CHARACTERISTIC speedgoat_test_SN5659__cal_impl.Encode2_P7_j "" VALUE 0x008EA5C0 Scalar_FLOAT64_IEEE 0 speedgoat_test_SN5659_R2020b_CM_double -1.7E+308 1.7E+308 /end CHARACTERISTIC
/begin CHARACTERISTIC speedgoat_test_SN5659__cal_impl.Encode2_P7_jh "" VALUE 0x008EA900 Scalar_FLOAT64_IEEE 0 speedgoat_test_SN5659_R2020b_CM_double -1.7E+308 1.7E+308 /end CHARACTERISTIC
/begin CHARACTERISTIC speedgoat_test_SN5659__cal_impl.Encode2_P7_k "" VALUE 0x008EAF70 Scalar_FLOAT64_IEEE 0 speedgoat_test_SN5659_R2020b_CM_double -1.7E+308 1.7E+308 /end CHARACTERISTIC
/begin CHARACTERISTIC speedgoat_test_SN5659__cal_impl.Encode2_P7_o "" VALUE 0x008EC2C0 Scalar_FLOAT64_IEEE 0 speedgoat_test_SN5659_R2020b_CM_double -1.7E+308 1.7E+308 /end CHARACTERISTIC
/begin CHARACTERISTIC speedgoat_test_SN5659__cal_impl.Encode2_P8_d "" VALUE 0x008EB5F8 Scalar_FLOAT64_IEEE 0 speedgoat_test_SN5659_R2020b_CM_double -1.7E+308 1.7E+308 /end CHARACTERISTIC
/begin CHARACTERISTIC speedgoat_test_SN5659__cal_impl.Encode2_P8_fs "" VALUE 0x008EC2D8 Scalar_FLOAT64_IEEE 0 speedgoat_test_SN5659_R2020b_CM_double -1.7E+308 1.7E+308 /end CHARACTERISTIC
/begin CHARACTERISTIC speedgoat_test_SN5659__cal_impl.Encode2_P8_h3 "" VALUE 0x008EAF88 Scalar_FLOAT64_IEEE 0 speedgoat_test_SN5659_R2020b_CM_double -1.7E+308 1.7E+308 /end CHARACTERISTIC
/begin CHARACTERISTIC speedgoat_test_SN5659__cal_impl.Encode2_P8_i "" VALUE 0x008E9C38 Scalar_FLOAT64_IEEE 0 speedgoat_test_SN5659_R2020b_CM_double -1.7E+308 1.7E+308 /end CHARACTERISTIC
/begin CHARACTERISTIC speedgoat_test_SN5659__cal_impl.Encode2_P8_iw "" VALUE 0x008EA5D8 Scalar_FLOAT64_IEEE 0 speedgoat_test_SN5659_R2020b_CM_double -1.7E+308 1.7E+308 /end CHARACTERISTIC
/begin CHARACTERISTIC speedgoat_test_SN5659__cal_impl.Encode2_P8_j "" VALUE 0x008EBC68 Scalar_FLOAT64_IEEE 0 speedgoat_test_SN5659_R2020b_CM_double -1.7E+308 1.7E+308 /end CHARACTERISTIC
/begin CHARACTERISTIC speedgoat_test_SN5659__cal_impl.Encode2_P8_n "" VALUE 0x008EA918 Scalar_FLOAT64_IEEE 0 speedgoat_test_SN5659_R2020b_CM_double -1.7E+308 1.7E+308 /end CHARACTERISTIC
/begin CHARACTERISTIC speedgoat_test_SN5659__cal_impl.Encode2_P9_a "" VALUE 0x008EAFA0 Scalar_FLOAT64_IEEE 0 speedgoat_test_SN5659_R2020b_CM_double -1.7E+308 1.7E+308 /end CHARACTERISTIC
/begin CHARACTERISTIC speedgoat_test_SN5659__cal_impl.Encode2_P9_c "" VALUE 0x008EC2F0 Scalar_FLOAT64_IEEE 0 speedgoat_test_SN5659_R2020b_CM_double -1.7E+308 1.7E+308 /end CHARACTERISTIC
/begin CHARACTERISTIC speedgoat_test_SN5659__cal_impl.Encode2_P9_d "" VALUE 0x008EB610 Scalar_FLOAT64_IEEE 0 speedgoat_test_SN5659_R2020b_CM_double -1.7E+308 1.7E+308 /end CHARACTERISTIC
/begin CHARACTERISTIC speedgoat_test_SN5659__cal_impl.Encode2_P9_h "" VALUE 0x008EA930 Scalar_FLOAT64_IEEE 0 speedgoat_test_SN5659_R2020b_CM_double -1.7E+308 1.7E+308 /end CHARACTERISTIC
/begin CHARACTERISTIC speedgoat_test_SN5659__cal_impl.Encode2_P9_n "" VALUE 0x008EBC80 Scalar_FLOAT64_IEEE 0 speedgoat_test_SN5659_R2020b_CM_double -1.7E+308 1.7E+308 /end CHARACTERISTIC
/begin CHARACTERISTIC speedgoat_test_SN5659__cal_impl.Encode2_P9_pd "" VALUE 0x008EA5F0 Scalar_FLOAT64_IEEE 0 speedgoat_test_SN5659_R2020b_CM_double -1.7E+308 1.7E+308 /end CHARACTERISTIC
/begin CHARACTERISTIC speedgoat_test_SN5659__cal_impl.Encode2_P9_pe "" VALUE 0x008E9C50 Scalar_FLOAT64_IEEE 0 speedgoat_test_SN5659_R2020b_CM_double -1.7E+308 1.7E+308 /end CHARACTERISTIC
/begin CHARACTERISTIC speedgoat_test_SN5659__cal_impl.Encode3_P10_a "" VALUE 0x008EC4B0 Scalar_FLOAT64_IEEE 0 speedgoat_test_SN5659_R2020b_CM_double -1.7E+308 1.7E+308 /end CHARACTERISTIC
/begin CHARACTERISTIC speedgoat_test_SN5659__cal_impl.Encode3_P10_l "" VALUE 0x008EA480 Scalar_FLOAT64_IEEE 0 speedgoat_test_SN5659_R2020b_CM_double -1.7E+308 1.7E+308 /end CHARACTERISTIC
/begin CHARACTERISTIC speedgoat_test_SN5659__cal_impl.Encode3_P10_l1 "" VALUE 0x008EAAF0 Scalar_FLOAT64_IEEE 0 speedgoat_test_SN5659_R2020b_CM_double -1.7E+308 1.7E+308 /end CHARACTERISTIC
/begin CHARACTERISTIC speedgoat_test_SN5659__cal_impl.Encode3_P10_lx "" VALUE 0x008EB160 Scalar_FLOAT64_IEEE 0 speedgoat_test_SN5659_R2020b_CM_double -1.7E+308 1.7E+308 /end CHARACTERISTIC
/begin CHARACTERISTIC speedgoat_test_SN5659__cal_impl.Encode3_P10_m "" VALUE 0x008E9E10 Scalar_FLOAT64_IEEE 0 speedgoat_test_SN5659_R2020b_CM_double -1.7E+308 1.7E+308 /end CHARACTERISTIC
/begin CHARACTERISTIC speedgoat_test_SN5659__cal_impl.Encode3_P10_o "" VALUE 0x008EB7D0 Scalar_FLOAT64_IEEE 0 speedgoat_test_SN5659_R2020b_CM_double -1.7E+308 1.7E+308 /end CHARACTERISTIC
/begin CHARACTERISTIC speedgoat_test_SN5659__cal_impl.Encode3_P10_p "" VALUE 0x008EBE40 Scalar_FLOAT64_IEEE 0 speedgoat_test_SN5659_R2020b_CM_double -1.7E+308 1.7E+308 /end CHARACTERISTIC
/begin CHARACTERISTIC speedgoat_test_SN5659__cal_impl.Encode3_P11_c "" VAL_BLK 0x008EAB08 Scalar_FLOAT64_IEEE 0 speedgoat_test_SN5659_R2020b_CM_double -1.7E+308 1.7E+308 MATRIX_DIM 2 1 /end CHARACTERISTIC
/begin CHARACTERISTIC speedgoat_test_SN5659__cal_impl.Encode3_P11_f "" VAL_BLK 0x008EC4C8 Scalar_FLOAT64_IEEE 0 speedgoat_test_SN5659_R2020b_CM_double -1.7E+308 1.7E+308 MATRIX_DIM 2 1 /end CHARACTERISTIC
/begin CHARACTERISTIC speedgoat_test_SN5659__cal_impl.Encode3_P11_h "" VAL_BLK 0x008EA498 Scalar_FLOAT64_IEEE 0 speedgoat_test_SN5659_R2020b_CM_double -1.7E+308 1.7E+308 MATRIX_DIM 2 1 /end CHARACTERISTIC
/begin CHARACTERISTIC speedgoat_test_SN5659__cal_impl.Encode3_P11_h0 "" VAL_BLK 0x008EB7E8 Scalar_FLOAT64_IEEE 0 speedgoat_test_SN5659_R2020b_CM_double -1.7E+308 1.7E+308 MATRIX_DIM 2 1 /end CHARACTERISTIC
/begin CHARACTERISTIC speedgoat_test_SN5659__cal_impl.Encode3_P11_i "" VAL_BLK 0x008E9E28 Scalar_FLOAT64_IEEE 0 speedgoat_test_SN5659_R2020b_CM_double -1.7E+308 1.7E+308 MATRIX_DIM 2 1 /end CHARACTERISTIC
/begin CHARACTERISTIC speedgoat_test_SN5659__cal_impl.Encode3_P11_jq "" VAL_BLK 0x008EBE58 Scalar_FLOAT64_IEEE 0 speedgoat_test_SN5659_R2020b_CM_double -1.7E+308 1.7E+308 MATRIX_DIM 2 1 /end CHARACTERISTIC
/begin CHARACTERISTIC speedgoat_test_SN5659__cal_impl.Encode3_P11_m "" VAL_BLK 0x008EB178 Scalar_FLOAT64_IEEE 0 speedgoat_test_SN5659_R2020b_CM_double -1.7E+308 1.7E+308 MATRIX_DIM 2 1 /end CHARACTERISTIC
/begin CHARACTERISTIC speedgoat_test_SN5659__cal_impl.Encode3_P12_b "" VALUE 0x008E9E48 Scalar_FLOAT64_IEEE 0 speedgoat_test_SN5659_R2020b_CM_double -1.7E+308 1.7E+308 /end CHARACTERISTIC
/begin CHARACTERISTIC speedgoat_test_SN5659__cal_impl.Encode3_P12_b3 "" VALUE 0x008EC4E8 Scalar_FLOAT64_IEEE 0 speedgoat_test_SN5659_R2020b_CM_double -1.7E+308 1.7E+308 /end CHARACTERISTIC
/begin CHARACTERISTIC speedgoat_test_SN5659__cal_impl.Encode3_P12_c "" VALUE 0x008EA4B8 Scalar_FLOAT64_IEEE 0 speedgoat_test_SN5659_R2020b_CM_double -1.7E+308 1.7E+308 /end CHARACTERISTIC
/begin CHARACTERISTIC speedgoat_test_SN5659__cal_impl.Encode3_P12_d "" VALUE 0x008EBE78 Scalar_FLOAT64_IEEE 0 speedgoat_test_SN5659_R2020b_CM_double -1.7E+308 1.7E+308 /end CHARACTERISTIC
/begin CHARACTERISTIC speedgoat_test_SN5659__cal_impl.Encode3_P12_i "" VALUE 0x008EB198 Scalar_FLOAT64_IEEE 0 speedgoat_test_SN5659_R2020b_CM_double -1.7E+308 1.7E+308 /end CHARACTERISTIC
/begin CHARACTERISTIC speedgoat_test_SN5659__cal_impl.Encode3_P12_k "" VALUE 0x008EB808 Scalar_FLOAT64_IEEE 0 speedgoat_test_SN5659_R2020b_CM_double -1.7E+308 1.7E+308 /end CHARACTERISTIC
/begin CHARACTERISTIC speedgoat_test_SN5659__cal_impl.Encode3_P12_p "" VALUE 0x008EAB28 Scalar_FLOAT64_IEEE 0 speedgoat_test_SN5659_R2020b_CM_double -1.7E+308 1.7E+308 /end CHARACTERISTIC
/begin CHARACTERISTIC speedgoat_test_SN5659__cal_impl.Encode3_P13_c "" VALUE 0x008EC500 Scalar_FLOAT64_IEEE 0 speedgoat_test_SN5659_R2020b_CM_double -1.7E+308 1.7E+308 /end CHARACTERISTIC
/begin CHARACTERISTIC speedgoat_test_SN5659__cal_impl.Encode3_P13_e "" VALUE 0x008EA4D0 Scalar_FLOAT64_IEEE 0 speedgoat_test_SN5659_R2020b_CM_double -1.7E+308 1.7E+308 /end CHARACTERISTIC
/begin CHARACTERISTIC speedgoat_test_SN5659__cal_impl.Encode3_P13_g "" VALUE 0x008E9E60 Scalar_FLOAT64_IEEE 0 speedgoat_test_SN5659_R2020b_CM_double -1.7E+308 1.7E+308 /end CHARACTERISTIC
/begin CHARACTERISTIC speedgoat_test_SN5659__cal_impl.Encode3_P13_h "" VALUE 0x008EBE90 Scalar_FLOAT64_IEEE 0 speedgoat_test_SN5659_R2020b_CM_double -1.7E+308 1.7E+308 /end CHARACTERISTIC
/begin CHARACTERISTIC speedgoat_test_SN5659__cal_impl.Encode3_P13_k "" VALUE 0x008EB1B0 Scalar_FLOAT64_IEEE 0 speedgoat_test_SN5659_R2020b_CM_double -1.7E+308 1.7E+308 /end CHARACTERISTIC
/begin CHARACTERISTIC speedgoat_test_SN5659__cal_impl.Encode3_P13_ka "" VALUE 0x008EB820 Scalar_FLOAT64_IEEE 0 speedgoat_test_SN5659_R2020b_CM_double -1.7E+308 1.7E+308 /end CHARACTERISTIC
/begin CHARACTERISTIC speedgoat_test_SN5659__cal_impl.Encode3_P13_p "" VALUE 0x008EAB40 Scalar_FLOAT64_IEEE 0 speedgoat_test_SN5659_R2020b_CM_double -1.7E+308 1.7E+308 /end CHARACTERISTIC
/begin CHARACTERISTIC speedgoat_test_SN5659__cal_impl.Encode3_P14_b "" VALUE 0x008EA4E8 Scalar_FLOAT64_IEEE 0 speedgoat_test_SN5659_R2020b_CM_double -1.7E+308 1.7E+308 /end CHARACTERISTIC
/begin CHARACTERISTIC speedgoat_test_SN5659__cal_impl.Encode3_P14_do "" VALUE 0x008EC518 Scalar_FLOAT64_IEEE 0 speedgoat_test_SN5659_R2020b_CM_double -1.7E+308 1.7E+308 /end CHARACTERISTIC
/begin CHARACTERISTIC speedgoat_test_SN5659__cal_impl.Encode3_P14_f "" VALUE 0x008EAB58 Scalar_FLOAT64_IEEE 0 speedgoat_test_SN5659_R2020b_CM_double -1.7E+308 1.7E+308 /end CHARACTERISTIC
/begin CHARACTERISTIC speedgoat_test_SN5659__cal_impl.Encode3_P14_m "" VALUE 0x008EB1C8 Scalar_FLOAT64_IEEE 0 speedgoat_test_SN5659_R2020b_CM_double -1.7E+308 1.7E+308 /end CHARACTERISTIC
/begin CHARACTERISTIC speedgoat_test_SN5659__cal_impl.Encode3_P14_n "" VALUE 0x008EB838 Scalar_FLOAT64_IEEE 0 speedgoat_test_SN5659_R2020b_CM_double -1.7E+308 1.7E+308 /end CHARACTERISTIC
/begin CHARACTERISTIC speedgoat_test_SN5659__cal_impl.Encode3_P14_ny "" VALUE 0x008EBEA8 Scalar_FLOAT64_IEEE 0 speedgoat_test_SN5659_R2020b_CM_double -1.7E+308 1.7E+308 /end CHARACTERISTIC
/begin CHARACTERISTIC speedgoat_test_SN5659__cal_impl.Encode3_P14_o "" VALUE 0x008E9E78 Scalar_FLOAT64_IEEE 0 speedgoat_test_SN5659_R2020b_CM_double -1.7E+308 1.7E+308 /end CHARACTERISTIC
/begin CHARACTERISTIC speedgoat_test_SN5659__cal_impl.Encode3_P15_b "" VALUE 0x008EB1E0 Scalar_FLOAT64_IEEE 0 speedgoat_test_SN5659_R2020b_CM_double -1.7E+308 1.7E+308 /end CHARACTERISTIC
/begin CHARACTERISTIC speedgoat_test_SN5659__cal_impl.Encode3_P15_c "" VALUE 0x008EB850 Scalar_FLOAT64_IEEE 0 speedgoat_test_SN5659_R2020b_CM_double -1.7E+308 1.7E+308 /end CHARACTERISTIC
/begin CHARACTERISTIC speedgoat_test_SN5659__cal_impl.Encode3_P15_g "" VALUE 0x008EBEC0 Scalar_FLOAT64_IEEE 0 speedgoat_test_SN5659_R2020b_CM_double -1.7E+308 1.7E+308 /end CHARACTERISTIC
/begin CHARACTERISTIC speedgoat_test_SN5659__cal_impl.Encode3_P15_hk "" VALUE 0x008E9E90 Scalar_FLOAT64_IEEE 0 speedgoat_test_SN5659_R2020b_CM_double -1.7E+308 1.7E+308 /end CHARACTERISTIC
/begin CHARACTERISTIC speedgoat_test_SN5659__cal_impl.Encode3_P15_hl "" VALUE 0x008EAB70 Scalar_FLOAT64_IEEE 0 speedgoat_test_SN5659_R2020b_CM_double -1.7E+308 1.7E+308 /end CHARACTERISTIC
/begin CHARACTERISTIC speedgoat_test_SN5659__cal_impl.Encode3_P15_i "" VALUE 0x008EA500 Scalar_FLOAT64_IEEE 0 speedgoat_test_SN5659_R2020b_CM_double -1.7E+308 1.7E+308 /end CHARACTERISTIC
/begin CHARACTERISTIC speedgoat_test_SN5659__cal_impl.Encode3_P15_pu "" VALUE 0x008EC530 Scalar_FLOAT64_IEEE 0 speedgoat_test_SN5659_R2020b_CM_double -1.7E+308 1.7E+308 /end CHARACTERISTIC
/begin CHARACTERISTIC speedgoat_test_SN5659__cal_impl.Encode3_P1_a "" VALUE 0x008EAA18 Scalar_FLOAT64_IEEE 0 speedgoat_test_SN5659_R2020b_CM_double -1.7E+308 1.7E+308 /end CHARACTERISTIC
/begin CHARACTERISTIC speedgoat_test_SN5659__cal_impl.Encode3_P1_i "" VALUE 0x008EA3A8 Scalar_FLOAT64_IEEE 0 speedgoat_test_SN5659_R2020b_CM_double -1.7E+308 1.7E+308 /end CHARACTERISTIC
/begin CHARACTERISTIC speedgoat_test_SN5659__cal_impl.Encode3_P1_m "" VALUE 0x008EBD68 Scalar_FLOAT64_IEEE 0 speedgoat_test_SN5659_R2020b_CM_double -1.7E+308 1.7E+308 /end CHARACTERISTIC
/begin CHARACTERISTIC speedgoat_test_SN5659__cal_impl.Encode3_P1_mk "" VALUE 0x008EC3D8 Scalar_FLOAT64_IEEE 0 speedgoat_test_SN5659_R2020b_CM_double -1.7E+308 1.7E+308 /end CHARACTERISTIC
/begin CHARACTERISTIC speedgoat_test_SN5659__cal_impl.Encode3_P1_n "" VALUE 0x008E9D38 Scalar_FLOAT64_IEEE 0 speedgoat_test_SN5659_R2020b_CM_double -1.7E+308 1.7E+308 /end CHARACTERISTIC
/begin CHARACTERISTIC speedgoat_test_SN5659__cal_impl.Encode3_P1_nj "" VALUE 0x008EB088 Scalar_FLOAT64_IEEE 0 speedgoat_test_SN5659_R2020b_CM_double -1.7E+308 1.7E+308 /end CHARACTERISTIC
/begin CHARACTERISTIC speedgoat_test_SN5659__cal_impl.Encode3_P1_nj3 "" VALUE 0x008EB6F8 Scalar_FLOAT64_IEEE 0 speedgoat_test_SN5659_R2020b_CM_double -1.7E+308 1.7E+308 /end CHARACTERISTIC
/begin CHARACTERISTIC speedgoat_test_SN5659__cal_impl.Encode3_P2_a "" VALUE 0x008EA3C0 Scalar_FLOAT64_IEEE 0 speedgoat_test_SN5659_R2020b_CM_double -1.7E+308 1.7E+308 /end CHARACTERISTIC
/begin CHARACTERISTIC speedgoat_test_SN5659__cal_impl.Encode3_P2_b "" VALUE 0x008EAA30 Scalar_FLOAT64_IEEE 0 speedgoat_test_SN5659_R2020b_CM_double -1.7E+308 1.7E+308 /end CHARACTERISTIC
/begin CHARACTERISTIC speedgoat_test_SN5659__cal_impl.Encode3_P2_h "" VALUE 0x008EB710 Scalar_FLOAT64_IEEE 0 speedgoat_test_SN5659_R2020b_CM_double -1.7E+308 1.7E+308 /end CHARACTERISTIC
/begin CHARACTERISTIC speedgoat_test_SN5659__cal_impl.Encode3_P2_i "" VALUE 0x008E9D50 Scalar_FLOAT64_IEEE 0 speedgoat_test_SN5659_R2020b_CM_double -1.7E+308 1.7E+308 /end CHARACTERISTIC
/begin CHARACTERISTIC speedgoat_test_SN5659__cal_impl.Encode3_P2_m "" VALUE 0x008EBD80 Scalar_FLOAT64_IEEE 0 speedgoat_test_SN5659_R2020b_CM_double -1.7E+308 1.7E+308 /end CHARACTERISTIC
/begin CHARACTERISTIC speedgoat_test_SN5659__cal_impl.Encode3_P2_n "" VALUE 0x008EB0A0 Scalar_FLOAT64_IEEE 0 speedgoat_test_SN5659_R2020b_CM_double -1.7E+308 1.7E+308 /end CHARACTERISTIC
/begin CHARACTERISTIC speedgoat_test_SN5659__cal_impl.Encode3_P2_o "" VALUE 0x008EC3F0 Scalar_FLOAT64_IEEE 0 speedgoat_test_SN5659_R2020b_CM_double -1.7E+308 1.7E+308 /end CHARACTERISTIC
/begin CHARACTERISTIC speedgoat_test_SN5659__cal_impl.Encode3_P3_c "" VALUE 0x008EA3D8 Scalar_FLOAT64_IEEE 0 speedgoat_test_SN5659_R2020b_CM_double -1.7E+308 1.7E+308 /end CHARACTERISTIC
/begin CHARACTERISTIC speedgoat_test_SN5659__cal_impl.Encode3_P3_cs "" VALUE 0x008EC408 Scalar_FLOAT64_IEEE 0 speedgoat_test_SN5659_R2020b_CM_double -1.7E+308 1.7E+308 /end CHARACTERISTIC
/begin CHARACTERISTIC speedgoat_test_SN5659__cal_impl.Encode3_P3_d "" VALUE 0x008EB728 Scalar_FLOAT64_IEEE 0 speedgoat_test_SN5659_R2020b_CM_double -1.7E+308 1.7E+308 /end CHARACTERISTIC
/begin CHARACTERISTIC speedgoat_test_SN5659__cal_impl.Encode3_P3_g "" VALUE 0x008EAA48 Scalar_FLOAT64_IEEE 0 speedgoat_test_SN5659_R2020b_CM_double -1.7E+308 1.7E+308 /end CHARACTERISTIC
/begin CHARACTERISTIC speedgoat_test_SN5659__cal_impl.Encode3_P3_gs "" VALUE 0x008EBD98 Scalar_FLOAT64_IEEE 0 speedgoat_test_SN5659_R2020b_CM_double -1.7E+308 1.7E+308 /end CHARACTERISTIC
/begin CHARACTERISTIC speedgoat_test_SN5659__cal_impl.Encode3_P3_j "" VALUE 0x008E9D68 Scalar_FLOAT64_IEEE 0 speedgoat_test_SN5659_R2020b_CM_double -1.7E+308 1.7E+308 /end CHARACTERISTIC
/begin CHARACTERISTIC speedgoat_test_SN5659__cal_impl.Encode3_P3_nc "" VALUE 0x008EB0B8 Scalar_FLOAT64_IEEE 0 speedgoat_test_SN5659_R2020b_CM_double -1.7E+308 1.7E+308 /end CHARACTERISTIC
/begin CHARACTERISTIC speedgoat_test_SN5659__cal_impl.Encode3_P4_b "" VALUE 0x008EAA60 Scalar_FLOAT64_IEEE 0 speedgoat_test_SN5659_R2020b_CM_double -1.7E+308 1.7E+308 /end CHARACTERISTIC
/begin CHARACTERISTIC speedgoat_test_SN5659__cal_impl.Encode3_P4_dq "" VALUE 0x008EC420 Scalar_FLOAT64_IEEE 0 speedgoat_test_SN5659_R2020b_CM_double -1.7E+308 1.7E+308 /end CHARACTERISTIC
/begin CHARACTERISTIC speedgoat_test_SN5659__cal_impl.Encode3_P4_dt "" VALUE 0x008EBDB0 Scalar_FLOAT64_IEEE 0 speedgoat_test_SN5659_R2020b_CM_double -1.7E+308 1.7E+308 /end CHARACTERISTIC
/begin CHARACTERISTIC speedgoat_test_SN5659__cal_impl.Encode3_P4_h "" VALUE 0x008EB740 Scalar_FLOAT64_IEEE 0 speedgoat_test_SN5659_R2020b_CM_double -1.7E+308 1.7E+308 /end CHARACTERISTIC
/begin CHARACTERISTIC speedgoat_test_SN5659__cal_impl.Encode3_P4_l "" VALUE 0x008E9D80 Scalar_FLOAT64_IEEE 0 speedgoat_test_SN5659_R2020b_CM_double -1.7E+308 1.7E+308 /end CHARACTERISTIC
/begin CHARACTERISTIC speedgoat_test_SN5659__cal_impl.Encode3_P4_ls "" VALUE 0x008EA3F0 Scalar_FLOAT64_IEEE 0 speedgoat_test_SN5659_R2020b_CM_double -1.7E+308 1.7E+308 /end CHARACTERISTIC
/begin CHARACTERISTIC speedgoat_test_SN5659__cal_impl.Encode3_P4_m "" VALUE 0x008EB0D0 Scalar_FLOAT64_IEEE 0 speedgoat_test_SN5659_R2020b_CM_double -1.7E+308 1.7E+308 /end CHARACTERISTIC
/begin CHARACTERISTIC speedgoat_test_SN5659__cal_impl.Encode3_P5_b "" VALUE 0x008E9D98 Scalar_FLOAT64_IEEE 0 speedgoat_test_SN5659_R2020b_CM_double -1.7E+308 1.7E+308 /end CHARACTERISTIC
/begin CHARACTERISTIC speedgoat_test_SN5659__cal_impl.Encode3_P5_bo "" VALUE 0x008EA408 Scalar_FLOAT64_IEEE 0 speedgoat_test_SN5659_R2020b_CM_double -1.7E+308 1.7E+308 /end CHARACTERISTIC
/begin CHARACTERISTIC speedgoat_test_SN5659__cal_impl.Encode3_P5_d "" VALUE 0x008EBDC8 Scalar_FLOAT64_IEEE 0 speedgoat_test_SN5659_R2020b_CM_double -1.7E+308 1.7E+308 /end CHARACTERISTIC
/begin CHARACTERISTIC speedgoat_test_SN5659__cal_impl.Encode3_P5_f "" VALUE 0x008EB758 Scalar_FLOAT64_IEEE 0 speedgoat_test_SN5659_R2020b_CM_double -1.7E+308 1.7E+308 /end CHARACTERISTIC
/begin CHARACTERISTIC speedgoat_test_SN5659__cal_impl.Encode3_P5_h "" VALUE 0x008EB0E8 Scalar_FLOAT64_IEEE 0 speedgoat_test_SN5659_R2020b_CM_double -1.7E+308 1.7E+308 /end CHARACTERISTIC
/begin CHARACTERISTIC speedgoat_test_SN5659__cal_impl.Encode3_P5_ij "" VALUE 0x008EAA78 Scalar_FLOAT64_IEEE 0 speedgoat_test_SN5659_R2020b_CM_double -1.7E+308 1.7E+308 /end CHARACTERISTIC
/begin CHARACTERISTIC speedgoat_test_SN5659__cal_impl.Encode3_P5_im "" VALUE 0x008EC438 Scalar_FLOAT64_IEEE 0 speedgoat_test_SN5659_R2020b_CM_double -1.7E+308 1.7E+308 /end CHARACTERISTIC
/begin CHARACTERISTIC speedgoat_test_SN5659__cal_impl.Encode3_P6_a "" VALUE 0x008EA420 Scalar_FLOAT64_IEEE 0 speedgoat_test_SN5659_R2020b_CM_double -1.7E+308 1.7E+308 /end CHARACTERISTIC
/begin CHARACTERISTIC speedgoat_test_SN5659__cal_impl.Encode3_P6_d "" VALUE 0x008EC450 Scalar_FLOAT64_IEEE 0 speedgoat_test_SN5659_R2020b_CM_double -1.7E+308 1.7E+308 /end CHARACTERISTIC
/begin CHARACTERISTIC speedgoat_test_SN5659__cal_impl.Encode3_P6_g "" VALUE 0x008EBDE0 Scalar_FLOAT64_IEEE 0 speedgoat_test_SN5659_R2020b_CM_double -1.7E+308 1.7E+308 /end CHARACTERISTIC
/begin CHARACTERISTIC speedgoat_test_SN5659__cal_impl.Encode3_P6_i "" VALUE 0x008EB100 Scalar_FLOAT64_IEEE 0 speedgoat_test_SN5659_R2020b_CM_double -1.7E+308 1.7E+308 /end CHARACTERISTIC
/begin CHARACTERISTIC speedgoat_test_SN5659__cal_impl.Encode3_P6_j "" VALUE 0x008E9DB0 Scalar_FLOAT64_IEEE 0 speedgoat_test_SN5659_R2020b_CM_double -1.7E+308 1.7E+308 /end CHARACTERISTIC
/begin CHARACTERISTIC speedgoat_test_SN5659__cal_impl.Encode3_P6_jb "" VALUE 0x008EAA90 Scalar_FLOAT64_IEEE 0 speedgoat_test_SN5659_R2020b_CM_double -1.7E+308 1.7E+308 /end CHARACTERISTIC
/begin CHARACTERISTIC speedgoat_test_SN5659__cal_impl.Encode3_P6_k "" VALUE 0x008EB770 Scalar_FLOAT64_IEEE 0 speedgoat_test_SN5659_R2020b_CM_double -1.7E+308 1.7E+308 /end CHARACTERISTIC
/begin CHARACTERISTIC speedgoat_test_SN5659__cal_impl.Encode3_P7_d "" VALUE 0x008EA438 Scalar_FLOAT64_IEEE 0 speedgoat_test_SN5659_R2020b_CM_double -1.7E+308 1.7E+308 /end CHARACTERISTIC
/begin CHARACTERISTIC speedgoat_test_SN5659__cal_impl.Encode3_P7_f "" VALUE 0x008EAAA8 Scalar_FLOAT64_IEEE 0 speedgoat_test_SN5659_R2020b_CM_double -1.7E+308 1.7E+308 /end CHARACTERISTIC
/begin CHARACTERISTIC speedgoat_test_SN5659__cal_impl.Encode3_P7_fm "" VALUE 0x008EBDF8 Scalar_FLOAT64_IEEE 0 speedgoat_test_SN5659_R2020b_CM_double -1.7E+308 1.7E+308 /end CHARACTERISTIC
/begin CHARACTERISTIC speedgoat_test_SN5659__cal_impl.Encode3_P7_fx "" VALUE 0x008EB788 Scalar_FLOAT64_IEEE 0 speedgoat_test_SN5659_R2020b_CM_double -1.7E+308 1.7E+308 /end CHARACTERISTIC
/begin CHARACTERISTIC speedgoat_test_SN5659__cal_impl.Encode3_P7_i "" VALUE 0x008EB118 Scalar_FLOAT64_IEEE 0 speedgoat_test_SN5659_R2020b_CM_double -1.7E+308 1.7E+308 /end CHARACTERISTIC
/begin CHARACTERISTIC speedgoat_test_SN5659__cal_impl.Encode3_P7_l "" VALUE 0x008E9DC8 Scalar_FLOAT64_IEEE 0 speedgoat_test_SN5659_R2020b_CM_double -1.7E+308 1.7E+308 /end CHARACTERISTIC
/begin CHARACTERISTIC speedgoat_test_SN5659__cal_impl.Encode3_P7_o "" VALUE 0x008EC468 Scalar_FLOAT64_IEEE 0 speedgoat_test_SN5659_R2020b_CM_double -1.7E+308 1.7E+308 /end CHARACTERISTIC
/begin CHARACTERISTIC speedgoat_test_SN5659__cal_impl.Encode3_P8_b "" VALUE 0x008EB7A0 Scalar_FLOAT64_IEEE 0 speedgoat_test_SN5659_R2020b_CM_double -1.7E+308 1.7E+308 /end CHARACTERISTIC
/begin CHARACTERISTIC speedgoat_test_SN5659__cal_impl.Encode3_P8_en "" VALUE 0x008EC480 Scalar_FLOAT64_IEEE 0 speedgoat_test_SN5659_R2020b_CM_double -1.7E+308 1.7E+308 /end CHARACTERISTIC
/begin CHARACTERISTIC speedgoat_test_SN5659__cal_impl.Encode3_P8_fh "" VALUE 0x008EBE10 Scalar_FLOAT64_IEEE 0 speedgoat_test_SN5659_R2020b_CM_double -1.7E+308 1.7E+308 /end CHARACTERISTIC
/begin CHARACTERISTIC speedgoat_test_SN5659__cal_impl.Encode3_P8_h "" VALUE 0x008E9DE0 Scalar_FLOAT64_IEEE 0 speedgoat_test_SN5659_R2020b_CM_double -1.7E+308 1.7E+308 /end CHARACTERISTIC
/begin CHARACTERISTIC speedgoat_test_SN5659__cal_impl.Encode3_P8_k "" VALUE 0x008EA450 Scalar_FLOAT64_IEEE 0 speedgoat_test_SN5659_R2020b_CM_double -1.7E+308 1.7E+308 /end CHARACTERISTIC
/begin CHARACTERISTIC speedgoat_test_SN5659__cal_impl.Encode3_P8_l "" VALUE 0x008EAAC0 Scalar_FLOAT64_IEEE 0 speedgoat_test_SN5659_R2020b_CM_double -1.7E+308 1.7E+308 /end CHARACTERISTIC
/begin CHARACTERISTIC speedgoat_test_SN5659__cal_impl.Encode3_P8_p "" VALUE 0x008EB130 Scalar_FLOAT64_IEEE 0 speedgoat_test_SN5659_R2020b_CM_double -1.7E+308 1.7E+308 /end CHARACTERISTIC
/begin CHARACTERISTIC speedgoat_test_SN5659__cal_impl.Encode3_P9_b "" VALUE 0x008E9DF8 Scalar_FLOAT64_IEEE 0 speedgoat_test_SN5659_R2020b_CM_double -1.7E+308 1.7E+308 /end CHARACTERISTIC
/begin CHARACTERISTIC speedgoat_test_SN5659__cal_impl.Encode3_P9_b5 "" VALUE 0x008EA468 Scalar_FLOAT64_IEEE 0 speedgoat_test_SN5659_R2020b_CM_double -1.7E+308 1.7E+308 /end CHARACTERISTIC
/begin CHARACTERISTIC speedgoat_test_SN5659__cal_impl.Encode3_P9_bx "" VALUE 0x008EB7B8 Scalar_FLOAT64_IEEE 0 speedgoat_test_SN5659_R2020b_CM_double -1.7E+308 1.7E+308 /end CHARACTERISTIC
/begin CHARACTERISTIC speedgoat_test_SN5659__cal_impl.Encode3_P9_c "" VALUE 0x008EAAD8 Scalar_FLOAT64_IEEE 0 speedgoat_test_SN5659_R2020b_CM_double -1.7E+308 1.7E+308 /end CHARACTERISTIC
/begin CHARACTERISTIC speedgoat_test_SN5659__cal_impl.Encode3_P9_m "" VALUE 0x008EC498 Scalar_FLOAT64_IEEE 0 speedgoat_test_SN5659_R2020b_CM_double -1.7E+308 1.7E+308 /end CHARACTERISTIC
/begin CHARACTERISTIC speedgoat_test_SN5659__cal_impl.Encode3_P9_n "" VALUE 0x008EBE28 Scalar_FLOAT64_IEEE 0 speedgoat_test_SN5659_R2020b_CM_double -1.7E+308 1.7E+308 /end CHARACTERISTIC
/begin CHARACTERISTIC speedgoat_test_SN5659__cal_impl.Encode3_P9_p "" VALUE 0x008EB148 Scalar_FLOAT64_IEEE 0 speedgoat_test_SN5659_R2020b_CM_double -1.7E+308 1.7E+308 /end CHARACTERISTIC
/begin CHARACTERISTIC speedgoat_test_SN5659__cal_impl.Encode4_P10_b "" VALUE 0x008EC638 Scalar_FLOAT64_IEEE 0 speedgoat_test_SN5659_R2020b_CM_double -1.7E+308 1.7E+308 /end CHARACTERISTIC
/begin CHARACTERISTIC speedgoat_test_SN5659__cal_impl.Encode4_P10_j "" VALUE 0x008EB958 Scalar_FLOAT64_IEEE 0 speedgoat_test_SN5659_R2020b_CM_double -1.7E+308 1.7E+308 /end CHARACTERISTIC
/begin CHARACTERISTIC speedgoat_test_SN5659__cal_impl.Encode4_P10_k "" VALUE 0x008EB2E8 Scalar_FLOAT64_IEEE 0 speedgoat_test_SN5659_R2020b_CM_double -1.7E+308 1.7E+308 /end CHARACTERISTIC
/begin CHARACTERISTIC speedgoat_test_SN5659__cal_impl.Encode4_P10_o "" VALUE 0x008E9F98 Scalar_FLOAT64_IEEE 0 speedgoat_test_SN5659_R2020b_CM_double -1.7E+308 1.7E+308 /end CHARACTERISTIC
/begin CHARACTERISTIC speedgoat_test_SN5659__cal_impl.Encode4_P10_o2 "" VALUE 0x008EAC78 Scalar_FLOAT64_IEEE 0 speedgoat_test_SN5659_R2020b_CM_double -1.7E+308 1.7E+308 /end CHARACTERISTIC
/begin CHARACTERISTIC speedgoat_test_SN5659__cal_impl.Encode4_P10_o4 "" VALUE 0x008EBFC8 Scalar_FLOAT64_IEEE 0 speedgoat_test_SN5659_R2020b_CM_double -1.7E+308 1.7E+308 /end CHARACTERISTIC
/begin CHARACTERISTIC speedgoat_test_SN5659__cal_impl.Encode4_P11_c "" VAL_BLK 0x008EBFE0 Scalar_FLOAT64_IEEE 0 speedgoat_test_SN5659_R2020b_CM_double -1.7E+308 1.7E+308 MATRIX_DIM 2 1 /end CHARACTERISTIC
/begin CHARACTERISTIC speedgoat_test_SN5659__cal_impl.Encode4_P11_e "" VAL_BLK 0x008EB970 Scalar_FLOAT64_IEEE 0 speedgoat_test_SN5659_R2020b_CM_double -1.7E+308 1.7E+308 MATRIX_DIM 2 1 /end CHARACTERISTIC
/begin CHARACTERISTIC speedgoat_test_SN5659__cal_impl.Encode4_P11_jr "" VAL_BLK 0x008EC650 Scalar_FLOAT64_IEEE 0 speedgoat_test_SN5659_R2020b_CM_double -1.7E+308 1.7E+308 MATRIX_DIM 2 1 /end CHARACTERISTIC
/begin CHARACTERISTIC speedgoat_test_SN5659__cal_impl.Encode4_P11_o "" VAL_BLK 0x008E9FB0 Scalar_FLOAT64_IEEE 0 speedgoat_test_SN5659_R2020b_CM_double -1.7E+308 1.7E+308 MATRIX_DIM 2 1 /end CHARACTERISTIC
/begin CHARACTERISTIC speedgoat_test_SN5659__cal_impl.Encode4_P11_p "" VAL_BLK 0x008EAC90 Scalar_FLOAT64_IEEE 0 speedgoat_test_SN5659_R2020b_CM_double -1.7E+308 1.7E+308 MATRIX_DIM 2 1 /end CHARACTERISTIC
/begin CHARACTERISTIC speedgoat_test_SN5659__cal_impl.Encode4_P11_pb "" VAL_BLK 0x008EB300 Scalar_FLOAT64_IEEE 0 speedgoat_test_SN5659_R2020b_CM_double -1.7E+308 1.7E+308 MATRIX_DIM 2 1 /end CHARACTERISTIC
/begin CHARACTERISTIC speedgoat_test_SN5659__cal_impl.Encode4_P12_d "" VALUE 0x008E9FD0 Scalar_FLOAT64_IEEE 0 speedgoat_test_SN5659_R2020b_CM_double -1.7E+308 1.7E+308 /end CHARACTERISTIC
/begin CHARACTERISTIC speedgoat_test_SN5659__cal_impl.Encode4_P12_e "" VALUE 0x008EB320 Scalar_FLOAT64_IEEE 0 speedgoat_test_SN5659_R2020b_CM_double -1.7E+308 1.7E+308 /end CHARACTERISTIC
/begin CHARACTERISTIC speedgoat_test_SN5659__cal_impl.Encode4_P12_g "" VALUE 0x008EC670 Scalar_FLOAT64_IEEE 0 speedgoat_test_SN5659_R2020b_CM_double -1.7E+308 1.7E+308 /end CHARACTERISTIC
/begin CHARACTERISTIC speedgoat_test_SN5659__cal_impl.Encode4_P12_h "" VALUE 0x008EACB0 Scalar_FLOAT64_IEEE 0 speedgoat_test_SN5659_R2020b_CM_double -1.7E+308 1.7E+308 /end CHARACTERISTIC
/begin CHARACTERISTIC speedgoat_test_SN5659__cal_impl.Encode4_P12_lr "" VALUE 0x008EC000 Scalar_FLOAT64_IEEE 0 speedgoat_test_SN5659_R2020b_CM_double -1.7E+308 1.7E+308 /end CHARACTERISTIC
/begin CHARACTERISTIC speedgoat_test_SN5659__cal_impl.Encode4_P12_o "" VALUE 0x008EB990 Scalar_FLOAT64_IEEE 0 speedgoat_test_SN5659_R2020b_CM_double -1.7E+308 1.7E+308 /end CHARACTERISTIC
/begin CHARACTERISTIC speedgoat_test_SN5659__cal_impl.Encode4_P13_d "" VALUE 0x008EC688 Scalar_FLOAT64_IEEE 0 speedgoat_test_SN5659_R2020b_CM_double -1.7E+308 1.7E+308 /end CHARACTERISTIC
/begin CHARACTERISTIC speedgoat_test_SN5659__cal_impl.Encode4_P13_f "" VALUE 0x008E9FE8 Scalar_FLOAT64_IEEE 0 speedgoat_test_SN5659_R2020b_CM_double -1.7E+308 1.7E+308 /end CHARACTERISTIC
/begin CHARACTERISTIC speedgoat_test_SN5659__cal_impl.Encode4_P13_h "" VALUE 0x008EB9A8 Scalar_FLOAT64_IEEE 0 speedgoat_test_SN5659_R2020b_CM_double -1.7E+308 1.7E+308 /end CHARACTERISTIC
/begin CHARACTERISTIC speedgoat_test_SN5659__cal_impl.Encode4_P13_m "" VALUE 0x008EC018 Scalar_FLOAT64_IEEE 0 speedgoat_test_SN5659_R2020b_CM_double -1.7E+308 1.7E+308 /end CHARACTERISTIC
/begin CHARACTERISTIC speedgoat_test_SN5659__cal_impl.Encode4_P13_o "" VALUE 0x008EACC8 Scalar_FLOAT64_IEEE 0 speedgoat_test_SN5659_R2020b_CM_double -1.7E+308 1.7E+308 /end CHARACTERISTIC
/begin CHARACTERISTIC speedgoat_test_SN5659__cal_impl.Encode4_P13_p "" VALUE 0x008EB338 Scalar_FLOAT64_IEEE 0 speedgoat_test_SN5659_R2020b_CM_double -1.7E+308 1.7E+308 /end CHARACTERISTIC
/begin CHARACTERISTIC speedgoat_test_SN5659__cal_impl.Encode4_P14_b "" VALUE 0x008EB350 Scalar_FLOAT64_IEEE 0 speedgoat_test_SN5659_R2020b_CM_double -1.7E+308 1.7E+308 /end CHARACTERISTIC
/begin CHARACTERISTIC speedgoat_test_SN5659__cal_impl.Encode4_P14_g "" VALUE 0x008EC6A0 Scalar_FLOAT64_IEEE 0 speedgoat_test_SN5659_R2020b_CM_double -1.7E+308 1.7E+308 /end CHARACTERISTIC
/begin CHARACTERISTIC speedgoat_test_SN5659__cal_impl.Encode4_P14_j "" VALUE 0x008EA000 Scalar_FLOAT64_IEEE 0 speedgoat_test_SN5659_R2020b_CM_double -1.7E+308 1.7E+308 /end CHARACTERISTIC
/begin CHARACTERISTIC speedgoat_test_SN5659__cal_impl.Encode4_P14_lr "" VALUE 0x008EACE0 Scalar_FLOAT64_IEEE 0 speedgoat_test_SN5659_R2020b_CM_double -1.7E+308 1.7E+308 /end CHARACTERISTIC
/begin CHARACTERISTIC speedgoat_test_SN5659__cal_impl.Encode4_P14_m "" VALUE 0x008EB9C0 Scalar_FLOAT64_IEEE 0 speedgoat_test_SN5659_R2020b_CM_double -1.7E+308 1.7E+308 /end CHARACTERISTIC
/begin CHARACTERISTIC speedgoat_test_SN5659__cal_impl.Encode4_P14_mx "" VALUE 0x008EC030 Scalar_FLOAT64_IEEE 0 speedgoat_test_SN5659_R2020b_CM_double -1.7E+308 1.7E+308 /end CHARACTERISTIC
/begin CHARACTERISTIC speedgoat_test_SN5659__cal_impl.Encode4_P15_a "" VALUE 0x008EACF8 Scalar_FLOAT64_IEEE 0 speedgoat_test_SN5659_R2020b_CM_double -1.7E+308 1.7E+308 /end CHARACTERISTIC
/begin CHARACTERISTIC speedgoat_test_SN5659__cal_impl.Encode4_P15_f "" VALUE 0x008EB9D8 Scalar_FLOAT64_IEEE 0 speedgoat_test_SN5659_R2020b_CM_double -1.7E+308 1.7E+308 /end CHARACTERISTIC
/begin CHARACTERISTIC speedgoat_test_SN5659__cal_impl.Encode4_P15_g "" VALUE 0x008EA018 Scalar_FLOAT64_IEEE 0 speedgoat_test_SN5659_R2020b_CM_double -1.7E+308 1.7E+308 /end CHARACTERISTIC
/begin CHARACTERISTIC speedgoat_test_SN5659__cal_impl.Encode4_P15_h "" VALUE 0x008EC6B8 Scalar_FLOAT64_IEEE 0 speedgoat_test_SN5659_R2020b_CM_double -1.7E+308 1.7E+308 /end CHARACTERISTIC
/begin CHARACTERISTIC speedgoat_test_SN5659__cal_impl.Encode4_P15_k "" VALUE 0x008EC048 Scalar_FLOAT64_IEEE 0 speedgoat_test_SN5659_R2020b_CM_double -1.7E+308 1.7E+308 /end CHARACTERISTIC
/begin CHARACTERISTIC speedgoat_test_SN5659__cal_impl.Encode4_P15_l "" VALUE 0x008EB368 Scalar_FLOAT64_IEEE 0 speedgoat_test_SN5659_R2020b_CM_double -1.7E+308 1.7E+308 /end CHARACTERISTIC
/begin CHARACTERISTIC speedgoat_test_SN5659__cal_impl.Encode4_P1_a "" VALUE 0x008EB880 Scalar_FLOAT64_IEEE 0 speedgoat_test_SN5659_R2020b_CM_double -1.7E+308 1.7E+308 /end CHARACTERISTIC
/begin CHARACTERISTIC speedgoat_test_SN5659__cal_impl.Encode4_P1_f "" VALUE 0x008E9EC0 Scalar_FLOAT64_IEEE 0 speedgoat_test_SN5659_R2020b_CM_double -1.7E+308 1.7E+308 /end CHARACTERISTIC
/begin CHARACTERISTIC speedgoat_test_SN5659__cal_impl.Encode4_P1_fl "" VALUE 0x008EABA0 Scalar_FLOAT64_IEEE 0 speedgoat_test_SN5659_R2020b_CM_double -1.7E+308 1.7E+308 /end CHARACTERISTIC
/begin CHARACTERISTIC speedgoat_test_SN5659__cal_impl.Encode4_P1_g "" VALUE 0x008EBEF0 Scalar_FLOAT64_IEEE 0 speedgoat_test_SN5659_R2020b_CM_double -1.7E+308 1.7E+308 /end CHARACTERISTIC
/begin CHARACTERISTIC speedgoat_test_SN5659__cal_impl.Encode4_P1_n "" VALUE 0x008EB210 Scalar_FLOAT64_IEEE 0 speedgoat_test_SN5659_R2020b_CM_double -1.7E+308 1.7E+308 /end CHARACTERISTIC
/begin CHARACTERISTIC speedgoat_test_SN5659__cal_impl.Encode4_P1_ns "" VALUE 0x008EC560 Scalar_FLOAT64_IEEE 0 speedgoat_test_SN5659_R2020b_CM_double -1.7E+308 1.7E+308 /end CHARACTERISTIC
/begin CHARACTERISTIC speedgoat_test_SN5659__cal_impl.Encode4_P2_dd "" VALUE 0x008EB228 Scalar_FLOAT64_IEEE 0 speedgoat_test_SN5659_R2020b_CM_double -1.7E+308 1.7E+308 /end CHARACTERISTIC
/begin CHARACTERISTIC speedgoat_test_SN5659__cal_impl.Encode4_P2_f "" VALUE 0x008EABB8 Scalar_FLOAT64_IEEE 0 speedgoat_test_SN5659_R2020b_CM_double -1.7E+308 1.7E+308 /end CHARACTERISTIC
/begin CHARACTERISTIC speedgoat_test_SN5659__cal_impl.Encode4_P2_g "" VALUE 0x008EC578 Scalar_FLOAT64_IEEE 0 speedgoat_test_SN5659_R2020b_CM_double -1.7E+308 1.7E+308 /end CHARACTERISTIC
/begin CHARACTERISTIC speedgoat_test_SN5659__cal_impl.Encode4_P2_h "" VALUE 0x008EBF08 Scalar_FLOAT64_IEEE 0 speedgoat_test_SN5659_R2020b_CM_double -1.7E+308 1.7E+308 /end CHARACTERISTIC
/begin CHARACTERISTIC speedgoat_test_SN5659__cal_impl.Encode4_P2_l "" VALUE 0x008E9ED8 Scalar_FLOAT64_IEEE 0 speedgoat_test_SN5659_R2020b_CM_double -1.7E+308 1.7E+308 /end CHARACTERISTIC
/begin CHARACTERISTIC speedgoat_test_SN5659__cal_impl.Encode4_P2_p "" VALUE 0x008EB898 Scalar_FLOAT64_IEEE 0 speedgoat_test_SN5659_R2020b_CM_double -1.7E+308 1.7E+308 /end CHARACTERISTIC
/begin CHARACTERISTIC speedgoat_test_SN5659__cal_impl.Encode4_P3_a "" VALUE 0x008EB8B0 Scalar_FLOAT64_IEEE 0 speedgoat_test_SN5659_R2020b_CM_double -1.7E+308 1.7E+308 /end CHARACTERISTIC
/begin CHARACTERISTIC speedgoat_test_SN5659__cal_impl.Encode4_P3_b "" VALUE 0x008EB240 Scalar_FLOAT64_IEEE 0 speedgoat_test_SN5659_R2020b_CM_double -1.7E+308 1.7E+308 /end CHARACTERISTIC
/begin CHARACTERISTIC speedgoat_test_SN5659__cal_impl.Encode4_P3_h "" VALUE 0x008EABD0 Scalar_FLOAT64_IEEE 0 speedgoat_test_SN5659_R2020b_CM_double -1.7E+308 1.7E+308 /end CHARACTERISTIC
/begin CHARACTERISTIC speedgoat_test_SN5659__cal_impl.Encode4_P3_m "" VALUE 0x008EBF20 Scalar_FLOAT64_IEEE 0 speedgoat_test_SN5659_R2020b_CM_double -1.7E+308 1.7E+308 /end CHARACTERISTIC
/begin CHARACTERISTIC speedgoat_test_SN5659__cal_impl.Encode4_P3_n "" VALUE 0x008EC590 Scalar_FLOAT64_IEEE 0 speedgoat_test_SN5659_R2020b_CM_double -1.7E+308 1.7E+308 /end CHARACTERISTIC
/begin CHARACTERISTIC speedgoat_test_SN5659__cal_impl.Encode4_P3_p "" VALUE 0x008E9EF0 Scalar_FLOAT64_IEEE 0 speedgoat_test_SN5659_R2020b_CM_double -1.7E+308 1.7E+308 /end CHARACTERISTIC
/begin CHARACTERISTIC speedgoat_test_SN5659__cal_impl.Encode4_P4_b "" VALUE 0x008EABE8 Scalar_FLOAT64_IEEE 0 speedgoat_test_SN5659_R2020b_CM_double -1.7E+308 1.7E+308 /end CHARACTERISTIC
/begin CHARACTERISTIC speedgoat_test_SN5659__cal_impl.Encode4_P4_h "" VALUE 0x008EB258 Scalar_FLOAT64_IEEE 0 speedgoat_test_SN5659_R2020b_CM_double -1.7E+308 1.7E+308 /end CHARACTERISTIC
/begin CHARACTERISTIC speedgoat_test_SN5659__cal_impl.Encode4_P4_i "" VALUE 0x008EBF38 Scalar_FLOAT64_IEEE 0 speedgoat_test_SN5659_R2020b_CM_double -1.7E+308 1.7E+308 /end CHARACTERISTIC
/begin CHARACTERISTIC speedgoat_test_SN5659__cal_impl.Encode4_P4_k "" VALUE 0x008E9F08 Scalar_FLOAT64_IEEE 0 speedgoat_test_SN5659_R2020b_CM_double -1.7E+308 1.7E+308 /end CHARACTERISTIC
/begin CHARACTERISTIC speedgoat_test_SN5659__cal_impl.Encode4_P4_l "" VALUE 0x008EB8C8 Scalar_FLOAT64_IEEE 0 speedgoat_test_SN5659_R2020b_CM_double -1.7E+308 1.7E+308 /end CHARACTERISTIC
/begin CHARACTERISTIC speedgoat_test_SN5659__cal_impl.Encode4_P4_m "" VALUE 0x008EC5A8 Scalar_FLOAT64_IEEE 0 speedgoat_test_SN5659_R2020b_CM_double -1.7E+308 1.7E+308 /end CHARACTERISTIC
/begin CHARACTERISTIC speedgoat_test_SN5659__cal_impl.Encode4_P5_i "" VALUE 0x008EB8E0 Scalar_FLOAT64_IEEE 0 speedgoat_test_SN5659_R2020b_CM_double -1.7E+308 1.7E+308 /end CHARACTERISTIC
/begin CHARACTERISTIC speedgoat_test_SN5659__cal_impl.Encode4_P5_j "" VALUE 0x008EBF50 Scalar_FLOAT64_IEEE 0 speedgoat_test_SN5659_R2020b_CM_double -1.7E+308 1.7E+308 /end CHARACTERISTIC
/begin CHARACTERISTIC speedgoat_test_SN5659__cal_impl.Encode4_P5_k "" VALUE 0x008EC5C0 Scalar_FLOAT64_IEEE 0 speedgoat_test_SN5659_R2020b_CM_double -1.7E+308 1.7E+308 /end CHARACTERISTIC
/begin CHARACTERISTIC speedgoat_test_SN5659__cal_impl.Encode4_P5_l "" VALUE 0x008EB270 Scalar_FLOAT64_IEEE 0 speedgoat_test_SN5659_R2020b_CM_double -1.7E+308 1.7E+308 /end CHARACTERISTIC
/begin CHARACTERISTIC speedgoat_test_SN5659__cal_impl.Encode4_P5_o "" VALUE 0x008EAC00 Scalar_FLOAT64_IEEE 0 speedgoat_test_SN5659_R2020b_CM_double -1.7E+308 1.7E+308 /end CHARACTERISTIC
/begin CHARACTERISTIC speedgoat_test_SN5659__cal_impl.Encode4_P5_p "" VALUE 0x008E9F20 Scalar_FLOAT64_IEEE 0 speedgoat_test_SN5659_R2020b_CM_double -1.7E+308 1.7E+308 /end CHARACTERISTIC
/begin CHARACTERISTIC speedgoat_test_SN5659__cal_impl.Encode4_P6_d "" VALUE 0x008EB8F8 Scalar_FLOAT64_IEEE 0 speedgoat_test_SN5659_R2020b_CM_double -1.7E+308 1.7E+308 /end CHARACTERISTIC
/begin CHARACTERISTIC speedgoat_test_SN5659__cal_impl.Encode4_P6_e "" VALUE 0x008EC5D8 Scalar_FLOAT64_IEEE 0 speedgoat_test_SN5659_R2020b_CM_double -1.7E+308 1.7E+308 /end CHARACTERISTIC
/begin CHARACTERISTIC speedgoat_test_SN5659__cal_impl.Encode4_P6_k "" VALUE 0x008E9F38 Scalar_FLOAT64_IEEE 0 speedgoat_test_SN5659_R2020b_CM_double -1.7E+308 1.7E+308 /end CHARACTERISTIC
/begin CHARACTERISTIC speedgoat_test_SN5659__cal_impl.Encode4_P6_kc "" VALUE 0x008EAC18 Scalar_FLOAT64_IEEE 0 speedgoat_test_SN5659_R2020b_CM_double -1.7E+308 1.7E+308 /end CHARACTERISTIC
/begin CHARACTERISTIC speedgoat_test_SN5659__cal_impl.Encode4_P6_l "" VALUE 0x008EB288 Scalar_FLOAT64_IEEE 0 speedgoat_test_SN5659_R2020b_CM_double -1.7E+308 1.7E+308 /end CHARACTERISTIC
/begin CHARACTERISTIC speedgoat_test_SN5659__cal_impl.Encode4_P6_n "" VALUE 0x008EBF68 Scalar_FLOAT64_IEEE 0 speedgoat_test_SN5659_R2020b_CM_double -1.7E+308 1.7E+308 /end CHARACTERISTIC
/begin CHARACTERISTIC speedgoat_test_SN5659__cal_impl.Encode4_P7_b "" VALUE 0x008EB910 Scalar_FLOAT64_IEEE 0 speedgoat_test_SN5659_R2020b_CM_double -1.7E+308 1.7E+308 /end CHARACTERISTIC
/begin CHARACTERISTIC speedgoat_test_SN5659__cal_impl.Encode4_P7_c "" VALUE 0x008E9F50 Scalar_FLOAT64_IEEE 0 speedgoat_test_SN5659_R2020b_CM_double -1.7E+308 1.7E+308 /end CHARACTERISTIC
/begin CHARACTERISTIC speedgoat_test_SN5659__cal_impl.Encode4_P7_d "" VALUE 0x008EAC30 Scalar_FLOAT64_IEEE 0 speedgoat_test_SN5659_R2020b_CM_double -1.7E+308 1.7E+308 /end CHARACTERISTIC
/begin CHARACTERISTIC speedgoat_test_SN5659__cal_impl.Encode4_P7_l "" VALUE 0x008EB2A0 Scalar_FLOAT64_IEEE 0 speedgoat_test_SN5659_R2020b_CM_double -1.7E+308 1.7E+308 /end CHARACTERISTIC
/begin CHARACTERISTIC speedgoat_test_SN5659__cal_impl.Encode4_P7_pf "" VALUE 0x008EBF80 Scalar_FLOAT64_IEEE 0 speedgoat_test_SN5659_R2020b_CM_double -1.7E+308 1.7E+308 /end CHARACTERISTIC
/begin CHARACTERISTIC speedgoat_test_SN5659__cal_impl.Encode4_P7_pm "" VALUE 0x008EC5F0 Scalar_FLOAT64_IEEE 0 speedgoat_test_SN5659_R2020b_CM_double -1.7E+308 1.7E+308 /end CHARACTERISTIC
/begin CHARACTERISTIC speedgoat_test_SN5659__cal_impl.Encode4_P8_f "" VALUE 0x008EC608 Scalar_FLOAT64_IEEE 0 speedgoat_test_SN5659_R2020b_CM_double -1.7E+308 1.7E+308 /end CHARACTERISTIC
/begin CHARACTERISTIC speedgoat_test_SN5659__cal_impl.Encode4_P8_h "" VALUE 0x008EB2B8 Scalar_FLOAT64_IEEE 0 speedgoat_test_SN5659_R2020b_CM_double -1.7E+308 1.7E+308 /end CHARACTERISTIC
/begin CHARACTERISTIC speedgoat_test_SN5659__cal_impl.Encode4_P8_j "" VALUE 0x008E9F68 Scalar_FLOAT64_IEEE 0 speedgoat_test_SN5659_R2020b_CM_double -1.7E+308 1.7E+308 /end CHARACTERISTIC
/begin CHARACTERISTIC speedgoat_test_SN5659__cal_impl.Encode4_P8_k "" VALUE 0x008EB928 Scalar_FLOAT64_IEEE 0 speedgoat_test_SN5659_R2020b_CM_double -1.7E+308 1.7E+308 /end CHARACTERISTIC
/begin CHARACTERISTIC speedgoat_test_SN5659__cal_impl.Encode4_P8_l "" VALUE 0x008EBF98 Scalar_FLOAT64_IEEE 0 speedgoat_test_SN5659_R2020b_CM_double -1.7E+308 1.7E+308 /end CHARACTERISTIC
/begin CHARACTERISTIC speedgoat_test_SN5659__cal_impl.Encode4_P8_oo "" VALUE 0x008EAC48 Scalar_FLOAT64_IEEE 0 speedgoat_test_SN5659_R2020b_CM_double -1.7E+308 1.7E+308 /end CHARACTERISTIC
/begin CHARACTERISTIC speedgoat_test_SN5659__cal_impl.Encode4_P9_c "" VALUE 0x008E9F80 Scalar_FLOAT64_IEEE 0 speedgoat_test_SN5659_R2020b_CM_double -1.7E+308 1.7E+308 /end CHARACTERISTIC
/begin CHARACTERISTIC speedgoat_test_SN5659__cal_impl.Encode4_P9_e "" VALUE 0x008EB2D0 Scalar_FLOAT64_IEEE 0 speedgoat_test_SN5659_R2020b_CM_double -1.7E+308 1.7E+308 /end CHARACTERISTIC
/begin CHARACTERISTIC speedgoat_test_SN5659__cal_impl.Encode4_P9_f "" VALUE 0x008EC620 Scalar_FLOAT64_IEEE 0 speedgoat_test_SN5659_R2020b_CM_double -1.7E+308 1.7E+308 /end CHARACTERISTIC
/begin CHARACTERISTIC speedgoat_test_SN5659__cal_impl.Encode4_P9_n "" VALUE 0x008EAC60 Scalar_FLOAT64_IEEE 0 speedgoat_test_SN5659_R2020b_CM_double -1.7E+308 1.7E+308 /end CHARACTERISTIC
/begin CHARACTERISTIC speedgoat_test_SN5659__cal_impl.Encode4_P9_ns "" VALUE 0x008EBFB0 Scalar_FLOAT64_IEEE 0 speedgoat_test_SN5659_R2020b_CM_double -1.7E+308 1.7E+308 /end CHARACTERISTIC
/begin CHARACTERISTIC speedgoat_test_SN5659__cal_impl.Encode4_P9_p "" VALUE 0x008EB940 Scalar_FLOAT64_IEEE 0 speedgoat_test_SN5659_R2020b_CM_double -1.7E+308 1.7E+308 /end CHARACTERISTIC
/begin CHARACTERISTIC speedgoat_test_SN5659__cal_impl.Encode5_P10_a "" VALUE 0x008EA2D8 Scalar_FLOAT64_IEEE 0 speedgoat_test_SN5659_R2020b_CM_double -1.7E+308 1.7E+308 /end CHARACTERISTIC
/begin CHARACTERISTIC speedgoat_test_SN5659__cal_impl.Encode5_P11_n "" VAL_BLK 0x008EA2F0 Scalar_FLOAT64_IEEE 0 speedgoat_test_SN5659_R2020b_CM_double -1.7E+308 1.7E+308 MATRIX_DIM 2 1 /end CHARACTERISTIC
/begin CHARACTERISTIC speedgoat_test_SN5659__cal_impl.Encode5_P12_m "" VALUE 0x008EA310 Scalar_FLOAT64_IEEE 0 speedgoat_test_SN5659_R2020b_CM_double -1.7E+308 1.7E+308 /end CHARACTERISTIC
/begin CHARACTERISTIC speedgoat_test_SN5659__cal_impl.Encode5_P13_g "" VALUE 0x008EA328 Scalar_FLOAT64_IEEE 0 speedgoat_test_SN5659_R2020b_CM_double -1.7E+308 1.7E+308 /end CHARACTERISTIC
/begin CHARACTERISTIC speedgoat_test_SN5659__cal_impl.Encode5_P14_l "" VALUE 0x008EA340 Scalar_FLOAT64_IEEE 0 speedgoat_test_SN5659_R2020b_CM_double -1.7E+308 1.7E+308 /end CHARACTERISTIC
/begin CHARACTERISTIC speedgoat_test_SN5659__cal_impl.Encode5_P15_c "" VALUE 0x008EA358 Scalar_FLOAT64_IEEE 0 speedgoat_test_SN5659_R2020b_CM_double -1.7E+308 1.7E+308 /end CHARACTERISTIC
/begin CHARACTERISTIC speedgoat_test_SN5659__cal_impl.Encode5_P1_f "" VALUE 0x008EA200 Scalar_FLOAT64_IEEE 0 speedgoat_test_SN5659_R2020b_CM_double -1.7E+308 1.7E+308 /end CHARACTERISTIC
/begin CHARACTERISTIC speedgoat_test_SN5659__cal_impl.Encode5_P2_e "" VALUE 0x008EA218 Scalar_FLOAT64_IEEE 0 speedgoat_test_SN5659_R2020b_CM_double -1.7E+308 1.7E+308 /end CHARACTERISTIC
/begin CHARACTERISTIC speedgoat_test_SN5659__cal_impl.Encode5_P3_m "" VALUE 0x008EA230 Scalar_FLOAT64_IEEE 0 speedgoat_test_SN5659_R2020b_CM_double -1.7E+308 1.7E+308 /end CHARACTERISTIC
/begin CHARACTERISTIC speedgoat_test_SN5659__cal_impl.Encode5_P4_a "" VALUE 0x008EA248 Scalar_FLOAT64_IEEE 0 speedgoat_test_SN5659_R2020b_CM_double -1.7E+308 1.7E+308 /end CHARACTERISTIC
/begin CHARACTERISTIC speedgoat_test_SN5659__cal_impl.Encode5_P5_i "" VALUE 0x008EA260 Scalar_FLOAT64_IEEE 0 speedgoat_test_SN5659_R2020b_CM_double -1.7E+308 1.7E+308 /end CHARACTERISTIC
/begin CHARACTERISTIC speedgoat_test_SN5659__cal_impl.Encode5_P6_d "" VALUE 0x008EA278 Scalar_FLOAT64_IEEE 0 speedgoat_test_SN5659_R2020b_CM_double -1.7E+308 1.7E+308 /end CHARACTERISTIC
/begin CHARACTERISTIC speedgoat_test_SN5659__cal_impl.Encode5_P7_f "" VALUE 0x008EA290 Scalar_FLOAT64_IEEE 0 speedgoat_test_SN5659_R2020b_CM_double -1.7E+308 1.7E+308 /end CHARACTERISTIC
/begin CHARACTERISTIC speedgoat_test_SN5659__cal_impl.Encode5_P8_k "" VALUE 0x008EA2A8 Scalar_FLOAT64_IEEE 0 speedgoat_test_SN5659_R2020b_CM_double -1.7E+308 1.7E+308 /end CHARACTERISTIC
/begin CHARACTERISTIC speedgoat_test_SN5659__cal_impl.Encode5_P9_l "" VALUE 0x008EA2C0 Scalar_FLOAT64_IEEE 0 speedgoat_test_SN5659_R2020b_CM_double -1.7E+308 1.7E+308 /end CHARACTERISTIC
/begin CHARACTERISTIC speedgoat_test_SN5659__cal_impl.FixPtConstant_Value_h "" VALUE 0x008EFCFD Scalar_UBYTE 0 speedgoat_test_SN5659_R2020b_CM_uint8 0 255 /end CHARACTERISTIC
/begin CHARACTERISTIC speedgoat_test_SN5659__cal_impl.FixPtConstant_Value_i "" VALUE 0x008EFCCE Scalar_UWORD 0 speedgoat_test_SN5659_R2020b_CM_uint16 0 65535 /end CHARACTERISTIC
/begin CHARACTERISTIC speedgoat_test_SN5659__cal_impl.FixPtConstant_Value_j "" VALUE 0x008EFCC2 Scalar_UWORD 0 speedgoat_test_SN5659_R2020b_CM_uint16 0 65535 /end CHARACTERISTIC
/begin CHARACTERISTIC speedgoat_test_SN5659__cal_impl.FixPtConstant_Value_k0 "" VALUE 0x008EFD00 Scalar_UBYTE 0 speedgoat_test_SN5659_R2020b_CM_uint8 0 255 /end CHARACTERISTIC
/begin CHARACTERISTIC speedgoat_test_SN5659__cal_impl.FixPtConstant_Value_l "" VALUE 0x008EFCC8 Scalar_UWORD 0 speedgoat_test_SN5659_R2020b_CM_uint16 0 65535 /end CHARACTERISTIC
/begin CHARACTERISTIC speedgoat_test_SN5659__cal_impl.FixPtConstant_Value_o "" VALUE 0x008EFCB6 Scalar_UWORD 0 speedgoat_test_SN5659_R2020b_CM_uint16 0 65535 /end CHARACTERISTIC
/begin CHARACTERISTIC speedgoat_test_SN5659__cal_impl.FixPtConstant_Value_oq "" VALUE 0x008EFCD4 Scalar_UWORD 0 speedgoat_test_SN5659_R2020b_CM_uint16 0 65535 /end CHARACTERISTIC
/begin CHARACTERISTIC speedgoat_test_SN5659__cal_impl.FixPtConstant_Value_oz "" VALUE 0x008EFCBC Scalar_UWORD 0 speedgoat_test_SN5659_R2020b_CM_uint16 0 65535 /end CHARACTERISTIC
/begin CHARACTERISTIC speedgoat_test_SN5659__cal_impl.Label_Value "" VALUE 0x008EFBF0 Scalar_ULONG 0 speedgoat_test_SN5659_R2020b_CM_uint32 0 2147483646 /end CHARACTERISTIC
/begin CHARACTERISTIC speedgoat_test_SN5659__cal_impl.Label_Value_b "" VALUE 0x008EFC38 Scalar_ULONG 0 speedgoat_test_SN5659_R2020b_CM_uint32 0 2147483646 /end CHARACTERISTIC
/begin CHARACTERISTIC speedgoat_test_SN5659__cal_impl.Label_Value_ex "" VALUE 0x008EFC20 Scalar_ULONG 0 speedgoat_test_SN5659_R2020b_CM_uint32 0 2147483646 /end CHARACTERISTIC
/begin CHARACTERISTIC speedgoat_test_SN5659__cal_impl.Label_Value_f "" VALUE 0x008EFC2C Scalar_ULONG 0 speedgoat_test_SN5659_R2020b_CM_uint32 0 2147483646 /end CHARACTERISTIC
/begin CHARACTERISTIC speedgoat_test_SN5659__cal_impl.Label_Value_fv "" VALUE 0x008EFC5C Scalar_ULONG 0 speedgoat_test_SN5659_R2020b_CM_uint32 0 2147483646 /end CHARACTERISTIC
/begin CHARACTERISTIC speedgoat_test_SN5659__cal_impl.Label_Value_j "" VALUE 0x008EFC14 Scalar_ULONG 0 speedgoat_test_SN5659_R2020b_CM_uint32 0 2147483646 /end CHARACTERISTIC
/begin CHARACTERISTIC speedgoat_test_SN5659__cal_impl.Label_Value_k "" VALUE 0x008EFC44 Scalar_ULONG 0 speedgoat_test_SN5659_R2020b_CM_uint32 0 2147483646 /end CHARACTERISTIC
/begin CHARACTERISTIC speedgoat_test_SN5659__cal_impl.Label_Value_n "" VALUE 0x008EFC50 Scalar_ULONG 0 speedgoat_test_SN5659_R2020b_CM_uint32 0 2147483646 /end CHARACTERISTIC
/begin CHARACTERISTIC speedgoat_test_SN5659__cal_impl.Mask_BitMask "" VALUE 0x008DF020 Scalar_ULONG 0 speedgoat_test_SN5659_R2020b_CM_uint32 0 2147483646 /end CHARACTERISTIC
/begin CHARACTERISTIC speedgoat_test_SN5659__cal_impl.Mask_BitMask_a "" VALUE 0x008DF03C Scalar_ULONG 0 speedgoat_test_SN5659_R2020b_CM_uint32 0 2147483646 /end CHARACTERISTIC
/begin CHARACTERISTIC speedgoat_test_SN5659__cal_impl.Mask_BitMask_d "" VALUE 0x008DF02C Scalar_ULONG 0 speedgoat_test_SN5659_R2020b_CM_uint32 0 2147483646 /end CHARACTERISTIC
/begin CHARACTERISTIC speedgoat_test_SN5659__cal_impl.Mask_BitMask_e "" VALUE 0x008DF030 Scalar_ULONG 0 speedgoat_test_SN5659_R2020b_CM_uint32 0 2147483646 /end CHARACTERISTIC
/begin CHARACTERISTIC speedgoat_test_SN5659__cal_impl.Mask_BitMask_e3 "" VALUE 0x008DF044 Scalar_ULONG 0 speedgoat_test_SN5659_R2020b_CM_uint32 0 2147483646 /end CHARACTERISTIC
/begin CHARACTERISTIC speedgoat_test_SN5659__cal_impl.Mask_BitMask_l "" VALUE 0x008DF040 Scalar_ULONG 0 speedgoat_test_SN5659_R2020b_CM_uint32 0 2147483646 /end CHARACTERISTIC
/begin CHARACTERISTIC speedgoat_test_SN5659__cal_impl.Mask_BitMask_p "" VALUE 0x008DF034 Scalar_ULONG 0 speedgoat_test_SN5659_R2020b_CM_uint32 0 2147483646 /end CHARACTERISTIC
/begin CHARACTERISTIC speedgoat_test_SN5659__cal_impl.Mask_BitMask_pd "" VALUE 0x008DF038 Scalar_ULONG 0 speedgoat_test_SN5659_R2020b_CM_uint32 0 2147483646 /end CHARACTERISTIC
/begin CHARACTERISTIC speedgoat_test_SN5659__cal_impl.Output_InitialCondition_b "" VALUE 0x008EFCFC Scalar_UBYTE 0 speedgoat_test_SN5659_R2020b_CM_uint8 0 255 /end CHARACTERISTIC
/begin CHARACTERISTIC speedgoat_test_SN5659__cal_impl.Output_InitialCondition_c "" VALUE 0x008EFCB4 Scalar_UWORD 0 speedgoat_test_SN5659_R2020b_CM_uint16 0 65535 /end CHARACTERISTIC
/begin CHARACTERISTIC speedgoat_test_SN5659__cal_impl.Output_InitialCondition_e "" VALUE 0x008EFCC0 Scalar_UWORD 0 speedgoat_test_SN5659_R2020b_CM_uint16 0 65535 /end CHARACTERISTIC
/begin CHARACTERISTIC speedgoat_test_SN5659__cal_impl.Output_InitialCondition_h "" VALUE 0x008EFCD2 Scalar_UWORD 0 speedgoat_test_SN5659_R2020b_CM_uint16 0 65535 /end CHARACTERISTIC
/begin CHARACTERISTIC speedgoat_test_SN5659__cal_impl.Output_InitialCondition_j "" VALUE 0x008EFCFF Scalar_UBYTE 0 speedgoat_test_SN5659_R2020b_CM_uint8 0 255 /end CHARACTERISTIC
/begin CHARACTERISTIC speedgoat_test_SN5659__cal_impl.Output_InitialCondition_k "" VALUE 0x008EFCBA Scalar_UWORD 0 speedgoat_test_SN5659_R2020b_CM_uint16 0 65535 /end CHARACTERISTIC
/begin CHARACTERISTIC speedgoat_test_SN5659__cal_impl.Output_InitialCondition_l "" VALUE 0x008EFCC6 Scalar_UWORD 0 speedgoat_test_SN5659_R2020b_CM_uint16 0 65535 /end CHARACTERISTIC
/begin CHARACTERISTIC speedgoat_test_SN5659__cal_impl.Output_InitialCondition_nl "" VALUE 0x008EFCCC Scalar_UWORD 0 speedgoat_test_SN5659_R2020b_CM_uint16 0 65535 /end CHARACTERISTIC
/begin CHARACTERISTIC speedgoat_test_SN5659__cal_impl.Randomnumber_Mean_a "" VALUE 0x008EA068 Scalar_FLOAT64_IEEE 0 speedgoat_test_SN5659_R2020b_CM_double -1.7E+308 1.7E+308 /end CHARACTERISTIC
/begin CHARACTERISTIC speedgoat_test_SN5659__cal_impl.Randomnumber_Mean_b "" VALUE 0x008EAD48 Scalar_FLOAT64_IEEE 0 speedgoat_test_SN5659_R2020b_CM_double -1.7E+308 1.7E+308 /end CHARACTERISTIC
/begin CHARACTERISTIC speedgoat_test_SN5659__cal_impl.Randomnumber_Mean_d "" VALUE 0x008EC098 Scalar_FLOAT64_IEEE 0 speedgoat_test_SN5659_R2020b_CM_double -1.7E+308 1.7E+308 /end CHARACTERISTIC
/begin CHARACTERISTIC speedgoat_test_SN5659__cal_impl.Randomnumber_Mean_f3 "" VALUE 0x008EBA28 Scalar_FLOAT64_IEEE 0 speedgoat_test_SN5659_R2020b_CM_double -1.7E+308 1.7E+308 /end CHARACTERISTIC
/begin CHARACTERISTIC speedgoat_test_SN5659__cal_impl.Randomnumber_Mean_fh "" VALUE 0x008EB3B8 Scalar_FLOAT64_IEEE 0 speedgoat_test_SN5659_R2020b_CM_double -1.7E+308 1.7E+308 /end CHARACTERISTIC
/begin CHARACTERISTIC speedgoat_test_SN5659__cal_impl.Randomnumber_Mean_fn "" VALUE 0x008E99F8 Scalar_FLOAT64_IEEE 0 speedgoat_test_SN5659_R2020b_CM_double -1.7E+308 1.7E+308 /end CHARACTERISTIC
/begin CHARACTERISTIC speedgoat_test_SN5659__cal_impl.Randomnumber_Mean_h "" VALUE 0x008EA6D8 Scalar_FLOAT64_IEEE 0 speedgoat_test_SN5659_R2020b_CM_double -1.7E+308 1.7E+308 /end CHARACTERISTIC
/begin CHARACTERISTIC speedgoat_test_SN5659__cal_impl.Randomnumber_Seed_c "" VALUE 0x008EA078 Scalar_FLOAT64_IEEE 0 speedgoat_test_SN5659_R2020b_CM_double -1.7E+308 1.7E+308 /end CHARACTERISTIC
/begin CHARACTERISTIC speedgoat_test_SN5659__cal_impl.Randomnumber_Seed_cd "" VALUE 0x008EB3C8 Scalar_FLOAT64_IEEE 0 speedgoat_test_SN5659_R2020b_CM_double -1.7E+308 1.7E+308 /end CHARACTERISTIC
/begin CHARACTERISTIC speedgoat_test_SN5659__cal_impl.Randomnumber_Seed_f "" VALUE 0x008E9A08 Scalar_FLOAT64_IEEE 0 speedgoat_test_SN5659_R2020b_CM_double -1.7E+308 1.7E+308 /end CHARACTERISTIC
/begin CHARACTERISTIC speedgoat_test_SN5659__cal_impl.Randomnumber_Seed_fj "" VALUE 0x008EAD58 Scalar_FLOAT64_IEEE 0 speedgoat_test_SN5659_R2020b_CM_double -1.7E+308 1.7E+308 /end CHARACTERISTIC
/begin CHARACTERISTIC speedgoat_test_SN5659__cal_impl.Randomnumber_Seed_fq "" VALUE 0x008EC0A8 Scalar_FLOAT64_IEEE 0 speedgoat_test_SN5659_R2020b_CM_double -1.7E+308 1.7E+308 /end CHARACTERISTIC
/begin CHARACTERISTIC speedgoat_test_SN5659__cal_impl.Randomnumber_Seed_nh "" VALUE 0x008EBA38 Scalar_FLOAT64_IEEE 0 speedgoat_test_SN5659_R2020b_CM_double -1.7E+308 1.7E+308 /end CHARACTERISTIC
/begin CHARACTERISTIC speedgoat_test_SN5659__cal_impl.Randomnumber_Seed_p "" VALUE 0x008EA6E8 Scalar_FLOAT64_IEEE 0 speedgoat_test_SN5659_R2020b_CM_double -1.7E+308 1.7E+308 /end CHARACTERISTIC
/begin CHARACTERISTIC speedgoat_test_SN5659__cal_impl.Randomnumber_StdDev_f "" VALUE 0x008EC0A0 Scalar_FLOAT64_IEEE 0 speedgoat_test_SN5659_R2020b_CM_double -1.7E+308 1.7E+308 /end CHARACTERISTIC
/begin CHARACTERISTIC speedgoat_test_SN5659__cal_impl.Randomnumber_StdDev_g "" VALUE 0x008EA6E0 Scalar_FLOAT64_IEEE 0 speedgoat_test_SN5659_R2020b_CM_double -1.7E+308 1.7E+308 /end CHARACTERISTIC
/begin CHARACTERISTIC speedgoat_test_SN5659__cal_impl.Randomnumber_StdDev_j "" VALUE 0x008E9A00 Scalar_FLOAT64_IEEE 0 speedgoat_test_SN5659_R2020b_CM_double -1.7E+308 1.7E+308 /end CHARACTERISTIC
/begin CHARACTERISTIC speedgoat_test_SN5659__cal_impl.Randomnumber_StdDev_k "" VALUE 0x008EA070 Scalar_FLOAT64_IEEE 0 speedgoat_test_SN5659_R2020b_CM_double -1.7E+308 1.7E+308 /end CHARACTERISTIC
/begin CHARACTERISTIC speedgoat_test_SN5659__cal_impl.Randomnumber_StdDev_l4 "" VALUE 0x008EAD50 Scalar_FLOAT64_IEEE 0 speedgoat_test_SN5659_R2020b_CM_double -1.7E+308 1.7E+308 /end CHARACTERISTIC
/begin CHARACTERISTIC speedgoat_test_SN5659__cal_impl.Randomnumber_StdDev_m "" VALUE 0x008EBA30 Scalar_FLOAT64_IEEE 0 speedgoat_test_SN5659_R2020b_CM_double -1.7E+308 1.7E+308 /end CHARACTERISTIC
/begin CHARACTERISTIC speedgoat_test_SN5659__cal_impl.Randomnumber_StdDev_n "" VALUE 0x008EB3C0 Scalar_FLOAT64_IEEE 0 speedgoat_test_SN5659_R2020b_CM_double -1.7E+308 1.7E+308 /end CHARACTERISTIC
/begin CHARACTERISTIC speedgoat_test_SN5659__cal_impl.SDI_Value "" VALUE 0x008EFBEC Scalar_ULONG 0 speedgoat_test_SN5659_R2020b_CM_uint32 0 2147483646 /end CHARACTERISTIC
/begin CHARACTERISTIC speedgoat_test_SN5659__cal_impl.SDI_Value_a "" VALUE 0x008EFC1C Scalar_ULONG 0 speedgoat_test_SN5659_R2020b_CM_uint32 0 2147483646 /end CHARACTERISTIC
/begin CHARACTERISTIC speedgoat_test_SN5659__cal_impl.SDI_Value_h "" VALUE 0x008EFC28 Scalar_ULONG 0 speedgoat_test_SN5659_R2020b_CM_uint32 0 2147483646 /end CHARACTERISTIC
/begin CHARACTERISTIC speedgoat_test_SN5659__cal_impl.SDI_Value_i "" VALUE 0x008EFC34 Scalar_ULONG 0 speedgoat_test_SN5659_R2020b_CM_uint32 0 2147483646 /end CHARACTERISTIC
/begin CHARACTERISTIC speedgoat_test_SN5659__cal_impl.SDI_Value_l "" VALUE 0x008EFC10 Scalar_ULONG 0 speedgoat_test_SN5659_R2020b_CM_uint32 0 2147483646 /end CHARACTERISTIC
/begin CHARACTERISTIC speedgoat_test_SN5659__cal_impl.SDI_Value_l4 "" VALUE 0x008EFC4C Scalar_ULONG 0 speedgoat_test_SN5659_R2020b_CM_uint32 0 2147483646 /end CHARACTERISTIC
/begin CHARACTERISTIC speedgoat_test_SN5659__cal_impl.SDI_Value_m3 "" VALUE 0x008EFC40 Scalar_ULONG 0 speedgoat_test_SN5659_R2020b_CM_uint32 0 2147483646 /end CHARACTERISTIC
/begin CHARACTERISTIC speedgoat_test_SN5659__cal_impl.SDI_Value_p "" VALUE 0x008EFC58 Scalar_ULONG 0 speedgoat_test_SN5659_R2020b_CM_uint32 0 2147483646 /end CHARACTERISTIC
/begin CHARACTERISTIC speedgoat_test_SN5659__cal_impl.SSM_Value "" VALUE 0x008EFBE8 Scalar_ULONG 0 speedgoat_test_SN5659_R2020b_CM_uint32 0 2147483646 /end CHARACTERISTIC
/begin CHARACTERISTIC speedgoat_test_SN5659__cal_impl.SSM_Value_i "" VALUE 0x008EFC3C Scalar_ULONG 0 speedgoat_test_SN5659_R2020b_CM_uint32 0 2147483646 /end CHARACTERISTIC
/begin CHARACTERISTIC speedgoat_test_SN5659__cal_impl.SSM_Value_j "" VALUE 0x008EFC24 Scalar_ULONG 0 speedgoat_test_SN5659_R2020b_CM_uint32 0 2147483646 /end CHARACTERISTIC
/begin CHARACTERISTIC speedgoat_test_SN5659__cal_impl.SSM_Value_ji "" VALUE 0x008EFC30 Scalar_ULONG 0 speedgoat_test_SN5659_R2020b_CM_uint32 0 2147483646 /end CHARACTERISTIC
/begin CHARACTERISTIC speedgoat_test_SN5659__cal_impl.SSM_Value_m "" VALUE 0x008EFC18 Scalar_ULONG 0 speedgoat_test_SN5659_R2020b_CM_uint32 0 2147483646 /end CHARACTERISTIC
/begin CHARACTERISTIC speedgoat_test_SN5659__cal_impl.SSM_Value_n "" VALUE 0x008EFC0C Scalar_ULONG 0 speedgoat_test_SN5659_R2020b_CM_uint32 0 2147483646 /end CHARACTERISTIC
/begin CHARACTERISTIC speedgoat_test_SN5659__cal_impl.SSM_Value_na "" VALUE 0x008EFC48 Scalar_ULONG 0 speedgoat_test_SN5659_R2020b_CM_uint32 0 2147483646 /end CHARACTERISTIC
/begin CHARACTERISTIC speedgoat_test_SN5659__cal_impl.SSM_Value_os "" VALUE 0x008EFC54 Scalar_ULONG 0 speedgoat_test_SN5659_R2020b_CM_uint32 0 2147483646 /end CHARACTERISTIC
/begin CHARACTERISTIC speedgoat_test_SN5659__cal_impl.Scale_Value "" VALUE 0x008E8B50 Scalar_FLOAT64_IEEE 0 speedgoat_test_SN5659_R2020b_CM_double -1.7E+308 1.7E+308 /end CHARACTERISTIC
/begin CHARACTERISTIC speedgoat_test_SN5659__cal_impl.Scale_Value_b "" VALUE 0x008E9EA0 Scalar_FLOAT64_IEEE 0 speedgoat_test_SN5659_R2020b_CM_double -1.7E+308 1.7E+308 /end CHARACTERISTIC
/begin CHARACTERISTIC speedgoat_test_SN5659__cal_impl.Scale_Value_c "" VALUE 0x008EB1F0 Scalar_FLOAT64_IEEE 0 speedgoat_test_SN5659_R2020b_CM_double -1.7E+308 1.7E+308 /end CHARACTERISTIC
/begin CHARACTERISTIC speedgoat_test_SN5659__cal_impl.Scale_Value_d "" VALUE 0x008EAB80 Scalar_FLOAT64_IEEE 0 speedgoat_test_SN5659_R2020b_CM_double -1.7E+308 1.7E+308 /end CHARACTERISTIC
/begin CHARACTERISTIC speedgoat_test_SN5659__cal_impl.Scale_Value_e "" VALUE 0x008EC540 Scalar_FLOAT64_IEEE 0 speedgoat_test_SN5659_R2020b_CM_double -1.7E+308 1.7E+308 /end CHARACTERISTIC
/begin CHARACTERISTIC speedgoat_test_SN5659__cal_impl.Scale_Value_f "" VALUE 0x008EA510 Scalar_FLOAT64_IEEE 0 speedgoat_test_SN5659_R2020b_CM_double -1.7E+308 1.7E+308 /end CHARACTERISTIC
/begin CHARACTERISTIC speedgoat_test_SN5659__cal_impl.Scale_Value_i "" VALUE 0x008EB860 Scalar_FLOAT64_IEEE 0 speedgoat_test_SN5659_R2020b_CM_double -1.7E+308 1.7E+308 /end CHARACTERISTIC
/begin CHARACTERISTIC speedgoat_test_SN5659__cal_impl.Scale_Value_k "" VALUE 0x008EBED0 Scalar_FLOAT64_IEEE 0 speedgoat_test_SN5659_R2020b_CM_double -1.7E+308 1.7E+308 /end CHARACTERISTIC
/begin CHARACTERISTIC speedgoat_test_SN5659__cal_impl.Sinewave_Amp_a "" VALUE 0x008EC390 Scalar_FLOAT64_IEEE 0 speedgoat_test_SN5659_R2020b_CM_double -1.7E+308 1.7E+308 /end CHARACTERISTIC
/begin CHARACTERISTIC speedgoat_test_SN5659__cal_impl.Sinewave_Amp_c "" VALUE 0x008EB6B0 Scalar_FLOAT64_IEEE 0 speedgoat_test_SN5659_R2020b_CM_double -1.7E+308 1.7E+308 /end CHARACTERISTIC
/begin CHARACTERISTIC speedgoat_test_SN5659__cal_impl.Sinewave_Amp_d "" VALUE 0x008E9CF0 Scalar_FLOAT64_IEEE 0 speedgoat_test_SN5659_R2020b_CM_double -1.7E+308 1.7E+308 /end CHARACTERISTIC
/begin CHARACTERISTIC speedgoat_test_SN5659__cal_impl.Sinewave_Amp_h "" VALUE 0x008EA360 Scalar_FLOAT64_IEEE 0 speedgoat_test_SN5659_R2020b_CM_double -1.7E+308 1.7E+308 /end CHARACTERISTIC
/begin CHARACTERISTIC speedgoat_test_SN5659__cal_impl.Sinewave_Amp_hh "" VALUE 0x008EB040 Scalar_FLOAT64_IEEE 0 speedgoat_test_SN5659_R2020b_CM_double -1.7E+308 1.7E+308 /end CHARACTERISTIC
/begin CHARACTERISTIC speedgoat_test_SN5659__cal_impl.Sinewave_Amp_n "" VALUE 0x008EA9D0 Scalar_FLOAT64_IEEE 0 speedgoat_test_SN5659_R2020b_CM_double -1.7E+308 1.7E+308 /end CHARACTERISTIC
/begin CHARACTERISTIC speedgoat_test_SN5659__cal_impl.Sinewave_Amp_nm "" VALUE 0x008EBD20 Scalar_FLOAT64_IEEE 0 speedgoat_test_SN5659_R2020b_CM_double -1.7E+308 1.7E+308 /end CHARACTERISTIC
/begin CHARACTERISTIC speedgoat_test_SN5659__cal_impl.Sinewave_Bias_e "" VALUE 0x008E9CF8 Scalar_FLOAT64_IEEE 0 speedgoat_test_SN5659_R2020b_CM_double -1.7E+308 1.7E+308 /end CHARACTERISTIC
/begin CHARACTERISTIC speedgoat_test_SN5659__cal_impl.Sinewave_Bias_g "" VALUE 0x008EB048 Scalar_FLOAT64_IEEE 0 speedgoat_test_SN5659_R2020b_CM_double -1.7E+308 1.7E+308 /end CHARACTERISTIC
/begin CHARACTERISTIC speedgoat_test_SN5659__cal_impl.Sinewave_Bias_j "" VALUE 0x008EA9D8 Scalar_FLOAT64_IEEE 0 speedgoat_test_SN5659_R2020b_CM_double -1.7E+308 1.7E+308 /end CHARACTERISTIC
/begin CHARACTERISTIC speedgoat_test_SN5659__cal_impl.Sinewave_Bias_jq "" VALUE 0x008EBD28 Scalar_FLOAT64_IEEE 0 speedgoat_test_SN5659_R2020b_CM_double -1.7E+308 1.7E+308 /end CHARACTERISTIC
/begin CHARACTERISTIC speedgoat_test_SN5659__cal_impl.Sinewave_Bias_kg "" VALUE 0x008EB6B8 Scalar_FLOAT64_IEEE 0 speedgoat_test_SN5659_R2020b_CM_double -1.7E+308 1.7E+308 /end CHARACTERISTIC
/begin CHARACTERISTIC speedgoat_test_SN5659__cal_impl.Sinewave_Bias_m "" VALUE 0x008EA368 Scalar_FLOAT64_IEEE 0 speedgoat_test_SN5659_R2020b_CM_double -1.7E+308 1.7E+308 /end CHARACTERISTIC
/begin CHARACTERISTIC speedgoat_test_SN5659__cal_impl.Sinewave_Bias_mn "" VALUE 0x008EC398 Scalar_FLOAT64_IEEE 0 speedgoat_test_SN5659_R2020b_CM_double -1.7E+308 1.7E+308 /end CHARACTERISTIC
/begin CHARACTERISTIC speedgoat_test_SN5659__cal_impl.Sinewave_Freq_a "" VALUE 0x008E9D00 Scalar_FLOAT64_IEEE 0 speedgoat_test_SN5659_R2020b_CM_double -1.7E+308 1.7E+308 /end CHARACTERISTIC
/begin CHARACTERISTIC speedgoat_test_SN5659__cal_impl.Sinewave_Freq_ah "" VALUE 0x008EA9E0 Scalar_FLOAT64_IEEE 0 speedgoat_test_SN5659_R2020b_CM_double -1.7E+308 1.7E+308 /end CHARACTERISTIC
/begin CHARACTERISTIC speedgoat_test_SN5659__cal_impl.Sinewave_Freq_b "" VALUE 0x008EC3A0 Scalar_FLOAT64_IEEE 0 speedgoat_test_SN5659_R2020b_CM_double -1.7E+308 1.7E+308 /end CHARACTERISTIC
/begin CHARACTERISTIC speedgoat_test_SN5659__cal_impl.Sinewave_Freq_c "" VALUE 0x008EB050 Scalar_FLOAT64_IEEE 0 speedgoat_test_SN5659_R2020b_CM_double -1.7E+308 1.7E+308 /end CHARACTERISTIC
/begin CHARACTERISTIC speedgoat_test_SN5659__cal_impl.Sinewave_Freq_l "" VALUE 0x008EBD30 Scalar_FLOAT64_IEEE 0 speedgoat_test_SN5659_R2020b_CM_double -1.7E+308 1.7E+308 /end CHARACTERISTIC
/begin CHARACTERISTIC speedgoat_test_SN5659__cal_impl.Sinewave_Freq_m "" VALUE 0x008EA370 Scalar_FLOAT64_IEEE 0 speedgoat_test_SN5659_R2020b_CM_double -1.7E+308 1.7E+308 /end CHARACTERISTIC
/begin CHARACTERISTIC speedgoat_test_SN5659__cal_impl.Sinewave_Freq_mo "" VALUE 0x008EB6C0 Scalar_FLOAT64_IEEE 0 speedgoat_test_SN5659_R2020b_CM_double -1.7E+308 1.7E+308 /end CHARACTERISTIC
/begin CHARACTERISTIC speedgoat_test_SN5659__cal_impl.Sinewave_HCos_b "" VALUE 0x008EBD40 Scalar_FLOAT64_IEEE 0 speedgoat_test_SN5659_R2020b_CM_double -1.7E+308 1.7E+308 /end CHARACTERISTIC
/begin CHARACTERISTIC speedgoat_test_SN5659__cal_impl.Sinewave_HCos_bz "" VALUE 0x008EC3B0 Scalar_FLOAT64_IEEE 0 speedgoat_test_SN5659_R2020b_CM_double -1.7E+308 1.7E+308 /end CHARACTERISTIC
/begin CHARACTERISTIC speedgoat_test_SN5659__cal_impl.Sinewave_HCos_f "" VALUE 0x008EB6D0 Scalar_FLOAT64_IEEE 0 speedgoat_test_SN5659_R2020b_CM_double -1.7E+308 1.7E+308 /end CHARACTERISTIC
/begin CHARACTERISTIC speedgoat_test_SN5659__cal_impl.Sinewave_HCos_j4 "" VALUE 0x008E9D10 Scalar_FLOAT64_IEEE 0 speedgoat_test_SN5659_R2020b_CM_double -1.7E+308 1.7E+308 /end CHARACTERISTIC
/begin CHARACTERISTIC speedgoat_test_SN5659__cal_impl.Sinewave_HCos_jg "" VALUE 0x008EB060 Scalar_FLOAT64_IEEE 0 speedgoat_test_SN5659_R2020b_CM_double -1.7E+308 1.7E+308 /end CHARACTERISTIC
/begin CHARACTERISTIC speedgoat_test_SN5659__cal_impl.Sinewave_HCos_jn "" VALUE 0x008EA9F0 Scalar_FLOAT64_IEEE 0 speedgoat_test_SN5659_R2020b_CM_double -1.7E+308 1.7E+308 /end CHARACTERISTIC
/begin CHARACTERISTIC speedgoat_test_SN5659__cal_impl.Sinewave_HCos_o "" VALUE 0x008EA380 Scalar_FLOAT64_IEEE 0 speedgoat_test_SN5659_R2020b_CM_double -1.7E+308 1.7E+308 /end CHARACTERISTIC
/begin CHARACTERISTIC speedgoat_test_SN5659__cal_impl.Sinewave_Hsin_d "" VALUE 0x008E9D08 Scalar_FLOAT64_IEEE 0 speedgoat_test_SN5659_R2020b_CM_double -1.7E+308 1.7E+308 /end CHARACTERISTIC
/begin CHARACTERISTIC speedgoat_test_SN5659__cal_impl.Sinewave_Hsin_e "" VALUE 0x008EBD38 Scalar_FLOAT64_IEEE 0 speedgoat_test_SN5659_R2020b_CM_double -1.7E+308 1.7E+308 /end CHARACTERISTIC
/begin CHARACTERISTIC speedgoat_test_SN5659__cal_impl.Sinewave_Hsin_h "" VALUE 0x008EB6C8 Scalar_FLOAT64_IEEE 0 speedgoat_test_SN5659_R2020b_CM_double -1.7E+308 1.7E+308 /end CHARACTERISTIC
/begin CHARACTERISTIC speedgoat_test_SN5659__cal_impl.Sinewave_Hsin_h4 "" VALUE 0x008EC3A8 Scalar_FLOAT64_IEEE 0 speedgoat_test_SN5659_R2020b_CM_double -1.7E+308 1.7E+308 /end CHARACTERISTIC
/begin CHARACTERISTIC speedgoat_test_SN5659__cal_impl.Sinewave_Hsin_i "" VALUE 0x008EA9E8 Scalar_FLOAT64_IEEE 0 speedgoat_test_SN5659_R2020b_CM_double -1.7E+308 1.7E+308 /end CHARACTERISTIC
/begin CHARACTERISTIC speedgoat_test_SN5659__cal_impl.Sinewave_Hsin_o "" VALUE 0x008EA378 Scalar_FLOAT64_IEEE 0 speedgoat_test_SN5659_R2020b_CM_double -1.7E+308 1.7E+308 /end CHARACTERISTIC
/begin CHARACTERISTIC speedgoat_test_SN5659__cal_impl.Sinewave_Hsin_o1 "" VALUE 0x008EB058 Scalar_FLOAT64_IEEE 0 speedgoat_test_SN5659_R2020b_CM_double -1.7E+308 1.7E+308 /end CHARACTERISTIC
/begin CHARACTERISTIC speedgoat_test_SN5659__cal_impl.Sinewave_PCos_a "" VALUE 0x008EB070 Scalar_FLOAT64_IEEE 0 speedgoat_test_SN5659_R2020b_CM_double -1.7E+308 1.7E+308 /end CHARACTERISTIC
/begin CHARACTERISTIC speedgoat_test_SN5659__cal_impl.Sinewave_PCos_f "" VALUE 0x008EAA00 Scalar_FLOAT64_IEEE 0 speedgoat_test_SN5659_R2020b_CM_double -1.7E+308 1.7E+308 /end CHARACTERISTIC
/begin CHARACTERISTIC speedgoat_test_SN5659__cal_impl.Sinewave_PCos_h "" VALUE 0x008EA390 Scalar_FLOAT64_IEEE 0 speedgoat_test_SN5659_R2020b_CM_double -1.7E+308 1.7E+308 /end CHARACTERISTIC
/begin CHARACTERISTIC speedgoat_test_SN5659__cal_impl.Sinewave_PCos_k "" VALUE 0x008EBD50 Scalar_FLOAT64_IEEE 0 speedgoat_test_SN5659_R2020b_CM_double -1.7E+308 1.7E+308 /end CHARACTERISTIC
/begin CHARACTERISTIC speedgoat_test_SN5659__cal_impl.Sinewave_PCos_m "" VALUE 0x008EB6E0 Scalar_FLOAT64_IEEE 0 speedgoat_test_SN5659_R2020b_CM_double -1.7E+308 1.7E+308 /end CHARACTERISTIC
/begin CHARACTERISTIC speedgoat_test_SN5659__cal_impl.Sinewave_PCos_ma "" VALUE 0x008EC3C0 Scalar_FLOAT64_IEEE 0 speedgoat_test_SN5659_R2020b_CM_double -1.7E+308 1.7E+308 /end CHARACTERISTIC
/begin CHARACTERISTIC speedgoat_test_SN5659__cal_impl.Sinewave_PCos_p "" VALUE 0x008E9D20 Scalar_FLOAT64_IEEE 0 speedgoat_test_SN5659_R2020b_CM_double -1.7E+308 1.7E+308 /end CHARACTERISTIC
/begin CHARACTERISTIC speedgoat_test_SN5659__cal_impl.Sinewave_PSin_c "" VALUE 0x008E9D18 Scalar_FLOAT64_IEEE 0 speedgoat_test_SN5659_R2020b_CM_double -1.7E+308 1.7E+308 /end CHARACTERISTIC
/begin CHARACTERISTIC speedgoat_test_SN5659__cal_impl.Sinewave_PSin_e "" VALUE 0x008EA388 Scalar_FLOAT64_IEEE 0 speedgoat_test_SN5659_R2020b_CM_double -1.7E+308 1.7E+308 /end CHARACTERISTIC
/begin CHARACTERISTIC speedgoat_test_SN5659__cal_impl.Sinewave_PSin_f "" VALUE 0x008EA9F8 Scalar_FLOAT64_IEEE 0 speedgoat_test_SN5659_R2020b_CM_double -1.7E+308 1.7E+308 /end CHARACTERISTIC
/begin CHARACTERISTIC speedgoat_test_SN5659__cal_impl.Sinewave_PSin_fk "" VALUE 0x008EB068 Scalar_FLOAT64_IEEE 0 speedgoat_test_SN5659_R2020b_CM_double -1.7E+308 1.7E+308 /end CHARACTERISTIC
/begin CHARACTERISTIC speedgoat_test_SN5659__cal_impl.Sinewave_PSin_g "" VALUE 0x008EBD48 Scalar_FLOAT64_IEEE 0 speedgoat_test_SN5659_R2020b_CM_double -1.7E+308 1.7E+308 /end CHARACTERISTIC
/begin CHARACTERISTIC speedgoat_test_SN5659__cal_impl.Sinewave_PSin_gt "" VALUE 0x008EC3B8 Scalar_FLOAT64_IEEE 0 speedgoat_test_SN5659_R2020b_CM_double -1.7E+308 1.7E+308 /end CHARACTERISTIC
/begin CHARACTERISTIC speedgoat_test_SN5659__cal_impl.Sinewave_PSin_m "" VALUE 0x008EB6D8 Scalar_FLOAT64_IEEE 0 speedgoat_test_SN5659_R2020b_CM_double -1.7E+308 1.7E+308 /end CHARACTERISTIC
/begin CHARACTERISTIC speedgoat_test_SN5659__cal_impl.shiftthedoublevalue27bitslef_oj "" VALUE 0x008EB1F8 Scalar_FLOAT64_IEEE 0 speedgoat_test_SN5659_R2020b_CM_double -1.7E+308 1.7E+308 /end CHARACTERISTIC
/begin CHARACTERISTIC speedgoat_test_SN5659__cal_impl.shiftthedoublevalue27bitslef_pp "" VALUE 0x008EAB88 Scalar_FLOAT64_IEEE 0 speedgoat_test_SN5659_R2020b_CM_double -1.7E+308 1.7E+308 /end CHARACTERISTIC
/begin CHARACTERISTIC speedgoat_test_SN5659__cal_impl.shiftthedoublevalue27bitsleft_V "" VALUE 0x008E8B58 Scalar_FLOAT64_IEEE 0 speedgoat_test_SN5659_R2020b_CM_double -1.7E+308 1.7E+308 /end CHARACTERISTIC
/begin CHARACTERISTIC speedgoat_test_SN5659__cal_impl.shiftthedoublevalue27bitsleft_g "" VALUE 0x008E9EA8 Scalar_FLOAT64_IEEE 0 speedgoat_test_SN5659_R2020b_CM_double -1.7E+308 1.7E+308 /end CHARACTERISTIC
/begin CHARACTERISTIC speedgoat_test_SN5659__cal_impl.shiftthedoublevalue27bitsleft_h "" VALUE 0x008EB868 Scalar_FLOAT64_IEEE 0 speedgoat_test_SN5659_R2020b_CM_double -1.7E+308 1.7E+308 /end CHARACTERISTIC
/begin CHARACTERISTIC speedgoat_test_SN5659__cal_impl.shiftthedoublevalue27bitsleft_i "" VALUE 0x008EA518 Scalar_FLOAT64_IEEE 0 speedgoat_test_SN5659_R2020b_CM_double -1.7E+308 1.7E+308 /end CHARACTERISTIC
/begin CHARACTERISTIC speedgoat_test_SN5659__cal_impl.shiftthedoublevalue27bitsleft_j "" VALUE 0x008EBED8 Scalar_FLOAT64_IEEE 0 speedgoat_test_SN5659_R2020b_CM_double -1.7E+308 1.7E+308 /end CHARACTERISTIC
/begin CHARACTERISTIC speedgoat_test_SN5659__cal_impl.shiftthedoublevalue27bitsleft_n "" VALUE 0x008EC548 Scalar_FLOAT64_IEEE 0 speedgoat_test_SN5659_R2020b_CM_double -1.7E+308 1.7E+308 /end CHARACTERISTIC
/begin MEASUREMENT speedgoat_test_SN5659_R2020b_B.BitwiseOperator "" ULONG speedgoat_test_SN5659_R2020b_CM_uint32 0 0 0 2147483646 ECU_ADDRESS 0x0095BE60 /end MEASUREMENT
/begin MEASUREMENT speedgoat_test_SN5659_R2020b_B.BitwiseOperator_a4 "" ULONG speedgoat_test_SN5659_R2020b_CM_uint32 0 0 0 2147483646 ECU_ADDRESS 0x0095BF14 /end MEASUREMENT
/begin MEASUREMENT speedgoat_test_SN5659_R2020b_B.BitwiseOperator_c "" ULONG speedgoat_test_SN5659_R2020b_CM_uint32 0 0 0 2147483646 ECU_ADDRESS 0x0095BEC4 /end MEASUREMENT
/begin MEASUREMENT speedgoat_test_SN5659_R2020b_B.BitwiseOperator_e "" ULONG speedgoat_test_SN5659_R2020b_CM_uint32 0 0 0 2147483646 ECU_ADDRESS 0x0095BEEC /end MEASUREMENT
/begin MEASUREMENT speedgoat_test_SN5659_R2020b_B.BitwiseOperator_f "" ULONG speedgoat_test_SN5659_R2020b_CM_uint32 0 0 0 2147483646 ECU_ADDRESS 0x0095BED8 /end MEASUREMENT
/begin MEASUREMENT speedgoat_test_SN5659_R2020b_B.BitwiseOperator_j "" ULONG speedgoat_test_SN5659_R2020b_CM_uint32 0 0 0 2147483646 ECU_ADDRESS 0x0095BF00 /end MEASUREMENT
/begin MEASUREMENT speedgoat_test_SN5659_R2020b_B.BitwiseOperator_k "" ULONG speedgoat_test_SN5659_R2020b_CM_uint32 0 0 0 2147483646 ECU_ADDRESS 0x0095BEB0 /end MEASUREMENT
/begin MEASUREMENT speedgoat_test_SN5659_R2020b_B.BitwiseOperator_p "" ULONG speedgoat_test_SN5659_R2020b_CM_uint32 0 0 0 2147483646 ECU_ADDRESS 0x0095BE9C /end MEASUREMENT
/begin MEASUREMENT speedgoat_test_SN5659_R2020b_B.DataTypeConversion1_a "" FLOAT64_IEEE speedgoat_test_SN5659_R2020b_CM_double 0 0 -1.7E+308 1.7E+308 ECU_ADDRESS 0x0095BBE8 /end MEASUREMENT
/begin MEASUREMENT speedgoat_test_SN5659_R2020b_B.DataTypeConversion1_d "" FLOAT64_IEEE speedgoat_test_SN5659_R2020b_CM_double 0 0 -1.7E+308 1.7E+308 ECU_ADDRESS 0x0095BB48 /end MEASUREMENT
/begin MEASUREMENT speedgoat_test_SN5659_R2020b_B.DataTypeConversion1_ga "" FLOAT64_IEEE speedgoat_test_SN5659_R2020b_CM_double 0 0 -1.7E+308 1.7E+308 ECU_ADDRESS 0x0095BAF8 /end MEASUREMENT
/begin MEASUREMENT speedgoat_test_SN5659_R2020b_B.DataTypeConversion1_gm "" FLOAT64_IEEE speedgoat_test_SN5659_R2020b_CM_double 0 0 -1.7E+308 1.7E+308 ECU_ADDRESS 0x0095BAA8 /end MEASUREMENT
/begin MEASUREMENT speedgoat_test_SN5659_R2020b_B.DataTypeConversion1_l "" FLOAT64_IEEE speedgoat_test_SN5659_R2020b_CM_double 0 0 -1.7E+308 1.7E+308 ECU_ADDRESS 0x0095BB98 /end MEASUREMENT
/begin MEASUREMENT speedgoat_test_SN5659_R2020b_B.DataTypeConversion1_n "" FLOAT64_IEEE speedgoat_test_SN5659_R2020b_CM_double 0 0 -1.7E+308 1.7E+308 ECU_ADDRESS 0x0095BA58 /end MEASUREMENT
/begin MEASUREMENT speedgoat_test_SN5659_R2020b_B.DataTypeConversion1_p "" FLOAT64_IEEE speedgoat_test_SN5659_R2020b_CM_double 0 0 -1.7E+308 1.7E+308 ECU_ADDRESS 0x0095BA08 /end MEASUREMENT
/begin MEASUREMENT speedgoat_test_SN5659_R2020b_B.DataTypeConversion_b "" ULONG speedgoat_test_SN5659_R2020b_CM_uint32 0 0 0 2147483646 ECU_ADDRESS 0x0095BEA0 /end MEASUREMENT
/begin MEASUREMENT speedgoat_test_SN5659_R2020b_B.DataTypeConversion_bh "" ULONG speedgoat_test_SN5659_R2020b_CM_uint32 0 0 0 2147483646 ECU_ADDRESS 0x0095BEF0 /end MEASUREMENT
/begin MEASUREMENT speedgoat_test_SN5659_R2020b_B.DataTypeConversion_d "" FLOAT64_IEEE speedgoat_test_SN5659_R2020b_CM_double 0 0 -1.7E+308 1.7E+308 ECU_ADDRESS 0x0095BAC8 /end MEASUREMENT
/begin MEASUREMENT speedgoat_test_SN5659_R2020b_B.DataTypeConversion_dd "" FLOAT64_IEEE speedgoat_test_SN5659_R2020b_CM_double 0 0 -1.7E+308 1.7E+308 ECU_ADDRESS 0x0095BBB8 /end MEASUREMENT
/begin MEASUREMENT speedgoat_test_SN5659_R2020b_B.DataTypeConversion_er "" ULONG speedgoat_test_SN5659_R2020b_CM_uint32 0 0 0 2147483646 ECU_ADDRESS 0x0095BEB4 /end MEASUREMENT
/begin MEASUREMENT speedgoat_test_SN5659_R2020b_B.DataTypeConversion_f5 "" ULONG speedgoat_test_SN5659_R2020b_CM_uint32 0 0 0 2147483646 ECU_ADDRESS 0x0095BEDC /end MEASUREMENT
/begin MEASUREMENT speedgoat_test_SN5659_R2020b_B.DataTypeConversion_fb "" ULONG speedgoat_test_SN5659_R2020b_CM_uint32 0 0 0 2147483646 ECU_ADDRESS 0x0095BEC8 /end MEASUREMENT
/begin MEASUREMENT speedgoat_test_SN5659_R2020b_B.DataTypeConversion_hu "" FLOAT64_IEEE speedgoat_test_SN5659_R2020b_CM_double 0 0 -1.7E+308 1.7E+308 ECU_ADDRESS 0x0095BB68 /end MEASUREMENT
/begin MEASUREMENT speedgoat_test_SN5659_R2020b_B.DataTypeConversion_j "" FLOAT64_IEEE speedgoat_test_SN5659_R2020b_CM_double 0 0 -1.7E+308 1.7E+308 ECU_ADDRESS 0x0095B9D8 /end MEASUREMENT
/begin MEASUREMENT speedgoat_test_SN5659_R2020b_B.DataTypeConversion_jj "" ULONG speedgoat_test_SN5659_R2020b_CM_uint32 0 0 0 2147483646 ECU_ADDRESS 0x0095BE8C /end MEASUREMENT
/begin MEASUREMENT speedgoat_test_SN5659_R2020b_B.DataTypeConversion_jr "" FLOAT64_IEEE speedgoat_test_SN5659_R2020b_CM_double 0 0 -1.7E+308 1.7E+308 ECU_ADDRESS 0x0095BB18 /end MEASUREMENT
/begin MEASUREMENT speedgoat_test_SN5659_R2020b_B.DataTypeConversion_k5 "" ULONG speedgoat_test_SN5659_R2020b_CM_uint32 0 0 0 2147483646 ECU_ADDRESS 0x0095BE50 /end MEASUREMENT
/begin MEASUREMENT speedgoat_test_SN5659_R2020b_B.DataTypeConversion_l "" ULONG speedgoat_test_SN5659_R2020b_CM_uint32 0 0 0 2147483646 ECU_ADDRESS 0x0095BF04 /end MEASUREMENT
/begin MEASUREMENT speedgoat_test_SN5659_R2020b_B.DataTypeConversion_o "" FLOAT64_IEEE speedgoat_test_SN5659_R2020b_CM_double 0 0 -1.7E+308 1.7E+308 ECU_ADDRESS 0x0095BA78 /end MEASUREMENT
/begin MEASUREMENT speedgoat_test_SN5659_R2020b_B.DataTypeConversion_p "" FLOAT64_IEEE speedgoat_test_SN5659_R2020b_CM_double 0 0 -1.7E+308 1.7E+308 ECU_ADDRESS 0x0095BA28 /end MEASUREMENT
/begin MEASUREMENT speedgoat_test_SN5659_R2020b_B.Divide "" FLOAT64_IEEE speedgoat_test_SN5659_R2020b_CM_double 0 0 -1.7E+308 1.7E+308 ECU_ADDRESS 0x0095B908 /end MEASUREMENT
/begin MEASUREMENT speedgoat_test_SN5659_R2020b_B.Divide_g "" FLOAT64_IEEE speedgoat_test_SN5659_R2020b_CM_double 0 0 -1.7E+308 1.7E+308 ECU_ADDRESS 0x0095BAE8 /end MEASUREMENT
/begin MEASUREMENT speedgoat_test_SN5659_R2020b_B.Divide_g4 "" FLOAT64_IEEE speedgoat_test_SN5659_R2020b_CM_double 0 0 -1.7E+308 1.7E+308 ECU_ADDRESS 0x0095BB88 /end MEASUREMENT
/begin MEASUREMENT speedgoat_test_SN5659_R2020b_B.Divide_i "" FLOAT64_IEEE speedgoat_test_SN5659_R2020b_CM_double 0 0 -1.7E+308 1.7E+308 ECU_ADDRESS 0x0095BA48 /end MEASUREMENT
/begin MEASUREMENT speedgoat_test_SN5659_R2020b_B.Divide_j "" FLOAT64_IEEE speedgoat_test_SN5659_R2020b_CM_double 0 0 -1.7E+308 1.7E+308 ECU_ADDRESS 0x0095BA98 /end MEASUREMENT
/begin MEASUREMENT speedgoat_test_SN5659_R2020b_B.Divide_k3 "" FLOAT64_IEEE speedgoat_test_SN5659_R2020b_CM_double 0 0 -1.7E+308 1.7E+308 ECU_ADDRESS 0x0095BB38 /end MEASUREMENT
/begin MEASUREMENT speedgoat_test_SN5659_R2020b_B.Divide_n "" FLOAT64_IEEE speedgoat_test_SN5659_R2020b_CM_double 0 0 -1.7E+308 1.7E+308 ECU_ADDRESS 0x0095BBD8 /end MEASUREMENT
/begin MEASUREMENT speedgoat_test_SN5659_R2020b_B.Divide_p "" FLOAT64_IEEE speedgoat_test_SN5659_R2020b_CM_double 0 0 -1.7E+308 1.7E+308 ECU_ADDRESS 0x0095B9F8 /end MEASUREMENT
/begin MEASUREMENT speedgoat_test_SN5659_R2020b_B.Encode1_f0 "" FLOAT64_IEEE speedgoat_test_SN5659_R2020b_CM_double 0 0 -1.7E+308 1.7E+308 ECU_ADDRESS 0x0095BBB0 /end MEASUREMENT
/begin MEASUREMENT speedgoat_test_SN5659_R2020b_B.Encode1_h "" FLOAT64_IEEE speedgoat_test_SN5659_R2020b_CM_double 0 0 -1.7E+308 1.7E+308 ECU_ADDRESS 0x0095BB60 /end MEASUREMENT
/begin MEASUREMENT speedgoat_test_SN5659_R2020b_B.Encode1_k "" FLOAT64_IEEE speedgoat_test_SN5659_R2020b_CM_double 0 0 -1.7E+308 1.7E+308 ECU_ADDRESS 0x0095B9D0 /end MEASUREMENT
/begin MEASUREMENT speedgoat_test_SN5659_R2020b_B.Encode1_l "" FLOAT64_IEEE speedgoat_test_SN5659_R2020b_CM_double 0 0 -1.7E+308 1.7E+308 ECU_ADDRESS 0x0095BA20 /end MEASUREMENT
/begin MEASUREMENT speedgoat_test_SN5659_R2020b_B.Encode1_p "" FLOAT64_IEEE speedgoat_test_SN5659_R2020b_CM_double 0 0 -1.7E+308 1.7E+308 ECU_ADDRESS 0x0095BA70 /end MEASUREMENT
/begin MEASUREMENT speedgoat_test_SN5659_R2020b_B.Encode1_pb "" FLOAT64_IEEE speedgoat_test_SN5659_R2020b_CM_double 0 0 -1.7E+308 1.7E+308 ECU_ADDRESS 0x0095BAC0 /end MEASUREMENT
/begin MEASUREMENT speedgoat_test_SN5659_R2020b_B.Encode1_pbz "" FLOAT64_IEEE speedgoat_test_SN5659_R2020b_CM_double 0 0 -1.7E+308 1.7E+308 ECU_ADDRESS 0x0095BB10 /end MEASUREMENT
/begin MEASUREMENT speedgoat_test_SN5659_R2020b_B.Encode2_fb "" FLOAT64_IEEE speedgoat_test_SN5659_R2020b_CM_double 0 0 -1.7E+308 1.7E+308 ECU_ADDRESS 0x0095BB70 /end MEASUREMENT
/begin MEASUREMENT speedgoat_test_SN5659_R2020b_B.Encode2_fi "" FLOAT64_IEEE speedgoat_test_SN5659_R2020b_CM_double 0 0 -1.7E+308 1.7E+308 ECU_ADDRESS 0x0095BA80 /end MEASUREMENT
/begin MEASUREMENT speedgoat_test_SN5659_R2020b_B.Encode2_h "" FLOAT64_IEEE speedgoat_test_SN5659_R2020b_CM_double 0 0 -1.7E+308 1.7E+308 ECU_ADDRESS 0x0095BAD0 /end MEASUREMENT
/begin MEASUREMENT speedgoat_test_SN5659_R2020b_B.Encode2_hc "" FLOAT64_IEEE speedgoat_test_SN5659_R2020b_CM_double 0 0 -1.7E+308 1.7E+308 ECU_ADDRESS 0x0095BB20 /end MEASUREMENT
/begin MEASUREMENT speedgoat_test_SN5659_R2020b_B.Encode2_i "" FLOAT64_IEEE speedgoat_test_SN5659_R2020b_CM_double 0 0 -1.7E+308 1.7E+308 ECU_ADDRESS 0x0095B9E0 /end MEASUREMENT
/begin MEASUREMENT speedgoat_test_SN5659_R2020b_B.Encode2_iu "" FLOAT64_IEEE speedgoat_test_SN5659_R2020b_CM_double 0 0 -1.7E+308 1.7E+308 ECU_ADDRESS 0x0095BBC0 /end MEASUREMENT
/begin MEASUREMENT speedgoat_test_SN5659_R2020b_B.Encode2_j "" FLOAT64_IEEE speedgoat_test_SN5659_R2020b_CM_double 0 0 -1.7E+308 1.7E+308 ECU_ADDRESS 0x0095BA60 /end MEASUREMENT
/begin MEASUREMENT speedgoat_test_SN5659_R2020b_B.Encode3_d "" FLOAT64_IEEE speedgoat_test_SN5659_R2020b_CM_double 0 0 -1.7E+308 1.7E+308 ECU_ADDRESS 0x0095BB80 /end MEASUREMENT
/begin MEASUREMENT speedgoat_test_SN5659_R2020b_B.Encode3_f "" FLOAT64_IEEE speedgoat_test_SN5659_R2020b_CM_double 0 0 -1.7E+308 1.7E+308 ECU_ADDRESS 0x0095BA90 /end MEASUREMENT
/begin MEASUREMENT speedgoat_test_SN5659_R2020b_B.Encode3_ik "" FLOAT64_IEEE speedgoat_test_SN5659_R2020b_CM_double 0 0 -1.7E+308 1.7E+308 ECU_ADDRESS 0x0095BBD0 /end MEASUREMENT
/begin MEASUREMENT speedgoat_test_SN5659_R2020b_B.Encode3_l "" FLOAT64_IEEE speedgoat_test_SN5659_R2020b_CM_double 0 0 -1.7E+308 1.7E+308 ECU_ADDRESS 0x0095BAE0 /end MEASUREMENT
/begin MEASUREMENT speedgoat_test_SN5659_R2020b_B.Encode3_o "" FLOAT64_IEEE speedgoat_test_SN5659_R2020b_CM_double 0 0 -1.7E+308 1.7E+308 ECU_ADDRESS 0x0095B9F0 /end MEASUREMENT
/begin MEASUREMENT speedgoat_test_SN5659_R2020b_B.Encode3_ou "" FLOAT64_IEEE speedgoat_test_SN5659_R2020b_CM_double 0 0 -1.7E+308 1.7E+308 ECU_ADDRESS 0x0095BB30 /end MEASUREMENT
/begin MEASUREMENT speedgoat_test_SN5659_R2020b_B.Encode3_p "" FLOAT64_IEEE speedgoat_test_SN5659_R2020b_CM_double 0 0 -1.7E+308 1.7E+308 ECU_ADDRESS 0x0095BA40 /end MEASUREMENT
/begin MEASUREMENT speedgoat_test_SN5659_R2020b_B.Encode4_c "" FLOAT64_IEEE speedgoat_test_SN5659_R2020b_CM_double 0 0 -1.7E+308 1.7E+308 ECU_ADDRESS 0x0095BA10 /end MEASUREMENT
/begin MEASUREMENT speedgoat_test_SN5659_R2020b_B.Encode4_g "" FLOAT64_IEEE speedgoat_test_SN5659_R2020b_CM_double 0 0 -1.7E+308 1.7E+308 ECU_ADDRESS 0x0095BAB0 /end MEASUREMENT
/begin MEASUREMENT speedgoat_test_SN5659_R2020b_B.Encode4_ix "" FLOAT64_IEEE speedgoat_test_SN5659_R2020b_CM_double 0 0 -1.7E+308 1.7E+308 ECU_ADDRESS 0x0095BBF0 /end MEASUREMENT
/begin MEASUREMENT speedgoat_test_SN5659_R2020b_B.Encode4_l "" FLOAT64_IEEE speedgoat_test_SN5659_R2020b_CM_double 0 0 -1.7E+308 1.7E+308 ECU_ADDRESS 0x0095BB00 /end MEASUREMENT
/begin MEASUREMENT speedgoat_test_SN5659_R2020b_B.Encode4_n "" FLOAT64_IEEE speedgoat_test_SN5659_R2020b_CM_double 0 0 -1.7E+308 1.7E+308 ECU_ADDRESS 0x0095BBA0 /end MEASUREMENT
/begin MEASUREMENT speedgoat_test_SN5659_R2020b_B.Encode4_p "" FLOAT64_IEEE speedgoat_test_SN5659_R2020b_CM_double 0 0 -1.7E+308 1.7E+308 ECU_ADDRESS 0x0095BB50 /end MEASUREMENT
/begin MEASUREMENT speedgoat_test_SN5659_R2020b_B.Encode5_d "" FLOAT64_IEEE speedgoat_test_SN5659_R2020b_CM_double 0 0 -1.7E+308 1.7E+308 ECU_ADDRESS 0x0095BA30 /end MEASUREMENT
/begin MEASUREMENT speedgoat_test_SN5659_R2020b_B.FixPtSum1_a "" UWORD speedgoat_test_SN5659_R2020b_CM_uint16 0 0 0 65535 ECU_ADDRESS 0x0095C3AE /end MEASUREMENT
/begin MEASUREMENT speedgoat_test_SN5659_R2020b_B.FixPtSum1_d "" UWORD speedgoat_test_SN5659_R2020b_CM_uint16 0 0 0 65535 ECU_ADDRESS 0x0095C3C6 /end MEASUREMENT
/begin MEASUREMENT speedgoat_test_SN5659_R2020b_B.FixPtSum1_e "" UWORD speedgoat_test_SN5659_R2020b_CM_uint16 0 0 0 65535 ECU_ADDRESS 0x0095C3BA /end MEASUREMENT
/begin MEASUREMENT speedgoat_test_SN5659_R2020b_B.FixPtSum1_fe "" UBYTE speedgoat_test_SN5659_R2020b_CM_uint8 0 0 0 255 ECU_ADDRESS 0x0095C3F8 /end MEASUREMENT
/begin MEASUREMENT speedgoat_test_SN5659_R2020b_B.FixPtSum1_g "" UWORD speedgoat_test_SN5659_R2020b_CM_uint16 0 0 0 65535 ECU_ADDRESS 0x0095C3B4 /end MEASUREMENT
/begin MEASUREMENT speedgoat_test_SN5659_R2020b_B.FixPtSum1_h "" UWORD speedgoat_test_SN5659_R2020b_CM_uint16 0 0 0 65535 ECU_ADDRESS 0x0095C3CC /end MEASUREMENT
/begin MEASUREMENT speedgoat_test_SN5659_R2020b_B.FixPtSum1_i "" UBYTE speedgoat_test_SN5659_R2020b_CM_uint8 0 0 0 255 ECU_ADDRESS 0x0095C3F5 /end MEASUREMENT
/begin MEASUREMENT speedgoat_test_SN5659_R2020b_B.FixPtSum1_o "" UWORD speedgoat_test_SN5659_R2020b_CM_uint16 0 0 0 65535 ECU_ADDRESS 0x0095C3C0 /end MEASUREMENT
/begin MEASUREMENT speedgoat_test_SN5659_R2020b_B.FixPtSwitch_b "" UWORD speedgoat_test_SN5659_R2020b_CM_uint16 0 0 0 65535 ECU_ADDRESS 0x0095C3B0 /end MEASUREMENT
/begin MEASUREMENT speedgoat_test_SN5659_R2020b_B.FixPtSwitch_bx "" UWORD speedgoat_test_SN5659_R2020b_CM_uint16 0 0 0 65535 ECU_ADDRESS 0x0095C3BC /end MEASUREMENT
/begin MEASUREMENT speedgoat_test_SN5659_R2020b_B.FixPtSwitch_d "" UWORD speedgoat_test_SN5659_R2020b_CM_uint16 0 0 0 65535 ECU_ADDRESS 0x0095C3CE /end MEASUREMENT
/begin MEASUREMENT speedgoat_test_SN5659_R2020b_B.FixPtSwitch_ha "" UBYTE speedgoat_test_SN5659_R2020b_CM_uint8 0 0 0 255 ECU_ADDRESS 0x0095C3F6 /end MEASUREMENT
/begin MEASUREMENT speedgoat_test_SN5659_R2020b_B.FixPtSwitch_jo "" UBYTE speedgoat_test_SN5659_R2020b_CM_uint8 0 0 0 255 ECU_ADDRESS 0x0095C3F9 /end MEASUREMENT
/begin MEASUREMENT speedgoat_test_SN5659_R2020b_B.FixPtSwitch_l "" UWORD speedgoat_test_SN5659_R2020b_CM_uint16 0 0 0 65535 ECU_ADDRESS 0x0095C3B6 /end MEASUREMENT
/begin MEASUREMENT speedgoat_test_SN5659_R2020b_B.FixPtSwitch_l2 "" UWORD speedgoat_test_SN5659_R2020b_CM_uint16 0 0 0 65535 ECU_ADDRESS 0x0095C3C8 /end MEASUREMENT
/begin MEASUREMENT speedgoat_test_SN5659_R2020b_B.FixPtSwitch_lo "" UWORD speedgoat_test_SN5659_R2020b_CM_uint16 0 0 0 65535 ECU_ADDRESS 0x0095C3C2 /end MEASUREMENT
/begin MEASUREMENT speedgoat_test_SN5659_R2020b_B.Mask "" ULONG speedgoat_test_SN5659_R2020b_CM_uint32 0 0 0 2147483646 ECU_ADDRESS 0x0095BE54 /end MEASUREMENT
/begin MEASUREMENT speedgoat_test_SN5659_R2020b_B.Mask_c "" ULONG speedgoat_test_SN5659_R2020b_CM_uint32 0 0 0 2147483646 ECU_ADDRESS 0x0095BEA4 /end MEASUREMENT
/begin MEASUREMENT speedgoat_test_SN5659_R2020b_B.Mask_d "" ULONG speedgoat_test_SN5659_R2020b_CM_uint32 0 0 0 2147483646 ECU_ADDRESS 0x0095BEF4 /end MEASUREMENT
/begin MEASUREMENT speedgoat_test_SN5659_R2020b_B.Mask_h "" ULONG speedgoat_test_SN5659_R2020b_CM_uint32 0 0 0 2147483646 ECU_ADDRESS 0x0095BECC /end MEASUREMENT
/begin MEASUREMENT speedgoat_test_SN5659_R2020b_B.Mask_h0 "" ULONG speedgoat_test_SN5659_R2020b_CM_uint32 0 0 0 2147483646 ECU_ADDRESS 0x0095BEE0 /end MEASUREMENT
/begin MEASUREMENT speedgoat_test_SN5659_R2020b_B.Mask_i "" ULONG speedgoat_test_SN5659_R2020b_CM_uint32 0 0 0 2147483646 ECU_ADDRESS 0x0095BE90 /end MEASUREMENT
/begin MEASUREMENT speedgoat_test_SN5659_R2020b_B.Mask_k "" ULONG speedgoat_test_SN5659_R2020b_CM_uint32 0 0 0 2147483646 ECU_ADDRESS 0x0095BF08 /end MEASUREMENT
/begin MEASUREMENT speedgoat_test_SN5659_R2020b_B.Mask_m "" ULONG speedgoat_test_SN5659_R2020b_CM_uint32 0 0 0 2147483646 ECU_ADDRESS 0x0095BEB8 /end MEASUREMENT
/begin MEASUREMENT speedgoat_test_SN5659_R2020b_B.Multiply "" FLOAT64_IEEE speedgoat_test_SN5659_R2020b_CM_double 0 0 -1.7E+308 1.7E+308 ECU_ADDRESS 0x0095B910 /end MEASUREMENT
/begin MEASUREMENT speedgoat_test_SN5659_R2020b_B.Multiply_e "" FLOAT64_IEEE speedgoat_test_SN5659_R2020b_CM_double 0 0 -1.7E+308 1.7E+308 ECU_ADDRESS 0x0095BBE0 /end MEASUREMENT
/begin MEASUREMENT speedgoat_test_SN5659_R2020b_B.Multiply_hd "" FLOAT64_IEEE speedgoat_test_SN5659_R2020b_CM_double 0 0 -1.7E+308 1.7E+308 ECU_ADDRESS 0x0095BB40 /end MEASUREMENT
/begin MEASUREMENT speedgoat_test_SN5659_R2020b_B.Multiply_he "" FLOAT64_IEEE speedgoat_test_SN5659_R2020b_CM_double 0 0 -1.7E+308 1.7E+308 ECU_ADDRESS 0x0095BA50 /end MEASUREMENT
/begin MEASUREMENT speedgoat_test_SN5659_R2020b_B.Multiply_i "" FLOAT64_IEEE speedgoat_test_SN5659_R2020b_CM_double 0 0 -1.7E+308 1.7E+308 ECU_ADDRESS 0x0095BAA0 /end MEASUREMENT
/begin MEASUREMENT speedgoat_test_SN5659_R2020b_B.Multiply_il "" FLOAT64_IEEE speedgoat_test_SN5659_R2020b_CM_double 0 0 -1.7E+308 1.7E+308 ECU_ADDRESS 0x0095BB90 /end MEASUREMENT
/begin MEASUREMENT speedgoat_test_SN5659_R2020b_B.Multiply_j "" FLOAT64_IEEE speedgoat_test_SN5659_R2020b_CM_double 0 0 -1.7E+308 1.7E+308 ECU_ADDRESS 0x0095BA00 /end MEASUREMENT
/begin MEASUREMENT speedgoat_test_SN5659_R2020b_B.Multiply_n "" FLOAT64_IEEE speedgoat_test_SN5659_R2020b_CM_double 0 0 -1.7E+308 1.7E+308 ECU_ADDRESS 0x0095BAF0 /end MEASUREMENT
/begin MEASUREMENT speedgoat_test_SN5659_R2020b_B.Output_b2 "" UWORD speedgoat_test_SN5659_R2020b_CM_uint16 0 0 0 65535 ECU_ADDRESS 0x0095C3CA /end MEASUREMENT
/begin MEASUREMENT speedgoat_test_SN5659_R2020b_B.Output_e "" UWORD speedgoat_test_SN5659_R2020b_CM_uint16 0 0 0 65535 ECU_ADDRESS 0x0095C3BE /end MEASUREMENT
/begin MEASUREMENT speedgoat_test_SN5659_R2020b_B.Output_g "" UBYTE speedgoat_test_SN5659_R2020b_CM_uint8 0 0 0 255 ECU_ADDRESS 0x0095C3F7 /end MEASUREMENT
/begin MEASUREMENT speedgoat_test_SN5659_R2020b_B.Output_j "" UWORD speedgoat_test_SN5659_R2020b_CM_uint16 0 0 0 65535 ECU_ADDRESS 0x0095C3B2 /end MEASUREMENT
/begin MEASUREMENT speedgoat_test_SN5659_R2020b_B.Output_k "" UWORD speedgoat_test_SN5659_R2020b_CM_uint16 0 0 0 65535 ECU_ADDRESS 0x0095C3C4 /end MEASUREMENT
/begin MEASUREMENT speedgoat_test_SN5659_R2020b_B.Output_m "" UWORD speedgoat_test_SN5659_R2020b_CM_uint16 0 0 0 65535 ECU_ADDRESS 0x0095C3B8 /end MEASUREMENT
/begin MEASUREMENT speedgoat_test_SN5659_R2020b_B.Output_p "" UWORD speedgoat_test_SN5659_R2020b_CM_uint16 0 0 0 65535 ECU_ADDRESS 0x0095C3AC /end MEASUREMENT
/begin MEASUREMENT speedgoat_test_SN5659_R2020b_B.Randomnumber_b "" FLOAT64_IEEE speedgoat_test_SN5659_R2020b_CM_double 0 0 -1.7E+308 1.7E+308 ECU_ADDRESS 0x0095B9C8 /end MEASUREMENT
/begin MEASUREMENT speedgoat_test_SN5659_R2020b_B.Randomnumber_br "" FLOAT64_IEEE speedgoat_test_SN5659_R2020b_CM_double 0 0 -1.7E+308 1.7E+308 ECU_ADDRESS 0x0095BB08 /end MEASUREMENT
/begin MEASUREMENT speedgoat_test_SN5659_R2020b_B.Randomnumber_e "" FLOAT64_IEEE speedgoat_test_SN5659_R2020b_CM_double 0 0 -1.7E+308 1.7E+308 ECU_ADDRESS 0x0095BB58 /end MEASUREMENT
/begin MEASUREMENT speedgoat_test_SN5659_R2020b_B.Randomnumber_f "" FLOAT64_IEEE speedgoat_test_SN5659_R2020b_CM_double 0 0 -1.7E+308 1.7E+308 ECU_ADDRESS 0x0095BBA8 /end MEASUREMENT
/begin MEASUREMENT speedgoat_test_SN5659_R2020b_B.Randomnumber_m "" FLOAT64_IEEE speedgoat_test_SN5659_R2020b_CM_double 0 0 -1.7E+308 1.7E+308 ECU_ADDRESS 0x0095BAB8 /end MEASUREMENT
/begin MEASUREMENT speedgoat_test_SN5659_R2020b_B.Randomnumber_n "" FLOAT64_IEEE speedgoat_test_SN5659_R2020b_CM_double 0 0 -1.7E+308 1.7E+308 ECU_ADDRESS 0x0095BA68 /end MEASUREMENT
/begin MEASUREMENT speedgoat_test_SN5659_R2020b_B.Randomnumber_pz "" FLOAT64_IEEE speedgoat_test_SN5659_R2020b_CM_double 0 0 -1.7E+308 1.7E+308 ECU_ADDRESS 0x0095BA18 /end MEASUREMENT
/begin MEASUREMENT speedgoat_test_SN5659_R2020b_B.ShifttoSDIslot "" ULONG speedgoat_test_SN5659_R2020b_CM_uint32 0 0 0 2147483646 ECU_ADDRESS 0x0095BE5C /end MEASUREMENT
/begin MEASUREMENT speedgoat_test_SN5659_R2020b_B.ShifttoSDIslot_b "" ULONG speedgoat_test_SN5659_R2020b_CM_uint32 0 0 0 2147483646 ECU_ADDRESS 0x0095BEAC /end MEASUREMENT
/begin MEASUREMENT speedgoat_test_SN5659_R2020b_B.ShifttoSDIslot_c "" ULONG speedgoat_test_SN5659_R2020b_CM_uint32 0 0 0 2147483646 ECU_ADDRESS 0x0095BED4 /end MEASUREMENT
/begin MEASUREMENT speedgoat_test_SN5659_R2020b_B.ShifttoSDIslot_g "" ULONG speedgoat_test_SN5659_R2020b_CM_uint32 0 0 0 2147483646 ECU_ADDRESS 0x0095BEFC /end MEASUREMENT
/begin MEASUREMENT speedgoat_test_SN5659_R2020b_B.ShifttoSDIslot_k "" ULONG speedgoat_test_SN5659_R2020b_CM_uint32 0 0 0 2147483646 ECU_ADDRESS 0x0095BE98 /end MEASUREMENT
/begin MEASUREMENT speedgoat_test_SN5659_R2020b_B.ShifttoSDIslot_km "" ULONG speedgoat_test_SN5659_R2020b_CM_uint32 0 0 0 2147483646 ECU_ADDRESS 0x0095BEC0 /end MEASUREMENT
/begin MEASUREMENT speedgoat_test_SN5659_R2020b_B.ShifttoSDIslot_m "" ULONG speedgoat_test_SN5659_R2020b_CM_uint32 0 0 0 2147483646 ECU_ADDRESS 0x0095BEE8 /end MEASUREMENT
/begin MEASUREMENT speedgoat_test_SN5659_R2020b_B.ShifttoSDIslot_n "" ULONG speedgoat_test_SN5659_R2020b_CM_uint32 0 0 0 2147483646 ECU_ADDRESS 0x0095BF10 /end MEASUREMENT
/begin MEASUREMENT speedgoat_test_SN5659_R2020b_B.ShifttoSSMslot "" ULONG speedgoat_test_SN5659_R2020b_CM_uint32 0 0 0 2147483646 ECU_ADDRESS 0x0095BE58 /end MEASUREMENT
/begin MEASUREMENT speedgoat_test_SN5659_R2020b_B.ShifttoSSMslot_b "" ULONG speedgoat_test_SN5659_R2020b_CM_uint32 0 0 0 2147483646 ECU_ADDRESS 0x0095BE94 /end MEASUREMENT
/begin MEASUREMENT speedgoat_test_SN5659_R2020b_B.ShifttoSSMslot_f "" ULONG speedgoat_test_SN5659_R2020b_CM_uint32 0 0 0 2147483646 ECU_ADDRESS 0x0095BED0 /end MEASUREMENT
/begin MEASUREMENT speedgoat_test_SN5659_R2020b_B.ShifttoSSMslot_g "" ULONG speedgoat_test_SN5659_R2020b_CM_uint32 0 0 0 2147483646 ECU_ADDRESS 0x0095BEF8 /end MEASUREMENT
/begin MEASUREMENT speedgoat_test_SN5659_R2020b_B.ShifttoSSMslot_k "" ULONG speedgoat_test_SN5659_R2020b_CM_uint32 0 0 0 2147483646 ECU_ADDRESS 0x0095BEA8 /end MEASUREMENT
/begin MEASUREMENT speedgoat_test_SN5659_R2020b_B.ShifttoSSMslot_kz "" ULONG speedgoat_test_SN5659_R2020b_CM_uint32 0 0 0 2147483646 ECU_ADDRESS 0x0095BF0C /end MEASUREMENT
/begin MEASUREMENT speedgoat_test_SN5659_R2020b_B.ShifttoSSMslot_m3 "" ULONG speedgoat_test_SN5659_R2020b_CM_uint32 0 0 0 2147483646 ECU_ADDRESS 0x0095BEE4 /end MEASUREMENT
/begin MEASUREMENT speedgoat_test_SN5659_R2020b_B.ShifttoSSMslot_mi "" ULONG speedgoat_test_SN5659_R2020b_CM_uint32 0 0 0 2147483646 ECU_ADDRESS 0x0095BEBC /end MEASUREMENT
/begin MEASUREMENT speedgoat_test_SN5659_R2020b_B.Sinewave_a "" FLOAT64_IEEE speedgoat_test_SN5659_R2020b_CM_double 0 0 -1.7E+308 1.7E+308 ECU_ADDRESS 0x0095BB28 /end MEASUREMENT
/begin MEASUREMENT speedgoat_test_SN5659_R2020b_B.Sinewave_g "" FLOAT64_IEEE speedgoat_test_SN5659_R2020b_CM_double 0 0 -1.7E+308 1.7E+308 ECU_ADDRESS 0x0095BA88 /end MEASUREMENT
/begin MEASUREMENT speedgoat_test_SN5659_R2020b_B.Sinewave_k "" FLOAT64_IEEE speedgoat_test_SN5659_R2020b_CM_double 0 0 -1.7E+308 1.7E+308 ECU_ADDRESS 0x0095B9E8 /end MEASUREMENT
/begin MEASUREMENT speedgoat_test_SN5659_R2020b_B.Sinewave_kh "" FLOAT64_IEEE speedgoat_test_SN5659_R2020b_CM_double 0 0 -1.7E+308 1.7E+308 ECU_ADDRESS 0x0095BAD8 /end MEASUREMENT
/begin MEASUREMENT speedgoat_test_SN5659_R2020b_B.Sinewave_o5 "" FLOAT64_IEEE speedgoat_test_SN5659_R2020b_CM_double 0 0 -1.7E+308 1.7E+308 ECU_ADDRESS 0x0095BB78 /end MEASUREMENT
/begin MEASUREMENT speedgoat_test_SN5659_R2020b_B.Sinewave_oh "" FLOAT64_IEEE speedgoat_test_SN5659_R2020b_CM_double 0 0 -1.7E+308 1.7E+308 ECU_ADDRESS 0x0095BBC8 /end MEASUREMENT
/begin MEASUREMENT speedgoat_test_SN5659_R2020b_B.Sinewave_p "" FLOAT64_IEEE speedgoat_test_SN5659_R2020b_CM_double 0 0 -1.7E+308 1.7E+308 ECU_ADDRESS 0x0095BA38 /end MEASUREMENT
/begin MEASUREMENT speedgoat_test_SN5659_R2020b_DW.NextOutput_f "" FLOAT64_IEEE speedgoat_test_SN5659_R2020b_CM_double 0 0 -1.7E+308 1.7E+308 ECU_ADDRESS 0x009588E8 /end MEASUREMENT
/begin MEASUREMENT speedgoat_test_SN5659_R2020b_DW.NextOutput_ft "" FLOAT64_IEEE speedgoat_test_SN5659_R2020b_CM_double 0 0 -1.7E+308 1.7E+308 ECU_ADDRESS 0x00958930 /end MEASUREMENT
/begin MEASUREMENT speedgoat_test_SN5659_R2020b_DW.NextOutput_i "" FLOAT64_IEEE speedgoat_test_SN5659_R2020b_CM_double 0 0 -1.7E+308 1.7E+308 ECU_ADDRESS 0x00958948 /end MEASUREMENT
/begin MEASUREMENT speedgoat_test_SN5659_R2020b_DW.NextOutput_j "" FLOAT64_IEEE speedgoat_test_SN5659_R2020b_CM_double 0 0 -1.7E+308 1.7E+308 ECU_ADDRESS 0x00958960 /end MEASUREMENT
/begin MEASUREMENT speedgoat_test_SN5659_R2020b_DW.NextOutput_m "" FLOAT64_IEEE speedgoat_test_SN5659_R2020b_CM_double 0 0 -1.7E+308 1.7E+308 ECU_ADDRESS 0x00958978 /end MEASUREMENT
/begin MEASUREMENT speedgoat_test_SN5659_R2020b_DW.NextOutput_ni "" FLOAT64_IEEE speedgoat_test_SN5659_R2020b_CM_double 0 0 -1.7E+308 1.7E+308 ECU_ADDRESS 0x00958918 /end MEASUREMENT
/begin MEASUREMENT speedgoat_test_SN5659_R2020b_DW.NextOutput_nj "" FLOAT64_IEEE speedgoat_test_SN5659_R2020b_CM_double 0 0 -1.7E+308 1.7E+308 ECU_ADDRESS 0x00958900 /end MEASUREMENT
/begin MEASUREMENT speedgoat_test_SN5659_R2020b_DW.Output_DSTATE_c "" UBYTE speedgoat_test_SN5659_R2020b_CM_uint8 0 0 0 255 ECU_ADDRESS 0x009598EC /end MEASUREMENT
/begin MEASUREMENT speedgoat_test_SN5659_R2020b_DW.Output_DSTATE_e "" UWORD speedgoat_test_SN5659_R2020b_CM_uint16 0 0 0 65535 ECU_ADDRESS 0x009598DA /end MEASUREMENT
/begin MEASUREMENT speedgoat_test_SN5659_R2020b_DW.Output_DSTATE_e0 "" UBYTE speedgoat_test_SN5659_R2020b_CM_uint8 0 0 0 255 ECU_ADDRESS 0x009598ED /end MEASUREMENT
/begin MEASUREMENT speedgoat_test_SN5659_R2020b_DW.Output_DSTATE_g "" UWORD speedgoat_test_SN5659_R2020b_CM_uint16 0 0 0 65535 ECU_ADDRESS 0x009598DE /end MEASUREMENT
/begin MEASUREMENT speedgoat_test_SN5659_R2020b_DW.Output_DSTATE_k "" UWORD speedgoat_test_SN5659_R2020b_CM_uint16 0 0 0 65535 ECU_ADDRESS 0x009598DC /end MEASUREMENT
/begin MEASUREMENT speedgoat_test_SN5659_R2020b_DW.Output_DSTATE_m "" UWORD speedgoat_test_SN5659_R2020b_CM_uint16 0 0 0 65535 ECU_ADDRESS 0x009598D6 /end MEASUREMENT
/begin MEASUREMENT speedgoat_test_SN5659_R2020b_DW.Output_DSTATE_o0 "" UWORD speedgoat_test_SN5659_R2020b_CM_uint16 0 0 0 65535 ECU_ADDRESS 0x009598D4 /end MEASUREMENT
/begin MEASUREMENT speedgoat_test_SN5659_R2020b_DW.Output_DSTATE_oy "" UWORD speedgoat_test_SN5659_R2020b_CM_uint16 0 0 0 65535 ECU_ADDRESS 0x009598D8 /end MEASUREMENT
/begin MEASUREMENT speedgoat_test_SN5659_R2020b_DW.RandSeed_b "" ULONG speedgoat_test_SN5659_R2020b_CM_uint32 0 0 0 2147483646 ECU_ADDRESS 0x009594F4 /end MEASUREMENT
/begin MEASUREMENT speedgoat_test_SN5659_R2020b_DW.RandSeed_d "" ULONG speedgoat_test_SN5659_R2020b_CM_uint32 0 0 0 2147483646 ECU_ADDRESS 0x009594F0 /end MEASUREMENT
/begin MEASUREMENT speedgoat_test_SN5659_R2020b_DW.RandSeed_f "" ULONG speedgoat_test_SN5659_R2020b_CM_uint32 0 0 0 2147483646 ECU_ADDRESS 0x009594E4 /end MEASUREMENT
/begin MEASUREMENT speedgoat_test_SN5659_R2020b_DW.RandSeed_f4 "" ULONG speedgoat_test_SN5659_R2020b_CM_uint32 0 0 0 2147483646 ECU_ADDRESS 0x009594E8 /end MEASUREMENT
/begin MEASUREMENT speedgoat_test_SN5659_R2020b_DW.RandSeed_g "" ULONG speedgoat_test_SN5659_R2020b_CM_uint32 0 0 0 2147483646 ECU_ADDRESS 0x009594E0 /end MEASUREMENT
/begin MEASUREMENT speedgoat_test_SN5659_R2020b_DW.RandSeed_i "" ULONG speedgoat_test_SN5659_R2020b_CM_uint32 0 0 0 2147483646 ECU_ADDRESS 0x009594EC /end MEASUREMENT
/begin MEASUREMENT speedgoat_test_SN5659_R2020b_DW.RandSeed_k "" ULONG speedgoat_test_SN5659_R2020b_CM_uint32 0 0 0 2147483646 ECU_ADDRESS 0x009594DC /end MEASUREMENT
/begin MEASUREMENT speedgoat_test_SN5659_R2020b_DW.lastCos_a "" FLOAT64_IEEE speedgoat_test_SN5659_R2020b_CM_double 0 0 -1.7E+308 1.7E+308 ECU_ADDRESS 0x009588F8 /end MEASUREMENT
/begin MEASUREMENT speedgoat_test_SN5659_R2020b_DW.lastCos_af "" FLOAT64_IEEE speedgoat_test_SN5659_R2020b_CM_double 0 0 -1.7E+308 1.7E+308 ECU_ADDRESS 0x00958910 /end MEASUREMENT
/begin MEASUREMENT speedgoat_test_SN5659_R2020b_DW.lastCos_gg "" FLOAT64_IEEE speedgoat_test_SN5659_R2020b_CM_double 0 0 -1.7E+308 1.7E+308 ECU_ADDRESS 0x00958988 /end MEASUREMENT
/begin MEASUREMENT speedgoat_test_SN5659_R2020b_DW.lastCos_ht "" FLOAT64_IEEE speedgoat_test_SN5659_R2020b_CM_double 0 0 -1.7E+308 1.7E+308 ECU_ADDRESS 0x00958928 /end MEASUREMENT
/begin MEASUREMENT speedgoat_test_SN5659_R2020b_DW.lastCos_l "" FLOAT64_IEEE speedgoat_test_SN5659_R2020b_CM_double 0 0 -1.7E+308 1.7E+308 ECU_ADDRESS 0x00958940 /end MEASUREMENT
/begin MEASUREMENT speedgoat_test_SN5659_R2020b_DW.lastCos_ld "" FLOAT64_IEEE speedgoat_test_SN5659_R2020b_CM_double 0 0 -1.7E+308 1.7E+308 ECU_ADDRESS 0x00958958 /end MEASUREMENT
/begin MEASUREMENT speedgoat_test_SN5659_R2020b_DW.lastCos_lh "" FLOAT64_IEEE speedgoat_test_SN5659_R2020b_CM_double 0 0 -1.7E+308 1.7E+308 ECU_ADDRESS 0x00958970 /end MEASUREMENT
/begin MEASUREMENT speedgoat_test_SN5659_R2020b_DW.lastSin_ct "" FLOAT64_IEEE speedgoat_test_SN5659_R2020b_CM_double 0 0 -1.7E+308 1.7E+308 ECU_ADDRESS 0x009588F0 /end MEASUREMENT
/begin MEASUREMENT speedgoat_test_SN5659_R2020b_DW.lastSin_dj "" FLOAT64_IEEE speedgoat_test_SN5659_R2020b_CM_double 0 0 -1.7E+308 1.7E+308 ECU_ADDRESS 0x00958920 /end MEASUREMENT
/begin MEASUREMENT speedgoat_test_SN5659_R2020b_DW.lastSin_du "" FLOAT64_IEEE speedgoat_test_SN5659_R2020b_CM_double 0 0 -1.7E+308 1.7E+308 ECU_ADDRESS 0x00958938 /end MEASUREMENT
/begin MEASUREMENT speedgoat_test_SN5659_R2020b_DW.lastSin_e "" FLOAT64_IEEE speedgoat_test_SN5659_R2020b_CM_double 0 0 -1.7E+308 1.7E+308 ECU_ADDRESS 0x00958968 /end MEASUREMENT
/begin MEASUREMENT speedgoat_test_SN5659_R2020b_DW.lastSin_f "" FLOAT64_IEEE speedgoat_test_SN5659_R2020b_CM_double 0 0 -1.7E+308 1.7E+308 ECU_ADDRESS 0x00958950 /end MEASUREMENT
/begin MEASUREMENT speedgoat_test_SN5659_R2020b_DW.lastSin_p "" FLOAT64_IEEE speedgoat_test_SN5659_R2020b_CM_double 0 0 -1.7E+308 1.7E+308 ECU_ADDRESS 0x00958908 /end MEASUREMENT
/begin MEASUREMENT speedgoat_test_SN5659_R2020b_DW.lastSin_pg "" FLOAT64_IEEE speedgoat_test_SN5659_R2020b_CM_double 0 0 -1.7E+308 1.7E+308 ECU_ADDRESS 0x00958980 /end MEASUREMENT
/begin MEASUREMENT speedgoat_test_SN5659_R2020b_DW.systemEnable_a "" SLONG speedgoat_test_SN5659_R2020b_CM_int32 0 0 -2147483648 2147483647 ECU_ADDRESS 0x00959494 /end MEASUREMENT
/begin MEASUREMENT speedgoat_test_SN5659_R2020b_DW.systemEnable_bx "" SLONG speedgoat_test_SN5659_R2020b_CM_int32 0 0 -2147483648 2147483647 ECU_ADDRESS 0x009594A0 /end MEASUREMENT
/begin MEASUREMENT speedgoat_test_SN5659_R2020b_DW.systemEnable_f "" SLONG speedgoat_test_SN5659_R2020b_CM_int32 0 0 -2147483648 2147483647 ECU_ADDRESS 0x00959488 /end MEASUREMENT
/begin MEASUREMENT speedgoat_test_SN5659_R2020b_DW.systemEnable_j "" SLONG speedgoat_test_SN5659_R2020b_CM_int32 0 0 -2147483648 2147483647 ECU_ADDRESS 0x00959490 /end MEASUREMENT
/begin MEASUREMENT speedgoat_test_SN5659_R2020b_DW.systemEnable_m "" SLONG speedgoat_test_SN5659_R2020b_CM_int32 0 0 -2147483648 2147483647 ECU_ADDRESS 0x0095948C /end MEASUREMENT
/begin MEASUREMENT speedgoat_test_SN5659_R2020b_DW.systemEnable_ml "" SLONG speedgoat_test_SN5659_R2020b_CM_int32 0 0 -2147483648 2147483647 ECU_ADDRESS 0x0095949C /end MEASUREMENT
/begin MEASUREMENT speedgoat_test_SN5659_R2020b_DW.systemEnable_p0 "" SLONG speedgoat_test_SN5659_R2020b_CM_int32 0 0 -2147483648 2147483647 ECU_ADDRESS 0x00959498 /end MEASUREMENT
/begin COMPU_METHOD speedgoat_test_SN5659_R2020b_CM_double "" IDENTICAL "%15.10" "" /end COMPU_METHOD
/begin COMPU_METHOD speedgoat_test_SN5659_R2020b_CM_int32 "" IDENTICAL "%10.0" "" /end COMPU_METHOD
/begin COMPU_METHOD speedgoat_test_SN5659_R2020b_CM_uint16 "" IDENTICAL "%5.0" "" /end COMPU_METHOD
/begin COMPU_METHOD speedgoat_test_SN5659_R2020b_CM_uint32 "" IDENTICAL "%10.0" "" /end COMPU_METHOD
/begin COMPU_METHOD speedgoat_test_SN5659_R2020b_CM_uint8 "" IDENTICAL "%3.0" "" /end COMPU_METHOD
/begin RECORD_LAYOUT Scalar_BOOLEAN FNC_VALUES 1 UBYTE COLUMN_DIR DIRECT /end RECORD_LAYOUT
/begin RECORD_LAYOUT Scalar_FLOAT64_IEEE FNC_VALUES 1 FLOAT64_IEEE COLUMN_DIR DIRECT /end RECORD_LAYOUT
/begin RECORD_LAYOUT Scalar_UBYTE FNC_VALUES 1 UBYTE COLUMN_DIR DIRECT /end RECORD_LAYOUT
/begin RECORD_LAYOUT Scalar_ULONG FNC_VALUES 1 ULONG COLUMN_DIR DIRECT /end RECORD_LAYOUT
/begin RECORD_LAYOUT Scalar_UWORD FNC_VALUES 1 UWORD COLUMN_DIR DIRECT /end RECORD_LAYOUT
/begin GROUP speedgoat_test_SN5659_R2020b_IO682_Encode_Channel_12 "speedgoat_test_SN5659_R2020b/IO682/Encode Channel 12"
 /begin SUB_GROUP speedgoat_test_SN5659_R2020b_IO682_Encode_Channel_12_Counter_Limited speedgoat_test_SN5659_R2020b_IO682_Encode_Channel_12_Prepare_RAW_value /end SUB_GROUP
 /begin REF_CHARACTERISTIC speedgoat_test_SN5659__cal_impl.Constant_Value_e speedgoat_test_SN5659__cal_impl.Encode1_P10_p speedgoat_test_SN5659__cal_impl.Encode1_P11_b speedgoat_test_SN5659__cal_impl.Encode1_P12_no speedgoat_test_SN5659__cal_impl.Encode1_P13_it speedgoat_test_SN5659__cal_impl.Encode1_P14_ho speedgoat_test_SN5659__cal_impl.Encode1_P15_k speedgoat_test_SN5659__cal_impl.Encode1_P1_i speedgoat_test_SN5659__cal_impl.Encode1_P2_l speedgoat_test_SN5659__cal_impl.Encode1_P3_b speedgoat_test_SN5659__cal_impl.Encode1_P4_a speedgoat_test_SN5659__cal_impl.Encode1_P5_j speedgoat_test_SN5659__cal_impl.Encode1_P6_e speedgoat_test_SN5659__cal_impl.Encode1_P7_db speedgoat_test_SN5659__cal_impl.Encode1_P8_b speedgoat_test_SN5659__cal_impl.Encode1_P9_md speedgoat_test_SN5659__cal_impl.Encode2_P10_i speedgoat_test_SN5659__cal_impl.Encode2_P11_h speedgoat_test_SN5659__cal_impl.Encode2_P12_k speedgoat_test_SN5659__cal_impl.Encode2_P13_f speedgoat_test_SN5659__cal_impl.Encode2_P14_f speedgoat_test_SN5659__cal_impl.Encode2_P15_o speedgoat_test_SN5659__cal_impl.Encode2_P1_p speedgoat_test_SN5659__cal_impl.Encode2_P2_k speedgoat_test_SN5659__cal_impl.Encode2_P3_l speedgoat_test_SN5659__cal_impl.Encode2_P4_j speedgoat_test_SN5659__cal_impl.Encode2_P5_d speedgoat_test_SN5659__cal_impl.Encode2_P6_e speedgoat_test_SN5659__cal_impl.Encode2_P7_f speedgoat_test_SN5659__cal_impl.Encode2_P8_i speedgoat_test_SN5659__cal_impl.Encode2_P9_pe speedgoat_test_SN5659__cal_impl.Encode3_P10_m speedgoat_test_SN5659__cal_impl.Encode3_P11_i speedgoat_test_SN5659__cal_impl.Encode3_P12_b speedgoat_test_SN5659__cal_impl.Encode3_P13_g speedgoat_test_SN5659__cal_impl.Encode3_P14_o speedgoat_test_SN5659__cal_impl.Encode3_P15_hk speedgoat_test_SN5659__cal_impl.Encode3_P1_n speedgoat_test_SN5659__cal_impl.Encode3_P2_i speedgoat_test_SN5659__cal_impl.Encode3_P3_j speedgoat_test_SN5659__cal_impl.Encode3_P4_l speedgoat_test_SN5659__cal_impl.Encode3_P5_b speedgoat_test_SN5659__cal_impl.Encode3_P6_j speedgoat_test_SN5659__cal_impl.Encode3_P7_l speedgoat_test_SN5659__cal_impl.Encode3_P8_h speedgoat_test_SN5659__cal_impl.Encode3_P9_b speedgoat_test_SN5659__cal_impl.Encode4_P10_o speedgoat_test_SN5659__cal_impl.Encode4_P11_o speedgoat_test_SN5659__cal_impl.Encode4_P12_d speedgoat_test_SN5659__cal_impl.Encode4_P13_f speedgoat_test_SN5659__cal_impl.Encode4_P14_j speedgoat_test_SN5659__cal_impl.Encode4_P15_g speedgoat_test_SN5659__cal_impl.Encode4_P1_f speedgoat_test_SN5659__cal_impl.Encode4_P2_l speedgoat_test_SN5659__cal_impl.Encode4_P3_p speedgoat_test_SN5659__cal_impl.Encode4_P4_k speedgoat_test_SN5659__cal_impl.Encode4_P5_p speedgoat_test_SN5659__cal_impl.Encode4_P6_k speedgoat_test_SN5659__cal_impl.Encode4_P7_c speedgoat_test_SN5659__cal_impl.Encode4_P8_j speedgoat_test_SN5659__cal_impl.Encode4_P9_c speedgoat_test_SN5659__cal_impl.Randomnumber_Mean_fn speedgoat_test_SN5659__cal_impl.Randomnumber_Seed_f speedgoat_test_SN5659__cal_impl.Randomnumber_StdDev_j speedgoat_test_SN5659__cal_impl.Sinewave_Amp_d speedgoat_test_SN5659__cal_impl.Sinewave_Bias_e speedgoat_test_SN5659__cal_impl.Sinewave_Freq_a speedgoat_test_SN5659__cal_impl.Sinewave_HCos_j4 speedgoat_test_SN5659__cal_impl.Sinewave_Hsin_d speedgoat_test_SN5659__cal_impl.Sinewave_PCos_p speedgoat_test_SN5659__cal_impl.Sinewave_PSin_c /end REF_CHARACTERISTIC
 /begin REF_MEASUREMENT speedgoat_test_SN5659_R2020b_B.DataTypeConversion1_p speedgoat_test_SN5659_R2020b_B.DataTypeConversion_j speedgoat_test_SN5659_R2020b_B.Encode1_k speedgoat_test_SN5659_R2020b_B.Encode2_i speedgoat_test_SN5659_R2020b_B.Encode3_o speedgoat_test_SN5659_R2020b_B.Encode4_c speedgoat_test_SN5659_R2020b_B.Output_p speedgoat_test_SN5659_R2020b_B.Randomnumber_b speedgoat_test_SN5659_R2020b_B.Sinewave_k speedgoat_test_SN5659_R2020b_DW.NextOutput_f speedgoat_test_SN5659_R2020b_DW.RandSeed_k speedgoat_test_SN5659_R2020b_DW.lastCos_a speedgoat_test_SN5659_R2020b_DW.lastSin_ct speedgoat_test_SN5659_R2020b_DW.systemEnable_f /end REF_MEASUREMENT
/end GROUP
/begin GROUP speedgoat_test_SN5659_R2020b_IO682_Encode_Channel_12_Counter_Limited "speedgoat_test_SN5659_R2020b/IO682/Encode Channel 12/Counter
Limited"
 /begin SUB_GROUP speedgoat_test_SN5659_R2020b_IO682_Encode_Channel_12_Counter_Limited_Increment_Real_World speedgoat_test_SN5659_R2020b_IO682_Encode_Channel_12_Counter_Limited_Wrap_To_Zero /end SUB_GROUP
 /begin REF_CHARACTERISTIC speedgoat_test_SN5659__cal_impl.Output_InitialCondition_c /end REF_CHARACTERISTIC
 /begin REF_MEASUREMENT speedgoat_test_SN5659_R2020b_B.FixPtSwitch_b speedgoat_test_SN5659_R2020b_B.Output_p speedgoat_test_SN5659_R2020b_DW.Output_DSTATE_o0 /end REF_MEASUREMENT
/end GROUP
/begin GROUP speedgoat_test_SN5659_R2020b_IO682_Encode_Channel_12_Counter_Limited_Increment_Real_World "speedgoat_test_SN5659_R2020b/IO682/Encode Channel 12/Counter
Limited/Increment
Real World" /begin REF_CHARACTERISTIC speedgoat_test_SN5659__cal_impl.FixPtConstant_Value_o /end REF_CHARACTERISTIC
 /begin REF_MEASUREMENT speedgoat_test_SN5659_R2020b_B.FixPtSum1_a speedgoat_test_SN5659_R2020b_B.Output_p /end REF_MEASUREMENT
/end GROUP
/begin GROUP speedgoat_test_SN5659_R2020b_IO682_Encode_Channel_12_Counter_Limited_Wrap_To_Zero "speedgoat_test_SN5659_R2020b/IO682/Encode Channel 12/Counter
Limited/Wrap To Zero"
 /begin REF_CHARACTERISTIC speedgoat_test_SN5659__cal_impl.Constant_Value_n speedgoat_test_SN5659__cal_impl.CounterLimited_uplimit_k /end REF_CHARACTERISTIC
 /begin REF_MEASUREMENT speedgoat_test_SN5659_R2020b_B.FixPtSum1_a speedgoat_test_SN5659_R2020b_B.FixPtSwitch_b /end REF_MEASUREMENT
/end GROUP
/begin GROUP speedgoat_test_SN5659_R2020b_IO682_Encode_Channel_12_Prepare_RAW_value "speedgoat_test_SN5659_R2020b/IO682/Encode Channel 12/Prepare RAW value"
 /begin REF_CHARACTERISTIC speedgoat_test_SN5659__cal_impl.Label_Value_j speedgoat_test_SN5659__cal_impl.Mask_BitMask_d speedgoat_test_SN5659__cal_impl.SDI_Value_l speedgoat_test_SN5659__cal_impl.SSM_Value_n speedgoat_test_SN5659__cal_impl.Scale_Value_b speedgoat_test_SN5659__cal_impl.shiftthedoublevalue27bitsleft_g /end REF_CHARACTERISTIC
 /begin REF_MEASUREMENT speedgoat_test_SN5659_R2020b_B.BitwiseOperator_p speedgoat_test_SN5659_R2020b_B.DataTypeConversion1_p speedgoat_test_SN5659_R2020b_B.DataTypeConversion_jj speedgoat_test_SN5659_R2020b_B.Divide_p speedgoat_test_SN5659_R2020b_B.Mask_i speedgoat_test_SN5659_R2020b_B.Multiply_j speedgoat_test_SN5659_R2020b_B.ShifttoSDIslot_k speedgoat_test_SN5659_R2020b_B.ShifttoSSMslot_b /end REF_MEASUREMENT
/end GROUP
/begin GROUP speedgoat_test_SN5659_R2020b_IO682_Encode_Channel_13 "speedgoat_test_SN5659_R2020b/IO682/Encode Channel 13"
 /begin SUB_GROUP speedgoat_test_SN5659_R2020b_IO682_Encode_Channel_13_Counter_Limited speedgoat_test_SN5659_R2020b_IO682_Encode_Channel_13_Prepare_RAW_value /end SUB_GROUP
 /begin REF_CHARACTERISTIC speedgoat_test_SN5659__cal_impl.Constant_Value_d speedgoat_test_SN5659__cal_impl.Encode1_P10_l speedgoat_test_SN5659__cal_impl.Encode1_P11_bk speedgoat_test_SN5659__cal_impl.Encode1_P12_o speedgoat_test_SN5659__cal_impl.Encode1_P13_o speedgoat_test_SN5659__cal_impl.Encode1_P14_g speedgoat_test_SN5659__cal_impl.Encode1_P15_j speedgoat_test_SN5659__cal_impl.Encode1_P1_g speedgoat_test_SN5659__cal_impl.Encode1_P2_p speedgoat_test_SN5659__cal_impl.Encode1_P3_o0 speedgoat_test_SN5659__cal_impl.Encode1_P4_c speedgoat_test_SN5659__cal_impl.Encode1_P5_oz speedgoat_test_SN5659__cal_impl.Encode1_P6_n5 speedgoat_test_SN5659__cal_impl.Encode1_P7_dz speedgoat_test_SN5659__cal_impl.Encode1_P8_d speedgoat_test_SN5659__cal_impl.Encode1_P9_a speedgoat_test_SN5659__cal_impl.Encode2_P10_g speedgoat_test_SN5659__cal_impl.Encode2_P11_gc speedgoat_test_SN5659__cal_impl.Encode2_P12_me speedgoat_test_SN5659__cal_impl.Encode2_P13_e speedgoat_test_SN5659__cal_impl.Encode2_P14_b speedgoat_test_SN5659__cal_impl.Encode2_P15_k speedgoat_test_SN5659__cal_impl.Encode2_P1_m speedgoat_test_SN5659__cal_impl.Encode2_P2_f speedgoat_test_SN5659__cal_impl.Encode2_P3_g speedgoat_test_SN5659__cal_impl.Encode2_P4_m speedgoat_test_SN5659__cal_impl.Encode2_P5_j speedgoat_test_SN5659__cal_impl.Encode2_P6_m speedgoat_test_SN5659__cal_impl.Encode2_P7_j speedgoat_test_SN5659__cal_impl.Encode2_P8_iw speedgoat_test_SN5659__cal_impl.Encode2_P9_pd speedgoat_test_SN5659__cal_impl.Encode3_P10_l speedgoat_test_SN5659__cal_impl.Encode3_P11_h speedgoat_test_SN5659__cal_impl.Encode3_P12_c speedgoat_test_SN5659__cal_impl.Encode3_P13_e speedgoat_test_SN5659__cal_impl.Encode3_P14_b speedgoat_test_SN5659__cal_impl.Encode3_P15_i speedgoat_test_SN5659__cal_impl.Encode3_P1_i speedgoat_test_SN5659__cal_impl.Encode3_P2_a speedgoat_test_SN5659__cal_impl.Encode3_P3_c speedgoat_test_SN5659__cal_impl.Encode3_P4_ls speedgoat_test_SN5659__cal_impl.Encode3_P5_bo speedgoat_test_SN5659__cal_impl.Encode3_P6_a speedgoat_test_SN5659__cal_impl.Encode3_P7_d speedgoat_test_SN5659__cal_impl.Encode3_P8_k speedgoat_test_SN5659__cal_impl.Encode3_P9_b5 speedgoat_test_SN5659__cal_impl.Encode5_P10_a speedgoat_test_SN5659__cal_impl.Encode5_P11_n speedgoat_test_SN5659__cal_impl.Encode5_P12_m speedgoat_test_SN5659__cal_impl.Encode5_P13_g speedgoat_test_SN5659__cal_impl.Encode5_P14_l speedgoat_test_SN5659__cal_impl.Encode5_P15_c speedgoat_test_SN5659__cal_impl.Encode5_P1_f speedgoat_test_SN5659__cal_impl.Encode5_P2_e speedgoat_test_SN5659__cal_impl.Encode5_P3_m speedgoat_test_SN5659__cal_impl.Encode5_P4_a speedgoat_test_SN5659__cal_impl.Encode5_P5_i speedgoat_test_SN5659__cal_impl.Encode5_P6_d speedgoat_test_SN5659__cal_impl.Encode5_P7_f speedgoat_test_SN5659__cal_impl.Encode5_P8_k speedgoat_test_SN5659__cal_impl.Encode5_P9_l speedgoat_test_SN5659__cal_impl.Randomnumber_Mean_a speedgoat_test_SN5659__cal_impl.Randomnumber_Seed_c speedgoat_test_SN5659__cal_impl.Randomnumber_StdDev_k speedgoat_test_SN5659__cal_impl.Sinewave_Amp_h speedgoat_test_SN5659__cal_impl.Sinewave_Bias_m speedgoat_test_SN5659__cal_impl.Sinewave_Freq_m speedgoat_test_SN5659__cal_impl.Sinewave_HCos_o speedgoat_test_SN5659__cal_impl.Sinewave_Hsin_o speedgoat_test_SN5659__cal_impl.Sinewave_PCos_h speedgoat_test_SN5659__cal_impl.Sinewave_PSin_e /end REF_CHARACTERISTIC
 /begin REF_MEASUREMENT speedgoat_test_SN5659_R2020b_B.DataTypeConversion1_n speedgoat_test_SN5659_R2020b_B.DataTypeConversion_p speedgoat_test_SN5659_R2020b_B.Encode1_l speedgoat_test_SN5659_R2020b_B.Encode2_j speedgoat_test_SN5659_R2020b_B.Encode3_p speedgoat_test_SN5659_R2020b_B.Encode5_d speedgoat_test_SN5659_R2020b_B.Output_j speedgoat_test_SN5659_R2020b_B.Randomnumber_pz speedgoat_test_SN5659_R2020b_B.Sinewave_p speedgoat_test_SN5659_R2020b_DW.NextOutput_nj speedgoat_test_SN5659_R2020b_DW.RandSeed_g speedgoat_test_SN5659_R2020b_DW.lastCos_af speedgoat_test_SN5659_R2020b_DW.lastSin_p speedgoat_test_SN5659_R2020b_DW.systemEnable_m /end REF_MEASUREMENT
/end GROUP
/begin GROUP speedgoat_test_SN5659_R2020b_IO682_Encode_Channel_13_Counter_Limited "speedgoat_test_SN5659_R2020b/IO682/Encode Channel 13/Counter
Limited"
 /begin SUB_GROUP speedgoat_test_SN5659_R2020b_IO682_Encode_Channel_13_Counter_Limited_Increment_Real_World speedgoat_test_SN5659_R2020b_IO682_Encode_Channel_13_Counter_Limited_Wrap_To_Zero /end SUB_GROUP
 /begin REF_CHARACTERISTIC speedgoat_test_SN5659__cal_impl.Output_InitialCondition_k /end REF_CHARACTERISTIC
 /begin REF_MEASUREMENT speedgoat_test_SN5659_R2020b_B.FixPtSwitch_l speedgoat_test_SN5659_R2020b_B.Output_j speedgoat_test_SN5659_R2020b_DW.Output_DSTATE_m /end REF_MEASUREMENT
/end GROUP
/begin GROUP speedgoat_test_SN5659_R2020b_IO682_Encode_Channel_13_Counter_Limited_Increment_Real_World "speedgoat_test_SN5659_R2020b/IO682/Encode Channel 13/Counter
Limited/Increment
Real World" /begin REF_CHARACTERISTIC speedgoat_test_SN5659__cal_impl.FixPtConstant_Value_oz /end REF_CHARACTERISTIC
 /begin REF_MEASUREMENT speedgoat_test_SN5659_R2020b_B.FixPtSum1_g speedgoat_test_SN5659_R2020b_B.Output_j /end REF_MEASUREMENT
/end GROUP
/begin GROUP speedgoat_test_SN5659_R2020b_IO682_Encode_Channel_13_Counter_Limited_Wrap_To_Zero "speedgoat_test_SN5659_R2020b/IO682/Encode Channel 13/Counter
Limited/Wrap To Zero"
 /begin REF_CHARACTERISTIC speedgoat_test_SN5659__cal_impl.Constant_Value_a speedgoat_test_SN5659__cal_impl.CounterLimited_uplimit_c /end REF_CHARACTERISTIC
 /begin REF_MEASUREMENT speedgoat_test_SN5659_R2020b_B.FixPtSum1_g speedgoat_test_SN5659_R2020b_B.FixPtSwitch_l /end REF_MEASUREMENT
/end GROUP
/begin GROUP speedgoat_test_SN5659_R2020b_IO682_Encode_Channel_13_Prepare_RAW_value "speedgoat_test_SN5659_R2020b/IO682/Encode Channel 13/Prepare RAW value"
 /begin REF_CHARACTERISTIC speedgoat_test_SN5659__cal_impl.Label_Value_ex speedgoat_test_SN5659__cal_impl.Mask_BitMask_e speedgoat_test_SN5659__cal_impl.SDI_Value_a speedgoat_test_SN5659__cal_impl.SSM_Value_m speedgoat_test_SN5659__cal_impl.Scale_Value_f speedgoat_test_SN5659__cal_impl.shiftthedoublevalue27bitsleft_i /end REF_CHARACTERISTIC
 /begin REF_MEASUREMENT speedgoat_test_SN5659_R2020b_B.BitwiseOperator_k speedgoat_test_SN5659_R2020b_B.DataTypeConversion1_n speedgoat_test_SN5659_R2020b_B.DataTypeConversion_b speedgoat_test_SN5659_R2020b_B.Divide_i speedgoat_test_SN5659_R2020b_B.Mask_c speedgoat_test_SN5659_R2020b_B.Multiply_he speedgoat_test_SN5659_R2020b_B.ShifttoSDIslot_b speedgoat_test_SN5659_R2020b_B.ShifttoSSMslot_k /end REF_MEASUREMENT
/end GROUP
/begin GROUP speedgoat_test_SN5659_R2020b_IO682_Encode_Channel_14 "speedgoat_test_SN5659_R2020b/IO682/Encode Channel 14"
 /begin SUB_GROUP speedgoat_test_SN5659_R2020b_IO682_Encode_Channel_14_Counter_Limited speedgoat_test_SN5659_R2020b_IO682_Encode_Channel_14_Prepare_RAW_value /end SUB_GROUP
 /begin REF_CHARACTERISTIC speedgoat_test_SN5659__cal_impl.Constant_Value_g speedgoat_test_SN5659__cal_impl.Encode1_P10_pc speedgoat_test_SN5659__cal_impl.Encode1_P11_a speedgoat_test_SN5659__cal_impl.Encode1_P12_h speedgoat_test_SN5659__cal_impl.Encode1_P13_l speedgoat_test_SN5659__cal_impl.Encode1_P14_e speedgoat_test_SN5659__cal_impl.Encode1_P15_m speedgoat_test_SN5659__cal_impl.Encode1_P1_f speedgoat_test_SN5659__cal_impl.Encode1_P2_pf speedgoat_test_SN5659__cal_impl.Encode1_P3_h speedgoat_test_SN5659__cal_impl.Encode1_P4_o speedgoat_test_SN5659__cal_impl.Encode1_P5_l speedgoat_test_SN5659__cal_impl.Encode1_P6_d speedgoat_test_SN5659__cal_impl.Encode1_P7_b speedgoat_test_SN5659__cal_impl.Encode1_P8_f speedgoat_test_SN5659__cal_impl.Encode1_P9_ng speedgoat_test_SN5659__cal_impl.Encode2_P10_a speedgoat_test_SN5659__cal_impl.Encode2_P11_ga speedgoat_test_SN5659__cal_impl.Encode2_P12_f speedgoat_test_SN5659__cal_impl.Encode2_P13_o speedgoat_test_SN5659__cal_impl.Encode2_P14_po speedgoat_test_SN5659__cal_impl.Encode2_P15_h speedgoat_test_SN5659__cal_impl.Encode2_P1_e speedgoat_test_SN5659__cal_impl.Encode2_P2_h speedgoat_test_SN5659__cal_impl.Encode2_P3_f speedgoat_test_SN5659__cal_impl.Encode2_P4_b speedgoat_test_SN5659__cal_impl.Encode2_P5_p speedgoat_test_SN5659__cal_impl.Encode2_P6_l speedgoat_test_SN5659__cal_impl.Encode2_P7_jh speedgoat_test_SN5659__cal_impl.Encode2_P8_n speedgoat_test_SN5659__cal_impl.Encode2_P9_h speedgoat_test_SN5659__cal_impl.Encode3_P10_l1 speedgoat_test_SN5659__cal_impl.Encode3_P11_c speedgoat_test_SN5659__cal_impl.Encode3_P12_p speedgoat_test_SN5659__cal_impl.Encode3_P13_p speedgoat_test_SN5659__cal_impl.Encode3_P14_f speedgoat_test_SN5659__cal_impl.Encode3_P15_hl speedgoat_test_SN5659__cal_impl.Encode3_P1_a speedgoat_test_SN5659__cal_impl.Encode3_P2_b speedgoat_test_SN5659__cal_impl.Encode3_P3_g speedgoat_test_SN5659__cal_impl.Encode3_P4_b speedgoat_test_SN5659__cal_impl.Encode3_P5_ij speedgoat_test_SN5659__cal_impl.Encode3_P6_jb speedgoat_test_SN5659__cal_impl.Encode3_P7_f speedgoat_test_SN5659__cal_impl.Encode3_P8_l speedgoat_test_SN5659__cal_impl.Encode3_P9_c speedgoat_test_SN5659__cal_impl.Encode4_P10_o2 speedgoat_test_SN5659__cal_impl.Encode4_P11_p speedgoat_test_SN5659__cal_impl.Encode4_P12_h speedgoat_test_SN5659__cal_impl.Encode4_P13_o speedgoat_test_SN5659__cal_impl.Encode4_P14_lr speedgoat_test_SN5659__cal_impl.Encode4_P15_a speedgoat_test_SN5659__cal_impl.Encode4_P1_fl speedgoat_test_SN5659__cal_impl.Encode4_P2_f speedgoat_test_SN5659__cal_impl.Encode4_P3_h speedgoat_test_SN5659__cal_impl.Encode4_P4_b speedgoat_test_SN5659__cal_impl.Encode4_P5_o speedgoat_test_SN5659__cal_impl.Encode4_P6_kc speedgoat_test_SN5659__cal_impl.Encode4_P7_d speedgoat_test_SN5659__cal_impl.Encode4_P8_oo speedgoat_test_SN5659__cal_impl.Encode4_P9_n speedgoat_test_SN5659__cal_impl.Randomnumber_Mean_h speedgoat_test_SN5659__cal_impl.Randomnumber_Seed_p speedgoat_test_SN5659__cal_impl.Randomnumber_StdDev_g speedgoat_test_SN5659__cal_impl.Sinewave_Amp_n speedgoat_test_SN5659__cal_impl.Sinewave_Bias_j speedgoat_test_SN5659__cal_impl.Sinewave_Freq_ah speedgoat_test_SN5659__cal_impl.Sinewave_HCos_jn speedgoat_test_SN5659__cal_impl.Sinewave_Hsin_i speedgoat_test_SN5659__cal_impl.Sinewave_PCos_f speedgoat_test_SN5659__cal_impl.Sinewave_PSin_f /end REF_CHARACTERISTIC
 /begin REF_MEASUREMENT speedgoat_test_SN5659_R2020b_B.DataTypeConversion1_gm speedgoat_test_SN5659_R2020b_B.DataTypeConversion_o speedgoat_test_SN5659_R2020b_B.Encode1_p speedgoat_test_SN5659_R2020b_B.Encode2_fi speedgoat_test_SN5659_R2020b_B.Encode3_f speedgoat_test_SN5659_R2020b_B.Encode4_g speedgoat_test_SN5659_R2020b_B.Output_m speedgoat_test_SN5659_R2020b_B.Randomnumber_n speedgoat_test_SN5659_R2020b_B.Sinewave_g speedgoat_test_SN5659_R2020b_DW.NextOutput_ni speedgoat_test_SN5659_R2020b_DW.RandSeed_f speedgoat_test_SN5659_R2020b_DW.lastCos_ht speedgoat_test_SN5659_R2020b_DW.lastSin_dj speedgoat_test_SN5659_R2020b_DW.systemEnable_j /end REF_MEASUREMENT
/end GROUP
/begin GROUP speedgoat_test_SN5659_R2020b_IO682_Encode_Channel_14_Counter_Limited "speedgoat_test_SN5659_R2020b/IO682/Encode Channel 14/Counter
Limited"
 /begin SUB_GROUP speedgoat_test_SN5659_R2020b_IO682_Encode_Channel_14_Counter_Limited_Increment_Real_World speedgoat_test_SN5659_R2020b_IO682_Encode_Channel_14_Counter_Limited_Wrap_To_Zero /end SUB_GROUP
 /begin REF_CHARACTERISTIC speedgoat_test_SN5659__cal_impl.Output_InitialCondition_e /end REF_CHARACTERISTIC
 /begin REF_MEASUREMENT speedgoat_test_SN5659_R2020b_B.FixPtSwitch_bx speedgoat_test_SN5659_R2020b_B.Output_m speedgoat_test_SN5659_R2020b_DW.Output_DSTATE_oy /end REF_MEASUREMENT
/end GROUP
/begin GROUP speedgoat_test_SN5659_R2020b_IO682_Encode_Channel_14_Counter_Limited_Increment_Real_World "speedgoat_test_SN5659_R2020b/IO682/Encode Channel 14/Counter
Limited/Increment
Real World" /begin REF_CHARACTERISTIC speedgoat_test_SN5659__cal_impl.FixPtConstant_Value_j /end REF_CHARACTERISTIC
 /begin REF_MEASUREMENT speedgoat_test_SN5659_R2020b_B.FixPtSum1_e speedgoat_test_SN5659_R2020b_B.Output_m /end REF_MEASUREMENT
/end GROUP
/begin GROUP speedgoat_test_SN5659_R2020b_IO682_Encode_Channel_14_Counter_Limited_Wrap_To_Zero "speedgoat_test_SN5659_R2020b/IO682/Encode Channel 14/Counter
Limited/Wrap To Zero"
 /begin REF_CHARACTERISTIC speedgoat_test_SN5659__cal_impl.Constant_Value_k speedgoat_test_SN5659__cal_impl.CounterLimited_uplimit_n /end REF_CHARACTERISTIC
 /begin REF_MEASUREMENT speedgoat_test_SN5659_R2020b_B.FixPtSum1_e speedgoat_test_SN5659_R2020b_B.FixPtSwitch_bx /end REF_MEASUREMENT
/end GROUP
/begin GROUP speedgoat_test_SN5659_R2020b_IO682_Encode_Channel_14_Prepare_RAW_value "speedgoat_test_SN5659_R2020b/IO682/Encode Channel 14/Prepare RAW value"
 /begin REF_CHARACTERISTIC speedgoat_test_SN5659__cal_impl.Label_Value_f speedgoat_test_SN5659__cal_impl.Mask_BitMask_p speedgoat_test_SN5659__cal_impl.SDI_Value_h speedgoat_test_SN5659__cal_impl.SSM_Value_j speedgoat_test_SN5659__cal_impl.Scale_Value_d speedgoat_test_SN5659__cal_impl.shiftthedoublevalue27bitslef_pp /end REF_CHARACTERISTIC
 /begin REF_MEASUREMENT speedgoat_test_SN5659_R2020b_B.BitwiseOperator_c speedgoat_test_SN5659_R2020b_B.DataTypeConversion1_gm speedgoat_test_SN5659_R2020b_B.DataTypeConversion_er speedgoat_test_SN5659_R2020b_B.Divide_j speedgoat_test_SN5659_R2020b_B.Mask_m speedgoat_test_SN5659_R2020b_B.Multiply_i speedgoat_test_SN5659_R2020b_B.ShifttoSDIslot_km speedgoat_test_SN5659_R2020b_B.ShifttoSSMslot_mi /end REF_MEASUREMENT
/end GROUP
/begin GROUP speedgoat_test_SN5659_R2020b_IO682_Encode_Channel_15 "speedgoat_test_SN5659_R2020b/IO682/Encode Channel 15"
 /begin SUB_GROUP speedgoat_test_SN5659_R2020b_IO682_Encode_Channel_15_Counter_Limited speedgoat_test_SN5659_R2020b_IO682_Encode_Channel_15_Prepare_RAW_value /end SUB_GROUP
 /begin REF_CHARACTERISTIC speedgoat_test_SN5659__cal_impl.Constant_Value_l speedgoat_test_SN5659__cal_impl.Encode1_P10_k speedgoat_test_SN5659__cal_impl.Encode1_P11_n speedgoat_test_SN5659__cal_impl.Encode1_P12_j speedgoat_test_SN5659__cal_impl.Encode1_P13_f speedgoat_test_SN5659__cal_impl.Encode1_P14_c speedgoat_test_SN5659__cal_impl.Encode1_P15_a speedgoat_test_SN5659__cal_impl.Encode1_P1_h speedgoat_test_SN5659__cal_impl.Encode1_P2_e speedgoat_test_SN5659__cal_impl.Encode1_P3_i speedgoat_test_SN5659__cal_impl.Encode1_P4_el speedgoat_test_SN5659__cal_impl.Encode1_P5_g speedgoat_test_SN5659__cal_impl.Encode1_P6_a speedgoat_test_SN5659__cal_impl.Encode1_P7_a speedgoat_test_SN5659__cal_impl.Encode1_P8_dh speedgoat_test_SN5659__cal_impl.Encode1_P9_k speedgoat_test_SN5659__cal_impl.Encode2_P10_ab speedgoat_test_SN5659__cal_impl.Encode2_P11_k speedgoat_test_SN5659__cal_impl.Encode2_P12_d speedgoat_test_SN5659__cal_impl.Encode2_P13_n speedgoat_test_SN5659__cal_impl.Encode2_P14_n speedgoat_test_SN5659__cal_impl.Encode2_P15_js speedgoat_test_SN5659__cal_impl.Encode2_P1_n speedgoat_test_SN5659__cal_impl.Encode2_P2_kr speedgoat_test_SN5659__cal_impl.Encode2_P3_j speedgoat_test_SN5659__cal_impl.Encode2_P4_o0 speedgoat_test_SN5659__cal_impl.Encode2_P5_m speedgoat_test_SN5659__cal_impl.Encode2_P6_i speedgoat_test_SN5659__cal_impl.Encode2_P7_k speedgoat_test_SN5659__cal_impl.Encode2_P8_h3 speedgoat_test_SN5659__cal_impl.Encode2_P9_a speedgoat_test_SN5659__cal_impl.Encode3_P10_lx speedgoat_test_SN5659__cal_impl.Encode3_P11_m speedgoat_test_SN5659__cal_impl.Encode3_P12_i speedgoat_test_SN5659__cal_impl.Encode3_P13_k speedgoat_test_SN5659__cal_impl.Encode3_P14_m speedgoat_test_SN5659__cal_impl.Encode3_P15_b speedgoat_test_SN5659__cal_impl.Encode3_P1_nj speedgoat_test_SN5659__cal_impl.Encode3_P2_n speedgoat_test_SN5659__cal_impl.Encode3_P3_nc speedgoat_test_SN5659__cal_impl.Encode3_P4_m speedgoat_test_SN5659__cal_impl.Encode3_P5_h speedgoat_test_SN5659__cal_impl.Encode3_P6_i speedgoat_test_SN5659__cal_impl.Encode3_P7_i speedgoat_test_SN5659__cal_impl.Encode3_P8_p speedgoat_test_SN5659__cal_impl.Encode3_P9_p speedgoat_test_SN5659__cal_impl.Encode4_P10_k speedgoat_test_SN5659__cal_impl.Encode4_P11_pb speedgoat_test_SN5659__cal_impl.Encode4_P12_e speedgoat_test_SN5659__cal_impl.Encode4_P13_p speedgoat_test_SN5659__cal_impl.Encode4_P14_b speedgoat_test_SN5659__cal_impl.Encode4_P15_l speedgoat_test_SN5659__cal_impl.Encode4_P1_n speedgoat_test_SN5659__cal_impl.Encode4_P2_dd speedgoat_test_SN5659__cal_impl.Encode4_P3_b speedgoat_test_SN5659__cal_impl.Encode4_P4_h speedgoat_test_SN5659__cal_impl.Encode4_P5_l speedgoat_test_SN5659__cal_impl.Encode4_P6_l speedgoat_test_SN5659__cal_impl.Encode4_P7_l speedgoat_test_SN5659__cal_impl.Encode4_P8_h speedgoat_test_SN5659__cal_impl.Encode4_P9_e speedgoat_test_SN5659__cal_impl.Randomnumber_Mean_b speedgoat_test_SN5659__cal_impl.Randomnumber_Seed_fj speedgoat_test_SN5659__cal_impl.Randomnumber_StdDev_l4 speedgoat_test_SN5659__cal_impl.Sinewave_Amp_hh speedgoat_test_SN5659__cal_impl.Sinewave_Bias_g speedgoat_test_SN5659__cal_impl.Sinewave_Freq_c speedgoat_test_SN5659__cal_impl.Sinewave_HCos_jg speedgoat_test_SN5659__cal_impl.Sinewave_Hsin_o1 speedgoat_test_SN5659__cal_impl.Sinewave_PCos_a speedgoat_test_SN5659__cal_impl.Sinewave_PSin_fk /end REF_CHARACTERISTIC
 /begin REF_MEASUREMENT speedgoat_test_SN5659_R2020b_B.DataTypeConversion1_ga speedgoat_test_SN5659_R2020b_B.DataTypeConversion_d speedgoat_test_SN5659_R2020b_B.Encode1_pb speedgoat_test_SN5659_R2020b_B.Encode2_h speedgoat_test_SN5659_R2020b_B.Encode3_l speedgoat_test_SN5659_R2020b_B.Encode4_l speedgoat_test_SN5659_R2020b_B.Output_e speedgoat_test_SN5659_R2020b_B.Randomnumber_m speedgoat_test_SN5659_R2020b_B.Sinewave_kh speedgoat_test_SN5659_R2020b_DW.NextOutput_ft speedgoat_test_SN5659_R2020b_DW.RandSeed_f4 speedgoat_test_SN5659_R2020b_DW.lastCos_l speedgoat_test_SN5659_R2020b_DW.lastSin_du speedgoat_test_SN5659_R2020b_DW.systemEnable_a /end REF_MEASUREMENT
/end GROUP
/begin GROUP speedgoat_test_SN5659_R2020b_IO682_Encode_Channel_15_Counter_Limited "speedgoat_test_SN5659_R2020b/IO682/Encode Channel 15/Counter
Limited"
 /begin SUB_GROUP speedgoat_test_SN5659_R2020b_IO682_Encode_Channel_15_Counter_Limited_Increment_Real_World speedgoat_test_SN5659_R2020b_IO682_Encode_Channel_15_Counter_Limited_Wrap_To_Zero /end SUB_GROUP
 /begin REF_CHARACTERISTIC speedgoat_test_SN5659__cal_impl.Output_InitialCondition_l /end REF_CHARACTERISTIC
 /begin REF_MEASUREMENT speedgoat_test_SN5659_R2020b_B.FixPtSwitch_lo speedgoat_test_SN5659_R2020b_B.Output_e speedgoat_test_SN5659_R2020b_DW.Output_DSTATE_e /end REF_MEASUREMENT
/end GROUP
/begin GROUP speedgoat_test_SN5659_R2020b_IO682_Encode_Channel_15_Counter_Limited_Increment_Real_World "speedgoat_test_SN5659_R2020b/IO682/Encode Channel 15/Counter
Limited/Increment
Real World" /begin REF_CHARACTERISTIC speedgoat_test_SN5659__cal_impl.FixPtConstant_Value_l /end REF_CHARACTERISTIC
 /begin REF_MEASUREMENT speedgoat_test_SN5659_R2020b_B.FixPtSum1_o speedgoat_test_SN5659_R2020b_B.Output_e /end REF_MEASUREMENT
/end GROUP
/begin GROUP speedgoat_test_SN5659_R2020b_IO682_Encode_Channel_15_Counter_Limited_Wrap_To_Zero "speedgoat_test_SN5659_R2020b/IO682/Encode Channel 15/Counter
Limited/Wrap To Zero"
 /begin REF_CHARACTERISTIC speedgoat_test_SN5659__cal_impl.Constant_Value_aq speedgoat_test_SN5659__cal_impl.CounterLimited_uplimit_cp /end REF_CHARACTERISTIC
 /begin REF_MEASUREMENT speedgoat_test_SN5659_R2020b_B.FixPtSum1_o speedgoat_test_SN5659_R2020b_B.FixPtSwitch_lo /end REF_MEASUREMENT
/end GROUP
/begin GROUP speedgoat_test_SN5659_R2020b_IO682_Encode_Channel_15_Prepare_RAW_value "speedgoat_test_SN5659_R2020b/IO682/Encode Channel 15/Prepare RAW value"
 /begin REF_CHARACTERISTIC speedgoat_test_SN5659__cal_impl.Label_Value_b speedgoat_test_SN5659__cal_impl.Mask_BitMask_pd speedgoat_test_SN5659__cal_impl.SDI_Value_i speedgoat_test_SN5659__cal_impl.SSM_Value_ji speedgoat_test_SN5659__cal_impl.Scale_Value_c speedgoat_test_SN5659__cal_impl.shiftthedoublevalue27bitslef_oj /end REF_CHARACTERISTIC
 /begin REF_MEASUREMENT speedgoat_test_SN5659_R2020b_B.BitwiseOperator_f speedgoat_test_SN5659_R2020b_B.DataTypeConversion1_ga speedgoat_test_SN5659_R2020b_B.DataTypeConversion_fb speedgoat_test_SN5659_R2020b_B.Divide_g speedgoat_test_SN5659_R2020b_B.Mask_h speedgoat_test_SN5659_R2020b_B.Multiply_n speedgoat_test_SN5659_R2020b_B.ShifttoSDIslot_c speedgoat_test_SN5659_R2020b_B.ShifttoSSMslot_f /end REF_MEASUREMENT
/end GROUP
/begin GROUP speedgoat_test_SN5659_R2020b_IO682_Encode_Channel_16 "speedgoat_test_SN5659_R2020b/IO682/Encode Channel 16"
 /begin SUB_GROUP speedgoat_test_SN5659_R2020b_IO682_Encode_Channel_16_Counter_Limited speedgoat_test_SN5659_R2020b_IO682_Encode_Channel_16_Prepare_RAW_value /end SUB_GROUP
 /begin REF_CHARACTERISTIC speedgoat_test_SN5659__cal_impl.Constant_Value_o speedgoat_test_SN5659__cal_impl.Encode1_P10_e speedgoat_test_SN5659__cal_impl.Encode1_P11_o speedgoat_test_SN5659__cal_impl.Encode1_P12_m speedgoat_test_SN5659__cal_impl.Encode1_P13_fj speedgoat_test_SN5659__cal_impl.Encode1_P14_d speedgoat_test_SN5659__cal_impl.Encode1_P15_i speedgoat_test_SN5659__cal_impl.Encode1_P1_j speedgoat_test_SN5659__cal_impl.Encode1_P2_n speedgoat_test_SN5659__cal_impl.Encode1_P3_hu speedgoat_test_SN5659__cal_impl.Encode1_P4_p speedgoat_test_SN5659__cal_impl.Encode1_P5_e speedgoat_test_SN5659__cal_impl.Encode1_P6_m speedgoat_test_SN5659__cal_impl.Encode1_P7_e speedgoat_test_SN5659__cal_impl.Encode1_P8_fq speedgoat_test_SN5659__cal_impl.Encode1_P9_o speedgoat_test_SN5659__cal_impl.Encode2_P10_o speedgoat_test_SN5659__cal_impl.Encode2_P11_e speedgoat_test_SN5659__cal_impl.Encode2_P12_fa speedgoat_test_SN5659__cal_impl.Encode2_P13_d speedgoat_test_SN5659__cal_impl.Encode2_P14_ck speedgoat_test_SN5659__cal_impl.Encode2_P15_e speedgoat_test_SN5659__cal_impl.Encode2_P1_g speedgoat_test_SN5659__cal_impl.Encode2_P2_d speedgoat_test_SN5659__cal_impl.Encode2_P3_i speedgoat_test_SN5659__cal_impl.Encode2_P4_l speedgoat_test_SN5659__cal_impl.Encode2_P5_p4 speedgoat_test_SN5659__cal_impl.Encode2_P6_d speedgoat_test_SN5659__cal_impl.Encode2_P7_bh speedgoat_test_SN5659__cal_impl.Encode2_P8_d speedgoat_test_SN5659__cal_impl.Encode2_P9_d speedgoat_test_SN5659__cal_impl.Encode3_P10_o speedgoat_test_SN5659__cal_impl.Encode3_P11_h0 speedgoat_test_SN5659__cal_impl.Encode3_P12_k speedgoat_test_SN5659__cal_impl.Encode3_P13_ka speedgoat_test_SN5659__cal_impl.Encode3_P14_n speedgoat_test_SN5659__cal_impl.Encode3_P15_c speedgoat_test_SN5659__cal_impl.Encode3_P1_nj3 speedgoat_test_SN5659__cal_impl.Encode3_P2_h speedgoat_test_SN5659__cal_impl.Encode3_P3_d speedgoat_test_SN5659__cal_impl.Encode3_P4_h speedgoat_test_SN5659__cal_impl.Encode3_P5_f speedgoat_test_SN5659__cal_impl.Encode3_P6_k speedgoat_test_SN5659__cal_impl.Encode3_P7_fx speedgoat_test_SN5659__cal_impl.Encode3_P8_b speedgoat_test_SN5659__cal_impl.Encode3_P9_bx speedgoat_test_SN5659__cal_impl.Encode4_P10_j speedgoat_test_SN5659__cal_impl.Encode4_P11_e speedgoat_test_SN5659__cal_impl.Encode4_P12_o speedgoat_test_SN5659__cal_impl.Encode4_P13_h speedgoat_test_SN5659__cal_impl.Encode4_P14_m speedgoat_test_SN5659__cal_impl.Encode4_P15_f speedgoat_test_SN5659__cal_impl.Encode4_P1_a speedgoat_test_SN5659__cal_impl.Encode4_P2_p speedgoat_test_SN5659__cal_impl.Encode4_P3_a speedgoat_test_SN5659__cal_impl.Encode4_P4_l speedgoat_test_SN5659__cal_impl.Encode4_P5_i speedgoat_test_SN5659__cal_impl.Encode4_P6_d speedgoat_test_SN5659__cal_impl.Encode4_P7_b speedgoat_test_SN5659__cal_impl.Encode4_P8_k speedgoat_test_SN5659__cal_impl.Encode4_P9_p speedgoat_test_SN5659__cal_impl.Randomnumber_Mean_fh speedgoat_test_SN5659__cal_impl.Randomnumber_Seed_cd speedgoat_test_SN5659__cal_impl.Randomnumber_StdDev_n speedgoat_test_SN5659__cal_impl.Sinewave_Amp_c speedgoat_test_SN5659__cal_impl.Sinewave_Bias_kg speedgoat_test_SN5659__cal_impl.Sinewave_Freq_mo speedgoat_test_SN5659__cal_impl.Sinewave_HCos_f speedgoat_test_SN5659__cal_impl.Sinewave_Hsin_h speedgoat_test_SN5659__cal_impl.Sinewave_PCos_m speedgoat_test_SN5659__cal_impl.Sinewave_PSin_m /end REF_CHARACTERISTIC
 /begin REF_MEASUREMENT speedgoat_test_SN5659_R2020b_B.DataTypeConversion1_d speedgoat_test_SN5659_R2020b_B.DataTypeConversion_jr speedgoat_test_SN5659_R2020b_B.Encode1_pbz speedgoat_test_SN5659_R2020b_B.Encode2_hc speedgoat_test_SN5659_R2020b_B.Encode3_ou speedgoat_test_SN5659_R2020b_B.Encode4_p speedgoat_test_SN5659_R2020b_B.Output_k speedgoat_test_SN5659_R2020b_B.Randomnumber_br speedgoat_test_SN5659_R2020b_B.Sinewave_a speedgoat_test_SN5659_R2020b_DW.NextOutput_i speedgoat_test_SN5659_R2020b_DW.RandSeed_i speedgoat_test_SN5659_R2020b_DW.lastCos_ld speedgoat_test_SN5659_R2020b_DW.lastSin_f speedgoat_test_SN5659_R2020b_DW.systemEnable_p0 /end REF_MEASUREMENT
/end GROUP
/begin GROUP speedgoat_test_SN5659_R2020b_IO682_Encode_Channel_16_Counter_Limited "speedgoat_test_SN5659_R2020b/IO682/Encode Channel 16/Counter
Limited"
 /begin SUB_GROUP speedgoat_test_SN5659_R2020b_IO682_Encode_Channel_16_Counter_Limited_Increment_Real_World speedgoat_test_SN5659_R2020b_IO682_Encode_Channel_16_Counter_Limited_Wrap_To_Zero /end SUB_GROUP
 /begin REF_CHARACTERISTIC speedgoat_test_SN5659__cal_impl.Output_InitialCondition_nl /end REF_CHARACTERISTIC
 /begin REF_MEASUREMENT speedgoat_test_SN5659_R2020b_B.FixPtSwitch_l2 speedgoat_test_SN5659_R2020b_B.Output_k speedgoat_test_SN5659_R2020b_DW.Output_DSTATE_k /end REF_MEASUREMENT
/end GROUP
/begin GROUP speedgoat_test_SN5659_R2020b_IO682_Encode_Channel_16_Counter_Limited_Increment_Real_World "speedgoat_test_SN5659_R2020b/IO682/Encode Channel 16/Counter
Limited/Increment
Real World" /begin REF_CHARACTERISTIC speedgoat_test_SN5659__cal_impl.FixPtConstant_Value_i /end REF_CHARACTERISTIC
 /begin REF_MEASUREMENT speedgoat_test_SN5659_R2020b_B.FixPtSum1_d speedgoat_test_SN5659_R2020b_B.Output_k /end REF_MEASUREMENT
/end GROUP
/begin GROUP speedgoat_test_SN5659_R2020b_IO682_Encode_Channel_16_Counter_Limited_Wrap_To_Zero "speedgoat_test_SN5659_R2020b/IO682/Encode Channel 16/Counter
Limited/Wrap To Zero"
 /begin REF_CHARACTERISTIC speedgoat_test_SN5659__cal_impl.Constant_Value_p speedgoat_test_SN5659__cal_impl.CounterLimited_uplimit_g /end REF_CHARACTERISTIC
 /begin REF_MEASUREMENT speedgoat_test_SN5659_R2020b_B.FixPtSum1_d speedgoat_test_SN5659_R2020b_B.FixPtSwitch_l2 /end REF_MEASUREMENT
/end GROUP
/begin GROUP speedgoat_test_SN5659_R2020b_IO682_Encode_Channel_16_Prepare_RAW_value "speedgoat_test_SN5659_R2020b/IO682/Encode Channel 16/Prepare RAW value"
 /begin REF_CHARACTERISTIC speedgoat_test_SN5659__cal_impl.Label_Value_k speedgoat_test_SN5659__cal_impl.Mask_BitMask_a speedgoat_test_SN5659__cal_impl.SDI_Value_m3 speedgoat_test_SN5659__cal_impl.SSM_Value_i speedgoat_test_SN5659__cal_impl.Scale_Value_i speedgoat_test_SN5659__cal_impl.shiftthedoublevalue27bitsleft_h /end REF_CHARACTERISTIC
 /begin REF_MEASUREMENT speedgoat_test_SN5659_R2020b_B.BitwiseOperator_e speedgoat_test_SN5659_R2020b_B.DataTypeConversion1_d speedgoat_test_SN5659_R2020b_B.DataTypeConversion_f5 speedgoat_test_SN5659_R2020b_B.Divide_k3 speedgoat_test_SN5659_R2020b_B.Mask_h0 speedgoat_test_SN5659_R2020b_B.Multiply_hd speedgoat_test_SN5659_R2020b_B.ShifttoSDIslot_m speedgoat_test_SN5659_R2020b_B.ShifttoSSMslot_m3 /end REF_MEASUREMENT
/end GROUP
/begin GROUP speedgoat_test_SN5659_R2020b_IO682_Encode_Channel_1_Counter_Limited "speedgoat_test_SN5659_R2020b/IO682/Encode Channel 1/Counter
Limited"
 /begin SUB_GROUP speedgoat_test_SN5659_R2020b_IO682_Encode_Channel_1_Counter_Limited_Increment_Real_World speedgoat_test_SN5659_R2020b_IO682_Encode_Channel_1_Counter_Limited_Wrap_To_Zero /end SUB_GROUP
 /begin REF_CHARACTERISTIC speedgoat_test_SN5659__cal_impl.Output_InitialCondition_b /end REF_CHARACTERISTIC
 /begin REF_MEASUREMENT speedgoat_test_SN5659_R2020b_B.FixPtSwitch_ha speedgoat_test_SN5659_R2020b_DW.Output_DSTATE_c /end REF_MEASUREMENT
/end GROUP
/begin GROUP speedgoat_test_SN5659_R2020b_IO682_Encode_Channel_1_Counter_Limited_Increment_Real_World "speedgoat_test_SN5659_R2020b/IO682/Encode Channel 1/Counter
Limited/Increment
Real World" /begin REF_CHARACTERISTIC speedgoat_test_SN5659__cal_impl.FixPtConstant_Value_h /end REF_CHARACTERISTIC /begin REF_MEASUREMENT speedgoat_test_SN5659_R2020b_B.FixPtSum1_i /end REF_MEASUREMENT /end GROUP
/begin GROUP speedgoat_test_SN5659_R2020b_IO682_Encode_Channel_1_Counter_Limited_Wrap_To_Zero "speedgoat_test_SN5659_R2020b/IO682/Encode Channel 1/Counter
Limited/Wrap To Zero"
 /begin REF_CHARACTERISTIC speedgoat_test_SN5659__cal_impl.Constant_Value_av speedgoat_test_SN5659__cal_impl.CounterLimited_uplimit_i /end REF_CHARACTERISTIC
 /begin REF_MEASUREMENT speedgoat_test_SN5659_R2020b_B.FixPtSum1_i speedgoat_test_SN5659_R2020b_B.FixPtSwitch_ha /end REF_MEASUREMENT
/end GROUP
/begin GROUP speedgoat_test_SN5659_R2020b_IO682_Encode_Channel_1_Prepare_RAW_value "speedgoat_test_SN5659_R2020b/IO682/Encode Channel 1/Prepare RAW value"
 /begin REF_CHARACTERISTIC speedgoat_test_SN5659__cal_impl.Label_Value speedgoat_test_SN5659__cal_impl.Mask_BitMask speedgoat_test_SN5659__cal_impl.SDI_Value speedgoat_test_SN5659__cal_impl.SSM_Value speedgoat_test_SN5659__cal_impl.Scale_Value speedgoat_test_SN5659__cal_impl.shiftthedoublevalue27bitsleft_V /end REF_CHARACTERISTIC
 /begin REF_MEASUREMENT speedgoat_test_SN5659_R2020b_B.BitwiseOperator speedgoat_test_SN5659_R2020b_B.DataTypeConversion_k5 speedgoat_test_SN5659_R2020b_B.Divide speedgoat_test_SN5659_R2020b_B.Mask speedgoat_test_SN5659_R2020b_B.Multiply speedgoat_test_SN5659_R2020b_B.ShifttoSDIslot speedgoat_test_SN5659_R2020b_B.ShifttoSSMslot /end REF_MEASUREMENT
/end GROUP
/begin GROUP speedgoat_test_SN5659_R2020b_IO682_Encode_Channel_2 "speedgoat_test_SN5659_R2020b/IO682/Encode Channel 2"
 /begin SUB_GROUP speedgoat_test_SN5659_R2020b_IO682_Encode_Channel_2_Counter_Limited speedgoat_test_SN5659_R2020b_IO682_Encode_Channel_2_Prepare_RAW_value /end SUB_GROUP
 /begin REF_CHARACTERISTIC speedgoat_test_SN5659__cal_impl.Constant_Value_b speedgoat_test_SN5659__cal_impl.Encode1_P10_f speedgoat_test_SN5659__cal_impl.Encode1_P11_e speedgoat_test_SN5659__cal_impl.Encode1_P12_g speedgoat_test_SN5659__cal_impl.Encode1_P13_k speedgoat_test_SN5659__cal_impl.Encode1_P14_a speedgoat_test_SN5659__cal_impl.Encode1_P15_p speedgoat_test_SN5659__cal_impl.Encode1_P1_ft speedgoat_test_SN5659__cal_impl.Encode1_P2_hw speedgoat_test_SN5659__cal_impl.Encode1_P3_j speedgoat_test_SN5659__cal_impl.Encode1_P4_g speedgoat_test_SN5659__cal_impl.Encode1_P5_ov speedgoat_test_SN5659__cal_impl.Encode1_P6_pe speedgoat_test_SN5659__cal_impl.Encode1_P7_m speedgoat_test_SN5659__cal_impl.Encode1_P8_ck speedgoat_test_SN5659__cal_impl.Encode1_P9_ol speedgoat_test_SN5659__cal_impl.Encode2_P10_gm speedgoat_test_SN5659__cal_impl.Encode2_P11_d speedgoat_test_SN5659__cal_impl.Encode2_P12_a speedgoat_test_SN5659__cal_impl.Encode2_P13_fz speedgoat_test_SN5659__cal_impl.Encode2_P14_i speedgoat_test_SN5659__cal_impl.Encode2_P15_m speedgoat_test_SN5659__cal_impl.Encode2_P1_hz speedgoat_test_SN5659__cal_impl.Encode2_P2_mu speedgoat_test_SN5659__cal_impl.Encode2_P3_jd speedgoat_test_SN5659__cal_impl.Encode2_P4_g0 speedgoat_test_SN5659__cal_impl.Encode2_P5_h speedgoat_test_SN5659__cal_impl.Encode2_P6_d2 speedgoat_test_SN5659__cal_impl.Encode2_P7_i speedgoat_test_SN5659__cal_impl.Encode2_P8_j speedgoat_test_SN5659__cal_impl.Encode2_P9_n speedgoat_test_SN5659__cal_impl.Encode3_P10_p speedgoat_test_SN5659__cal_impl.Encode3_P11_jq speedgoat_test_SN5659__cal_impl.Encode3_P12_d speedgoat_test_SN5659__cal_impl.Encode3_P13_h speedgoat_test_SN5659__cal_impl.Encode3_P14_ny speedgoat_test_SN5659__cal_impl.Encode3_P15_g speedgoat_test_SN5659__cal_impl.Encode3_P1_m speedgoat_test_SN5659__cal_impl.Encode3_P2_m speedgoat_test_SN5659__cal_impl.Encode3_P3_gs speedgoat_test_SN5659__cal_impl.Encode3_P4_dt speedgoat_test_SN5659__cal_impl.Encode3_P5_d speedgoat_test_SN5659__cal_impl.Encode3_P6_g speedgoat_test_SN5659__cal_impl.Encode3_P7_fm speedgoat_test_SN5659__cal_impl.Encode3_P8_fh speedgoat_test_SN5659__cal_impl.Encode3_P9_n speedgoat_test_SN5659__cal_impl.Encode4_P10_o4 speedgoat_test_SN5659__cal_impl.Encode4_P11_c speedgoat_test_SN5659__cal_impl.Encode4_P12_lr speedgoat_test_SN5659__cal_impl.Encode4_P13_m speedgoat_test_SN5659__cal_impl.Encode4_P14_mx speedgoat_test_SN5659__cal_impl.Encode4_P15_k speedgoat_test_SN5659__cal_impl.Encode4_P1_g speedgoat_test_SN5659__cal_impl.Encode4_P2_h speedgoat_test_SN5659__cal_impl.Encode4_P3_m speedgoat_test_SN5659__cal_impl.Encode4_P4_i speedgoat_test_SN5659__cal_impl.Encode4_P5_j speedgoat_test_SN5659__cal_impl.Encode4_P6_n speedgoat_test_SN5659__cal_impl.Encode4_P7_pf speedgoat_test_SN5659__cal_impl.Encode4_P8_l speedgoat_test_SN5659__cal_impl.Encode4_P9_ns speedgoat_test_SN5659__cal_impl.Randomnumber_Mean_f3 speedgoat_test_SN5659__cal_impl.Randomnumber_Seed_nh speedgoat_test_SN5659__cal_impl.Randomnumber_StdDev_m speedgoat_test_SN5659__cal_impl.Sinewave_Amp_nm speedgoat_test_SN5659__cal_impl.Sinewave_Bias_jq speedgoat_test_SN5659__cal_impl.Sinewave_Freq_l speedgoat_test_SN5659__cal_impl.Sinewave_HCos_b speedgoat_test_SN5659__cal_impl.Sinewave_Hsin_e speedgoat_test_SN5659__cal_impl.Sinewave_PCos_k speedgoat_test_SN5659__cal_impl.Sinewave_PSin_g /end REF_CHARACTERISTIC
 /begin REF_MEASUREMENT speedgoat_test_SN5659_R2020b_B.DataTypeConversion1_l speedgoat_test_SN5659_R2020b_B.DataTypeConversion_hu speedgoat_test_SN5659_R2020b_B.Encode1_h speedgoat_test_SN5659_R2020b_B.Encode2_fb speedgoat_test_SN5659_R2020b_B.Encode3_d speedgoat_test_SN5659_R2020b_B.Encode4_n speedgoat_test_SN5659_R2020b_B.Output_g speedgoat_test_SN5659_R2020b_B.Randomnumber_e speedgoat_test_SN5659_R2020b_B.Sinewave_o5 speedgoat_test_SN5659_R2020b_DW.NextOutput_j speedgoat_test_SN5659_R2020b_DW.RandSeed_d speedgoat_test_SN5659_R2020b_DW.lastCos_lh speedgoat_test_SN5659_R2020b_DW.lastSin_e speedgoat_test_SN5659_R2020b_DW.systemEnable_ml /end REF_MEASUREMENT
/end GROUP
/begin GROUP speedgoat_test_SN5659_R2020b_IO682_Encode_Channel_2_Counter_Limited "speedgoat_test_SN5659_R2020b/IO682/Encode Channel 2/Counter
Limited"
 /begin SUB_GROUP speedgoat_test_SN5659_R2020b_IO682_Encode_Channel_2_Counter_Limited_Increment_Real_World speedgoat_test_SN5659_R2020b_IO682_Encode_Channel_2_Counter_Limited_Wrap_To_Zero /end SUB_GROUP
 /begin REF_CHARACTERISTIC speedgoat_test_SN5659__cal_impl.Output_InitialCondition_j /end REF_CHARACTERISTIC
 /begin REF_MEASUREMENT speedgoat_test_SN5659_R2020b_B.FixPtSwitch_jo speedgoat_test_SN5659_R2020b_B.Output_g speedgoat_test_SN5659_R2020b_DW.Output_DSTATE_e0 /end REF_MEASUREMENT
/end GROUP
/begin GROUP speedgoat_test_SN5659_R2020b_IO682_Encode_Channel_2_Counter_Limited_Increment_Real_World "speedgoat_test_SN5659_R2020b/IO682/Encode Channel 2/Counter
Limited/Increment
Real World" /begin REF_CHARACTERISTIC speedgoat_test_SN5659__cal_impl.FixPtConstant_Value_k0 /end REF_CHARACTERISTIC
 /begin REF_MEASUREMENT speedgoat_test_SN5659_R2020b_B.FixPtSum1_fe speedgoat_test_SN5659_R2020b_B.Output_g /end REF_MEASUREMENT
/end GROUP
/begin GROUP speedgoat_test_SN5659_R2020b_IO682_Encode_Channel_2_Counter_Limited_Wrap_To_Zero "speedgoat_test_SN5659_R2020b/IO682/Encode Channel 2/Counter
Limited/Wrap To Zero"
 /begin REF_CHARACTERISTIC speedgoat_test_SN5659__cal_impl.Constant_Value_ee speedgoat_test_SN5659__cal_impl.CounterLimited_uplimit_be /end REF_CHARACTERISTIC
 /begin REF_MEASUREMENT speedgoat_test_SN5659_R2020b_B.FixPtSum1_fe speedgoat_test_SN5659_R2020b_B.FixPtSwitch_jo /end REF_MEASUREMENT
/end GROUP
/begin GROUP speedgoat_test_SN5659_R2020b_IO682_Encode_Channel_2_Prepare_RAW_value "speedgoat_test_SN5659_R2020b/IO682/Encode Channel 2/Prepare RAW value"
 /begin REF_CHARACTERISTIC speedgoat_test_SN5659__cal_impl.Label_Value_n speedgoat_test_SN5659__cal_impl.Mask_BitMask_l speedgoat_test_SN5659__cal_impl.SDI_Value_l4 speedgoat_test_SN5659__cal_impl.SSM_Value_na speedgoat_test_SN5659__cal_impl.Scale_Value_k speedgoat_test_SN5659__cal_impl.shiftthedoublevalue27bitsleft_j /end REF_CHARACTERISTIC
 /begin REF_MEASUREMENT speedgoat_test_SN5659_R2020b_B.BitwiseOperator_j speedgoat_test_SN5659_R2020b_B.DataTypeConversion1_l speedgoat_test_SN5659_R2020b_B.DataTypeConversion_bh speedgoat_test_SN5659_R2020b_B.Divide_g4 speedgoat_test_SN5659_R2020b_B.Mask_d speedgoat_test_SN5659_R2020b_B.Multiply_il speedgoat_test_SN5659_R2020b_B.ShifttoSDIslot_g speedgoat_test_SN5659_R2020b_B.ShifttoSSMslot_g /end REF_MEASUREMENT
/end GROUP
/begin GROUP speedgoat_test_SN5659_R2020b_IO682_Encode_Channel_3 "speedgoat_test_SN5659_R2020b/IO682/Encode Channel 3"
 /begin SUB_GROUP speedgoat_test_SN5659_R2020b_IO682_Encode_Channel_3_Counter_Limited speedgoat_test_SN5659_R2020b_IO682_Encode_Channel_3_Prepare_RAW_value /end SUB_GROUP
 /begin REF_CHARACTERISTIC speedgoat_test_SN5659__cal_impl.Constant_Value_ek speedgoat_test_SN5659__cal_impl.Encode1_P10_l0 speedgoat_test_SN5659__cal_impl.Encode1_P11_f speedgoat_test_SN5659__cal_impl.Encode1_P12_a speedgoat_test_SN5659__cal_impl.Encode1_P13_n speedgoat_test_SN5659__cal_impl.Encode1_P14_on speedgoat_test_SN5659__cal_impl.Encode1_P15_pw speedgoat_test_SN5659__cal_impl.Encode1_P1_m speedgoat_test_SN5659__cal_impl.Encode1_P2_i speedgoat_test_SN5659__cal_impl.Encode1_P3_e speedgoat_test_SN5659__cal_impl.Encode1_P4_d2 speedgoat_test_SN5659__cal_impl.Encode1_P5_h speedgoat_test_SN5659__cal_impl.Encode1_P6_i speedgoat_test_SN5659__cal_impl.Encode1_P7_gj speedgoat_test_SN5659__cal_impl.Encode1_P8_ct speedgoat_test_SN5659__cal_impl.Encode1_P9_j speedgoat_test_SN5659__cal_impl.Encode2_P10_f speedgoat_test_SN5659__cal_impl.Encode2_P11_m speedgoat_test_SN5659__cal_impl.Encode2_P12_e speedgoat_test_SN5659__cal_impl.Encode2_P13_fx speedgoat_test_SN5659__cal_impl.Encode2_P14_d speedgoat_test_SN5659__cal_impl.Encode2_P15_ck speedgoat_test_SN5659__cal_impl.Encode2_P1_az speedgoat_test_SN5659__cal_impl.Encode2_P2_f0 speedgoat_test_SN5659__cal_impl.Encode2_P3_o2 speedgoat_test_SN5659__cal_impl.Encode2_P4_h speedgoat_test_SN5659__cal_impl.Encode2_P5_i speedgoat_test_SN5659__cal_impl.Encode2_P6_o speedgoat_test_SN5659__cal_impl.Encode2_P7_o speedgoat_test_SN5659__cal_impl.Encode2_P8_fs speedgoat_test_SN5659__cal_impl.Encode2_P9_c speedgoat_test_SN5659__cal_impl.Encode3_P10_a speedgoat_test_SN5659__cal_impl.Encode3_P11_f speedgoat_test_SN5659__cal_impl.Encode3_P12_b3 speedgoat_test_SN5659__cal_impl.Encode3_P13_c speedgoat_test_SN5659__cal_impl.Encode3_P14_do speedgoat_test_SN5659__cal_impl.Encode3_P15_pu speedgoat_test_SN5659__cal_impl.Encode3_P1_mk speedgoat_test_SN5659__cal_impl.Encode3_P2_o speedgoat_test_SN5659__cal_impl.Encode3_P3_cs speedgoat_test_SN5659__cal_impl.Encode3_P4_dq speedgoat_test_SN5659__cal_impl.Encode3_P5_im speedgoat_test_SN5659__cal_impl.Encode3_P6_d speedgoat_test_SN5659__cal_impl.Encode3_P7_o speedgoat_test_SN5659__cal_impl.Encode3_P8_en speedgoat_test_SN5659__cal_impl.Encode3_P9_m speedgoat_test_SN5659__cal_impl.Encode4_P10_b speedgoat_test_SN5659__cal_impl.Encode4_P11_jr speedgoat_test_SN5659__cal_impl.Encode4_P12_g speedgoat_test_SN5659__cal_impl.Encode4_P13_d speedgoat_test_SN5659__cal_impl.Encode4_P14_g speedgoat_test_SN5659__cal_impl.Encode4_P15_h speedgoat_test_SN5659__cal_impl.Encode4_P1_ns speedgoat_test_SN5659__cal_impl.Encode4_P2_g speedgoat_test_SN5659__cal_impl.Encode4_P3_n speedgoat_test_SN5659__cal_impl.Encode4_P4_m speedgoat_test_SN5659__cal_impl.Encode4_P5_k speedgoat_test_SN5659__cal_impl.Encode4_P6_e speedgoat_test_SN5659__cal_impl.Encode4_P7_pm speedgoat_test_SN5659__cal_impl.Encode4_P8_f speedgoat_test_SN5659__cal_impl.Encode4_P9_f speedgoat_test_SN5659__cal_impl.Randomnumber_Mean_d speedgoat_test_SN5659__cal_impl.Randomnumber_Seed_fq speedgoat_test_SN5659__cal_impl.Randomnumber_StdDev_f speedgoat_test_SN5659__cal_impl.Sinewave_Amp_a speedgoat_test_SN5659__cal_impl.Sinewave_Bias_mn speedgoat_test_SN5659__cal_impl.Sinewave_Freq_b speedgoat_test_SN5659__cal_impl.Sinewave_HCos_bz speedgoat_test_SN5659__cal_impl.Sinewave_Hsin_h4 speedgoat_test_SN5659__cal_impl.Sinewave_PCos_ma speedgoat_test_SN5659__cal_impl.Sinewave_PSin_gt /end REF_CHARACTERISTIC
 /begin REF_MEASUREMENT speedgoat_test_SN5659_R2020b_B.DataTypeConversion1_a speedgoat_test_SN5659_R2020b_B.DataTypeConversion_dd speedgoat_test_SN5659_R2020b_B.Encode1_f0 speedgoat_test_SN5659_R2020b_B.Encode2_iu speedgoat_test_SN5659_R2020b_B.Encode3_ik speedgoat_test_SN5659_R2020b_B.Encode4_ix speedgoat_test_SN5659_R2020b_B.Output_b2 speedgoat_test_SN5659_R2020b_B.Randomnumber_f speedgoat_test_SN5659_R2020b_B.Sinewave_oh speedgoat_test_SN5659_R2020b_DW.NextOutput_m speedgoat_test_SN5659_R2020b_DW.RandSeed_b speedgoat_test_SN5659_R2020b_DW.lastCos_gg speedgoat_test_SN5659_R2020b_DW.lastSin_pg speedgoat_test_SN5659_R2020b_DW.systemEnable_bx /end REF_MEASUREMENT
/end GROUP
/begin GROUP speedgoat_test_SN5659_R2020b_IO682_Encode_Channel_3_Counter_Limited "speedgoat_test_SN5659_R2020b/IO682/Encode Channel 3/Counter
Limited"
 /begin SUB_GROUP speedgoat_test_SN5659_R2020b_IO682_Encode_Channel_3_Counter_Limited_Increment_Real_World speedgoat_test_SN5659_R2020b_IO682_Encode_Channel_3_Counter_Limited_Wrap_To_Zero /end SUB_GROUP
 /begin REF_CHARACTERISTIC speedgoat_test_SN5659__cal_impl.Output_InitialCondition_h /end REF_CHARACTERISTIC
 /begin REF_MEASUREMENT speedgoat_test_SN5659_R2020b_B.FixPtSwitch_d speedgoat_test_SN5659_R2020b_B.Output_b2 speedgoat_test_SN5659_R2020b_DW.Output_DSTATE_g /end REF_MEASUREMENT
/end GROUP
/begin GROUP speedgoat_test_SN5659_R2020b_IO682_Encode_Channel_3_Counter_Limited_Increment_Real_World "speedgoat_test_SN5659_R2020b/IO682/Encode Channel 3/Counter
Limited/Increment
Real World" /begin REF_CHARACTERISTIC speedgoat_test_SN5659__cal_impl.FixPtConstant_Value_oq /end REF_CHARACTERISTIC
 /begin REF_MEASUREMENT speedgoat_test_SN5659_R2020b_B.FixPtSum1_h speedgoat_test_SN5659_R2020b_B.Output_b2 /end REF_MEASUREMENT
/end GROUP
/begin GROUP speedgoat_test_SN5659_R2020b_IO682_Encode_Channel_3_Counter_Limited_Wrap_To_Zero "speedgoat_test_SN5659_R2020b/IO682/Encode Channel 3/Counter
Limited/Wrap To Zero"
 /begin REF_CHARACTERISTIC speedgoat_test_SN5659__cal_impl.Constant_Value_j5 speedgoat_test_SN5659__cal_impl.CounterLimited_uplimit_e /end REF_CHARACTERISTIC
 /begin REF_MEASUREMENT speedgoat_test_SN5659_R2020b_B.FixPtSum1_h speedgoat_test_SN5659_R2020b_B.FixPtSwitch_d /end REF_MEASUREMENT
/end GROUP
/begin GROUP speedgoat_test_SN5659_R2020b_IO682_Encode_Channel_3_Prepare_RAW_value "speedgoat_test_SN5659_R2020b/IO682/Encode Channel 3/Prepare RAW value"
 /begin REF_CHARACTERISTIC speedgoat_test_SN5659__cal_impl.Label_Value_fv speedgoat_test_SN5659__cal_impl.Mask_BitMask_e3 speedgoat_test_SN5659__cal_impl.SDI_Value_p speedgoat_test_SN5659__cal_impl.SSM_Value_os speedgoat_test_SN5659__cal_impl.Scale_Value_e speedgoat_test_SN5659__cal_impl.shiftthedoublevalue27bitsleft_n /end REF_CHARACTERISTIC
 /begin REF_MEASUREMENT speedgoat_test_SN5659_R2020b_B.BitwiseOperator_a4 speedgoat_test_SN5659_R2020b_B.DataTypeConversion1_a speedgoat_test_SN5659_R2020b_B.DataTypeConversion_l speedgoat_test_SN5659_R2020b_B.Divide_n speedgoat_test_SN5659_R2020b_B.Mask_k speedgoat_test_SN5659_R2020b_B.Multiply_e speedgoat_test_SN5659_R2020b_B.ShifttoSDIslot_n speedgoat_test_SN5659_R2020b_B.ShifttoSSMslot_kz /end REF_MEASUREMENT
/end GROUP
/end MODULE
/end PROJECT
