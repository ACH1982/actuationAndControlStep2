/******************************************************************************
* ASAP2 file: speedgoat_test_SN5659_R2021b.a2l
* Code generation for model "speedgoat_test_SN5659_R2021b".
* Model version : 3.2
* Simulink Coder version : 10.4 R2021b
* C source code generated on : Fri Apr 08 16:07:24 2022
* Target selection: slrealtime.tlc
* Embedded hardware selection: Intel->x86-64 (Linux 64)
* Code generation objectives: Unspecified
* Validation result: Not run
* (add additional file header information here)
******************************************************************************/
ASAP2_VERSION 1 71
/begin PROJECT ProjectName "Project Comment Goes Here"
/begin HEADER "Header Comments go here" /end HEADER
/begin MODULE ModuleName "Module Comment Goes Here"
/begin IF_DATA XCP
 /begin PROTOCOL_LAYER 0x0100 0x03E8 0x00C8 0x0000 0x0000 0x0000 0x0000 0x0000 0xFC 0x0578 BYTE_ORDER_MSB_LAST ADDRESS_GRANULARITY_BYTE OPTIONAL_CMD ALLOC_ODT_ENTRY OPTIONAL_CMD ALLOC_ODT OPTIONAL_CMD ALLOC_DAQ OPTIONAL_CMD FREE_DAQ OPTIONAL_CMD GET_DAQ_RESOLUTION_INFO OPTIONAL_CMD GET_DAQ_PROCESSOR_INFO OPTIONAL_CMD START_STOP_SYNCH OPTIONAL_CMD START_STOP_DAQ_LIST OPTIONAL_CMD SET_DAQ_LIST_MODE OPTIONAL_CMD WRITE_DAQ OPTIONAL_CMD SET_DAQ_PTR OPTIONAL_CMD GET_CAL_PAGE OPTIONAL_CMD SET_CAL_PAGE OPTIONAL_CMD COPY_CAL_PAGE OPTIONAL_CMD SHORT_DOWNLOAD OPTIONAL_CMD DOWNLOAD_MAX OPTIONAL_CMD DOWNLOAD OPTIONAL_CMD SHORT_UPLOAD OPTIONAL_CMD UPLOAD OPTIONAL_CMD SET_MTA /end PROTOCOL_LAYER
 /begin DAQ DYNAMIC 0x0000 0x0080 0x00 OPTIMISATION_TYPE_DEFAULT ADDRESS_EXTENSION_FREE IDENTIFICATION_FIELD_TYPE_RELATIVE_WORD_ALIGNED GRANULARITY_ODT_ENTRY_SIZE_DAQ_BYTE 0xFF OVERLOAD_INDICATION_PID PRESCALER_SUPPORTED /begin STIM GRANULARITY_ODT_ENTRY_SIZE_STIM_BYTE 0xFF /end STIM /begin TIMESTAMP_SUPPORTED 0x0001 SIZE_DWORD UNIT_1US TIMESTAMP_FIXED /end TIMESTAMP_SUPPORTED /begin EVENT "1 ms" "1 ms" 0x0000 DAQ 0xFF 0x01 0x06 0x00 /end EVENT /begin EVENT "5 ms" "5 ms" 0x0001 DAQ 0xFF 0x05 0x06 0x00 /end EVENT /begin EVENT "10 ms" "10 ms" 0x0002 DAQ 0xFF 0x01 0x07 0x00 /end EVENT /end DAQ
 /begin XCP_ON_UDP_IP 0x0100 0x15B3 ADDRESS "192.168.7.2" /end XCP_ON_UDP_IP
/end IF_DATA
/begin MOD_PAR "MOD PAR Comment Goes Here"
 /begin MEMORY_SEGMENT speedgoat_test_SN5659__cal_impl "speedgoat_test_SN5659__cal_impl" DATA FLASH INTERN 0x008D5020 0xFDC0 -1 -1 -1 -1 -1
  /begin IF_DATA XCP
   /begin SEGMENT 0x00 0x02 0x00 0x00 0x00
    /begin PAGE 0x00 ECU_ACCESS_DONT_CARE XCP_READ_ACCESS_DONT_CARE XCP_WRITE_ACCESS_NOT_ALLOWED /end PAGE
    /begin PAGE 0x01 ECU_ACCESS_DONT_CARE XCP_READ_ACCESS_DONT_CARE XCP_WRITE_ACCESS_DONT_CARE /end PAGE
   /end SEGMENT
  /end IF_DATA
 /end MEMORY_SEGMENT
/end MOD_PAR
/begin MOD_COMMON "Mod Common Comment Here" BYTE_ORDER MSB_LAST ALIGNMENT_BYTE 1 ALIGNMENT_WORD 2 ALIGNMENT_LONG 4 ALIGNMENT_FLOAT32_IEEE 4 ALIGNMENT_FLOAT64_IEEE 8 ALIGNMENT_INT64 8 /end MOD_COMMON
/begin CHARACTERISTIC speedgoat_test_SN5659__cal_impl.Analoginputv2_P1 "" VALUE 0x008D5630 Scalar_FLOAT64_IEEE 0 speedgoat_test_SN5659_R2021b_CM_double -1.7E+308 1.7E+308 /end CHARACTERISTIC
/begin CHARACTERISTIC speedgoat_test_SN5659__cal_impl.Analoginputv2_P10 "" VAL_BLK 0x008D5730 Scalar_FLOAT64_IEEE 0 speedgoat_test_SN5659_R2021b_CM_double -1.7E+308 1.7E+308 MATRIX_DIM 2 1 /end CHARACTERISTIC
/begin CHARACTERISTIC speedgoat_test_SN5659__cal_impl.Analoginputv2_P11 "" VALUE 0x008D5750 Scalar_FLOAT64_IEEE 0 speedgoat_test_SN5659_R2021b_CM_double -1.7E+308 1.7E+308 /end CHARACTERISTIC
/begin CHARACTERISTIC speedgoat_test_SN5659__cal_impl.Analoginputv2_P2 "" VALUE 0x008D5648 Scalar_FLOAT64_IEEE 0 speedgoat_test_SN5659_R2021b_CM_double -1.7E+308 1.7E+308 /end CHARACTERISTIC
/begin CHARACTERISTIC speedgoat_test_SN5659__cal_impl.Analoginputv2_P3 "" VALUE 0x008D5660 Scalar_FLOAT64_IEEE 0 speedgoat_test_SN5659_R2021b_CM_double -1.7E+308 1.7E+308 /end CHARACTERISTIC
/begin CHARACTERISTIC speedgoat_test_SN5659__cal_impl.Analoginputv2_P4 "" VALUE 0x008D5678 Scalar_FLOAT64_IEEE 0 speedgoat_test_SN5659_R2021b_CM_double -1.7E+308 1.7E+308 /end CHARACTERISTIC
/begin CHARACTERISTIC speedgoat_test_SN5659__cal_impl.Analoginputv2_P5 "" VAL_BLK 0x008D5690 Scalar_FLOAT64_IEEE 0 speedgoat_test_SN5659_R2021b_CM_double -1.7E+308 1.7E+308 MATRIX_DIM 4 1 /end CHARACTERISTIC
/begin CHARACTERISTIC speedgoat_test_SN5659__cal_impl.Analoginputv2_P6 "" VAL_BLK 0x008D56C0 Scalar_FLOAT64_IEEE 0 speedgoat_test_SN5659_R2021b_CM_double -1.7E+308 1.7E+308 MATRIX_DIM 2 1 /end CHARACTERISTIC
/begin CHARACTERISTIC speedgoat_test_SN5659__cal_impl.Analoginputv2_P7 "" VAL_BLK 0x008D56E0 Scalar_FLOAT64_IEEE 0 speedgoat_test_SN5659_R2021b_CM_double -1.7E+308 1.7E+308 MATRIX_DIM 2 1 /end CHARACTERISTIC
/begin CHARACTERISTIC speedgoat_test_SN5659__cal_impl.Analoginputv2_P8 "" VALUE 0x008D5700 Scalar_FLOAT64_IEEE 0 speedgoat_test_SN5659_R2021b_CM_double -1.7E+308 1.7E+308 /end CHARACTERISTIC
/begin CHARACTERISTIC speedgoat_test_SN5659__cal_impl.Analoginputv2_P9 "" VALUE 0x008D5718 Scalar_FLOAT64_IEEE 0 speedgoat_test_SN5659_R2021b_CM_double -1.7E+308 1.7E+308 /end CHARACTERISTIC
/begin CHARACTERISTIC speedgoat_test_SN5659__cal_impl.Analogoutput1_P1 "" VALUE 0x008D6F30 Scalar_FLOAT64_IEEE 0 speedgoat_test_SN5659_R2021b_CM_double -1.7E+308 1.7E+308 /end CHARACTERISTIC
/begin CHARACTERISTIC speedgoat_test_SN5659__cal_impl.Analogoutput1_P2 "" VAL_BLK 0x008D6F48 Scalar_FLOAT64_IEEE 0 speedgoat_test_SN5659_R2021b_CM_double -1.7E+308 1.7E+308 MATRIX_DIM 16 1 /end CHARACTERISTIC
/begin CHARACTERISTIC speedgoat_test_SN5659__cal_impl.Analogoutput1_P3 "" VAL_BLK 0x008D6FD8 Scalar_FLOAT64_IEEE 0 speedgoat_test_SN5659_R2021b_CM_double -1.7E+308 1.7E+308 MATRIX_DIM 16 1 /end CHARACTERISTIC
/begin CHARACTERISTIC speedgoat_test_SN5659__cal_impl.Analogoutput1_P4 "" VALUE 0x008D7068 Scalar_FLOAT64_IEEE 0 speedgoat_test_SN5659_R2021b_CM_double -1.7E+308 1.7E+308 /end CHARACTERISTIC
/begin CHARACTERISTIC speedgoat_test_SN5659__cal_impl.Analogoutput1_P5 "" VALUE 0x008D7080 Scalar_FLOAT64_IEEE 0 speedgoat_test_SN5659_R2021b_CM_double -1.7E+308 1.7E+308 /end CHARACTERISTIC
/begin CHARACTERISTIC speedgoat_test_SN5659__cal_impl.Analogoutput1_P6 "" VALUE 0x008D7098 Scalar_FLOAT64_IEEE 0 speedgoat_test_SN5659_R2021b_CM_double -1.7E+308 1.7E+308 /end CHARACTERISTIC
/begin CHARACTERISTIC speedgoat_test_SN5659__cal_impl.Analogoutput1_P7 "" VALUE 0x008D70B0 Scalar_FLOAT64_IEEE 0 speedgoat_test_SN5659_R2021b_CM_double -1.7E+308 1.7E+308 /end CHARACTERISTIC
/begin CHARACTERISTIC speedgoat_test_SN5659__cal_impl.Analogoutput_P1 "" VALUE 0x008D6D60 Scalar_FLOAT64_IEEE 0 speedgoat_test_SN5659_R2021b_CM_double -1.7E+308 1.7E+308 /end CHARACTERISTIC
/begin CHARACTERISTIC speedgoat_test_SN5659__cal_impl.Analogoutput_P2 "" VAL_BLK 0x008D6D78 Scalar_FLOAT64_IEEE 0 speedgoat_test_SN5659_R2021b_CM_double -1.7E+308 1.7E+308 MATRIX_DIM 16 1 /end CHARACTERISTIC
/begin CHARACTERISTIC speedgoat_test_SN5659__cal_impl.Analogoutput_P3 "" VAL_BLK 0x008D6E08 Scalar_FLOAT64_IEEE 0 speedgoat_test_SN5659_R2021b_CM_double -1.7E+308 1.7E+308 MATRIX_DIM 16 1 /end CHARACTERISTIC
/begin CHARACTERISTIC speedgoat_test_SN5659__cal_impl.Analogoutput_P4 "" VALUE 0x008D6E98 Scalar_FLOAT64_IEEE 0 speedgoat_test_SN5659_R2021b_CM_double -1.7E+308 1.7E+308 /end CHARACTERISTIC
/begin CHARACTERISTIC speedgoat_test_SN5659__cal_impl.Analogoutput_P5 "" VALUE 0x008D6EB0 Scalar_FLOAT64_IEEE 0 speedgoat_test_SN5659_R2021b_CM_double -1.7E+308 1.7E+308 /end CHARACTERISTIC
/begin CHARACTERISTIC speedgoat_test_SN5659__cal_impl.Analogoutput_P6 "" VALUE 0x008D6EC8 Scalar_FLOAT64_IEEE 0 speedgoat_test_SN5659_R2021b_CM_double -1.7E+308 1.7E+308 /end CHARACTERISTIC
/begin CHARACTERISTIC speedgoat_test_SN5659__cal_impl.Analogoutput_P7 "" VALUE 0x008D6EE0 Scalar_FLOAT64_IEEE 0 speedgoat_test_SN5659_R2021b_CM_double -1.7E+308 1.7E+308 /end CHARACTERISTIC
/begin CHARACTERISTIC speedgoat_test_SN5659__cal_impl.Analogoutputv2_P1 "" VALUE 0x008D57A8 Scalar_FLOAT64_IEEE 0 speedgoat_test_SN5659_R2021b_CM_double -1.7E+308 1.7E+308 /end CHARACTERISTIC
/begin CHARACTERISTIC speedgoat_test_SN5659__cal_impl.Analogoutputv2_P10 "" VALUE 0x008D5900 Scalar_FLOAT64_IEEE 0 speedgoat_test_SN5659_R2021b_CM_double -1.7E+308 1.7E+308 /end CHARACTERISTIC
/begin CHARACTERISTIC speedgoat_test_SN5659__cal_impl.Analogoutputv2_P11 "" VAL_BLK 0x008D5918 Scalar_FLOAT64_IEEE 0 speedgoat_test_SN5659_R2021b_CM_double -1.7E+308 1.7E+308 MATRIX_DIM 2 1 /end CHARACTERISTIC
/begin CHARACTERISTIC speedgoat_test_SN5659__cal_impl.Analogoutputv2_P12 "" VALUE 0x008D5938 Scalar_FLOAT64_IEEE 0 speedgoat_test_SN5659_R2021b_CM_double -1.7E+308 1.7E+308 /end CHARACTERISTIC
/begin CHARACTERISTIC speedgoat_test_SN5659__cal_impl.Analogoutputv2_P13 "" VALUE 0x008D5950 Scalar_FLOAT64_IEEE 0 speedgoat_test_SN5659_R2021b_CM_double -1.7E+308 1.7E+308 /end CHARACTERISTIC
/begin CHARACTERISTIC speedgoat_test_SN5659__cal_impl.Analogoutputv2_P2 "" VALUE 0x008D57C0 Scalar_FLOAT64_IEEE 0 speedgoat_test_SN5659_R2021b_CM_double -1.7E+308 1.7E+308 /end CHARACTERISTIC
/begin CHARACTERISTIC speedgoat_test_SN5659__cal_impl.Analogoutputv2_P3 "" VALUE 0x008D57D8 Scalar_FLOAT64_IEEE 0 speedgoat_test_SN5659_R2021b_CM_double -1.7E+308 1.7E+308 /end CHARACTERISTIC
/begin CHARACTERISTIC speedgoat_test_SN5659__cal_impl.Analogoutputv2_P4 "" VALUE 0x008D57F0 Scalar_FLOAT64_IEEE 0 speedgoat_test_SN5659_R2021b_CM_double -1.7E+308 1.7E+308 /end CHARACTERISTIC
/begin CHARACTERISTIC speedgoat_test_SN5659__cal_impl.Analogoutputv2_P5 "" VAL_BLK 0x008D5808 Scalar_FLOAT64_IEEE 0 speedgoat_test_SN5659_R2021b_CM_double -1.7E+308 1.7E+308 MATRIX_DIM 4 1 /end CHARACTERISTIC
/begin CHARACTERISTIC speedgoat_test_SN5659__cal_impl.Analogoutputv2_P6 "" VAL_BLK 0x008D5838 Scalar_FLOAT64_IEEE 0 speedgoat_test_SN5659_R2021b_CM_double -1.7E+308 1.7E+308 MATRIX_DIM 8 1 /end CHARACTERISTIC
/begin CHARACTERISTIC speedgoat_test_SN5659__cal_impl.Analogoutputv2_P7 "" VAL_BLK 0x008D5888 Scalar_FLOAT64_IEEE 0 speedgoat_test_SN5659_R2021b_CM_double -1.7E+308 1.7E+308 MATRIX_DIM 4 1 /end CHARACTERISTIC
/begin CHARACTERISTIC speedgoat_test_SN5659__cal_impl.Analogoutputv2_P8 "" VAL_BLK 0x008D58B8 Scalar_FLOAT64_IEEE 0 speedgoat_test_SN5659_R2021b_CM_double -1.7E+308 1.7E+308 MATRIX_DIM 4 1 /end CHARACTERISTIC
/begin CHARACTERISTIC speedgoat_test_SN5659__cal_impl.Analogoutputv2_P9 "" VALUE 0x008D58E8 Scalar_FLOAT64_IEEE 0 speedgoat_test_SN5659_R2021b_CM_double -1.7E+308 1.7E+308 /end CHARACTERISTIC
/begin CHARACTERISTIC speedgoat_test_SN5659__cal_impl.CANRead1_P1 "" VALUE 0x008D5188 Scalar_FLOAT64_IEEE 0 speedgoat_test_SN5659_R2021b_CM_double -1.7E+308 1.7E+308 /end CHARACTERISTIC
/begin CHARACTERISTIC speedgoat_test_SN5659__cal_impl.CANRead1_P2 "" VALUE 0x008D51A0 Scalar_FLOAT64_IEEE 0 speedgoat_test_SN5659_R2021b_CM_double -1.7E+308 1.7E+308 /end CHARACTERISTIC
/begin CHARACTERISTIC speedgoat_test_SN5659__cal_impl.CANRead1_P3 "" VALUE 0x008D51B8 Scalar_FLOAT64_IEEE 0 speedgoat_test_SN5659_R2021b_CM_double -1.7E+308 1.7E+308 /end CHARACTERISTIC
/begin CHARACTERISTIC speedgoat_test_SN5659__cal_impl.CANRead1_P4 "" VAL_BLK 0x008D51D0 Scalar_FLOAT64_IEEE 0 speedgoat_test_SN5659_R2021b_CM_double -1.7E+308 1.7E+308 MATRIX_DIM 5 1 /end CHARACTERISTIC
/begin CHARACTERISTIC speedgoat_test_SN5659__cal_impl.CANRead1_P5 "" VALUE 0x008D5208 Scalar_FLOAT64_IEEE 0 speedgoat_test_SN5659_R2021b_CM_double -1.7E+308 1.7E+308 /end CHARACTERISTIC
/begin CHARACTERISTIC speedgoat_test_SN5659__cal_impl.CANRead1_P6 "" VALUE 0x008D5220 Scalar_FLOAT64_IEEE 0 speedgoat_test_SN5659_R2021b_CM_double -1.7E+308 1.7E+308 /end CHARACTERISTIC
/begin CHARACTERISTIC speedgoat_test_SN5659__cal_impl.CANRead1_P7 "" VALUE 0x008D5238 Scalar_FLOAT64_IEEE 0 speedgoat_test_SN5659_R2021b_CM_double -1.7E+308 1.7E+308 /end CHARACTERISTIC
/begin CHARACTERISTIC speedgoat_test_SN5659__cal_impl.CANRead_P1 "" VALUE 0x008D50A8 Scalar_FLOAT64_IEEE 0 speedgoat_test_SN5659_R2021b_CM_double -1.7E+308 1.7E+308 /end CHARACTERISTIC
/begin CHARACTERISTIC speedgoat_test_SN5659__cal_impl.CANRead_P2 "" VALUE 0x008D50C0 Scalar_FLOAT64_IEEE 0 speedgoat_test_SN5659_R2021b_CM_double -1.7E+308 1.7E+308 /end CHARACTERISTIC
/begin CHARACTERISTIC speedgoat_test_SN5659__cal_impl.CANRead_P3 "" VALUE 0x008D50D8 Scalar_FLOAT64_IEEE 0 speedgoat_test_SN5659_R2021b_CM_double -1.7E+308 1.7E+308 /end CHARACTERISTIC
/begin CHARACTERISTIC speedgoat_test_SN5659__cal_impl.CANRead_P4 "" VAL_BLK 0x008D50F0 Scalar_FLOAT64_IEEE 0 speedgoat_test_SN5659_R2021b_CM_double -1.7E+308 1.7E+308 MATRIX_DIM 5 1 /end CHARACTERISTIC
/begin CHARACTERISTIC speedgoat_test_SN5659__cal_impl.CANRead_P5 "" VALUE 0x008D5128 Scalar_FLOAT64_IEEE 0 speedgoat_test_SN5659_R2021b_CM_double -1.7E+308 1.7E+308 /end CHARACTERISTIC
/begin CHARACTERISTIC speedgoat_test_SN5659__cal_impl.CANRead_P6 "" VALUE 0x008D5140 Scalar_FLOAT64_IEEE 0 speedgoat_test_SN5659_R2021b_CM_double -1.7E+308 1.7E+308 /end CHARACTERISTIC
/begin CHARACTERISTIC speedgoat_test_SN5659__cal_impl.CANRead_P7 "" VALUE 0x008D5158 Scalar_FLOAT64_IEEE 0 speedgoat_test_SN5659_R2021b_CM_double -1.7E+308 1.7E+308 /end CHARACTERISTIC
/begin CHARACTERISTIC speedgoat_test_SN5659__cal_impl.CANSetup_P1 "" VALUE 0x008D5D60 Scalar_FLOAT64_IEEE 0 speedgoat_test_SN5659_R2021b_CM_double -1.7E+308 1.7E+308 /end CHARACTERISTIC
/begin CHARACTERISTIC speedgoat_test_SN5659__cal_impl.CANSetup_P10 "" VAL_BLK 0x008D5E58 Scalar_FLOAT64_IEEE 0 speedgoat_test_SN5659_R2021b_CM_double -1.7E+308 1.7E+308 MATRIX_DIM 2 1 /end CHARACTERISTIC
/begin CHARACTERISTIC speedgoat_test_SN5659__cal_impl.CANSetup_P11 "" VAL_BLK 0x008D5E78 Scalar_FLOAT64_IEEE 0 speedgoat_test_SN5659_R2021b_CM_double -1.7E+308 1.7E+308 MATRIX_DIM 2 1 /end CHARACTERISTIC
/begin CHARACTERISTIC speedgoat_test_SN5659__cal_impl.CANSetup_P12 "" VALUE 0x008D5E98 Scalar_FLOAT64_IEEE 0 speedgoat_test_SN5659_R2021b_CM_double -1.7E+308 1.7E+308 /end CHARACTERISTIC
/begin CHARACTERISTIC speedgoat_test_SN5659__cal_impl.CANSetup_P13 "" VAL_BLK 0x008D5EB0 Scalar_FLOAT64_IEEE 0 speedgoat_test_SN5659_R2021b_CM_double -1.7E+308 1.7E+308 MATRIX_DIM 4 1 /end CHARACTERISTIC
/begin CHARACTERISTIC speedgoat_test_SN5659__cal_impl.CANSetup_P14 "" VAL_BLK 0x008D5EE0 Scalar_FLOAT64_IEEE 0 speedgoat_test_SN5659_R2021b_CM_double -1.7E+308 1.7E+308 MATRIX_DIM 2 1 /end CHARACTERISTIC
/begin CHARACTERISTIC speedgoat_test_SN5659__cal_impl.CANSetup_P15 "" VAL_BLK 0x008D5F00 Scalar_FLOAT64_IEEE 0 speedgoat_test_SN5659_R2021b_CM_double -1.7E+308 1.7E+308 MATRIX_DIM 2 1 /end CHARACTERISTIC
/begin CHARACTERISTIC speedgoat_test_SN5659__cal_impl.CANSetup_P16 "" VALUE 0x008D5F20 Scalar_FLOAT64_IEEE 0 speedgoat_test_SN5659_R2021b_CM_double -1.7E+308 1.7E+308 /end CHARACTERISTIC
/begin CHARACTERISTIC speedgoat_test_SN5659__cal_impl.CANSetup_P17 "" VAL_BLK 0x008D5F38 Scalar_FLOAT64_IEEE 0 speedgoat_test_SN5659_R2021b_CM_double -1.7E+308 1.7E+308 MATRIX_DIM 4 1 /end CHARACTERISTIC
/begin CHARACTERISTIC speedgoat_test_SN5659__cal_impl.CANSetup_P18 "" VAL_BLK 0x008D5F68 Scalar_FLOAT64_IEEE 0 speedgoat_test_SN5659_R2021b_CM_double -1.7E+308 1.7E+308 MATRIX_DIM 2 1 /end CHARACTERISTIC
/begin CHARACTERISTIC speedgoat_test_SN5659__cal_impl.CANSetup_P19 "" VAL_BLK 0x008D5F88 Scalar_FLOAT64_IEEE 0 speedgoat_test_SN5659_R2021b_CM_double -1.7E+308 1.7E+308 MATRIX_DIM 2 1 /end CHARACTERISTIC
/begin CHARACTERISTIC speedgoat_test_SN5659__cal_impl.CANSetup_P2 "" VAL_BLK 0x008D5D78 Scalar_FLOAT64_IEEE 0 speedgoat_test_SN5659_R2021b_CM_double -1.7E+308 1.7E+308 MATRIX_DIM 2 1 /end CHARACTERISTIC
/begin CHARACTERISTIC speedgoat_test_SN5659__cal_impl.CANSetup_P20 "" VALUE 0x008D5FA8 Scalar_FLOAT64_IEEE 0 speedgoat_test_SN5659_R2021b_CM_double -1.7E+308 1.7E+308 /end CHARACTERISTIC
/begin CHARACTERISTIC speedgoat_test_SN5659__cal_impl.CANSetup_P21 "" VAL_BLK 0x008D5FC0 Scalar_FLOAT64_IEEE 0 speedgoat_test_SN5659_R2021b_CM_double -1.7E+308 1.7E+308 MATRIX_DIM 4 1 /end CHARACTERISTIC
/begin CHARACTERISTIC speedgoat_test_SN5659__cal_impl.CANSetup_P22 "" VAL_BLK 0x008D5FF0 Scalar_FLOAT64_IEEE 0 speedgoat_test_SN5659_R2021b_CM_double -1.7E+308 1.7E+308 MATRIX_DIM 2 1 /end CHARACTERISTIC
/begin CHARACTERISTIC speedgoat_test_SN5659__cal_impl.CANSetup_P23 "" VAL_BLK 0x008D6010 Scalar_FLOAT64_IEEE 0 speedgoat_test_SN5659_R2021b_CM_double -1.7E+308 1.7E+308 MATRIX_DIM 2 1 /end CHARACTERISTIC
/begin CHARACTERISTIC speedgoat_test_SN5659__cal_impl.CANSetup_P24 "" VALUE 0x008D6030 Scalar_FLOAT64_IEEE 0 speedgoat_test_SN5659_R2021b_CM_double -1.7E+308 1.7E+308 /end CHARACTERISTIC
/begin CHARACTERISTIC speedgoat_test_SN5659__cal_impl.CANSetup_P25 "" VALUE 0x008D6048 Scalar_FLOAT64_IEEE 0 speedgoat_test_SN5659_R2021b_CM_double -1.7E+308 1.7E+308 /end CHARACTERISTIC
/begin CHARACTERISTIC speedgoat_test_SN5659__cal_impl.CANSetup_P26 "" VAL_BLK 0x008D6060 Scalar_FLOAT64_IEEE 0 speedgoat_test_SN5659_R2021b_CM_double -1.7E+308 1.7E+308 MATRIX_DIM 5 1 /end CHARACTERISTIC
/begin CHARACTERISTIC speedgoat_test_SN5659__cal_impl.CANSetup_P27 "" VALUE 0x008D6098 Scalar_FLOAT64_IEEE 0 speedgoat_test_SN5659_R2021b_CM_double -1.7E+308 1.7E+308 /end CHARACTERISTIC
/begin CHARACTERISTIC speedgoat_test_SN5659__cal_impl.CANSetup_P28 "" VAL_BLK 0x008D60B0 Scalar_FLOAT64_IEEE 0 speedgoat_test_SN5659_R2021b_CM_double -1.7E+308 1.7E+308 MATRIX_DIM 4 1 /end CHARACTERISTIC
/begin CHARACTERISTIC speedgoat_test_SN5659__cal_impl.CANSetup_P29 "" VAL_BLK 0x008D60E0 Scalar_FLOAT64_IEEE 0 speedgoat_test_SN5659_R2021b_CM_double -1.7E+308 1.7E+308 MATRIX_DIM 4 1 /end CHARACTERISTIC
/begin CHARACTERISTIC speedgoat_test_SN5659__cal_impl.CANSetup_P3 "" VALUE 0x008D5D98 Scalar_FLOAT64_IEEE 0 speedgoat_test_SN5659_R2021b_CM_double -1.7E+308 1.7E+308 /end CHARACTERISTIC
/begin CHARACTERISTIC speedgoat_test_SN5659__cal_impl.CANSetup_P30 "" VAL_BLK 0x008D6110 Scalar_FLOAT64_IEEE 0 speedgoat_test_SN5659_R2021b_CM_double -1.7E+308 1.7E+308 MATRIX_DIM 4 1 /end CHARACTERISTIC
/begin CHARACTERISTIC speedgoat_test_SN5659__cal_impl.CANSetup_P31 "" VALUE 0x008D6140 Scalar_FLOAT64_IEEE 0 speedgoat_test_SN5659_R2021b_CM_double -1.7E+308 1.7E+308 /end CHARACTERISTIC
/begin CHARACTERISTIC speedgoat_test_SN5659__cal_impl.CANSetup_P4 "" VALUE 0x008D5DB0 Scalar_FLOAT64_IEEE 0 speedgoat_test_SN5659_R2021b_CM_double -1.7E+308 1.7E+308 /end CHARACTERISTIC
/begin CHARACTERISTIC speedgoat_test_SN5659__cal_impl.CANSetup_P5 "" VALUE 0x008D5DC8 Scalar_FLOAT64_IEEE 0 speedgoat_test_SN5659_R2021b_CM_double -1.7E+308 1.7E+308 /end CHARACTERISTIC
/begin CHARACTERISTIC speedgoat_test_SN5659__cal_impl.CANSetup_P6 "" VALUE 0x008D5DE0 Scalar_FLOAT64_IEEE 0 speedgoat_test_SN5659_R2021b_CM_double -1.7E+308 1.7E+308 /end CHARACTERISTIC
/begin CHARACTERISTIC speedgoat_test_SN5659__cal_impl.CANSetup_P7 "" VALUE 0x008D5DF8 Scalar_FLOAT64_IEEE 0 speedgoat_test_SN5659_R2021b_CM_double -1.7E+308 1.7E+308 /end CHARACTERISTIC
/begin CHARACTERISTIC speedgoat_test_SN5659__cal_impl.CANSetup_P8 "" VALUE 0x008D5E10 Scalar_FLOAT64_IEEE 0 speedgoat_test_SN5659_R2021b_CM_double -1.7E+308 1.7E+308 /end CHARACTERISTIC
/begin CHARACTERISTIC speedgoat_test_SN5659__cal_impl.CANSetup_P9 "" VAL_BLK 0x008D5E28 Scalar_FLOAT64_IEEE 0 speedgoat_test_SN5659_R2021b_CM_double -1.7E+308 1.7E+308 MATRIX_DIM 4 1 /end CHARACTERISTIC
/begin CHARACTERISTIC speedgoat_test_SN5659__cal_impl.CANWrite1_P1 "" VALUE 0x008D64D8 Scalar_FLOAT64_IEEE 0 speedgoat_test_SN5659_R2021b_CM_double -1.7E+308 1.7E+308 /end CHARACTERISTIC
/begin CHARACTERISTIC speedgoat_test_SN5659__cal_impl.CANWrite1_P2 "" VALUE 0x008D64F0 Scalar_FLOAT64_IEEE 0 speedgoat_test_SN5659_R2021b_CM_double -1.7E+308 1.7E+308 /end CHARACTERISTIC
/begin CHARACTERISTIC speedgoat_test_SN5659__cal_impl.CANWrite1_P3 "" VALUE 0x008D6508 Scalar_FLOAT64_IEEE 0 speedgoat_test_SN5659_R2021b_CM_double -1.7E+308 1.7E+308 /end CHARACTERISTIC
/begin CHARACTERISTIC speedgoat_test_SN5659__cal_impl.CANWrite1_P4 "" VALUE 0x008D6520 Scalar_FLOAT64_IEEE 0 speedgoat_test_SN5659_R2021b_CM_double -1.7E+308 1.7E+308 /end CHARACTERISTIC
/begin CHARACTERISTIC speedgoat_test_SN5659__cal_impl.CANWrite1_P5 "" VAL_BLK 0x008D6538 Scalar_FLOAT64_IEEE 0 speedgoat_test_SN5659_R2021b_CM_double -1.7E+308 1.7E+308 MATRIX_DIM 5 1 /end CHARACTERISTIC
/begin CHARACTERISTIC speedgoat_test_SN5659__cal_impl.CANWrite1_P6 "" VALUE 0x008D6570 Scalar_FLOAT64_IEEE 0 speedgoat_test_SN5659_R2021b_CM_double -1.7E+308 1.7E+308 /end CHARACTERISTIC
/begin CHARACTERISTIC speedgoat_test_SN5659__cal_impl.CANWrite1_P7 "" VALUE 0x008D6588 Scalar_FLOAT64_IEEE 0 speedgoat_test_SN5659_R2021b_CM_double -1.7E+308 1.7E+308 /end CHARACTERISTIC
/begin CHARACTERISTIC speedgoat_test_SN5659__cal_impl.CANWrite1_P8 "" VALUE 0x008D65A0 Scalar_FLOAT64_IEEE 0 speedgoat_test_SN5659_R2021b_CM_double -1.7E+308 1.7E+308 /end CHARACTERISTIC
/begin CHARACTERISTIC speedgoat_test_SN5659__cal_impl.CANWrite2_P1 "" VALUE 0x008D62A8 Scalar_FLOAT64_IEEE 0 speedgoat_test_SN5659_R2021b_CM_double -1.7E+308 1.7E+308 /end CHARACTERISTIC
/begin CHARACTERISTIC speedgoat_test_SN5659__cal_impl.CANWrite2_P2 "" VALUE 0x008D62C0 Scalar_FLOAT64_IEEE 0 speedgoat_test_SN5659_R2021b_CM_double -1.7E+308 1.7E+308 /end CHARACTERISTIC
/begin CHARACTERISTIC speedgoat_test_SN5659__cal_impl.CANWrite2_P3 "" VALUE 0x008D62D8 Scalar_FLOAT64_IEEE 0 speedgoat_test_SN5659_R2021b_CM_double -1.7E+308 1.7E+308 /end CHARACTERISTIC
/begin CHARACTERISTIC speedgoat_test_SN5659__cal_impl.CANWrite2_P4 "" VALUE 0x008D62F0 Scalar_FLOAT64_IEEE 0 speedgoat_test_SN5659_R2021b_CM_double -1.7E+308 1.7E+308 /end CHARACTERISTIC
/begin CHARACTERISTIC speedgoat_test_SN5659__cal_impl.CANWrite2_P5 "" VAL_BLK 0x008D6308 Scalar_FLOAT64_IEEE 0 speedgoat_test_SN5659_R2021b_CM_double -1.7E+308 1.7E+308 MATRIX_DIM 5 1 /end CHARACTERISTIC
/begin CHARACTERISTIC speedgoat_test_SN5659__cal_impl.CANWrite2_P6 "" VALUE 0x008D6340 Scalar_FLOAT64_IEEE 0 speedgoat_test_SN5659_R2021b_CM_double -1.7E+308 1.7E+308 /end CHARACTERISTIC
/begin CHARACTERISTIC speedgoat_test_SN5659__cal_impl.CANWrite2_P7 "" VALUE 0x008D6358 Scalar_FLOAT64_IEEE 0 speedgoat_test_SN5659_R2021b_CM_double -1.7E+308 1.7E+308 /end CHARACTERISTIC
/begin CHARACTERISTIC speedgoat_test_SN5659__cal_impl.CANWrite2_P8 "" VALUE 0x008D6370 Scalar_FLOAT64_IEEE 0 speedgoat_test_SN5659_R2021b_CM_double -1.7E+308 1.7E+308 /end CHARACTERISTIC
/begin CHARACTERISTIC speedgoat_test_SN5659__cal_impl.CANWrite3_P1 "" VALUE 0x008D63C0 Scalar_FLOAT64_IEEE 0 speedgoat_test_SN5659_R2021b_CM_double -1.7E+308 1.7E+308 /end CHARACTERISTIC
/begin CHARACTERISTIC speedgoat_test_SN5659__cal_impl.CANWrite3_P2 "" VALUE 0x008D63D8 Scalar_FLOAT64_IEEE 0 speedgoat_test_SN5659_R2021b_CM_double -1.7E+308 1.7E+308 /end CHARACTERISTIC
/begin CHARACTERISTIC speedgoat_test_SN5659__cal_impl.CANWrite3_P3 "" VALUE 0x008D63F0 Scalar_FLOAT64_IEEE 0 speedgoat_test_SN5659_R2021b_CM_double -1.7E+308 1.7E+308 /end CHARACTERISTIC
/begin CHARACTERISTIC speedgoat_test_SN5659__cal_impl.CANWrite3_P4 "" VALUE 0x008D6408 Scalar_FLOAT64_IEEE 0 speedgoat_test_SN5659_R2021b_CM_double -1.7E+308 1.7E+308 /end CHARACTERISTIC
/begin CHARACTERISTIC speedgoat_test_SN5659__cal_impl.CANWrite3_P5 "" VAL_BLK 0x008D6420 Scalar_FLOAT64_IEEE 0 speedgoat_test_SN5659_R2021b_CM_double -1.7E+308 1.7E+308 MATRIX_DIM 5 1 /end CHARACTERISTIC
/begin CHARACTERISTIC speedgoat_test_SN5659__cal_impl.CANWrite3_P6 "" VALUE 0x008D6458 Scalar_FLOAT64_IEEE 0 speedgoat_test_SN5659_R2021b_CM_double -1.7E+308 1.7E+308 /end CHARACTERISTIC
/begin CHARACTERISTIC speedgoat_test_SN5659__cal_impl.CANWrite3_P7 "" VALUE 0x008D6470 Scalar_FLOAT64_IEEE 0 speedgoat_test_SN5659_R2021b_CM_double -1.7E+308 1.7E+308 /end CHARACTERISTIC
/begin CHARACTERISTIC speedgoat_test_SN5659__cal_impl.CANWrite3_P8 "" VALUE 0x008D6488 Scalar_FLOAT64_IEEE 0 speedgoat_test_SN5659_R2021b_CM_double -1.7E+308 1.7E+308 /end CHARACTERISTIC
/begin CHARACTERISTIC speedgoat_test_SN5659__cal_impl.CANWrite4_P1 "" VALUE 0x008D65F0 Scalar_FLOAT64_IEEE 0 speedgoat_test_SN5659_R2021b_CM_double -1.7E+308 1.7E+308 /end CHARACTERISTIC
/begin CHARACTERISTIC speedgoat_test_SN5659__cal_impl.CANWrite4_P2 "" VALUE 0x008D6608 Scalar_FLOAT64_IEEE 0 speedgoat_test_SN5659_R2021b_CM_double -1.7E+308 1.7E+308 /end CHARACTERISTIC
/begin CHARACTERISTIC speedgoat_test_SN5659__cal_impl.CANWrite4_P3 "" VALUE 0x008D6620 Scalar_FLOAT64_IEEE 0 speedgoat_test_SN5659_R2021b_CM_double -1.7E+308 1.7E+308 /end CHARACTERISTIC
/begin CHARACTERISTIC speedgoat_test_SN5659__cal_impl.CANWrite4_P4 "" VALUE 0x008D6638 Scalar_FLOAT64_IEEE 0 speedgoat_test_SN5659_R2021b_CM_double -1.7E+308 1.7E+308 /end CHARACTERISTIC
/begin CHARACTERISTIC speedgoat_test_SN5659__cal_impl.CANWrite4_P5 "" VAL_BLK 0x008D6650 Scalar_FLOAT64_IEEE 0 speedgoat_test_SN5659_R2021b_CM_double -1.7E+308 1.7E+308 MATRIX_DIM 5 1 /end CHARACTERISTIC
/begin CHARACTERISTIC speedgoat_test_SN5659__cal_impl.CANWrite4_P6 "" VALUE 0x008D6688 Scalar_FLOAT64_IEEE 0 speedgoat_test_SN5659_R2021b_CM_double -1.7E+308 1.7E+308 /end CHARACTERISTIC
/begin CHARACTERISTIC speedgoat_test_SN5659__cal_impl.CANWrite4_P7 "" VALUE 0x008D66A0 Scalar_FLOAT64_IEEE 0 speedgoat_test_SN5659_R2021b_CM_double -1.7E+308 1.7E+308 /end CHARACTERISTIC
/begin CHARACTERISTIC speedgoat_test_SN5659__cal_impl.CANWrite4_P8 "" VALUE 0x008D66B8 Scalar_FLOAT64_IEEE 0 speedgoat_test_SN5659_R2021b_CM_double -1.7E+308 1.7E+308 /end CHARACTERISTIC
/begin CHARACTERISTIC speedgoat_test_SN5659__cal_impl.CANWrite5_P1 "" VALUE 0x008D6708 Scalar_FLOAT64_IEEE 0 speedgoat_test_SN5659_R2021b_CM_double -1.7E+308 1.7E+308 /end CHARACTERISTIC
/begin CHARACTERISTIC speedgoat_test_SN5659__cal_impl.CANWrite5_P2 "" VALUE 0x008D6720 Scalar_FLOAT64_IEEE 0 speedgoat_test_SN5659_R2021b_CM_double -1.7E+308 1.7E+308 /end CHARACTERISTIC
/begin CHARACTERISTIC speedgoat_test_SN5659__cal_impl.CANWrite5_P3 "" VALUE 0x008D6738 Scalar_FLOAT64_IEEE 0 speedgoat_test_SN5659_R2021b_CM_double -1.7E+308 1.7E+308 /end CHARACTERISTIC
/begin CHARACTERISTIC speedgoat_test_SN5659__cal_impl.CANWrite5_P4 "" VALUE 0x008D6750 Scalar_FLOAT64_IEEE 0 speedgoat_test_SN5659_R2021b_CM_double -1.7E+308 1.7E+308 /end CHARACTERISTIC
/begin CHARACTERISTIC speedgoat_test_SN5659__cal_impl.CANWrite5_P5 "" VAL_BLK 0x008D6768 Scalar_FLOAT64_IEEE 0 speedgoat_test_SN5659_R2021b_CM_double -1.7E+308 1.7E+308 MATRIX_DIM 5 1 /end CHARACTERISTIC
/begin CHARACTERISTIC speedgoat_test_SN5659__cal_impl.CANWrite5_P6 "" VALUE 0x008D67A0 Scalar_FLOAT64_IEEE 0 speedgoat_test_SN5659_R2021b_CM_double -1.7E+308 1.7E+308 /end CHARACTERISTIC
/begin CHARACTERISTIC speedgoat_test_SN5659__cal_impl.CANWrite5_P7 "" VALUE 0x008D67B8 Scalar_FLOAT64_IEEE 0 speedgoat_test_SN5659_R2021b_CM_double -1.7E+308 1.7E+308 /end CHARACTERISTIC
/begin CHARACTERISTIC speedgoat_test_SN5659__cal_impl.CANWrite5_P8 "" VALUE 0x008D67D0 Scalar_FLOAT64_IEEE 0 speedgoat_test_SN5659_R2021b_CM_double -1.7E+308 1.7E+308 /end CHARACTERISTIC
/begin CHARACTERISTIC speedgoat_test_SN5659__cal_impl.CANWrite_P1 "" VALUE 0x008D6190 Scalar_FLOAT64_IEEE 0 speedgoat_test_SN5659_R2021b_CM_double -1.7E+308 1.7E+308 /end CHARACTERISTIC
/begin CHARACTERISTIC speedgoat_test_SN5659__cal_impl.CANWrite_P2 "" VALUE 0x008D61A8 Scalar_FLOAT64_IEEE 0 speedgoat_test_SN5659_R2021b_CM_double -1.7E+308 1.7E+308 /end CHARACTERISTIC
/begin CHARACTERISTIC speedgoat_test_SN5659__cal_impl.CANWrite_P3 "" VALUE 0x008D61C0 Scalar_FLOAT64_IEEE 0 speedgoat_test_SN5659_R2021b_CM_double -1.7E+308 1.7E+308 /end CHARACTERISTIC
/begin CHARACTERISTIC speedgoat_test_SN5659__cal_impl.CANWrite_P4 "" VALUE 0x008D61D8 Scalar_FLOAT64_IEEE 0 speedgoat_test_SN5659_R2021b_CM_double -1.7E+308 1.7E+308 /end CHARACTERISTIC
/begin CHARACTERISTIC speedgoat_test_SN5659__cal_impl.CANWrite_P5 "" VAL_BLK 0x008D61F0 Scalar_FLOAT64_IEEE 0 speedgoat_test_SN5659_R2021b_CM_double -1.7E+308 1.7E+308 MATRIX_DIM 5 1 /end CHARACTERISTIC
/begin CHARACTERISTIC speedgoat_test_SN5659__cal_impl.CANWrite_P6 "" VALUE 0x008D6228 Scalar_FLOAT64_IEEE 0 speedgoat_test_SN5659_R2021b_CM_double -1.7E+308 1.7E+308 /end CHARACTERISTIC
/begin CHARACTERISTIC speedgoat_test_SN5659__cal_impl.CANWrite_P7 "" VALUE 0x008D6240 Scalar_FLOAT64_IEEE 0 speedgoat_test_SN5659_R2021b_CM_double -1.7E+308 1.7E+308 /end CHARACTERISTIC
/begin CHARACTERISTIC speedgoat_test_SN5659__cal_impl.CANWrite_P8 "" VALUE 0x008D6258 Scalar_FLOAT64_IEEE 0 speedgoat_test_SN5659_R2021b_CM_double -1.7E+308 1.7E+308 /end CHARACTERISTIC
/begin CHARACTERISTIC speedgoat_test_SN5659__cal_impl.Decode1_P1 "" VALUE 0x008D7908 Scalar_FLOAT64_IEEE 0 speedgoat_test_SN5659_R2021b_CM_double -1.7E+308 1.7E+308 /end CHARACTERISTIC
/begin CHARACTERISTIC speedgoat_test_SN5659__cal_impl.Decode1_P10 "" VAL_BLK 0x008D79E0 Scalar_FLOAT64_IEEE 0 speedgoat_test_SN5659_R2021b_CM_double -1.7E+308 1.7E+308 MATRIX_DIM 2 1 /end CHARACTERISTIC
/begin CHARACTERISTIC speedgoat_test_SN5659__cal_impl.Decode1_P11 "" VALUE 0x008D7A00 Scalar_FLOAT64_IEEE 0 speedgoat_test_SN5659_R2021b_CM_double -1.7E+308 1.7E+308 /end CHARACTERISTIC
/begin CHARACTERISTIC speedgoat_test_SN5659__cal_impl.Decode1_P12 "" VALUE 0x008D7A18 Scalar_FLOAT64_IEEE 0 speedgoat_test_SN5659_R2021b_CM_double -1.7E+308 1.7E+308 /end CHARACTERISTIC
/begin CHARACTERISTIC speedgoat_test_SN5659__cal_impl.Decode1_P13 "" VALUE 0x008D7A30 Scalar_FLOAT64_IEEE 0 speedgoat_test_SN5659_R2021b_CM_double -1.7E+308 1.7E+308 /end CHARACTERISTIC
/begin CHARACTERISTIC speedgoat_test_SN5659__cal_impl.Decode1_P14 "" VALUE 0x008D7A48 Scalar_FLOAT64_IEEE 0 speedgoat_test_SN5659_R2021b_CM_double -1.7E+308 1.7E+308 /end CHARACTERISTIC
/begin CHARACTERISTIC speedgoat_test_SN5659__cal_impl.Decode1_P15 "" VALUE 0x008D7A60 Scalar_FLOAT64_IEEE 0 speedgoat_test_SN5659_R2021b_CM_double -1.7E+308 1.7E+308 /end CHARACTERISTIC
/begin CHARACTERISTIC speedgoat_test_SN5659__cal_impl.Decode1_P16 "" VALUE 0x008D7A78 Scalar_FLOAT64_IEEE 0 speedgoat_test_SN5659_R2021b_CM_double -1.7E+308 1.7E+308 /end CHARACTERISTIC
/begin CHARACTERISTIC speedgoat_test_SN5659__cal_impl.Decode1_P2 "" VALUE 0x008D7920 Scalar_FLOAT64_IEEE 0 speedgoat_test_SN5659_R2021b_CM_double -1.7E+308 1.7E+308 /end CHARACTERISTIC
/begin CHARACTERISTIC speedgoat_test_SN5659__cal_impl.Decode1_P3 "" VALUE 0x008D7938 Scalar_FLOAT64_IEEE 0 speedgoat_test_SN5659_R2021b_CM_double -1.7E+308 1.7E+308 /end CHARACTERISTIC
/begin CHARACTERISTIC speedgoat_test_SN5659__cal_impl.Decode1_P4 "" VALUE 0x008D7950 Scalar_FLOAT64_IEEE 0 speedgoat_test_SN5659_R2021b_CM_double -1.7E+308 1.7E+308 /end CHARACTERISTIC
/begin CHARACTERISTIC speedgoat_test_SN5659__cal_impl.Decode1_P5 "" VALUE 0x008D7968 Scalar_FLOAT64_IEEE 0 speedgoat_test_SN5659_R2021b_CM_double -1.7E+308 1.7E+308 /end CHARACTERISTIC
/begin CHARACTERISTIC speedgoat_test_SN5659__cal_impl.Decode1_P6 "" VALUE 0x008D7980 Scalar_FLOAT64_IEEE 0 speedgoat_test_SN5659_R2021b_CM_double -1.7E+308 1.7E+308 /end CHARACTERISTIC
/begin CHARACTERISTIC speedgoat_test_SN5659__cal_impl.Decode1_P7 "" VALUE 0x008D7998 Scalar_FLOAT64_IEEE 0 speedgoat_test_SN5659_R2021b_CM_double -1.7E+308 1.7E+308 /end CHARACTERISTIC
/begin CHARACTERISTIC speedgoat_test_SN5659__cal_impl.Decode1_P8 "" VALUE 0x008D79B0 Scalar_FLOAT64_IEEE 0 speedgoat_test_SN5659_R2021b_CM_double -1.7E+308 1.7E+308 /end CHARACTERISTIC
/begin CHARACTERISTIC speedgoat_test_SN5659__cal_impl.Decode1_P9 "" VALUE 0x008D79C8 Scalar_FLOAT64_IEEE 0 speedgoat_test_SN5659_R2021b_CM_double -1.7E+308 1.7E+308 /end CHARACTERISTIC
/begin CHARACTERISTIC speedgoat_test_SN5659__cal_impl.Decode3_P1 "" VALUE 0x008D7C18 Scalar_FLOAT64_IEEE 0 speedgoat_test_SN5659_R2021b_CM_double -1.7E+308 1.7E+308 /end CHARACTERISTIC
/begin CHARACTERISTIC speedgoat_test_SN5659__cal_impl.Decode3_P10 "" VAL_BLK 0x008D7CF0 Scalar_FLOAT64_IEEE 0 speedgoat_test_SN5659_R2021b_CM_double -1.7E+308 1.7E+308 MATRIX_DIM 2 1 /end CHARACTERISTIC
/begin CHARACTERISTIC speedgoat_test_SN5659__cal_impl.Decode3_P11 "" VALUE 0x008D7D10 Scalar_FLOAT64_IEEE 0 speedgoat_test_SN5659_R2021b_CM_double -1.7E+308 1.7E+308 /end CHARACTERISTIC
/begin CHARACTERISTIC speedgoat_test_SN5659__cal_impl.Decode3_P12 "" VALUE 0x008D7D28 Scalar_FLOAT64_IEEE 0 speedgoat_test_SN5659_R2021b_CM_double -1.7E+308 1.7E+308 /end CHARACTERISTIC
/begin CHARACTERISTIC speedgoat_test_SN5659__cal_impl.Decode3_P13 "" VALUE 0x008D7D40 Scalar_FLOAT64_IEEE 0 speedgoat_test_SN5659_R2021b_CM_double -1.7E+308 1.7E+308 /end CHARACTERISTIC
/begin CHARACTERISTIC speedgoat_test_SN5659__cal_impl.Decode3_P14 "" VALUE 0x008D7D58 Scalar_FLOAT64_IEEE 0 speedgoat_test_SN5659_R2021b_CM_double -1.7E+308 1.7E+308 /end CHARACTERISTIC
/begin CHARACTERISTIC speedgoat_test_SN5659__cal_impl.Decode3_P15 "" VALUE 0x008D7D70 Scalar_FLOAT64_IEEE 0 speedgoat_test_SN5659_R2021b_CM_double -1.7E+308 1.7E+308 /end CHARACTERISTIC
/begin CHARACTERISTIC speedgoat_test_SN5659__cal_impl.Decode3_P16 "" VALUE 0x008D7D88 Scalar_FLOAT64_IEEE 0 speedgoat_test_SN5659_R2021b_CM_double -1.7E+308 1.7E+308 /end CHARACTERISTIC
/begin CHARACTERISTIC speedgoat_test_SN5659__cal_impl.Decode3_P2 "" VALUE 0x008D7C30 Scalar_FLOAT64_IEEE 0 speedgoat_test_SN5659_R2021b_CM_double -1.7E+308 1.7E+308 /end CHARACTERISTIC
/begin CHARACTERISTIC speedgoat_test_SN5659__cal_impl.Decode3_P3 "" VALUE 0x008D7C48 Scalar_FLOAT64_IEEE 0 speedgoat_test_SN5659_R2021b_CM_double -1.7E+308 1.7E+308 /end CHARACTERISTIC
/begin CHARACTERISTIC speedgoat_test_SN5659__cal_impl.Decode3_P4 "" VALUE 0x008D7C60 Scalar_FLOAT64_IEEE 0 speedgoat_test_SN5659_R2021b_CM_double -1.7E+308 1.7E+308 /end CHARACTERISTIC
/begin CHARACTERISTIC speedgoat_test_SN5659__cal_impl.Decode3_P5 "" VALUE 0x008D7C78 Scalar_FLOAT64_IEEE 0 speedgoat_test_SN5659_R2021b_CM_double -1.7E+308 1.7E+308 /end CHARACTERISTIC
/begin CHARACTERISTIC speedgoat_test_SN5659__cal_impl.Decode3_P6 "" VALUE 0x008D7C90 Scalar_FLOAT64_IEEE 0 speedgoat_test_SN5659_R2021b_CM_double -1.7E+308 1.7E+308 /end CHARACTERISTIC
/begin CHARACTERISTIC speedgoat_test_SN5659__cal_impl.Decode3_P7 "" VALUE 0x008D7CA8 Scalar_FLOAT64_IEEE 0 speedgoat_test_SN5659_R2021b_CM_double -1.7E+308 1.7E+308 /end CHARACTERISTIC
/begin CHARACTERISTIC speedgoat_test_SN5659__cal_impl.Decode3_P8 "" VALUE 0x008D7CC0 Scalar_FLOAT64_IEEE 0 speedgoat_test_SN5659_R2021b_CM_double -1.7E+308 1.7E+308 /end CHARACTERISTIC
/begin CHARACTERISTIC speedgoat_test_SN5659__cal_impl.Decode3_P9 "" VALUE 0x008D7CD8 Scalar_FLOAT64_IEEE 0 speedgoat_test_SN5659_R2021b_CM_double -1.7E+308 1.7E+308 /end CHARACTERISTIC
/begin CHARACTERISTIC speedgoat_test_SN5659__cal_impl.Decode4_P1 "" VALUE 0x008D7DA0 Scalar_FLOAT64_IEEE 0 speedgoat_test_SN5659_R2021b_CM_double -1.7E+308 1.7E+308 /end CHARACTERISTIC
/begin CHARACTERISTIC speedgoat_test_SN5659__cal_impl.Decode4_P10 "" VAL_BLK 0x008D7E78 Scalar_FLOAT64_IEEE 0 speedgoat_test_SN5659_R2021b_CM_double -1.7E+308 1.7E+308 MATRIX_DIM 2 1 /end CHARACTERISTIC
/begin CHARACTERISTIC speedgoat_test_SN5659__cal_impl.Decode4_P11 "" VALUE 0x008D7E98 Scalar_FLOAT64_IEEE 0 speedgoat_test_SN5659_R2021b_CM_double -1.7E+308 1.7E+308 /end CHARACTERISTIC
/begin CHARACTERISTIC speedgoat_test_SN5659__cal_impl.Decode4_P12 "" VALUE 0x008D7EB0 Scalar_FLOAT64_IEEE 0 speedgoat_test_SN5659_R2021b_CM_double -1.7E+308 1.7E+308 /end CHARACTERISTIC
/begin CHARACTERISTIC speedgoat_test_SN5659__cal_impl.Decode4_P13 "" VALUE 0x008D7EC8 Scalar_FLOAT64_IEEE 0 speedgoat_test_SN5659_R2021b_CM_double -1.7E+308 1.7E+308 /end CHARACTERISTIC
/begin CHARACTERISTIC speedgoat_test_SN5659__cal_impl.Decode4_P14 "" VALUE 0x008D7EE0 Scalar_FLOAT64_IEEE 0 speedgoat_test_SN5659_R2021b_CM_double -1.7E+308 1.7E+308 /end CHARACTERISTIC
/begin CHARACTERISTIC speedgoat_test_SN5659__cal_impl.Decode4_P15 "" VALUE 0x008D7EF8 Scalar_FLOAT64_IEEE 0 speedgoat_test_SN5659_R2021b_CM_double -1.7E+308 1.7E+308 /end CHARACTERISTIC
/begin CHARACTERISTIC speedgoat_test_SN5659__cal_impl.Decode4_P16 "" VALUE 0x008D7F10 Scalar_FLOAT64_IEEE 0 speedgoat_test_SN5659_R2021b_CM_double -1.7E+308 1.7E+308 /end CHARACTERISTIC
/begin CHARACTERISTIC speedgoat_test_SN5659__cal_impl.Decode4_P2 "" VALUE 0x008D7DB8 Scalar_FLOAT64_IEEE 0 speedgoat_test_SN5659_R2021b_CM_double -1.7E+308 1.7E+308 /end CHARACTERISTIC
/begin CHARACTERISTIC speedgoat_test_SN5659__cal_impl.Decode4_P3 "" VALUE 0x008D7DD0 Scalar_FLOAT64_IEEE 0 speedgoat_test_SN5659_R2021b_CM_double -1.7E+308 1.7E+308 /end CHARACTERISTIC
/begin CHARACTERISTIC speedgoat_test_SN5659__cal_impl.Decode4_P4 "" VALUE 0x008D7DE8 Scalar_FLOAT64_IEEE 0 speedgoat_test_SN5659_R2021b_CM_double -1.7E+308 1.7E+308 /end CHARACTERISTIC
/begin CHARACTERISTIC speedgoat_test_SN5659__cal_impl.Decode4_P5 "" VALUE 0x008D7E00 Scalar_FLOAT64_IEEE 0 speedgoat_test_SN5659_R2021b_CM_double -1.7E+308 1.7E+308 /end CHARACTERISTIC
/begin CHARACTERISTIC speedgoat_test_SN5659__cal_impl.Decode4_P6 "" VALUE 0x008D7E18 Scalar_FLOAT64_IEEE 0 speedgoat_test_SN5659_R2021b_CM_double -1.7E+308 1.7E+308 /end CHARACTERISTIC
/begin CHARACTERISTIC speedgoat_test_SN5659__cal_impl.Decode4_P7 "" VALUE 0x008D7E30 Scalar_FLOAT64_IEEE 0 speedgoat_test_SN5659_R2021b_CM_double -1.7E+308 1.7E+308 /end CHARACTERISTIC
/begin CHARACTERISTIC speedgoat_test_SN5659__cal_impl.Decode4_P8 "" VALUE 0x008D7E48 Scalar_FLOAT64_IEEE 0 speedgoat_test_SN5659_R2021b_CM_double -1.7E+308 1.7E+308 /end CHARACTERISTIC
/begin CHARACTERISTIC speedgoat_test_SN5659__cal_impl.Decode4_P9 "" VALUE 0x008D7E60 Scalar_FLOAT64_IEEE 0 speedgoat_test_SN5659_R2021b_CM_double -1.7E+308 1.7E+308 /end CHARACTERISTIC
/begin CHARACTERISTIC speedgoat_test_SN5659__cal_impl.Decode5_P1 "" VALUE 0x008D7A90 Scalar_FLOAT64_IEEE 0 speedgoat_test_SN5659_R2021b_CM_double -1.7E+308 1.7E+308 /end CHARACTERISTIC
/begin CHARACTERISTIC speedgoat_test_SN5659__cal_impl.Decode5_P10 "" VAL_BLK 0x008D7B68 Scalar_FLOAT64_IEEE 0 speedgoat_test_SN5659_R2021b_CM_double -1.7E+308 1.7E+308 MATRIX_DIM 2 1 /end CHARACTERISTIC
/begin CHARACTERISTIC speedgoat_test_SN5659__cal_impl.Decode5_P11 "" VALUE 0x008D7B88 Scalar_FLOAT64_IEEE 0 speedgoat_test_SN5659_R2021b_CM_double -1.7E+308 1.7E+308 /end CHARACTERISTIC
/begin CHARACTERISTIC speedgoat_test_SN5659__cal_impl.Decode5_P12 "" VALUE 0x008D7BA0 Scalar_FLOAT64_IEEE 0 speedgoat_test_SN5659_R2021b_CM_double -1.7E+308 1.7E+308 /end CHARACTERISTIC
/begin CHARACTERISTIC speedgoat_test_SN5659__cal_impl.Decode5_P13 "" VALUE 0x008D7BB8 Scalar_FLOAT64_IEEE 0 speedgoat_test_SN5659_R2021b_CM_double -1.7E+308 1.7E+308 /end CHARACTERISTIC
/begin CHARACTERISTIC speedgoat_test_SN5659__cal_impl.Decode5_P14 "" VALUE 0x008D7BD0 Scalar_FLOAT64_IEEE 0 speedgoat_test_SN5659_R2021b_CM_double -1.7E+308 1.7E+308 /end CHARACTERISTIC
/begin CHARACTERISTIC speedgoat_test_SN5659__cal_impl.Decode5_P15 "" VALUE 0x008D7BE8 Scalar_FLOAT64_IEEE 0 speedgoat_test_SN5659_R2021b_CM_double -1.7E+308 1.7E+308 /end CHARACTERISTIC
/begin CHARACTERISTIC speedgoat_test_SN5659__cal_impl.Decode5_P16 "" VALUE 0x008D7C00 Scalar_FLOAT64_IEEE 0 speedgoat_test_SN5659_R2021b_CM_double -1.7E+308 1.7E+308 /end CHARACTERISTIC
/begin CHARACTERISTIC speedgoat_test_SN5659__cal_impl.Decode5_P2 "" VALUE 0x008D7AA8 Scalar_FLOAT64_IEEE 0 speedgoat_test_SN5659_R2021b_CM_double -1.7E+308 1.7E+308 /end CHARACTERISTIC
/begin CHARACTERISTIC speedgoat_test_SN5659__cal_impl.Decode5_P3 "" VALUE 0x008D7AC0 Scalar_FLOAT64_IEEE 0 speedgoat_test_SN5659_R2021b_CM_double -1.7E+308 1.7E+308 /end CHARACTERISTIC
/begin CHARACTERISTIC speedgoat_test_SN5659__cal_impl.Decode5_P4 "" VALUE 0x008D7AD8 Scalar_FLOAT64_IEEE 0 speedgoat_test_SN5659_R2021b_CM_double -1.7E+308 1.7E+308 /end CHARACTERISTIC
/begin CHARACTERISTIC speedgoat_test_SN5659__cal_impl.Decode5_P5 "" VALUE 0x008D7AF0 Scalar_FLOAT64_IEEE 0 speedgoat_test_SN5659_R2021b_CM_double -1.7E+308 1.7E+308 /end CHARACTERISTIC
/begin CHARACTERISTIC speedgoat_test_SN5659__cal_impl.Decode5_P6 "" VALUE 0x008D7B08 Scalar_FLOAT64_IEEE 0 speedgoat_test_SN5659_R2021b_CM_double -1.7E+308 1.7E+308 /end CHARACTERISTIC
/begin CHARACTERISTIC speedgoat_test_SN5659__cal_impl.Decode5_P7 "" VALUE 0x008D7B20 Scalar_FLOAT64_IEEE 0 speedgoat_test_SN5659_R2021b_CM_double -1.7E+308 1.7E+308 /end CHARACTERISTIC
/begin CHARACTERISTIC speedgoat_test_SN5659__cal_impl.Decode5_P8 "" VALUE 0x008D7B38 Scalar_FLOAT64_IEEE 0 speedgoat_test_SN5659_R2021b_CM_double -1.7E+308 1.7E+308 /end CHARACTERISTIC
/begin CHARACTERISTIC speedgoat_test_SN5659__cal_impl.Decode5_P9 "" VALUE 0x008D7B50 Scalar_FLOAT64_IEEE 0 speedgoat_test_SN5659_R2021b_CM_double -1.7E+308 1.7E+308 /end CHARACTERISTIC
/begin CHARACTERISTIC speedgoat_test_SN5659__cal_impl.Digitalinputv2_P1 "" VALUE 0x008D5968 Scalar_FLOAT64_IEEE 0 speedgoat_test_SN5659_R2021b_CM_double -1.7E+308 1.7E+308 /end CHARACTERISTIC
/begin CHARACTERISTIC speedgoat_test_SN5659__cal_impl.Digitalinputv2_P2 "" VALUE 0x008D5980 Scalar_FLOAT64_IEEE 0 speedgoat_test_SN5659_R2021b_CM_double -1.7E+308 1.7E+308 /end CHARACTERISTIC
/begin CHARACTERISTIC speedgoat_test_SN5659__cal_impl.Digitalinputv2_P3 "" VALUE 0x008D5998 Scalar_FLOAT64_IEEE 0 speedgoat_test_SN5659_R2021b_CM_double -1.7E+308 1.7E+308 /end CHARACTERISTIC
/begin CHARACTERISTIC speedgoat_test_SN5659__cal_impl.Digitalinputv2_P4 "" VALUE 0x008D59B0 Scalar_FLOAT64_IEEE 0 speedgoat_test_SN5659_R2021b_CM_double -1.7E+308 1.7E+308 /end CHARACTERISTIC
/begin CHARACTERISTIC speedgoat_test_SN5659__cal_impl.Digitalinputv2_P5 "" VAL_BLK 0x008D59C8 Scalar_FLOAT64_IEEE 0 speedgoat_test_SN5659_R2021b_CM_double -1.7E+308 1.7E+308 MATRIX_DIM 2 1 /end CHARACTERISTIC
/begin CHARACTERISTIC speedgoat_test_SN5659__cal_impl.Digitaloutputv2_P1 "" VALUE 0x008D5A28 Scalar_FLOAT64_IEEE 0 speedgoat_test_SN5659_R2021b_CM_double -1.7E+308 1.7E+308 /end CHARACTERISTIC
/begin CHARACTERISTIC speedgoat_test_SN5659__cal_impl.Digitaloutputv2_P2 "" VALUE 0x008D5A40 Scalar_FLOAT64_IEEE 0 speedgoat_test_SN5659_R2021b_CM_double -1.7E+308 1.7E+308 /end CHARACTERISTIC
/begin CHARACTERISTIC speedgoat_test_SN5659__cal_impl.Digitaloutputv2_P3 "" VALUE 0x008D5A58 Scalar_FLOAT64_IEEE 0 speedgoat_test_SN5659_R2021b_CM_double -1.7E+308 1.7E+308 /end CHARACTERISTIC
/begin CHARACTERISTIC speedgoat_test_SN5659__cal_impl.Digitaloutputv2_P4 "" VALUE 0x008D5A70 Scalar_FLOAT64_IEEE 0 speedgoat_test_SN5659_R2021b_CM_double -1.7E+308 1.7E+308 /end CHARACTERISTIC
/begin CHARACTERISTIC speedgoat_test_SN5659__cal_impl.Digitaloutputv2_P5 "" VAL_BLK 0x008D5A88 Scalar_FLOAT64_IEEE 0 speedgoat_test_SN5659_R2021b_CM_double -1.7E+308 1.7E+308 MATRIX_DIM 2 1 /end CHARACTERISTIC
/begin CHARACTERISTIC speedgoat_test_SN5659__cal_impl.Digitaloutputv2_P6 "" VAL_BLK 0x008D5AA8 Scalar_FLOAT64_IEEE 0 speedgoat_test_SN5659_R2021b_CM_double -1.7E+308 1.7E+308 MATRIX_DIM 2 1 /end CHARACTERISTIC
/begin CHARACTERISTIC speedgoat_test_SN5659__cal_impl.Digitaloutputv2_P7 "" VAL_BLK 0x008D5AC8 Scalar_FLOAT64_IEEE 0 speedgoat_test_SN5659_R2021b_CM_double -1.7E+308 1.7E+308 MATRIX_DIM 2 1 /end CHARACTERISTIC
/begin CHARACTERISTIC speedgoat_test_SN5659__cal_impl.Gain1_Gain "" VALUE 0x008D5780 Scalar_FLOAT64_IEEE 0 speedgoat_test_SN5659_R2021b_CM_double -1.7E+308 1.7E+308 /end CHARACTERISTIC
/begin CHARACTERISTIC speedgoat_test_SN5659__cal_impl.Gain1_Gain_o "" VALUE 0x008D5CC0 Scalar_FLOAT64_IEEE 0 speedgoat_test_SN5659_R2021b_CM_double -1.7E+308 1.7E+308 /end CHARACTERISTIC
/begin CHARACTERISTIC speedgoat_test_SN5659__cal_impl.Gain2_Gain "" VALUE 0x008D5788 Scalar_FLOAT64_IEEE 0 speedgoat_test_SN5659_R2021b_CM_double -1.7E+308 1.7E+308 /end CHARACTERISTIC
/begin CHARACTERISTIC speedgoat_test_SN5659__cal_impl.Gain2_Gain_j "" VALUE 0x008D5CC8 Scalar_FLOAT64_IEEE 0 speedgoat_test_SN5659_R2021b_CM_double -1.7E+308 1.7E+308 /end CHARACTERISTIC
/begin CHARACTERISTIC speedgoat_test_SN5659__cal_impl.Gain3_Gain "" VALUE 0x008D5790 Scalar_FLOAT64_IEEE 0 speedgoat_test_SN5659_R2021b_CM_double -1.7E+308 1.7E+308 /end CHARACTERISTIC
/begin CHARACTERISTIC speedgoat_test_SN5659__cal_impl.Gain_Gain "" VALUE 0x008D5778 Scalar_FLOAT64_IEEE 0 speedgoat_test_SN5659_R2021b_CM_double -1.7E+308 1.7E+308 /end CHARACTERISTIC
/begin CHARACTERISTIC speedgoat_test_SN5659__cal_impl.Gain_Gain_i "" VALUE 0x008D5CB8 Scalar_FLOAT64_IEEE 0 speedgoat_test_SN5659_R2021b_CM_double -1.7E+308 1.7E+308 /end CHARACTERISTIC
/begin CHARACTERISTIC speedgoat_test_SN5659__cal_impl.ID100_Signal1_Y0 "" VALUE 0x008D5080 Scalar_FLOAT64_IEEE 0 speedgoat_test_SN5659_R2021b_CM_double -1.7E+308 1.7E+308 /end CHARACTERISTIC
/begin CHARACTERISTIC speedgoat_test_SN5659__cal_impl.ID100_Signal1_Y0_j "" VALUE 0x008D5160 Scalar_FLOAT64_IEEE 0 speedgoat_test_SN5659_R2021b_CM_double -1.7E+308 1.7E+308 /end CHARACTERISTIC
/begin CHARACTERISTIC speedgoat_test_SN5659__cal_impl.ID101_Signal1_Y0 "" VALUE 0x008D5088 Scalar_FLOAT64_IEEE 0 speedgoat_test_SN5659_R2021b_CM_double -1.7E+308 1.7E+308 /end CHARACTERISTIC
/begin CHARACTERISTIC speedgoat_test_SN5659__cal_impl.ID101_Signal1_Y0_o "" VALUE 0x008D5168 Scalar_FLOAT64_IEEE 0 speedgoat_test_SN5659_R2021b_CM_double -1.7E+308 1.7E+308 /end CHARACTERISTIC
/begin CHARACTERISTIC speedgoat_test_SN5659__cal_impl.ID102_Signal1_Y0 "" VALUE 0x008D5090 Scalar_FLOAT64_IEEE 0 speedgoat_test_SN5659_R2021b_CM_double -1.7E+308 1.7E+308 /end CHARACTERISTIC
/begin CHARACTERISTIC speedgoat_test_SN5659__cal_impl.ID102_Signal1_Y0_i "" VALUE 0x008D5170 Scalar_FLOAT64_IEEE 0 speedgoat_test_SN5659_R2021b_CM_double -1.7E+308 1.7E+308 /end CHARACTERISTIC
/begin CHARACTERISTIC speedgoat_test_SN5659__cal_impl.LVDTread1_P1 "" VALUE 0x008D7758 Scalar_FLOAT64_IEEE 0 speedgoat_test_SN5659_R2021b_CM_double -1.7E+308 1.7E+308 /end CHARACTERISTIC
/begin CHARACTERISTIC speedgoat_test_SN5659__cal_impl.LVDTread1_P2 "" VALUE 0x008D7770 Scalar_FLOAT64_IEEE 0 speedgoat_test_SN5659_R2021b_CM_double -1.7E+308 1.7E+308 /end CHARACTERISTIC
/begin CHARACTERISTIC speedgoat_test_SN5659__cal_impl.LVDTread1_P3 "" VALUE 0x008D7788 Scalar_FLOAT64_IEEE 0 speedgoat_test_SN5659_R2021b_CM_double -1.7E+308 1.7E+308 /end CHARACTERISTIC
/begin CHARACTERISTIC speedgoat_test_SN5659__cal_impl.LVDTread1_P4 "" VALUE 0x008D77A0 Scalar_FLOAT64_IEEE 0 speedgoat_test_SN5659_R2021b_CM_double -1.7E+308 1.7E+308 /end CHARACTERISTIC
/begin CHARACTERISTIC speedgoat_test_SN5659__cal_impl.LVDTread1_P5 "" VALUE 0x008D77B8 Scalar_FLOAT64_IEEE 0 speedgoat_test_SN5659_R2021b_CM_double -1.7E+308 1.7E+308 /end CHARACTERISTIC
/begin CHARACTERISTIC speedgoat_test_SN5659__cal_impl.LVDTread1_P6 "" VALUE 0x008D77D0 Scalar_FLOAT64_IEEE 0 speedgoat_test_SN5659_R2021b_CM_double -1.7E+308 1.7E+308 /end CHARACTERISTIC
/begin CHARACTERISTIC speedgoat_test_SN5659__cal_impl.LVDTread1_P7 "" VALUE 0x008D77E8 Scalar_FLOAT64_IEEE 0 speedgoat_test_SN5659_R2021b_CM_double -1.7E+308 1.7E+308 /end CHARACTERISTIC
/begin CHARACTERISTIC speedgoat_test_SN5659__cal_impl.LVDTread1_P8 "" VALUE 0x008D7800 Scalar_FLOAT64_IEEE 0 speedgoat_test_SN5659_R2021b_CM_double -1.7E+308 1.7E+308 /end CHARACTERISTIC
/begin CHARACTERISTIC speedgoat_test_SN5659__cal_impl.LVDTread_P1 "" VALUE 0x008D7698 Scalar_FLOAT64_IEEE 0 speedgoat_test_SN5659_R2021b_CM_double -1.7E+308 1.7E+308 /end CHARACTERISTIC
/begin CHARACTERISTIC speedgoat_test_SN5659__cal_impl.LVDTread_P2 "" VALUE 0x008D76B0 Scalar_FLOAT64_IEEE 0 speedgoat_test_SN5659_R2021b_CM_double -1.7E+308 1.7E+308 /end CHARACTERISTIC
/begin CHARACTERISTIC speedgoat_test_SN5659__cal_impl.LVDTread_P3 "" VALUE 0x008D76C8 Scalar_FLOAT64_IEEE 0 speedgoat_test_SN5659_R2021b_CM_double -1.7E+308 1.7E+308 /end CHARACTERISTIC
/begin CHARACTERISTIC speedgoat_test_SN5659__cal_impl.LVDTread_P4 "" VALUE 0x008D76E0 Scalar_FLOAT64_IEEE 0 speedgoat_test_SN5659_R2021b_CM_double -1.7E+308 1.7E+308 /end CHARACTERISTIC
/begin CHARACTERISTIC speedgoat_test_SN5659__cal_impl.LVDTread_P5 "" VALUE 0x008D76F8 Scalar_FLOAT64_IEEE 0 speedgoat_test_SN5659_R2021b_CM_double -1.7E+308 1.7E+308 /end CHARACTERISTIC
/begin CHARACTERISTIC speedgoat_test_SN5659__cal_impl.LVDTread_P6 "" VALUE 0x008D7710 Scalar_FLOAT64_IEEE 0 speedgoat_test_SN5659_R2021b_CM_double -1.7E+308 1.7E+308 /end CHARACTERISTIC
/begin CHARACTERISTIC speedgoat_test_SN5659__cal_impl.LVDTread_P7 "" VALUE 0x008D7728 Scalar_FLOAT64_IEEE 0 speedgoat_test_SN5659_R2021b_CM_double -1.7E+308 1.7E+308 /end CHARACTERISTIC
/begin CHARACTERISTIC speedgoat_test_SN5659__cal_impl.LVDTread_P8 "" VALUE 0x008D7740 Scalar_FLOAT64_IEEE 0 speedgoat_test_SN5659_R2021b_CM_double -1.7E+308 1.7E+308 /end CHARACTERISTIC
/begin CHARACTERISTIC speedgoat_test_SN5659__cal_impl.PulseGenerator1_Amp "" VALUE 0x008D59F8 Scalar_FLOAT64_IEEE 0 speedgoat_test_SN5659_R2021b_CM_double -1.7E+308 1.7E+308 /end CHARACTERISTIC
/begin CHARACTERISTIC speedgoat_test_SN5659__cal_impl.PulseGenerator1_Duty "" VALUE 0x008D5A08 Scalar_FLOAT64_IEEE 0 speedgoat_test_SN5659_R2021b_CM_double -1.7E+308 1.7E+308 /end CHARACTERISTIC
/begin CHARACTERISTIC speedgoat_test_SN5659__cal_impl.PulseGenerator1_Period "" VALUE 0x008D5A00 Scalar_FLOAT64_IEEE 0 speedgoat_test_SN5659_R2021b_CM_double -1.7E+308 1.7E+308 /end CHARACTERISTIC
/begin CHARACTERISTIC speedgoat_test_SN5659__cal_impl.PulseGenerator1_PhaseDelay "" VALUE 0x008D5A10 Scalar_FLOAT64_IEEE 0 speedgoat_test_SN5659_R2021b_CM_double -1.7E+308 1.7E+308 /end CHARACTERISTIC
/begin CHARACTERISTIC speedgoat_test_SN5659__cal_impl.PulseGenerator_Amp "" VALUE 0x008D59D8 Scalar_FLOAT64_IEEE 0 speedgoat_test_SN5659_R2021b_CM_double -1.7E+308 1.7E+308 /end CHARACTERISTIC
/begin CHARACTERISTIC speedgoat_test_SN5659__cal_impl.PulseGenerator_Amp_g "" VALUE 0x008D5D30 Scalar_FLOAT64_IEEE 0 speedgoat_test_SN5659_R2021b_CM_double -1.7E+308 1.7E+308 /end CHARACTERISTIC
/begin CHARACTERISTIC speedgoat_test_SN5659__cal_impl.PulseGenerator_Duty "" VALUE 0x008D59E8 Scalar_FLOAT64_IEEE 0 speedgoat_test_SN5659_R2021b_CM_double -1.7E+308 1.7E+308 /end CHARACTERISTIC
/begin CHARACTERISTIC speedgoat_test_SN5659__cal_impl.PulseGenerator_Duty_i "" VALUE 0x008D5D40 Scalar_FLOAT64_IEEE 0 speedgoat_test_SN5659_R2021b_CM_double -1.7E+308 1.7E+308 /end CHARACTERISTIC
/begin CHARACTERISTIC speedgoat_test_SN5659__cal_impl.PulseGenerator_Period "" VALUE 0x008D59E0 Scalar_FLOAT64_IEEE 0 speedgoat_test_SN5659_R2021b_CM_double -1.7E+308 1.7E+308 /end CHARACTERISTIC
/begin CHARACTERISTIC speedgoat_test_SN5659__cal_impl.PulseGenerator_Period_i "" VALUE 0x008D5D38 Scalar_FLOAT64_IEEE 0 speedgoat_test_SN5659_R2021b_CM_double -1.7E+308 1.7E+308 /end CHARACTERISTIC
/begin CHARACTERISTIC speedgoat_test_SN5659__cal_impl.PulseGenerator_PhaseDelay "" VALUE 0x008D59F0 Scalar_FLOAT64_IEEE 0 speedgoat_test_SN5659_R2021b_CM_double -1.7E+308 1.7E+308 /end CHARACTERISTIC
/begin CHARACTERISTIC speedgoat_test_SN5659__cal_impl.PulseGenerator_PhaseDelay_l "" VALUE 0x008D5D48 Scalar_FLOAT64_IEEE 0 speedgoat_test_SN5659_R2021b_CM_double -1.7E+308 1.7E+308 /end CHARACTERISTIC
/begin CHARACTERISTIC speedgoat_test_SN5659__cal_impl.REF_P1 "" VALUE 0x008D7818 Scalar_FLOAT64_IEEE 0 speedgoat_test_SN5659_R2021b_CM_double -1.7E+308 1.7E+308 /end CHARACTERISTIC
/begin CHARACTERISTIC speedgoat_test_SN5659__cal_impl.REF_P2 "" VALUE 0x008D7830 Scalar_FLOAT64_IEEE 0 speedgoat_test_SN5659_R2021b_CM_double -1.7E+308 1.7E+308 /end CHARACTERISTIC
/begin CHARACTERISTIC speedgoat_test_SN5659__cal_impl.REF_P3 "" VALUE 0x008D7848 Scalar_FLOAT64_IEEE 0 speedgoat_test_SN5659_R2021b_CM_double -1.7E+308 1.7E+308 /end CHARACTERISTIC
/begin CHARACTERISTIC speedgoat_test_SN5659__cal_impl.REF_P4 "" VALUE 0x008D7860 Scalar_FLOAT64_IEEE 0 speedgoat_test_SN5659_R2021b_CM_double -1.7E+308 1.7E+308 /end CHARACTERISTIC
/begin CHARACTERISTIC speedgoat_test_SN5659__cal_impl.REF_P5 "" VALUE 0x008D7878 Scalar_FLOAT64_IEEE 0 speedgoat_test_SN5659_R2021b_CM_double -1.7E+308 1.7E+308 /end CHARACTERISTIC
/begin CHARACTERISTIC speedgoat_test_SN5659__cal_impl.RXSampleTime1_Value "" VALUE 0x008D67E0 Scalar_FLOAT64_IEEE 0 speedgoat_test_SN5659_R2021b_CM_double -1.7E+308 1.7E+308 /end CHARACTERISTIC
/begin CHARACTERISTIC speedgoat_test_SN5659__cal_impl.RXSampleTime_Value "" VALUE 0x008D67D8 Scalar_FLOAT64_IEEE 0 speedgoat_test_SN5659_R2021b_CM_double -1.7E+308 1.7E+308 /end CHARACTERISTIC
/begin CHARACTERISTIC speedgoat_test_SN5659__cal_impl.Read_P1 "" VALUE 0x008D5C50 Scalar_FLOAT64_IEEE 0 speedgoat_test_SN5659_R2021b_CM_double -1.7E+308 1.7E+308 /end CHARACTERISTIC
/begin CHARACTERISTIC speedgoat_test_SN5659__cal_impl.Read_P2 "" VALUE 0x008D5C68 Scalar_FLOAT64_IEEE 0 speedgoat_test_SN5659_R2021b_CM_double -1.7E+308 1.7E+308 /end CHARACTERISTIC
/begin CHARACTERISTIC speedgoat_test_SN5659__cal_impl.Read_P3 "" VALUE 0x008D5C80 Scalar_FLOAT64_IEEE 0 speedgoat_test_SN5659_R2021b_CM_double -1.7E+308 1.7E+308 /end CHARACTERISTIC
/begin CHARACTERISTIC speedgoat_test_SN5659__cal_impl.Read_P4 "" VALUE 0x008D5C98 Scalar_FLOAT64_IEEE 0 speedgoat_test_SN5659_R2021b_CM_double -1.7E+308 1.7E+308 /end CHARACTERISTIC
/begin CHARACTERISTIC speedgoat_test_SN5659__cal_impl.Read_P5 "" VALUE 0x008D5CB0 Scalar_FLOAT64_IEEE 0 speedgoat_test_SN5659_R2021b_CM_double -1.7E+308 1.7E+308 /end CHARACTERISTIC
/begin CHARACTERISTIC speedgoat_test_SN5659__cal_impl.Receivev210_P1 "" VALUE 0x008D92F0 Scalar_FLOAT64_IEEE 0 speedgoat_test_SN5659_R2021b_CM_double -1.7E+308 1.7E+308 /end CHARACTERISTIC
/begin CHARACTERISTIC speedgoat_test_SN5659__cal_impl.Receivev210_P2 "" VALUE 0x008D9308 Scalar_FLOAT64_IEEE 0 speedgoat_test_SN5659_R2021b_CM_double -1.7E+308 1.7E+308 /end CHARACTERISTIC
/begin CHARACTERISTIC speedgoat_test_SN5659__cal_impl.Receivev210_P3 "" VALUE 0x008D9320 Scalar_FLOAT64_IEEE 0 speedgoat_test_SN5659_R2021b_CM_double -1.7E+308 1.7E+308 /end CHARACTERISTIC
/begin CHARACTERISTIC speedgoat_test_SN5659__cal_impl.Receivev210_P4 "" VALUE 0x008D9338 Scalar_FLOAT64_IEEE 0 speedgoat_test_SN5659_R2021b_CM_double -1.7E+308 1.7E+308 /end CHARACTERISTIC
/begin CHARACTERISTIC speedgoat_test_SN5659__cal_impl.Receivev210_P5 "" VALUE 0x008D9350 Scalar_FLOAT64_IEEE 0 speedgoat_test_SN5659_R2021b_CM_double -1.7E+308 1.7E+308 /end CHARACTERISTIC
/begin CHARACTERISTIC speedgoat_test_SN5659__cal_impl.Receivev211_P1 "" VALUE 0x008D9988 Scalar_FLOAT64_IEEE 0 speedgoat_test_SN5659_R2021b_CM_double -1.7E+308 1.7E+308 /end CHARACTERISTIC
/begin CHARACTERISTIC speedgoat_test_SN5659__cal_impl.Receivev211_P2 "" VALUE 0x008D99A0 Scalar_FLOAT64_IEEE 0 speedgoat_test_SN5659_R2021b_CM_double -1.7E+308 1.7E+308 /end CHARACTERISTIC
/begin CHARACTERISTIC speedgoat_test_SN5659__cal_impl.Receivev211_P3 "" VALUE 0x008D99B8 Scalar_FLOAT64_IEEE 0 speedgoat_test_SN5659_R2021b_CM_double -1.7E+308 1.7E+308 /end CHARACTERISTIC
/begin CHARACTERISTIC speedgoat_test_SN5659__cal_impl.Receivev211_P4 "" VALUE 0x008D99D0 Scalar_FLOAT64_IEEE 0 speedgoat_test_SN5659_R2021b_CM_double -1.7E+308 1.7E+308 /end CHARACTERISTIC
/begin CHARACTERISTIC speedgoat_test_SN5659__cal_impl.Receivev211_P5 "" VALUE 0x008D99E8 Scalar_FLOAT64_IEEE 0 speedgoat_test_SN5659_R2021b_CM_double -1.7E+308 1.7E+308 /end CHARACTERISTIC
/begin CHARACTERISTIC speedgoat_test_SN5659__cal_impl.Receivev212_P1 "" VALUE 0x008DA020 Scalar_FLOAT64_IEEE 0 speedgoat_test_SN5659_R2021b_CM_double -1.7E+308 1.7E+308 /end CHARACTERISTIC
/begin CHARACTERISTIC speedgoat_test_SN5659__cal_impl.Receivev212_P2 "" VALUE 0x008DA038 Scalar_FLOAT64_IEEE 0 speedgoat_test_SN5659_R2021b_CM_double -1.7E+308 1.7E+308 /end CHARACTERISTIC
/begin CHARACTERISTIC speedgoat_test_SN5659__cal_impl.Receivev212_P3 "" VALUE 0x008DA050 Scalar_FLOAT64_IEEE 0 speedgoat_test_SN5659_R2021b_CM_double -1.7E+308 1.7E+308 /end CHARACTERISTIC
/begin CHARACTERISTIC speedgoat_test_SN5659__cal_impl.Receivev212_P4 "" VALUE 0x008DA068 Scalar_FLOAT64_IEEE 0 speedgoat_test_SN5659_R2021b_CM_double -1.7E+308 1.7E+308 /end CHARACTERISTIC
/begin CHARACTERISTIC speedgoat_test_SN5659__cal_impl.Receivev212_P5 "" VALUE 0x008DA080 Scalar_FLOAT64_IEEE 0 speedgoat_test_SN5659_R2021b_CM_double -1.7E+308 1.7E+308 /end CHARACTERISTIC
/begin CHARACTERISTIC speedgoat_test_SN5659__cal_impl.Receivev213_P1 "" VALUE 0x008DA6B8 Scalar_FLOAT64_IEEE 0 speedgoat_test_SN5659_R2021b_CM_double -1.7E+308 1.7E+308 /end CHARACTERISTIC
/begin CHARACTERISTIC speedgoat_test_SN5659__cal_impl.Receivev213_P2 "" VALUE 0x008DA6D0 Scalar_FLOAT64_IEEE 0 speedgoat_test_SN5659_R2021b_CM_double -1.7E+308 1.7E+308 /end CHARACTERISTIC
/begin CHARACTERISTIC speedgoat_test_SN5659__cal_impl.Receivev213_P3 "" VALUE 0x008DA6E8 Scalar_FLOAT64_IEEE 0 speedgoat_test_SN5659_R2021b_CM_double -1.7E+308 1.7E+308 /end CHARACTERISTIC
/begin CHARACTERISTIC speedgoat_test_SN5659__cal_impl.Receivev213_P4 "" VALUE 0x008DA700 Scalar_FLOAT64_IEEE 0 speedgoat_test_SN5659_R2021b_CM_double -1.7E+308 1.7E+308 /end CHARACTERISTIC
/begin CHARACTERISTIC speedgoat_test_SN5659__cal_impl.Receivev213_P5 "" VALUE 0x008DA718 Scalar_FLOAT64_IEEE 0 speedgoat_test_SN5659_R2021b_CM_double -1.7E+308 1.7E+308 /end CHARACTERISTIC
/begin CHARACTERISTIC speedgoat_test_SN5659__cal_impl.Receivev214_P1 "" VALUE 0x008DAD50 Scalar_FLOAT64_IEEE 0 speedgoat_test_SN5659_R2021b_CM_double -1.7E+308 1.7E+308 /end CHARACTERISTIC
/begin CHARACTERISTIC speedgoat_test_SN5659__cal_impl.Receivev214_P2 "" VALUE 0x008DAD68 Scalar_FLOAT64_IEEE 0 speedgoat_test_SN5659_R2021b_CM_double -1.7E+308 1.7E+308 /end CHARACTERISTIC
/begin CHARACTERISTIC speedgoat_test_SN5659__cal_impl.Receivev214_P3 "" VALUE 0x008DAD80 Scalar_FLOAT64_IEEE 0 speedgoat_test_SN5659_R2021b_CM_double -1.7E+308 1.7E+308 /end CHARACTERISTIC
/begin CHARACTERISTIC speedgoat_test_SN5659__cal_impl.Receivev214_P4 "" VALUE 0x008DAD98 Scalar_FLOAT64_IEEE 0 speedgoat_test_SN5659_R2021b_CM_double -1.7E+308 1.7E+308 /end CHARACTERISTIC
/begin CHARACTERISTIC speedgoat_test_SN5659__cal_impl.Receivev214_P5 "" VALUE 0x008DADB0 Scalar_FLOAT64_IEEE 0 speedgoat_test_SN5659_R2021b_CM_double -1.7E+308 1.7E+308 /end CHARACTERISTIC
/begin CHARACTERISTIC speedgoat_test_SN5659__cal_impl.Receivev215_P1 "" VALUE 0x008DB3E8 Scalar_FLOAT64_IEEE 0 speedgoat_test_SN5659_R2021b_CM_double -1.7E+308 1.7E+308 /end CHARACTERISTIC
/begin CHARACTERISTIC speedgoat_test_SN5659__cal_impl.Receivev215_P2 "" VALUE 0x008DB400 Scalar_FLOAT64_IEEE 0 speedgoat_test_SN5659_R2021b_CM_double -1.7E+308 1.7E+308 /end CHARACTERISTIC
/begin CHARACTERISTIC speedgoat_test_SN5659__cal_impl.Receivev215_P3 "" VALUE 0x008DB418 Scalar_FLOAT64_IEEE 0 speedgoat_test_SN5659_R2021b_CM_double -1.7E+308 1.7E+308 /end CHARACTERISTIC
/begin CHARACTERISTIC speedgoat_test_SN5659__cal_impl.Receivev215_P4 "" VALUE 0x008DB430 Scalar_FLOAT64_IEEE 0 speedgoat_test_SN5659_R2021b_CM_double -1.7E+308 1.7E+308 /end CHARACTERISTIC
/begin CHARACTERISTIC speedgoat_test_SN5659__cal_impl.Receivev215_P5 "" VALUE 0x008DB448 Scalar_FLOAT64_IEEE 0 speedgoat_test_SN5659_R2021b_CM_double -1.7E+308 1.7E+308 /end CHARACTERISTIC
/begin CHARACTERISTIC speedgoat_test_SN5659__cal_impl.Receivev21_P1 "" VALUE 0x008D7F28 Scalar_FLOAT64_IEEE 0 speedgoat_test_SN5659_R2021b_CM_double -1.7E+308 1.7E+308 /end CHARACTERISTIC
/begin CHARACTERISTIC speedgoat_test_SN5659__cal_impl.Receivev21_P2 "" VALUE 0x008D7F40 Scalar_FLOAT64_IEEE 0 speedgoat_test_SN5659_R2021b_CM_double -1.7E+308 1.7E+308 /end CHARACTERISTIC
/begin CHARACTERISTIC speedgoat_test_SN5659__cal_impl.Receivev21_P3 "" VALUE 0x008D7F58 Scalar_FLOAT64_IEEE 0 speedgoat_test_SN5659_R2021b_CM_double -1.7E+308 1.7E+308 /end CHARACTERISTIC
/begin CHARACTERISTIC speedgoat_test_SN5659__cal_impl.Receivev21_P4 "" VALUE 0x008D7F70 Scalar_FLOAT64_IEEE 0 speedgoat_test_SN5659_R2021b_CM_double -1.7E+308 1.7E+308 /end CHARACTERISTIC
/begin CHARACTERISTIC speedgoat_test_SN5659__cal_impl.Receivev21_P5 "" VALUE 0x008D7F88 Scalar_FLOAT64_IEEE 0 speedgoat_test_SN5659_R2021b_CM_double -1.7E+308 1.7E+308 /end CHARACTERISTIC
/begin CHARACTERISTIC speedgoat_test_SN5659__cal_impl.Receivev22_P1 "" VALUE 0x008DBA80 Scalar_FLOAT64_IEEE 0 speedgoat_test_SN5659_R2021b_CM_double -1.7E+308 1.7E+308 /end CHARACTERISTIC
/begin CHARACTERISTIC speedgoat_test_SN5659__cal_impl.Receivev22_P2 "" VALUE 0x008DBA98 Scalar_FLOAT64_IEEE 0 speedgoat_test_SN5659_R2021b_CM_double -1.7E+308 1.7E+308 /end CHARACTERISTIC
/begin CHARACTERISTIC speedgoat_test_SN5659__cal_impl.Receivev22_P3 "" VALUE 0x008DBAB0 Scalar_FLOAT64_IEEE 0 speedgoat_test_SN5659_R2021b_CM_double -1.7E+308 1.7E+308 /end CHARACTERISTIC
/begin CHARACTERISTIC speedgoat_test_SN5659__cal_impl.Receivev22_P4 "" VALUE 0x008DBAC8 Scalar_FLOAT64_IEEE 0 speedgoat_test_SN5659_R2021b_CM_double -1.7E+308 1.7E+308 /end CHARACTERISTIC
/begin CHARACTERISTIC speedgoat_test_SN5659__cal_impl.Receivev22_P5 "" VALUE 0x008DBAE0 Scalar_FLOAT64_IEEE 0 speedgoat_test_SN5659_R2021b_CM_double -1.7E+308 1.7E+308 /end CHARACTERISTIC
/begin CHARACTERISTIC speedgoat_test_SN5659__cal_impl.Receivev23_P1 "" VALUE 0x008DC118 Scalar_FLOAT64_IEEE 0 speedgoat_test_SN5659_R2021b_CM_double -1.7E+308 1.7E+308 /end CHARACTERISTIC
/begin CHARACTERISTIC speedgoat_test_SN5659__cal_impl.Receivev23_P2 "" VALUE 0x008DC130 Scalar_FLOAT64_IEEE 0 speedgoat_test_SN5659_R2021b_CM_double -1.7E+308 1.7E+308 /end CHARACTERISTIC
/begin CHARACTERISTIC speedgoat_test_SN5659__cal_impl.Receivev23_P3 "" VALUE 0x008DC148 Scalar_FLOAT64_IEEE 0 speedgoat_test_SN5659_R2021b_CM_double -1.7E+308 1.7E+308 /end CHARACTERISTIC
/begin CHARACTERISTIC speedgoat_test_SN5659__cal_impl.Receivev23_P4 "" VALUE 0x008DC160 Scalar_FLOAT64_IEEE 0 speedgoat_test_SN5659_R2021b_CM_double -1.7E+308 1.7E+308 /end CHARACTERISTIC
/begin CHARACTERISTIC speedgoat_test_SN5659__cal_impl.Receivev23_P5 "" VALUE 0x008DC178 Scalar_FLOAT64_IEEE 0 speedgoat_test_SN5659_R2021b_CM_double -1.7E+308 1.7E+308 /end CHARACTERISTIC
/begin CHARACTERISTIC speedgoat_test_SN5659__cal_impl.Receivev24_P1 "" VALUE 0x008DC7B0 Scalar_FLOAT64_IEEE 0 speedgoat_test_SN5659_R2021b_CM_double -1.7E+308 1.7E+308 /end CHARACTERISTIC
/begin CHARACTERISTIC speedgoat_test_SN5659__cal_impl.Receivev24_P2 "" VALUE 0x008DC7C8 Scalar_FLOAT64_IEEE 0 speedgoat_test_SN5659_R2021b_CM_double -1.7E+308 1.7E+308 /end CHARACTERISTIC
/begin CHARACTERISTIC speedgoat_test_SN5659__cal_impl.Receivev24_P3 "" VALUE 0x008DC7E0 Scalar_FLOAT64_IEEE 0 speedgoat_test_SN5659_R2021b_CM_double -1.7E+308 1.7E+308 /end CHARACTERISTIC
/begin CHARACTERISTIC speedgoat_test_SN5659__cal_impl.Receivev24_P4 "" VALUE 0x008DC7F8 Scalar_FLOAT64_IEEE 0 speedgoat_test_SN5659_R2021b_CM_double -1.7E+308 1.7E+308 /end CHARACTERISTIC
/begin CHARACTERISTIC speedgoat_test_SN5659__cal_impl.Receivev24_P5 "" VALUE 0x008DC810 Scalar_FLOAT64_IEEE 0 speedgoat_test_SN5659_R2021b_CM_double -1.7E+308 1.7E+308 /end CHARACTERISTIC
/begin CHARACTERISTIC speedgoat_test_SN5659__cal_impl.Receivev25_P1 "" VALUE 0x008DCE48 Scalar_FLOAT64_IEEE 0 speedgoat_test_SN5659_R2021b_CM_double -1.7E+308 1.7E+308 /end CHARACTERISTIC
/begin CHARACTERISTIC speedgoat_test_SN5659__cal_impl.Receivev25_P2 "" VALUE 0x008DCE60 Scalar_FLOAT64_IEEE 0 speedgoat_test_SN5659_R2021b_CM_double -1.7E+308 1.7E+308 /end CHARACTERISTIC
/begin CHARACTERISTIC speedgoat_test_SN5659__cal_impl.Receivev25_P3 "" VALUE 0x008DCE78 Scalar_FLOAT64_IEEE 0 speedgoat_test_SN5659_R2021b_CM_double -1.7E+308 1.7E+308 /end CHARACTERISTIC
/begin CHARACTERISTIC speedgoat_test_SN5659__cal_impl.Receivev25_P4 "" VALUE 0x008DCE90 Scalar_FLOAT64_IEEE 0 speedgoat_test_SN5659_R2021b_CM_double -1.7E+308 1.7E+308 /end CHARACTERISTIC
/begin CHARACTERISTIC speedgoat_test_SN5659__cal_impl.Receivev25_P5 "" VALUE 0x008DCEA8 Scalar_FLOAT64_IEEE 0 speedgoat_test_SN5659_R2021b_CM_double -1.7E+308 1.7E+308 /end CHARACTERISTIC
/begin CHARACTERISTIC speedgoat_test_SN5659__cal_impl.Receivev26_P1 "" VALUE 0x008DD4E0 Scalar_FLOAT64_IEEE 0 speedgoat_test_SN5659_R2021b_CM_double -1.7E+308 1.7E+308 /end CHARACTERISTIC
/begin CHARACTERISTIC speedgoat_test_SN5659__cal_impl.Receivev26_P2 "" VALUE 0x008DD4F8 Scalar_FLOAT64_IEEE 0 speedgoat_test_SN5659_R2021b_CM_double -1.7E+308 1.7E+308 /end CHARACTERISTIC
/begin CHARACTERISTIC speedgoat_test_SN5659__cal_impl.Receivev26_P3 "" VALUE 0x008DD510 Scalar_FLOAT64_IEEE 0 speedgoat_test_SN5659_R2021b_CM_double -1.7E+308 1.7E+308 /end CHARACTERISTIC
/begin CHARACTERISTIC speedgoat_test_SN5659__cal_impl.Receivev26_P4 "" VALUE 0x008DD528 Scalar_FLOAT64_IEEE 0 speedgoat_test_SN5659_R2021b_CM_double -1.7E+308 1.7E+308 /end CHARACTERISTIC
/begin CHARACTERISTIC speedgoat_test_SN5659__cal_impl.Receivev26_P5 "" VALUE 0x008DD540 Scalar_FLOAT64_IEEE 0 speedgoat_test_SN5659_R2021b_CM_double -1.7E+308 1.7E+308 /end CHARACTERISTIC
/begin CHARACTERISTIC speedgoat_test_SN5659__cal_impl.Receivev27_P1 "" VALUE 0x008DDB78 Scalar_FLOAT64_IEEE 0 speedgoat_test_SN5659_R2021b_CM_double -1.7E+308 1.7E+308 /end CHARACTERISTIC
/begin CHARACTERISTIC speedgoat_test_SN5659__cal_impl.Receivev27_P2 "" VALUE 0x008DDB90 Scalar_FLOAT64_IEEE 0 speedgoat_test_SN5659_R2021b_CM_double -1.7E+308 1.7E+308 /end CHARACTERISTIC
/begin CHARACTERISTIC speedgoat_test_SN5659__cal_impl.Receivev27_P3 "" VALUE 0x008DDBA8 Scalar_FLOAT64_IEEE 0 speedgoat_test_SN5659_R2021b_CM_double -1.7E+308 1.7E+308 /end CHARACTERISTIC
/begin CHARACTERISTIC speedgoat_test_SN5659__cal_impl.Receivev27_P4 "" VALUE 0x008DDBC0 Scalar_FLOAT64_IEEE 0 speedgoat_test_SN5659_R2021b_CM_double -1.7E+308 1.7E+308 /end CHARACTERISTIC
/begin CHARACTERISTIC speedgoat_test_SN5659__cal_impl.Receivev27_P5 "" VALUE 0x008DDBD8 Scalar_FLOAT64_IEEE 0 speedgoat_test_SN5659_R2021b_CM_double -1.7E+308 1.7E+308 /end CHARACTERISTIC
/begin CHARACTERISTIC speedgoat_test_SN5659__cal_impl.Receivev28_P1 "" VALUE 0x008D85C0 Scalar_FLOAT64_IEEE 0 speedgoat_test_SN5659_R2021b_CM_double -1.7E+308 1.7E+308 /end CHARACTERISTIC
/begin CHARACTERISTIC speedgoat_test_SN5659__cal_impl.Receivev28_P2 "" VALUE 0x008D85D8 Scalar_FLOAT64_IEEE 0 speedgoat_test_SN5659_R2021b_CM_double -1.7E+308 1.7E+308 /end CHARACTERISTIC
/begin CHARACTERISTIC speedgoat_test_SN5659__cal_impl.Receivev28_P3 "" VALUE 0x008D85F0 Scalar_FLOAT64_IEEE 0 speedgoat_test_SN5659_R2021b_CM_double -1.7E+308 1.7E+308 /end CHARACTERISTIC
/begin CHARACTERISTIC speedgoat_test_SN5659__cal_impl.Receivev28_P4 "" VALUE 0x008D8608 Scalar_FLOAT64_IEEE 0 speedgoat_test_SN5659_R2021b_CM_double -1.7E+308 1.7E+308 /end CHARACTERISTIC
/begin CHARACTERISTIC speedgoat_test_SN5659__cal_impl.Receivev28_P5 "" VALUE 0x008D8620 Scalar_FLOAT64_IEEE 0 speedgoat_test_SN5659_R2021b_CM_double -1.7E+308 1.7E+308 /end CHARACTERISTIC
/begin CHARACTERISTIC speedgoat_test_SN5659__cal_impl.Receivev29_P1 "" VALUE 0x008D8C58 Scalar_FLOAT64_IEEE 0 speedgoat_test_SN5659_R2021b_CM_double -1.7E+308 1.7E+308 /end CHARACTERISTIC
/begin CHARACTERISTIC speedgoat_test_SN5659__cal_impl.Receivev29_P2 "" VALUE 0x008D8C70 Scalar_FLOAT64_IEEE 0 speedgoat_test_SN5659_R2021b_CM_double -1.7E+308 1.7E+308 /end CHARACTERISTIC
/begin CHARACTERISTIC speedgoat_test_SN5659__cal_impl.Receivev29_P3 "" VALUE 0x008D8C88 Scalar_FLOAT64_IEEE 0 speedgoat_test_SN5659_R2021b_CM_double -1.7E+308 1.7E+308 /end CHARACTERISTIC
/begin CHARACTERISTIC speedgoat_test_SN5659__cal_impl.Receivev29_P4 "" VALUE 0x008D8CA0 Scalar_FLOAT64_IEEE 0 speedgoat_test_SN5659_R2021b_CM_double -1.7E+308 1.7E+308 /end CHARACTERISTIC
/begin CHARACTERISTIC speedgoat_test_SN5659__cal_impl.Receivev29_P5 "" VALUE 0x008D8CB8 Scalar_FLOAT64_IEEE 0 speedgoat_test_SN5659_R2021b_CM_double -1.7E+308 1.7E+308 /end CHARACTERISTIC
/begin CHARACTERISTIC speedgoat_test_SN5659__cal_impl.Receivev2_P1 "" VALUE 0x008D7890 Scalar_FLOAT64_IEEE 0 speedgoat_test_SN5659_R2021b_CM_double -1.7E+308 1.7E+308 /end CHARACTERISTIC
/begin CHARACTERISTIC speedgoat_test_SN5659__cal_impl.Receivev2_P2 "" VALUE 0x008D78A8 Scalar_FLOAT64_IEEE 0 speedgoat_test_SN5659_R2021b_CM_double -1.7E+308 1.7E+308 /end CHARACTERISTIC
/begin CHARACTERISTIC speedgoat_test_SN5659__cal_impl.Receivev2_P3 "" VALUE 0x008D78C0 Scalar_FLOAT64_IEEE 0 speedgoat_test_SN5659_R2021b_CM_double -1.7E+308 1.7E+308 /end CHARACTERISTIC
/begin CHARACTERISTIC speedgoat_test_SN5659__cal_impl.Receivev2_P4 "" VALUE 0x008D78D8 Scalar_FLOAT64_IEEE 0 speedgoat_test_SN5659_R2021b_CM_double -1.7E+308 1.7E+308 /end CHARACTERISTIC
/begin CHARACTERISTIC speedgoat_test_SN5659__cal_impl.Receivev2_P5 "" VALUE 0x008D78F0 Scalar_FLOAT64_IEEE 0 speedgoat_test_SN5659_R2021b_CM_double -1.7E+308 1.7E+308 /end CHARACTERISTIC
/begin CHARACTERISTIC speedgoat_test_SN5659__cal_impl.Sendv210_P1 "" VALUE 0x008DF518 Scalar_FLOAT64_IEEE 0 speedgoat_test_SN5659_R2021b_CM_double -1.7E+308 1.7E+308 /end CHARACTERISTIC
/begin CHARACTERISTIC speedgoat_test_SN5659__cal_impl.Sendv210_P2 "" VALUE 0x008DF530 Scalar_FLOAT64_IEEE 0 speedgoat_test_SN5659_R2021b_CM_double -1.7E+308 1.7E+308 /end CHARACTERISTIC
/begin CHARACTERISTIC speedgoat_test_SN5659__cal_impl.Sendv210_P3 "" VALUE 0x008DF548 Scalar_FLOAT64_IEEE 0 speedgoat_test_SN5659_R2021b_CM_double -1.7E+308 1.7E+308 /end CHARACTERISTIC
/begin CHARACTERISTIC speedgoat_test_SN5659__cal_impl.Sendv211_P1 "" VALUE 0x008DFB88 Scalar_FLOAT64_IEEE 0 speedgoat_test_SN5659_R2021b_CM_double -1.7E+308 1.7E+308 /end CHARACTERISTIC
/begin CHARACTERISTIC speedgoat_test_SN5659__cal_impl.Sendv211_P2 "" VALUE 0x008DFBA0 Scalar_FLOAT64_IEEE 0 speedgoat_test_SN5659_R2021b_CM_double -1.7E+308 1.7E+308 /end CHARACTERISTIC
/begin CHARACTERISTIC speedgoat_test_SN5659__cal_impl.Sendv211_P3 "" VALUE 0x008DFBB8 Scalar_FLOAT64_IEEE 0 speedgoat_test_SN5659_R2021b_CM_double -1.7E+308 1.7E+308 /end CHARACTERISTIC
/begin CHARACTERISTIC speedgoat_test_SN5659__cal_impl.Sendv212_P1 "" VALUE 0x008E01F8 Scalar_FLOAT64_IEEE 0 speedgoat_test_SN5659_R2021b_CM_double -1.7E+308 1.7E+308 /end CHARACTERISTIC
/begin CHARACTERISTIC speedgoat_test_SN5659__cal_impl.Sendv212_P2 "" VALUE 0x008E0210 Scalar_FLOAT64_IEEE 0 speedgoat_test_SN5659_R2021b_CM_double -1.7E+308 1.7E+308 /end CHARACTERISTIC
/begin CHARACTERISTIC speedgoat_test_SN5659__cal_impl.Sendv212_P3 "" VALUE 0x008E0228 Scalar_FLOAT64_IEEE 0 speedgoat_test_SN5659_R2021b_CM_double -1.7E+308 1.7E+308 /end CHARACTERISTIC
/begin CHARACTERISTIC speedgoat_test_SN5659__cal_impl.Sendv213_P1 "" VALUE 0x008E0868 Scalar_FLOAT64_IEEE 0 speedgoat_test_SN5659_R2021b_CM_double -1.7E+308 1.7E+308 /end CHARACTERISTIC
/begin CHARACTERISTIC speedgoat_test_SN5659__cal_impl.Sendv213_P2 "" VALUE 0x008E0880 Scalar_FLOAT64_IEEE 0 speedgoat_test_SN5659_R2021b_CM_double -1.7E+308 1.7E+308 /end CHARACTERISTIC
/begin CHARACTERISTIC speedgoat_test_SN5659__cal_impl.Sendv213_P3 "" VALUE 0x008E0898 Scalar_FLOAT64_IEEE 0 speedgoat_test_SN5659_R2021b_CM_double -1.7E+308 1.7E+308 /end CHARACTERISTIC
/begin CHARACTERISTIC speedgoat_test_SN5659__cal_impl.Sendv214_P1 "" VALUE 0x008E0ED8 Scalar_FLOAT64_IEEE 0 speedgoat_test_SN5659_R2021b_CM_double -1.7E+308 1.7E+308 /end CHARACTERISTIC
/begin CHARACTERISTIC speedgoat_test_SN5659__cal_impl.Sendv214_P2 "" VALUE 0x008E0EF0 Scalar_FLOAT64_IEEE 0 speedgoat_test_SN5659_R2021b_CM_double -1.7E+308 1.7E+308 /end CHARACTERISTIC
/begin CHARACTERISTIC speedgoat_test_SN5659__cal_impl.Sendv214_P3 "" VALUE 0x008E0F08 Scalar_FLOAT64_IEEE 0 speedgoat_test_SN5659_R2021b_CM_double -1.7E+308 1.7E+308 /end CHARACTERISTIC
/begin CHARACTERISTIC speedgoat_test_SN5659__cal_impl.Sendv215_P1 "" VALUE 0x008E1548 Scalar_FLOAT64_IEEE 0 speedgoat_test_SN5659_R2021b_CM_double -1.7E+308 1.7E+308 /end CHARACTERISTIC
/begin CHARACTERISTIC speedgoat_test_SN5659__cal_impl.Sendv215_P2 "" VALUE 0x008E1560 Scalar_FLOAT64_IEEE 0 speedgoat_test_SN5659_R2021b_CM_double -1.7E+308 1.7E+308 /end CHARACTERISTIC
/begin CHARACTERISTIC speedgoat_test_SN5659__cal_impl.Sendv215_P3 "" VALUE 0x008E1578 Scalar_FLOAT64_IEEE 0 speedgoat_test_SN5659_R2021b_CM_double -1.7E+308 1.7E+308 /end CHARACTERISTIC
/begin CHARACTERISTIC speedgoat_test_SN5659__cal_impl.Sendv21_P1 "" VALUE 0x008E1BB8 Scalar_FLOAT64_IEEE 0 speedgoat_test_SN5659_R2021b_CM_double -1.7E+308 1.7E+308 /end CHARACTERISTIC
/begin CHARACTERISTIC speedgoat_test_SN5659__cal_impl.Sendv21_P2 "" VALUE 0x008E1BD0 Scalar_FLOAT64_IEEE 0 speedgoat_test_SN5659_R2021b_CM_double -1.7E+308 1.7E+308 /end CHARACTERISTIC
/begin CHARACTERISTIC speedgoat_test_SN5659__cal_impl.Sendv21_P3 "" VALUE 0x008E1BE8 Scalar_FLOAT64_IEEE 0 speedgoat_test_SN5659_R2021b_CM_double -1.7E+308 1.7E+308 /end CHARACTERISTIC
/begin CHARACTERISTIC speedgoat_test_SN5659__cal_impl.Sendv22_P1 "" VALUE 0x008E2228 Scalar_FLOAT64_IEEE 0 speedgoat_test_SN5659_R2021b_CM_double -1.7E+308 1.7E+308 /end CHARACTERISTIC
/begin CHARACTERISTIC speedgoat_test_SN5659__cal_impl.Sendv22_P2 "" VALUE 0x008E2240 Scalar_FLOAT64_IEEE 0 speedgoat_test_SN5659_R2021b_CM_double -1.7E+308 1.7E+308 /end CHARACTERISTIC
/begin CHARACTERISTIC speedgoat_test_SN5659__cal_impl.Sendv22_P3 "" VALUE 0x008E2258 Scalar_FLOAT64_IEEE 0 speedgoat_test_SN5659_R2021b_CM_double -1.7E+308 1.7E+308 /end CHARACTERISTIC
/begin CHARACTERISTIC speedgoat_test_SN5659__cal_impl.Sendv23_P1 "" VALUE 0x008E2898 Scalar_FLOAT64_IEEE 0 speedgoat_test_SN5659_R2021b_CM_double -1.7E+308 1.7E+308 /end CHARACTERISTIC
/begin CHARACTERISTIC speedgoat_test_SN5659__cal_impl.Sendv23_P2 "" VALUE 0x008E28B0 Scalar_FLOAT64_IEEE 0 speedgoat_test_SN5659_R2021b_CM_double -1.7E+308 1.7E+308 /end CHARACTERISTIC
/begin CHARACTERISTIC speedgoat_test_SN5659__cal_impl.Sendv23_P3 "" VALUE 0x008E28C8 Scalar_FLOAT64_IEEE 0 speedgoat_test_SN5659_R2021b_CM_double -1.7E+308 1.7E+308 /end CHARACTERISTIC
/begin CHARACTERISTIC speedgoat_test_SN5659__cal_impl.Sendv24_P1 "" VALUE 0x008E2F08 Scalar_FLOAT64_IEEE 0 speedgoat_test_SN5659_R2021b_CM_double -1.7E+308 1.7E+308 /end CHARACTERISTIC
/begin CHARACTERISTIC speedgoat_test_SN5659__cal_impl.Sendv24_P2 "" VALUE 0x008E2F20 Scalar_FLOAT64_IEEE 0 speedgoat_test_SN5659_R2021b_CM_double -1.7E+308 1.7E+308 /end CHARACTERISTIC
/begin CHARACTERISTIC speedgoat_test_SN5659__cal_impl.Sendv24_P3 "" VALUE 0x008E2F38 Scalar_FLOAT64_IEEE 0 speedgoat_test_SN5659_R2021b_CM_double -1.7E+308 1.7E+308 /end CHARACTERISTIC
/begin CHARACTERISTIC speedgoat_test_SN5659__cal_impl.Sendv25_P1 "" VALUE 0x008E3578 Scalar_FLOAT64_IEEE 0 speedgoat_test_SN5659_R2021b_CM_double -1.7E+308 1.7E+308 /end CHARACTERISTIC
/begin CHARACTERISTIC speedgoat_test_SN5659__cal_impl.Sendv25_P2 "" VALUE 0x008E3590 Scalar_FLOAT64_IEEE 0 speedgoat_test_SN5659_R2021b_CM_double -1.7E+308 1.7E+308 /end CHARACTERISTIC
/begin CHARACTERISTIC speedgoat_test_SN5659__cal_impl.Sendv25_P3 "" VALUE 0x008E35A8 Scalar_FLOAT64_IEEE 0 speedgoat_test_SN5659_R2021b_CM_double -1.7E+308 1.7E+308 /end CHARACTERISTIC
/begin CHARACTERISTIC speedgoat_test_SN5659__cal_impl.Sendv26_P1 "" VALUE 0x008E3BE8 Scalar_FLOAT64_IEEE 0 speedgoat_test_SN5659_R2021b_CM_double -1.7E+308 1.7E+308 /end CHARACTERISTIC
/begin CHARACTERISTIC speedgoat_test_SN5659__cal_impl.Sendv26_P2 "" VALUE 0x008E3C00 Scalar_FLOAT64_IEEE 0 speedgoat_test_SN5659_R2021b_CM_double -1.7E+308 1.7E+308 /end CHARACTERISTIC
/begin CHARACTERISTIC speedgoat_test_SN5659__cal_impl.Sendv26_P3 "" VALUE 0x008E3C18 Scalar_FLOAT64_IEEE 0 speedgoat_test_SN5659_R2021b_CM_double -1.7E+308 1.7E+308 /end CHARACTERISTIC
/begin CHARACTERISTIC speedgoat_test_SN5659__cal_impl.Sendv27_P1 "" VALUE 0x008E4258 Scalar_FLOAT64_IEEE 0 speedgoat_test_SN5659_R2021b_CM_double -1.7E+308 1.7E+308 /end CHARACTERISTIC
/begin CHARACTERISTIC speedgoat_test_SN5659__cal_impl.Sendv27_P2 "" VALUE 0x008E4270 Scalar_FLOAT64_IEEE 0 speedgoat_test_SN5659_R2021b_CM_double -1.7E+308 1.7E+308 /end CHARACTERISTIC
/begin CHARACTERISTIC speedgoat_test_SN5659__cal_impl.Sendv27_P3 "" VALUE 0x008E4288 Scalar_FLOAT64_IEEE 0 speedgoat_test_SN5659_R2021b_CM_double -1.7E+308 1.7E+308 /end CHARACTERISTIC
/begin CHARACTERISTIC speedgoat_test_SN5659__cal_impl.Sendv28_P1 "" VALUE 0x008E48C8 Scalar_FLOAT64_IEEE 0 speedgoat_test_SN5659_R2021b_CM_double -1.7E+308 1.7E+308 /end CHARACTERISTIC
/begin CHARACTERISTIC speedgoat_test_SN5659__cal_impl.Sendv28_P2 "" VALUE 0x008E48E0 Scalar_FLOAT64_IEEE 0 speedgoat_test_SN5659_R2021b_CM_double -1.7E+308 1.7E+308 /end CHARACTERISTIC
/begin CHARACTERISTIC speedgoat_test_SN5659__cal_impl.Sendv28_P3 "" VALUE 0x008E48F8 Scalar_FLOAT64_IEEE 0 speedgoat_test_SN5659_R2021b_CM_double -1.7E+308 1.7E+308 /end CHARACTERISTIC
/begin CHARACTERISTIC speedgoat_test_SN5659__cal_impl.Sendv29_P1 "" VALUE 0x008DEEA8 Scalar_FLOAT64_IEEE 0 speedgoat_test_SN5659_R2021b_CM_double -1.7E+308 1.7E+308 /end CHARACTERISTIC
/begin CHARACTERISTIC speedgoat_test_SN5659__cal_impl.Sendv29_P2 "" VALUE 0x008DEEC0 Scalar_FLOAT64_IEEE 0 speedgoat_test_SN5659_R2021b_CM_double -1.7E+308 1.7E+308 /end CHARACTERISTIC
/begin CHARACTERISTIC speedgoat_test_SN5659__cal_impl.Sendv29_P3 "" VALUE 0x008DEED8 Scalar_FLOAT64_IEEE 0 speedgoat_test_SN5659_R2021b_CM_double -1.7E+308 1.7E+308 /end CHARACTERISTIC
/begin CHARACTERISTIC speedgoat_test_SN5659__cal_impl.Sendv2_P1 "" VALUE 0x008DE838 Scalar_FLOAT64_IEEE 0 speedgoat_test_SN5659_R2021b_CM_double -1.7E+308 1.7E+308 /end CHARACTERISTIC
/begin CHARACTERISTIC speedgoat_test_SN5659__cal_impl.Sendv2_P2 "" VALUE 0x008DE850 Scalar_FLOAT64_IEEE 0 speedgoat_test_SN5659_R2021b_CM_double -1.7E+308 1.7E+308 /end CHARACTERISTIC
/begin CHARACTERISTIC speedgoat_test_SN5659__cal_impl.Sendv2_P3 "" VALUE 0x008DE868 Scalar_FLOAT64_IEEE 0 speedgoat_test_SN5659_R2021b_CM_double -1.7E+308 1.7E+308 /end CHARACTERISTIC
/begin CHARACTERISTIC speedgoat_test_SN5659__cal_impl.Setup1_P1 "" VALUE 0x008D73B0 Scalar_FLOAT64_IEEE 0 speedgoat_test_SN5659_R2021b_CM_double -1.7E+308 1.7E+308 /end CHARACTERISTIC
/begin CHARACTERISTIC speedgoat_test_SN5659__cal_impl.Setup1_P10 "" VAL_BLK 0x008D75F0 Scalar_FLOAT64_IEEE 0 speedgoat_test_SN5659_R2021b_CM_double -1.7E+308 1.7E+308 MATRIX_DIM 16 1 /end CHARACTERISTIC
/begin CHARACTERISTIC speedgoat_test_SN5659__cal_impl.Setup1_P11 "" VALUE 0x008D7680 Scalar_FLOAT64_IEEE 0 speedgoat_test_SN5659_R2021b_CM_double -1.7E+308 1.7E+308 /end CHARACTERISTIC
/begin CHARACTERISTIC speedgoat_test_SN5659__cal_impl.Setup1_P2 "" VALUE 0x008D73C8 Scalar_FLOAT64_IEEE 0 speedgoat_test_SN5659_R2021b_CM_double -1.7E+308 1.7E+308 /end CHARACTERISTIC
/begin CHARACTERISTIC speedgoat_test_SN5659__cal_impl.Setup1_P3 "" VALUE 0x008D73E0 Scalar_FLOAT64_IEEE 0 speedgoat_test_SN5659_R2021b_CM_double -1.7E+308 1.7E+308 /end CHARACTERISTIC
/begin CHARACTERISTIC speedgoat_test_SN5659__cal_impl.Setup1_P4 "" VALUE 0x008D73F8 Scalar_FLOAT64_IEEE 0 speedgoat_test_SN5659_R2021b_CM_double -1.7E+308 1.7E+308 /end CHARACTERISTIC
/begin CHARACTERISTIC speedgoat_test_SN5659__cal_impl.Setup1_P5 "" VALUE 0x008D7410 Scalar_FLOAT64_IEEE 0 speedgoat_test_SN5659_R2021b_CM_double -1.7E+308 1.7E+308 /end CHARACTERISTIC
/begin CHARACTERISTIC speedgoat_test_SN5659__cal_impl.Setup1_P6 "" VALUE 0x008D7428 Scalar_FLOAT64_IEEE 0 speedgoat_test_SN5659_R2021b_CM_double -1.7E+308 1.7E+308 /end CHARACTERISTIC
/begin CHARACTERISTIC speedgoat_test_SN5659__cal_impl.Setup1_P7 "" VAL_BLK 0x008D7440 Scalar_FLOAT64_IEEE 0 speedgoat_test_SN5659_R2021b_CM_double -1.7E+308 1.7E+308 MATRIX_DIM 16 1 /end CHARACTERISTIC
/begin CHARACTERISTIC speedgoat_test_SN5659__cal_impl.Setup1_P8 "" VAL_BLK 0x008D74D0 Scalar_FLOAT64_IEEE 0 speedgoat_test_SN5659_R2021b_CM_double -1.7E+308 1.7E+308 MATRIX_DIM 16 1 /end CHARACTERISTIC
/begin CHARACTERISTIC speedgoat_test_SN5659__cal_impl.Setup1_P9 "" VAL_BLK 0x008D7560 Scalar_FLOAT64_IEEE 0 speedgoat_test_SN5659_R2021b_CM_double -1.7E+308 1.7E+308 MATRIX_DIM 16 1 /end CHARACTERISTIC
/begin CHARACTERISTIC speedgoat_test_SN5659__cal_impl.Setup_P1 "" VALUE 0x008D5AE8 Scalar_FLOAT64_IEEE 0 speedgoat_test_SN5659_R2021b_CM_double -1.7E+308 1.7E+308 /end CHARACTERISTIC
/begin CHARACTERISTIC speedgoat_test_SN5659__cal_impl.Setup_P10 "" VAL_BLK 0x008D7308 Scalar_FLOAT64_IEEE 0 speedgoat_test_SN5659_R2021b_CM_double -1.7E+308 1.7E+308 MATRIX_DIM 16 1 /end CHARACTERISTIC
/begin CHARACTERISTIC speedgoat_test_SN5659__cal_impl.Setup_P11 "" VALUE 0x008D7398 Scalar_FLOAT64_IEEE 0 speedgoat_test_SN5659_R2021b_CM_double -1.7E+308 1.7E+308 /end CHARACTERISTIC
/begin CHARACTERISTIC speedgoat_test_SN5659__cal_impl.Setup_P1_c "" VALUE 0x008D70C8 Scalar_FLOAT64_IEEE 0 speedgoat_test_SN5659_R2021b_CM_double -1.7E+308 1.7E+308 /end CHARACTERISTIC
/begin CHARACTERISTIC speedgoat_test_SN5659__cal_impl.Setup_P2 "" VALUE 0x008D5B00 Scalar_FLOAT64_IEEE 0 speedgoat_test_SN5659_R2021b_CM_double -1.7E+308 1.7E+308 /end CHARACTERISTIC
/begin CHARACTERISTIC speedgoat_test_SN5659__cal_impl.Setup_P2_j "" VALUE 0x008D70E0 Scalar_FLOAT64_IEEE 0 speedgoat_test_SN5659_R2021b_CM_double -1.7E+308 1.7E+308 /end CHARACTERISTIC
/begin CHARACTERISTIC speedgoat_test_SN5659__cal_impl.Setup_P3 "" VALUE 0x008D5B18 Scalar_FLOAT64_IEEE 0 speedgoat_test_SN5659_R2021b_CM_double -1.7E+308 1.7E+308 /end CHARACTERISTIC
/begin CHARACTERISTIC speedgoat_test_SN5659__cal_impl.Setup_P3_p "" VALUE 0x008D70F8 Scalar_FLOAT64_IEEE 0 speedgoat_test_SN5659_R2021b_CM_double -1.7E+308 1.7E+308 /end CHARACTERISTIC
/begin CHARACTERISTIC speedgoat_test_SN5659__cal_impl.Setup_P4 "" VAL_BLK 0x008D5B30 Scalar_FLOAT64_IEEE 0 speedgoat_test_SN5659_R2021b_CM_double -1.7E+308 1.7E+308 MATRIX_DIM 16 1 /end CHARACTERISTIC
/begin CHARACTERISTIC speedgoat_test_SN5659__cal_impl.Setup_P4_h "" VALUE 0x008D7110 Scalar_FLOAT64_IEEE 0 speedgoat_test_SN5659_R2021b_CM_double -1.7E+308 1.7E+308 /end CHARACTERISTIC
/begin CHARACTERISTIC speedgoat_test_SN5659__cal_impl.Setup_P5 "" VAL_BLK 0x008D5BC0 Scalar_FLOAT64_IEEE 0 speedgoat_test_SN5659_R2021b_CM_double -1.7E+308 1.7E+308 MATRIX_DIM 16 1 /end CHARACTERISTIC
/begin CHARACTERISTIC speedgoat_test_SN5659__cal_impl.Setup_P5_k "" VALUE 0x008D7128 Scalar_FLOAT64_IEEE 0 speedgoat_test_SN5659_R2021b_CM_double -1.7E+308 1.7E+308 /end CHARACTERISTIC
/begin CHARACTERISTIC speedgoat_test_SN5659__cal_impl.Setup_P6 "" VALUE 0x008D7140 Scalar_FLOAT64_IEEE 0 speedgoat_test_SN5659_R2021b_CM_double -1.7E+308 1.7E+308 /end CHARACTERISTIC
/begin CHARACTERISTIC speedgoat_test_SN5659__cal_impl.Setup_P7 "" VAL_BLK 0x008D7158 Scalar_FLOAT64_IEEE 0 speedgoat_test_SN5659_R2021b_CM_double -1.7E+308 1.7E+308 MATRIX_DIM 16 1 /end CHARACTERISTIC
/begin CHARACTERISTIC speedgoat_test_SN5659__cal_impl.Setup_P8 "" VAL_BLK 0x008D71E8 Scalar_FLOAT64_IEEE 0 speedgoat_test_SN5659_R2021b_CM_double -1.7E+308 1.7E+308 MATRIX_DIM 16 1 /end CHARACTERISTIC
/begin CHARACTERISTIC speedgoat_test_SN5659__cal_impl.Setup_P9 "" VAL_BLK 0x008D7278 Scalar_FLOAT64_IEEE 0 speedgoat_test_SN5659_R2021b_CM_double -1.7E+308 1.7E+308 MATRIX_DIM 16 1 /end CHARACTERISTIC
/begin CHARACTERISTIC speedgoat_test_SN5659__cal_impl.Setupv2_P1 "" VALUE 0x008D5250 Scalar_FLOAT64_IEEE 0 speedgoat_test_SN5659_R2021b_CM_double -1.7E+308 1.7E+308 /end CHARACTERISTIC
/begin CHARACTERISTIC speedgoat_test_SN5659__cal_impl.Setupv2_P10 "" VALUE 0x008D5350 Scalar_FLOAT64_IEEE 0 speedgoat_test_SN5659_R2021b_CM_double -1.7E+308 1.7E+308 /end CHARACTERISTIC
/begin CHARACTERISTIC speedgoat_test_SN5659__cal_impl.Setupv2_P11 "" VAL_BLK 0x008D5368 Scalar_FLOAT64_IEEE 0 speedgoat_test_SN5659_R2021b_CM_double -1.7E+308 1.7E+308 MATRIX_DIM 2 1 /end CHARACTERISTIC
/begin CHARACTERISTIC speedgoat_test_SN5659__cal_impl.Setupv2_P12 "" VALUE 0x008D5388 Scalar_FLOAT64_IEEE 0 speedgoat_test_SN5659_R2021b_CM_double -1.7E+308 1.7E+308 /end CHARACTERISTIC
/begin CHARACTERISTIC speedgoat_test_SN5659__cal_impl.Setupv2_P13 "" VALUE 0x008D53A0 Scalar_FLOAT64_IEEE 0 speedgoat_test_SN5659_R2021b_CM_double -1.7E+308 1.7E+308 /end CHARACTERISTIC
/begin CHARACTERISTIC speedgoat_test_SN5659__cal_impl.Setupv2_P14 "" VALUE 0x008D53B8 Scalar_FLOAT64_IEEE 0 speedgoat_test_SN5659_R2021b_CM_double -1.7E+308 1.7E+308 /end CHARACTERISTIC
/begin CHARACTERISTIC speedgoat_test_SN5659__cal_impl.Setupv2_P15 "" VAL_BLK 0x008D53D0 Scalar_FLOAT64_IEEE 0 speedgoat_test_SN5659_R2021b_CM_double -1.7E+308 1.7E+308 MATRIX_DIM 4 1 /end CHARACTERISTIC
/begin CHARACTERISTIC speedgoat_test_SN5659__cal_impl.Setupv2_P16 "" VAL_BLK 0x008D5400 Scalar_FLOAT64_IEEE 0 speedgoat_test_SN5659_R2021b_CM_double -1.7E+308 1.7E+308 MATRIX_DIM 8 1 /end CHARACTERISTIC
/begin CHARACTERISTIC speedgoat_test_SN5659__cal_impl.Setupv2_P17 "" VALUE 0x008D5450 Scalar_FLOAT64_IEEE 0 speedgoat_test_SN5659_R2021b_CM_double -1.7E+308 1.7E+308 /end CHARACTERISTIC
/begin CHARACTERISTIC speedgoat_test_SN5659__cal_impl.Setupv2_P18 "" VALUE 0x008D5468 Scalar_FLOAT64_IEEE 0 speedgoat_test_SN5659_R2021b_CM_double -1.7E+308 1.7E+308 /end CHARACTERISTIC
/begin CHARACTERISTIC speedgoat_test_SN5659__cal_impl.Setupv2_P19 "" VALUE 0x008D5480 Scalar_FLOAT64_IEEE 0 speedgoat_test_SN5659_R2021b_CM_double -1.7E+308 1.7E+308 /end CHARACTERISTIC
/begin CHARACTERISTIC speedgoat_test_SN5659__cal_impl.Setupv2_P1_p "" VALUE 0x008D67F8 Scalar_FLOAT64_IEEE 0 speedgoat_test_SN5659_R2021b_CM_double -1.7E+308 1.7E+308 /end CHARACTERISTIC
/begin CHARACTERISTIC speedgoat_test_SN5659__cal_impl.Setupv2_P2 "" VALUE 0x008D5268 Scalar_FLOAT64_IEEE 0 speedgoat_test_SN5659_R2021b_CM_double -1.7E+308 1.7E+308 /end CHARACTERISTIC
/begin CHARACTERISTIC speedgoat_test_SN5659__cal_impl.Setupv2_P20 "" VAL_BLK 0x008D5498 Scalar_FLOAT64_IEEE 0 speedgoat_test_SN5659_R2021b_CM_double -1.7E+308 1.7E+308 MATRIX_DIM 2 1 /end CHARACTERISTIC
/begin CHARACTERISTIC speedgoat_test_SN5659__cal_impl.Setupv2_P21 "" VALUE 0x008D54B8 Scalar_FLOAT64_IEEE 0 speedgoat_test_SN5659_R2021b_CM_double -1.7E+308 1.7E+308 /end CHARACTERISTIC
/begin CHARACTERISTIC speedgoat_test_SN5659__cal_impl.Setupv2_P22 "" VALUE 0x008D54D0 Scalar_FLOAT64_IEEE 0 speedgoat_test_SN5659_R2021b_CM_double -1.7E+308 1.7E+308 /end CHARACTERISTIC
/begin CHARACTERISTIC speedgoat_test_SN5659__cal_impl.Setupv2_P23 "" VALUE 0x008D54E8 Scalar_FLOAT64_IEEE 0 speedgoat_test_SN5659_R2021b_CM_double -1.7E+308 1.7E+308 /end CHARACTERISTIC
/begin CHARACTERISTIC speedgoat_test_SN5659__cal_impl.Setupv2_P24 "" VALUE 0x008D5500 Scalar_FLOAT64_IEEE 0 speedgoat_test_SN5659_R2021b_CM_double -1.7E+308 1.7E+308 /end CHARACTERISTIC
/begin CHARACTERISTIC speedgoat_test_SN5659__cal_impl.Setupv2_P25 "" VALUE 0x008D5518 Scalar_FLOAT64_IEEE 0 speedgoat_test_SN5659_R2021b_CM_double -1.7E+308 1.7E+308 /end CHARACTERISTIC
/begin CHARACTERISTIC speedgoat_test_SN5659__cal_impl.Setupv2_P26 "" VALUE 0x008D5530 Scalar_FLOAT64_IEEE 0 speedgoat_test_SN5659_R2021b_CM_double -1.7E+308 1.7E+308 /end CHARACTERISTIC
/begin CHARACTERISTIC speedgoat_test_SN5659__cal_impl.Setupv2_P27 "" VALUE 0x008D5548 Scalar_FLOAT64_IEEE 0 speedgoat_test_SN5659_R2021b_CM_double -1.7E+308 1.7E+308 /end CHARACTERISTIC
/begin CHARACTERISTIC speedgoat_test_SN5659__cal_impl.Setupv2_P28 "" VALUE 0x008D5560 Scalar_FLOAT64_IEEE 0 speedgoat_test_SN5659_R2021b_CM_double -1.7E+308 1.7E+308 /end CHARACTERISTIC
/begin CHARACTERISTIC speedgoat_test_SN5659__cal_impl.Setupv2_P29 "" VALUE 0x008D5578 Scalar_FLOAT64_IEEE 0 speedgoat_test_SN5659_R2021b_CM_double -1.7E+308 1.7E+308 /end CHARACTERISTIC
/begin CHARACTERISTIC speedgoat_test_SN5659__cal_impl.Setupv2_P2_h "" VALUE 0x008D6810 Scalar_FLOAT64_IEEE 0 speedgoat_test_SN5659_R2021b_CM_double -1.7E+308 1.7E+308 /end CHARACTERISTIC
/begin CHARACTERISTIC speedgoat_test_SN5659__cal_impl.Setupv2_P3 "" VALUE 0x008D5280 Scalar_FLOAT64_IEEE 0 speedgoat_test_SN5659_R2021b_CM_double -1.7E+308 1.7E+308 /end CHARACTERISTIC
/begin CHARACTERISTIC speedgoat_test_SN5659__cal_impl.Setupv2_P30 "" VALUE 0x008D5590 Scalar_FLOAT64_IEEE 0 speedgoat_test_SN5659_R2021b_CM_double -1.7E+308 1.7E+308 /end CHARACTERISTIC
/begin CHARACTERISTIC speedgoat_test_SN5659__cal_impl.Setupv2_P31 "" VAL_BLK 0x008D55A8 Scalar_FLOAT64_IEEE 0 speedgoat_test_SN5659_R2021b_CM_double -1.7E+308 1.7E+308 MATRIX_DIM 2 1 /end CHARACTERISTIC
/begin CHARACTERISTIC speedgoat_test_SN5659__cal_impl.Setupv2_P32 "" VAL_BLK 0x008D55C8 Scalar_FLOAT64_IEEE 0 speedgoat_test_SN5659_R2021b_CM_double -1.7E+308 1.7E+308 MATRIX_DIM 2 1 /end CHARACTERISTIC
/begin CHARACTERISTIC speedgoat_test_SN5659__cal_impl.Setupv2_P33 "" VALUE 0x008D55E8 Scalar_FLOAT64_IEEE 0 speedgoat_test_SN5659_R2021b_CM_double -1.7E+308 1.7E+308 /end CHARACTERISTIC
/begin CHARACTERISTIC speedgoat_test_SN5659__cal_impl.Setupv2_P34 "" VALUE 0x008D5600 Scalar_FLOAT64_IEEE 0 speedgoat_test_SN5659_R2021b_CM_double -1.7E+308 1.7E+308 /end CHARACTERISTIC
/begin CHARACTERISTIC speedgoat_test_SN5659__cal_impl.Setupv2_P35 "" VALUE 0x008D5618 Scalar_FLOAT64_IEEE 0 speedgoat_test_SN5659_R2021b_CM_double -1.7E+308 1.7E+308 /end CHARACTERISTIC
/begin CHARACTERISTIC speedgoat_test_SN5659__cal_impl.Setupv2_P3_o "" VALUE 0x008D6828 Scalar_FLOAT64_IEEE 0 speedgoat_test_SN5659_R2021b_CM_double -1.7E+308 1.7E+308 /end CHARACTERISTIC
/begin CHARACTERISTIC speedgoat_test_SN5659__cal_impl.Setupv2_P4 "" VALUE 0x008D5298 Scalar_FLOAT64_IEEE 0 speedgoat_test_SN5659_R2021b_CM_double -1.7E+308 1.7E+308 /end CHARACTERISTIC
/begin CHARACTERISTIC speedgoat_test_SN5659__cal_impl.Setupv2_P4_p "" VALUE 0x008D6840 Scalar_FLOAT64_IEEE 0 speedgoat_test_SN5659_R2021b_CM_double -1.7E+308 1.7E+308 /end CHARACTERISTIC
/begin CHARACTERISTIC speedgoat_test_SN5659__cal_impl.Setupv2_P5 "" VAL_BLK 0x008D52B0 Scalar_FLOAT64_IEEE 0 speedgoat_test_SN5659_R2021b_CM_double -1.7E+308 1.7E+308 MATRIX_DIM 4 1 /end CHARACTERISTIC
/begin CHARACTERISTIC speedgoat_test_SN5659__cal_impl.Setupv2_P5_p "" VALUE 0x008D6858 Scalar_FLOAT64_IEEE 0 speedgoat_test_SN5659_R2021b_CM_double -1.7E+308 1.7E+308 /end CHARACTERISTIC
/begin CHARACTERISTIC speedgoat_test_SN5659__cal_impl.Setupv2_P6 "" VAL_BLK 0x008D52E0 Scalar_FLOAT64_IEEE 0 speedgoat_test_SN5659_R2021b_CM_double -1.7E+308 1.7E+308 MATRIX_DIM 2 1 /end CHARACTERISTIC
/begin CHARACTERISTIC speedgoat_test_SN5659__cal_impl.Setupv2_P6_a "" VALUE 0x008D6870 Scalar_FLOAT64_IEEE 0 speedgoat_test_SN5659_R2021b_CM_double -1.7E+308 1.7E+308 /end CHARACTERISTIC
/begin CHARACTERISTIC speedgoat_test_SN5659__cal_impl.Setupv2_P7 "" VAL_BLK 0x008D5300 Scalar_FLOAT64_IEEE 0 speedgoat_test_SN5659_R2021b_CM_double -1.7E+308 1.7E+308 MATRIX_DIM 2 1 /end CHARACTERISTIC
/begin CHARACTERISTIC speedgoat_test_SN5659__cal_impl.Setupv2_P7_c "" VAL_BLK 0x008D6888 Scalar_FLOAT64_IEEE 0 speedgoat_test_SN5659_R2021b_CM_double -1.7E+308 1.7E+308 MATRIX_DIM 5 16 /end CHARACTERISTIC
/begin CHARACTERISTIC speedgoat_test_SN5659__cal_impl.Setupv2_P8 "" VALUE 0x008D5320 Scalar_FLOAT64_IEEE 0 speedgoat_test_SN5659_R2021b_CM_double -1.7E+308 1.7E+308 /end CHARACTERISTIC
/begin CHARACTERISTIC speedgoat_test_SN5659__cal_impl.Setupv2_P8_o "" VAL_BLK 0x008D6B18 Scalar_FLOAT64_IEEE 0 speedgoat_test_SN5659_R2021b_CM_double -1.7E+308 1.7E+308 MATRIX_DIM 4 16 /end CHARACTERISTIC
/begin CHARACTERISTIC speedgoat_test_SN5659__cal_impl.Setupv2_P9 "" VALUE 0x008D5338 Scalar_FLOAT64_IEEE 0 speedgoat_test_SN5659_R2021b_CM_double -1.7E+308 1.7E+308 /end CHARACTERISTIC
/begin CHARACTERISTIC speedgoat_test_SN5659__cal_impl.SineWave1_Amp "" VALUE 0x008D6260 Scalar_FLOAT64_IEEE 0 speedgoat_test_SN5659_R2021b_CM_double -1.7E+308 1.7E+308 /end CHARACTERISTIC
/begin CHARACTERISTIC speedgoat_test_SN5659__cal_impl.SineWave1_Amp_d "" VALUE 0x008D6EE8 Scalar_FLOAT64_IEEE 0 speedgoat_test_SN5659_R2021b_CM_double -1.7E+308 1.7E+308 /end CHARACTERISTIC
/begin CHARACTERISTIC speedgoat_test_SN5659__cal_impl.SineWave1_Bias "" VALUE 0x008D6268 Scalar_FLOAT64_IEEE 0 speedgoat_test_SN5659_R2021b_CM_double -1.7E+308 1.7E+308 /end CHARACTERISTIC
/begin CHARACTERISTIC speedgoat_test_SN5659__cal_impl.SineWave1_Bias_d "" VALUE 0x008D6EF0 Scalar_FLOAT64_IEEE 0 speedgoat_test_SN5659_R2021b_CM_double -1.7E+308 1.7E+308 /end CHARACTERISTIC
/begin CHARACTERISTIC speedgoat_test_SN5659__cal_impl.SineWave1_Freq "" VALUE 0x008D6270 Scalar_FLOAT64_IEEE 0 speedgoat_test_SN5659_R2021b_CM_double -1.7E+308 1.7E+308 /end CHARACTERISTIC
/begin CHARACTERISTIC speedgoat_test_SN5659__cal_impl.SineWave1_Freq_c "" VALUE 0x008D6EF8 Scalar_FLOAT64_IEEE 0 speedgoat_test_SN5659_R2021b_CM_double -1.7E+308 1.7E+308 /end CHARACTERISTIC
/begin CHARACTERISTIC speedgoat_test_SN5659__cal_impl.SineWave1_HCos "" VALUE 0x008D6280 Scalar_FLOAT64_IEEE 0 speedgoat_test_SN5659_R2021b_CM_double -1.7E+308 1.7E+308 /end CHARACTERISTIC
/begin CHARACTERISTIC speedgoat_test_SN5659__cal_impl.SineWave1_HCos_j "" VALUE 0x008D6F08 Scalar_FLOAT64_IEEE 0 speedgoat_test_SN5659_R2021b_CM_double -1.7E+308 1.7E+308 /end CHARACTERISTIC
/begin CHARACTERISTIC speedgoat_test_SN5659__cal_impl.SineWave1_Hsin "" VALUE 0x008D6278 Scalar_FLOAT64_IEEE 0 speedgoat_test_SN5659_R2021b_CM_double -1.7E+308 1.7E+308 /end CHARACTERISTIC
/begin CHARACTERISTIC speedgoat_test_SN5659__cal_impl.SineWave1_Hsin_m "" VALUE 0x008D6F00 Scalar_FLOAT64_IEEE 0 speedgoat_test_SN5659_R2021b_CM_double -1.7E+308 1.7E+308 /end CHARACTERISTIC
/begin CHARACTERISTIC speedgoat_test_SN5659__cal_impl.SineWave1_PCos "" VALUE 0x008D6290 Scalar_FLOAT64_IEEE 0 speedgoat_test_SN5659_R2021b_CM_double -1.7E+308 1.7E+308 /end CHARACTERISTIC
/begin CHARACTERISTIC speedgoat_test_SN5659__cal_impl.SineWave1_PCos_o "" VALUE 0x008D6F18 Scalar_FLOAT64_IEEE 0 speedgoat_test_SN5659_R2021b_CM_double -1.7E+308 1.7E+308 /end CHARACTERISTIC
/begin CHARACTERISTIC speedgoat_test_SN5659__cal_impl.SineWave1_PSin "" VALUE 0x008D6288 Scalar_FLOAT64_IEEE 0 speedgoat_test_SN5659_R2021b_CM_double -1.7E+308 1.7E+308 /end CHARACTERISTIC
/begin CHARACTERISTIC speedgoat_test_SN5659__cal_impl.SineWave1_PSin_n "" VALUE 0x008D6F10 Scalar_FLOAT64_IEEE 0 speedgoat_test_SN5659_R2021b_CM_double -1.7E+308 1.7E+308 /end CHARACTERISTIC
/begin CHARACTERISTIC speedgoat_test_SN5659__cal_impl.SineWave2_Amp "" VALUE 0x008D6378 Scalar_FLOAT64_IEEE 0 speedgoat_test_SN5659_R2021b_CM_double -1.7E+308 1.7E+308 /end CHARACTERISTIC
/begin CHARACTERISTIC speedgoat_test_SN5659__cal_impl.SineWave2_Bias "" VALUE 0x008D6380 Scalar_FLOAT64_IEEE 0 speedgoat_test_SN5659_R2021b_CM_double -1.7E+308 1.7E+308 /end CHARACTERISTIC
/begin CHARACTERISTIC speedgoat_test_SN5659__cal_impl.SineWave2_Freq "" VALUE 0x008D6388 Scalar_FLOAT64_IEEE 0 speedgoat_test_SN5659_R2021b_CM_double -1.7E+308 1.7E+308 /end CHARACTERISTIC
/begin CHARACTERISTIC speedgoat_test_SN5659__cal_impl.SineWave2_HCos "" VALUE 0x008D6398 Scalar_FLOAT64_IEEE 0 speedgoat_test_SN5659_R2021b_CM_double -1.7E+308 1.7E+308 /end CHARACTERISTIC
/begin CHARACTERISTIC speedgoat_test_SN5659__cal_impl.SineWave2_Hsin "" VALUE 0x008D6390 Scalar_FLOAT64_IEEE 0 speedgoat_test_SN5659_R2021b_CM_double -1.7E+308 1.7E+308 /end CHARACTERISTIC
/begin CHARACTERISTIC speedgoat_test_SN5659__cal_impl.SineWave2_PCos "" VALUE 0x008D63A8 Scalar_FLOAT64_IEEE 0 speedgoat_test_SN5659_R2021b_CM_double -1.7E+308 1.7E+308 /end CHARACTERISTIC
/begin CHARACTERISTIC speedgoat_test_SN5659__cal_impl.SineWave2_PSin "" VALUE 0x008D63A0 Scalar_FLOAT64_IEEE 0 speedgoat_test_SN5659_R2021b_CM_double -1.7E+308 1.7E+308 /end CHARACTERISTIC
/begin CHARACTERISTIC speedgoat_test_SN5659__cal_impl.SineWave3_Amp "" VALUE 0x008D6490 Scalar_FLOAT64_IEEE 0 speedgoat_test_SN5659_R2021b_CM_double -1.7E+308 1.7E+308 /end CHARACTERISTIC
/begin CHARACTERISTIC speedgoat_test_SN5659__cal_impl.SineWave3_Bias "" VALUE 0x008D6498 Scalar_FLOAT64_IEEE 0 speedgoat_test_SN5659_R2021b_CM_double -1.7E+308 1.7E+308 /end CHARACTERISTIC
/begin CHARACTERISTIC speedgoat_test_SN5659__cal_impl.SineWave3_Freq "" VALUE 0x008D64A0 Scalar_FLOAT64_IEEE 0 speedgoat_test_SN5659_R2021b_CM_double -1.7E+308 1.7E+308 /end CHARACTERISTIC
/begin CHARACTERISTIC speedgoat_test_SN5659__cal_impl.SineWave3_HCos "" VALUE 0x008D64B0 Scalar_FLOAT64_IEEE 0 speedgoat_test_SN5659_R2021b_CM_double -1.7E+308 1.7E+308 /end CHARACTERISTIC
/begin CHARACTERISTIC speedgoat_test_SN5659__cal_impl.SineWave3_Hsin "" VALUE 0x008D64A8 Scalar_FLOAT64_IEEE 0 speedgoat_test_SN5659_R2021b_CM_double -1.7E+308 1.7E+308 /end CHARACTERISTIC
/begin CHARACTERISTIC speedgoat_test_SN5659__cal_impl.SineWave3_PCos "" VALUE 0x008D64C0 Scalar_FLOAT64_IEEE 0 speedgoat_test_SN5659_R2021b_CM_double -1.7E+308 1.7E+308 /end CHARACTERISTIC
/begin CHARACTERISTIC speedgoat_test_SN5659__cal_impl.SineWave3_PSin "" VALUE 0x008D64B8 Scalar_FLOAT64_IEEE 0 speedgoat_test_SN5659_R2021b_CM_double -1.7E+308 1.7E+308 /end CHARACTERISTIC
/begin CHARACTERISTIC speedgoat_test_SN5659__cal_impl.SineWave4_Amp "" VALUE 0x008D65A8 Scalar_FLOAT64_IEEE 0 speedgoat_test_SN5659_R2021b_CM_double -1.7E+308 1.7E+308 /end CHARACTERISTIC
/begin CHARACTERISTIC speedgoat_test_SN5659__cal_impl.SineWave4_Bias "" VALUE 0x008D65B0 Scalar_FLOAT64_IEEE 0 speedgoat_test_SN5659_R2021b_CM_double -1.7E+308 1.7E+308 /end CHARACTERISTIC
/begin CHARACTERISTIC speedgoat_test_SN5659__cal_impl.SineWave4_Freq "" VALUE 0x008D65B8 Scalar_FLOAT64_IEEE 0 speedgoat_test_SN5659_R2021b_CM_double -1.7E+308 1.7E+308 /end CHARACTERISTIC
/begin CHARACTERISTIC speedgoat_test_SN5659__cal_impl.SineWave4_HCos "" VALUE 0x008D65C8 Scalar_FLOAT64_IEEE 0 speedgoat_test_SN5659_R2021b_CM_double -1.7E+308 1.7E+308 /end CHARACTERISTIC
/begin CHARACTERISTIC speedgoat_test_SN5659__cal_impl.SineWave4_Hsin "" VALUE 0x008D65C0 Scalar_FLOAT64_IEEE 0 speedgoat_test_SN5659_R2021b_CM_double -1.7E+308 1.7E+308 /end CHARACTERISTIC
/begin CHARACTERISTIC speedgoat_test_SN5659__cal_impl.SineWave4_PCos "" VALUE 0x008D65D8 Scalar_FLOAT64_IEEE 0 speedgoat_test_SN5659_R2021b_CM_double -1.7E+308 1.7E+308 /end CHARACTERISTIC
/begin CHARACTERISTIC speedgoat_test_SN5659__cal_impl.SineWave4_PSin "" VALUE 0x008D65D0 Scalar_FLOAT64_IEEE 0 speedgoat_test_SN5659_R2021b_CM_double -1.7E+308 1.7E+308 /end CHARACTERISTIC
/begin CHARACTERISTIC speedgoat_test_SN5659__cal_impl.SineWave5_Amp "" VALUE 0x008D66C0 Scalar_FLOAT64_IEEE 0 speedgoat_test_SN5659_R2021b_CM_double -1.7E+308 1.7E+308 /end CHARACTERISTIC
/begin CHARACTERISTIC speedgoat_test_SN5659__cal_impl.SineWave5_Bias "" VALUE 0x008D66C8 Scalar_FLOAT64_IEEE 0 speedgoat_test_SN5659_R2021b_CM_double -1.7E+308 1.7E+308 /end CHARACTERISTIC
/begin CHARACTERISTIC speedgoat_test_SN5659__cal_impl.SineWave5_Freq "" VALUE 0x008D66D0 Scalar_FLOAT64_IEEE 0 speedgoat_test_SN5659_R2021b_CM_double -1.7E+308 1.7E+308 /end CHARACTERISTIC
/begin CHARACTERISTIC speedgoat_test_SN5659__cal_impl.SineWave5_HCos "" VALUE 0x008D66E0 Scalar_FLOAT64_IEEE 0 speedgoat_test_SN5659_R2021b_CM_double -1.7E+308 1.7E+308 /end CHARACTERISTIC
/begin CHARACTERISTIC speedgoat_test_SN5659__cal_impl.SineWave5_Hsin "" VALUE 0x008D66D8 Scalar_FLOAT64_IEEE 0 speedgoat_test_SN5659_R2021b_CM_double -1.7E+308 1.7E+308 /end CHARACTERISTIC
/begin CHARACTERISTIC speedgoat_test_SN5659__cal_impl.SineWave5_PCos "" VALUE 0x008D66F0 Scalar_FLOAT64_IEEE 0 speedgoat_test_SN5659_R2021b_CM_double -1.7E+308 1.7E+308 /end CHARACTERISTIC
/begin CHARACTERISTIC speedgoat_test_SN5659__cal_impl.SineWave5_PSin "" VALUE 0x008D66E8 Scalar_FLOAT64_IEEE 0 speedgoat_test_SN5659_R2021b_CM_double -1.7E+308 1.7E+308 /end CHARACTERISTIC
/begin CHARACTERISTIC speedgoat_test_SN5659__cal_impl.SineWave_Amp "" VALUE 0x008D5758 Scalar_FLOAT64_IEEE 0 speedgoat_test_SN5659_R2021b_CM_double -1.7E+308 1.7E+308 /end CHARACTERISTIC
/begin CHARACTERISTIC speedgoat_test_SN5659__cal_impl.SineWave_Amp_i "" VALUE 0x008D6148 Scalar_FLOAT64_IEEE 0 speedgoat_test_SN5659_R2021b_CM_double -1.7E+308 1.7E+308 /end CHARACTERISTIC
/begin CHARACTERISTIC speedgoat_test_SN5659__cal_impl.SineWave_Amp_l "" VALUE 0x008D6D18 Scalar_FLOAT64_IEEE 0 speedgoat_test_SN5659_R2021b_CM_double -1.7E+308 1.7E+308 /end CHARACTERISTIC
/begin CHARACTERISTIC speedgoat_test_SN5659__cal_impl.SineWave_Bias "" VALUE 0x008D5760 Scalar_FLOAT64_IEEE 0 speedgoat_test_SN5659_R2021b_CM_double -1.7E+308 1.7E+308 /end CHARACTERISTIC
/begin CHARACTERISTIC speedgoat_test_SN5659__cal_impl.SineWave_Bias_d "" VALUE 0x008D6D20 Scalar_FLOAT64_IEEE 0 speedgoat_test_SN5659_R2021b_CM_double -1.7E+308 1.7E+308 /end CHARACTERISTIC
/begin CHARACTERISTIC speedgoat_test_SN5659__cal_impl.SineWave_Bias_e "" VALUE 0x008D6150 Scalar_FLOAT64_IEEE 0 speedgoat_test_SN5659_R2021b_CM_double -1.7E+308 1.7E+308 /end CHARACTERISTIC
/begin CHARACTERISTIC speedgoat_test_SN5659__cal_impl.SineWave_Freq "" VALUE 0x008D5768 Scalar_FLOAT64_IEEE 0 speedgoat_test_SN5659_R2021b_CM_double -1.7E+308 1.7E+308 /end CHARACTERISTIC
/begin CHARACTERISTIC speedgoat_test_SN5659__cal_impl.SineWave_Freq_f "" VALUE 0x008D6D28 Scalar_FLOAT64_IEEE 0 speedgoat_test_SN5659_R2021b_CM_double -1.7E+308 1.7E+308 /end CHARACTERISTIC
/begin CHARACTERISTIC speedgoat_test_SN5659__cal_impl.SineWave_Freq_k "" VALUE 0x008D6158 Scalar_FLOAT64_IEEE 0 speedgoat_test_SN5659_R2021b_CM_double -1.7E+308 1.7E+308 /end CHARACTERISTIC
/begin CHARACTERISTIC speedgoat_test_SN5659__cal_impl.SineWave_HCos "" VALUE 0x008D6168 Scalar_FLOAT64_IEEE 0 speedgoat_test_SN5659_R2021b_CM_double -1.7E+308 1.7E+308 /end CHARACTERISTIC
/begin CHARACTERISTIC speedgoat_test_SN5659__cal_impl.SineWave_HCos_b "" VALUE 0x008D6D38 Scalar_FLOAT64_IEEE 0 speedgoat_test_SN5659_R2021b_CM_double -1.7E+308 1.7E+308 /end CHARACTERISTIC
/begin CHARACTERISTIC speedgoat_test_SN5659__cal_impl.SineWave_Hsin "" VALUE 0x008D6160 Scalar_FLOAT64_IEEE 0 speedgoat_test_SN5659_R2021b_CM_double -1.7E+308 1.7E+308 /end CHARACTERISTIC
/begin CHARACTERISTIC speedgoat_test_SN5659__cal_impl.SineWave_Hsin_c "" VALUE 0x008D6D30 Scalar_FLOAT64_IEEE 0 speedgoat_test_SN5659_R2021b_CM_double -1.7E+308 1.7E+308 /end CHARACTERISTIC
/begin CHARACTERISTIC speedgoat_test_SN5659__cal_impl.SineWave_PCos "" VALUE 0x008D6178 Scalar_FLOAT64_IEEE 0 speedgoat_test_SN5659_R2021b_CM_double -1.7E+308 1.7E+308 /end CHARACTERISTIC
/begin CHARACTERISTIC speedgoat_test_SN5659__cal_impl.SineWave_PCos_l "" VALUE 0x008D6D48 Scalar_FLOAT64_IEEE 0 speedgoat_test_SN5659_R2021b_CM_double -1.7E+308 1.7E+308 /end CHARACTERISTIC
/begin CHARACTERISTIC speedgoat_test_SN5659__cal_impl.SineWave_PSin "" VALUE 0x008D6170 Scalar_FLOAT64_IEEE 0 speedgoat_test_SN5659_R2021b_CM_double -1.7E+308 1.7E+308 /end CHARACTERISTIC
/begin CHARACTERISTIC speedgoat_test_SN5659__cal_impl.SineWave_PSin_o "" VALUE 0x008D6D40 Scalar_FLOAT64_IEEE 0 speedgoat_test_SN5659_R2021b_CM_double -1.7E+308 1.7E+308 /end CHARACTERISTIC
/begin CHARACTERISTIC speedgoat_test_SN5659__cal_impl.SineWave_Phase "" VALUE 0x008D5770 Scalar_FLOAT64_IEEE 0 speedgoat_test_SN5659_R2021b_CM_double -1.7E+308 1.7E+308 /end CHARACTERISTIC
/begin CHARACTERISTIC speedgoat_test_SN5659__cal_impl.Write_P1 "" VALUE 0x008D5CE0 Scalar_FLOAT64_IEEE 0 speedgoat_test_SN5659_R2021b_CM_double -1.7E+308 1.7E+308 /end CHARACTERISTIC
/begin CHARACTERISTIC speedgoat_test_SN5659__cal_impl.Write_P2 "" VALUE 0x008D5CF8 Scalar_FLOAT64_IEEE 0 speedgoat_test_SN5659_R2021b_CM_double -1.7E+308 1.7E+308 /end CHARACTERISTIC
/begin CHARACTERISTIC speedgoat_test_SN5659__cal_impl.Write_P3 "" VALUE 0x008D5D10 Scalar_FLOAT64_IEEE 0 speedgoat_test_SN5659_R2021b_CM_double -1.7E+308 1.7E+308 /end CHARACTERISTIC
/begin CHARACTERISTIC speedgoat_test_SN5659__cal_impl.Write_P4 "" VALUE 0x008D5D28 Scalar_FLOAT64_IEEE 0 speedgoat_test_SN5659_R2021b_CM_double -1.7E+308 1.7E+308 /end CHARACTERISTIC
/begin MEASUREMENT speedgoat_test_SN5659_R2021b_B.CANRead1_o1 "" UBYTE speedgoat_test_SN5659_R2021b_CM_logical 0 0 0 1 ECU_ADDRESS 0x00948423 /end MEASUREMENT
/begin MEASUREMENT speedgoat_test_SN5659_R2021b_B.CANRead_o1 "" UBYTE speedgoat_test_SN5659_R2021b_CM_logical 0 0 0 1 ECU_ADDRESS 0x00948424 /end MEASUREMENT
/begin MEASUREMENT speedgoat_test_SN5659_R2021b_B.CANUnpack "" FLOAT64_IEEE speedgoat_test_SN5659_R2021b_CM_double 0 0 -1.7E+308 1.7E+308 ECU_ADDRESS 0x00948250 /end MEASUREMENT
/begin MEASUREMENT speedgoat_test_SN5659_R2021b_B.CANUnpack1 "" FLOAT64_IEEE speedgoat_test_SN5659_R2021b_CM_double 0 0 -1.7E+308 1.7E+308 ECU_ADDRESS 0x00948258 /end MEASUREMENT
/begin MEASUREMENT speedgoat_test_SN5659_R2021b_B.CANUnpack1_o "" FLOAT64_IEEE speedgoat_test_SN5659_R2021b_CM_double 0 0 -1.7E+308 1.7E+308 ECU_ADDRESS 0x00948270 /end MEASUREMENT
/begin MEASUREMENT speedgoat_test_SN5659_R2021b_B.CANUnpack2 "" FLOAT64_IEEE speedgoat_test_SN5659_R2021b_CM_double 0 0 -1.7E+308 1.7E+308 ECU_ADDRESS 0x00948260 /end MEASUREMENT
/begin MEASUREMENT speedgoat_test_SN5659_R2021b_B.CANUnpack2_j "" FLOAT64_IEEE speedgoat_test_SN5659_R2021b_CM_double 0 0 -1.7E+308 1.7E+308 ECU_ADDRESS 0x00948278 /end MEASUREMENT
/begin MEASUREMENT speedgoat_test_SN5659_R2021b_B.CANUnpack_c "" FLOAT64_IEEE speedgoat_test_SN5659_R2021b_CM_double 0 0 -1.7E+308 1.7E+308 ECU_ADDRESS 0x00948268 /end MEASUREMENT
/begin MEASUREMENT speedgoat_test_SN5659_R2021b_B.Decode1 "" FLOAT64_IEEE speedgoat_test_SN5659_R2021b_CM_double 0 0 -1.7E+308 1.7E+308 ECU_ADDRESS 0x00946160 /end MEASUREMENT
/begin MEASUREMENT speedgoat_test_SN5659_R2021b_B.Decode3 "" FLOAT64_IEEE speedgoat_test_SN5659_R2021b_CM_double 0 0 -1.7E+308 1.7E+308 ECU_ADDRESS 0x00946170 /end MEASUREMENT
/begin MEASUREMENT speedgoat_test_SN5659_R2021b_B.Decode4 "" FLOAT64_IEEE speedgoat_test_SN5659_R2021b_CM_double 0 0 -1.7E+308 1.7E+308 ECU_ADDRESS 0x00946178 /end MEASUREMENT
/begin MEASUREMENT speedgoat_test_SN5659_R2021b_B.Decode5 "" FLOAT64_IEEE speedgoat_test_SN5659_R2021b_CM_double 0 0 -1.7E+308 1.7E+308 ECU_ADDRESS 0x00946168 /end MEASUREMENT
/begin MEASUREMENT speedgoat_test_SN5659_R2021b_B.Gain "" FLOAT64_IEEE speedgoat_test_SN5659_R2021b_CM_double 0 0 -1.7E+308 1.7E+308 ECU_ADDRESS 0x00945E88 /end MEASUREMENT
/begin MEASUREMENT speedgoat_test_SN5659_R2021b_B.Gain1 "" FLOAT64_IEEE speedgoat_test_SN5659_R2021b_CM_double 0 0 -1.7E+308 1.7E+308 ECU_ADDRESS 0x00945E90 /end MEASUREMENT
/begin MEASUREMENT speedgoat_test_SN5659_R2021b_B.Gain2 "" FLOAT64_IEEE speedgoat_test_SN5659_R2021b_CM_double 0 0 -1.7E+308 1.7E+308 ECU_ADDRESS 0x00945E98 /end MEASUREMENT
/begin MEASUREMENT speedgoat_test_SN5659_R2021b_B.Gain3 "" FLOAT64_IEEE speedgoat_test_SN5659_R2021b_CM_double 0 0 -1.7E+308 1.7E+308 ECU_ADDRESS 0x00945EA0 /end MEASUREMENT
/begin MEASUREMENT speedgoat_test_SN5659_R2021b_B.IO133_AI_CH1 "" FLOAT64_IEEE speedgoat_test_SN5659_R2021b_CM_double 0 0 -1.7E+308 1.7E+308 ECU_ADDRESS 0x00945E60 /end MEASUREMENT
/begin MEASUREMENT speedgoat_test_SN5659_R2021b_B.IO133_AI_CH2 "" FLOAT64_IEEE speedgoat_test_SN5659_R2021b_CM_double 0 0 -1.7E+308 1.7E+308 ECU_ADDRESS 0x00945E68 /end MEASUREMENT
/begin MEASUREMENT speedgoat_test_SN5659_R2021b_B.IO133_AI_CH3 "" FLOAT64_IEEE speedgoat_test_SN5659_R2021b_CM_double 0 0 -1.7E+308 1.7E+308 ECU_ADDRESS 0x00945E70 /end MEASUREMENT
/begin MEASUREMENT speedgoat_test_SN5659_R2021b_B.IO133_AI_CH4 "" FLOAT64_IEEE speedgoat_test_SN5659_R2021b_CM_double 0 0 -1.7E+308 1.7E+308 ECU_ADDRESS 0x00945E78 /end MEASUREMENT
/begin MEASUREMENT speedgoat_test_SN5659_R2021b_B.IO133_DI_CH8 "" FLOAT64_IEEE speedgoat_test_SN5659_R2021b_CM_double 0 0 -1.7E+308 1.7E+308 ECU_ADDRESS 0x00945EA8 /end MEASUREMENT
/begin MEASUREMENT speedgoat_test_SN5659_R2021b_B.IO133_DI_CH9 "" FLOAT64_IEEE speedgoat_test_SN5659_R2021b_CM_double 0 0 -1.7E+308 1.7E+308 ECU_ADDRESS 0x00945EB0 /end MEASUREMENT
/begin MEASUREMENT speedgoat_test_SN5659_R2021b_B.IO204_CH1 "" FLOAT64_IEEE speedgoat_test_SN5659_R2021b_CM_double 0 0 -1.7E+308 1.7E+308 ECU_ADDRESS 0x00945EC8 /end MEASUREMENT
/begin MEASUREMENT speedgoat_test_SN5659_R2021b_B.IO204_CH11 "" FLOAT64_IEEE speedgoat_test_SN5659_R2021b_CM_double 0 0 -1.7E+308 1.7E+308 ECU_ADDRESS 0x00945F50 /end MEASUREMENT
/begin MEASUREMENT speedgoat_test_SN5659_R2021b_B.IO204_CH16 "" FLOAT64_IEEE speedgoat_test_SN5659_R2021b_CM_double 0 0 -1.7E+308 1.7E+308 ECU_ADDRESS 0x00945F58 /end MEASUREMENT
/begin MEASUREMENT speedgoat_test_SN5659_R2021b_B.IO204_CH6 "" FLOAT64_IEEE speedgoat_test_SN5659_R2021b_CM_double 0 0 -1.7E+308 1.7E+308 ECU_ADDRESS 0x00945F48 /end MEASUREMENT
/begin MEASUREMENT speedgoat_test_SN5659_R2021b_B.IO421_LVDT_POS1 "" FLOAT64_IEEE speedgoat_test_SN5659_R2021b_CM_double 0 0 -1.7E+308 1.7E+308 ECU_ADDRESS 0x00945FB8 /end MEASUREMENT
/begin MEASUREMENT speedgoat_test_SN5659_R2021b_B.IO421_LVDT_POS2 "" FLOAT64_IEEE speedgoat_test_SN5659_R2021b_CM_double 0 0 -1.7E+308 1.7E+308 ECU_ADDRESS 0x00945FC0 /end MEASUREMENT
/begin MEASUREMENT speedgoat_test_SN5659_R2021b_B.IO682_SerialIN_CH1 "" FLOAT64_IEEE speedgoat_test_SN5659_R2021b_CM_double 0 0 -1.7E+308 1.7E+308 LAYOUT COLUMN_DIR MATRIX_DIM 4 ECU_ADDRESS 0x00946180 /end MEASUREMENT
/begin MEASUREMENT speedgoat_test_SN5659_R2021b_B.IO682_SerialIN_CH10 "" FLOAT64_IEEE speedgoat_test_SN5659_R2021b_CM_double 0 0 -1.7E+308 1.7E+308 LAYOUT COLUMN_DIR MATRIX_DIM 4 ECU_ADDRESS 0x00946708 /end MEASUREMENT
/begin MEASUREMENT speedgoat_test_SN5659_R2021b_B.IO682_SerialIN_CH11 "" FLOAT64_IEEE speedgoat_test_SN5659_R2021b_CM_double 0 0 -1.7E+308 1.7E+308 LAYOUT COLUMN_DIR MATRIX_DIM 4 ECU_ADDRESS 0x009468E0 /end MEASUREMENT
/begin MEASUREMENT speedgoat_test_SN5659_R2021b_B.IO682_SerialIN_CH12 "" FLOAT64_IEEE speedgoat_test_SN5659_R2021b_CM_double 0 0 -1.7E+308 1.7E+308 LAYOUT COLUMN_DIR MATRIX_DIM 4 ECU_ADDRESS 0x00946AB8 /end MEASUREMENT
/begin MEASUREMENT speedgoat_test_SN5659_R2021b_B.IO682_SerialIN_CH13 "" FLOAT64_IEEE speedgoat_test_SN5659_R2021b_CM_double 0 0 -1.7E+308 1.7E+308 LAYOUT COLUMN_DIR MATRIX_DIM 4 ECU_ADDRESS 0x00946C90 /end MEASUREMENT
/begin MEASUREMENT speedgoat_test_SN5659_R2021b_B.IO682_SerialIN_CH14 "" FLOAT64_IEEE speedgoat_test_SN5659_R2021b_CM_double 0 0 -1.7E+308 1.7E+308 LAYOUT COLUMN_DIR MATRIX_DIM 4 ECU_ADDRESS 0x00946E68 /end MEASUREMENT
/begin MEASUREMENT speedgoat_test_SN5659_R2021b_B.IO682_SerialIN_CH15 "" FLOAT64_IEEE speedgoat_test_SN5659_R2021b_CM_double 0 0 -1.7E+308 1.7E+308 LAYOUT COLUMN_DIR MATRIX_DIM 4 ECU_ADDRESS 0x00947040 /end MEASUREMENT
/begin MEASUREMENT speedgoat_test_SN5659_R2021b_B.IO682_SerialIN_CH16 "" FLOAT64_IEEE speedgoat_test_SN5659_R2021b_CM_double 0 0 -1.7E+308 1.7E+308 LAYOUT COLUMN_DIR MATRIX_DIM 4 ECU_ADDRESS 0x00947218 /end MEASUREMENT
/begin MEASUREMENT speedgoat_test_SN5659_R2021b_B.IO682_SerialIN_CH2 "" FLOAT64_IEEE speedgoat_test_SN5659_R2021b_CM_double 0 0 -1.7E+308 1.7E+308 LAYOUT COLUMN_DIR MATRIX_DIM 4 ECU_ADDRESS 0x00946358 /end MEASUREMENT
/begin MEASUREMENT speedgoat_test_SN5659_R2021b_B.IO682_SerialIN_CH3 "" FLOAT64_IEEE speedgoat_test_SN5659_R2021b_CM_double 0 0 -1.7E+308 1.7E+308 LAYOUT COLUMN_DIR MATRIX_DIM 4 ECU_ADDRESS 0x009473F0 /end MEASUREMENT
/begin MEASUREMENT speedgoat_test_SN5659_R2021b_B.IO682_SerialIN_CH4 "" FLOAT64_IEEE speedgoat_test_SN5659_R2021b_CM_double 0 0 -1.7E+308 1.7E+308 LAYOUT COLUMN_DIR MATRIX_DIM 4 ECU_ADDRESS 0x009475C8 /end MEASUREMENT
/begin MEASUREMENT speedgoat_test_SN5659_R2021b_B.IO682_SerialIN_CH5 "" FLOAT64_IEEE speedgoat_test_SN5659_R2021b_CM_double 0 0 -1.7E+308 1.7E+308 LAYOUT COLUMN_DIR MATRIX_DIM 4 ECU_ADDRESS 0x009477A0 /end MEASUREMENT
/begin MEASUREMENT speedgoat_test_SN5659_R2021b_B.IO682_SerialIN_CH6 "" FLOAT64_IEEE speedgoat_test_SN5659_R2021b_CM_double 0 0 -1.7E+308 1.7E+308 LAYOUT COLUMN_DIR MATRIX_DIM 4 ECU_ADDRESS 0x00947978 /end MEASUREMENT
/begin MEASUREMENT speedgoat_test_SN5659_R2021b_B.IO682_SerialIN_CH7 "" FLOAT64_IEEE speedgoat_test_SN5659_R2021b_CM_double 0 0 -1.7E+308 1.7E+308 LAYOUT COLUMN_DIR MATRIX_DIM 4 ECU_ADDRESS 0x00947B50 /end MEASUREMENT
/begin MEASUREMENT speedgoat_test_SN5659_R2021b_B.IO682_SerialIN_CH8 "" FLOAT64_IEEE speedgoat_test_SN5659_R2021b_CM_double 0 0 -1.7E+308 1.7E+308 LAYOUT COLUMN_DIR MATRIX_DIM 4 ECU_ADDRESS 0x00947D28 /end MEASUREMENT
/begin MEASUREMENT speedgoat_test_SN5659_R2021b_B.IO682_SerialIN_CH9 "" FLOAT64_IEEE speedgoat_test_SN5659_R2021b_CM_double 0 0 -1.7E+308 1.7E+308 LAYOUT COLUMN_DIR MATRIX_DIM 4 ECU_ADDRESS 0x00946530 /end MEASUREMENT
/begin MEASUREMENT speedgoat_test_SN5659_R2021b_B.PulseGenerator "" FLOAT64_IEEE speedgoat_test_SN5659_R2021b_CM_double 0 0 -1.7E+308 1.7E+308 ECU_ADDRESS 0x00945EB8 /end MEASUREMENT
/begin MEASUREMENT speedgoat_test_SN5659_R2021b_B.PulseGenerator1 "" FLOAT64_IEEE speedgoat_test_SN5659_R2021b_CM_double 0 0 -1.7E+308 1.7E+308 ECU_ADDRESS 0x00945EC0 /end MEASUREMENT
/begin MEASUREMENT speedgoat_test_SN5659_R2021b_B.PulseGenerator_k "" FLOAT64_IEEE speedgoat_test_SN5659_R2021b_CM_double 0 0 -1.7E+308 1.7E+308 ECU_ADDRESS 0x00945F60 /end MEASUREMENT
/begin MEASUREMENT speedgoat_test_SN5659_R2021b_B.RXSampleTime "" FLOAT64_IEEE speedgoat_test_SN5659_R2021b_CM_double 0 0 -1.7E+308 1.7E+308 ECU_ADDRESS 0x00945F98 /end MEASUREMENT
/begin MEASUREMENT speedgoat_test_SN5659_R2021b_B.RXSampleTime1 "" FLOAT64_IEEE speedgoat_test_SN5659_R2021b_CM_double 0 0 -1.7E+308 1.7E+308 ECU_ADDRESS 0x00945FA0 /end MEASUREMENT
/begin MEASUREMENT speedgoat_test_SN5659_R2021b_B.Read_o11 "" FLOAT64_IEEE speedgoat_test_SN5659_R2021b_CM_double 0 0 -1.7E+308 1.7E+308 ECU_ADDRESS 0x00945F18 /end MEASUREMENT
/begin MEASUREMENT speedgoat_test_SN5659_R2021b_B.Read_o16 "" FLOAT64_IEEE speedgoat_test_SN5659_R2021b_CM_double 0 0 -1.7E+308 1.7E+308 ECU_ADDRESS 0x00945F40 /end MEASUREMENT
/begin MEASUREMENT speedgoat_test_SN5659_R2021b_B.Read_o6 "" FLOAT64_IEEE speedgoat_test_SN5659_R2021b_CM_double 0 0 -1.7E+308 1.7E+308 ECU_ADDRESS 0x00945EF0 /end MEASUREMENT
/begin MEASUREMENT speedgoat_test_SN5659_R2021b_B.Receivev2 "" FLOAT64_IEEE speedgoat_test_SN5659_R2021b_CM_double 0 0 -1.7E+308 1.7E+308 LAYOUT COLUMN_DIR MATRIX_DIM 51 ECU_ADDRESS 0x00945FC8 /end MEASUREMENT
/begin MEASUREMENT speedgoat_test_SN5659_R2021b_B.Receivev21 "" FLOAT64_IEEE speedgoat_test_SN5659_R2021b_CM_double 0 0 -1.7E+308 1.7E+308 LAYOUT COLUMN_DIR MATRIX_DIM 51 ECU_ADDRESS 0x009461A0 /end MEASUREMENT
/begin MEASUREMENT speedgoat_test_SN5659_R2021b_B.Receivev210 "" FLOAT64_IEEE speedgoat_test_SN5659_R2021b_CM_double 0 0 -1.7E+308 1.7E+308 LAYOUT COLUMN_DIR MATRIX_DIM 51 ECU_ADDRESS 0x00946728 /end MEASUREMENT
/begin MEASUREMENT speedgoat_test_SN5659_R2021b_B.Receivev211 "" FLOAT64_IEEE speedgoat_test_SN5659_R2021b_CM_double 0 0 -1.7E+308 1.7E+308 LAYOUT COLUMN_DIR MATRIX_DIM 51 ECU_ADDRESS 0x00946900 /end MEASUREMENT
/begin MEASUREMENT speedgoat_test_SN5659_R2021b_B.Receivev212 "" FLOAT64_IEEE speedgoat_test_SN5659_R2021b_CM_double 0 0 -1.7E+308 1.7E+308 LAYOUT COLUMN_DIR MATRIX_DIM 51 ECU_ADDRESS 0x00946AD8 /end MEASUREMENT
/begin MEASUREMENT speedgoat_test_SN5659_R2021b_B.Receivev213 "" FLOAT64_IEEE speedgoat_test_SN5659_R2021b_CM_double 0 0 -1.7E+308 1.7E+308 LAYOUT COLUMN_DIR MATRIX_DIM 51 ECU_ADDRESS 0x00946CB0 /end MEASUREMENT
/begin MEASUREMENT speedgoat_test_SN5659_R2021b_B.Receivev214 "" FLOAT64_IEEE speedgoat_test_SN5659_R2021b_CM_double 0 0 -1.7E+308 1.7E+308 LAYOUT COLUMN_DIR MATRIX_DIM 51 ECU_ADDRESS 0x00946E88 /end MEASUREMENT
/begin MEASUREMENT speedgoat_test_SN5659_R2021b_B.Receivev215 "" FLOAT64_IEEE speedgoat_test_SN5659_R2021b_CM_double 0 0 -1.7E+308 1.7E+308 LAYOUT COLUMN_DIR MATRIX_DIM 51 ECU_ADDRESS 0x00947060 /end MEASUREMENT
/begin MEASUREMENT speedgoat_test_SN5659_R2021b_B.Receivev22 "" FLOAT64_IEEE speedgoat_test_SN5659_R2021b_CM_double 0 0 -1.7E+308 1.7E+308 LAYOUT COLUMN_DIR MATRIX_DIM 51 ECU_ADDRESS 0x00947238 /end MEASUREMENT
/begin MEASUREMENT speedgoat_test_SN5659_R2021b_B.Receivev23 "" FLOAT64_IEEE speedgoat_test_SN5659_R2021b_CM_double 0 0 -1.7E+308 1.7E+308 LAYOUT COLUMN_DIR MATRIX_DIM 51 ECU_ADDRESS 0x00947410 /end MEASUREMENT
/begin MEASUREMENT speedgoat_test_SN5659_R2021b_B.Receivev24 "" FLOAT64_IEEE speedgoat_test_SN5659_R2021b_CM_double 0 0 -1.7E+308 1.7E+308 LAYOUT COLUMN_DIR MATRIX_DIM 51 ECU_ADDRESS 0x009475E8 /end MEASUREMENT
/begin MEASUREMENT speedgoat_test_SN5659_R2021b_B.Receivev25 "" FLOAT64_IEEE speedgoat_test_SN5659_R2021b_CM_double 0 0 -1.7E+308 1.7E+308 LAYOUT COLUMN_DIR MATRIX_DIM 51 ECU_ADDRESS 0x009477C0 /end MEASUREMENT
/begin MEASUREMENT speedgoat_test_SN5659_R2021b_B.Receivev26 "" FLOAT64_IEEE speedgoat_test_SN5659_R2021b_CM_double 0 0 -1.7E+308 1.7E+308 LAYOUT COLUMN_DIR MATRIX_DIM 51 ECU_ADDRESS 0x00947998 /end MEASUREMENT
/begin MEASUREMENT speedgoat_test_SN5659_R2021b_B.Receivev27 "" FLOAT64_IEEE speedgoat_test_SN5659_R2021b_CM_double 0 0 -1.7E+308 1.7E+308 LAYOUT COLUMN_DIR MATRIX_DIM 51 ECU_ADDRESS 0x00947B70 /end MEASUREMENT
/begin MEASUREMENT speedgoat_test_SN5659_R2021b_B.Receivev28 "" FLOAT64_IEEE speedgoat_test_SN5659_R2021b_CM_double 0 0 -1.7E+308 1.7E+308 LAYOUT COLUMN_DIR MATRIX_DIM 51 ECU_ADDRESS 0x00946378 /end MEASUREMENT
/begin MEASUREMENT speedgoat_test_SN5659_R2021b_B.Receivev29 "" FLOAT64_IEEE speedgoat_test_SN5659_R2021b_CM_double 0 0 -1.7E+308 1.7E+308 LAYOUT COLUMN_DIR MATRIX_DIM 51 ECU_ADDRESS 0x00946550 /end MEASUREMENT
/begin MEASUREMENT speedgoat_test_SN5659_R2021b_B.SineWave "" FLOAT64_IEEE speedgoat_test_SN5659_R2021b_CM_double 0 0 -1.7E+308 1.7E+308 ECU_ADDRESS 0x00945E80 /end MEASUREMENT
/begin MEASUREMENT speedgoat_test_SN5659_R2021b_B.SineWave1 "" FLOAT64_IEEE speedgoat_test_SN5659_R2021b_CM_double 0 0 -1.7E+308 1.7E+308 ECU_ADDRESS 0x00945F70 /end MEASUREMENT
/begin MEASUREMENT speedgoat_test_SN5659_R2021b_B.SineWave1_c "" FLOAT64_IEEE speedgoat_test_SN5659_R2021b_CM_double 0 0 -1.7E+308 1.7E+308 ECU_ADDRESS 0x00945FB0 /end MEASUREMENT
/begin MEASUREMENT speedgoat_test_SN5659_R2021b_B.SineWave2 "" FLOAT64_IEEE speedgoat_test_SN5659_R2021b_CM_double 0 0 -1.7E+308 1.7E+308 ECU_ADDRESS 0x00945F78 /end MEASUREMENT
/begin MEASUREMENT speedgoat_test_SN5659_R2021b_B.SineWave3 "" FLOAT64_IEEE speedgoat_test_SN5659_R2021b_CM_double 0 0 -1.7E+308 1.7E+308 ECU_ADDRESS 0x00945F80 /end MEASUREMENT
/begin MEASUREMENT speedgoat_test_SN5659_R2021b_B.SineWave4 "" FLOAT64_IEEE speedgoat_test_SN5659_R2021b_CM_double 0 0 -1.7E+308 1.7E+308 ECU_ADDRESS 0x00945F88 /end MEASUREMENT
/begin MEASUREMENT speedgoat_test_SN5659_R2021b_B.SineWave5 "" FLOAT64_IEEE speedgoat_test_SN5659_R2021b_CM_double 0 0 -1.7E+308 1.7E+308 ECU_ADDRESS 0x00945F90 /end MEASUREMENT
/begin MEASUREMENT speedgoat_test_SN5659_R2021b_B.SineWave_e "" FLOAT64_IEEE speedgoat_test_SN5659_R2021b_CM_double 0 0 -1.7E+308 1.7E+308 ECU_ADDRESS 0x00945F68 /end MEASUREMENT
/begin MEASUREMENT speedgoat_test_SN5659_R2021b_B.SineWave_h "" FLOAT64_IEEE speedgoat_test_SN5659_R2021b_CM_double 0 0 -1.7E+308 1.7E+308 ECU_ADDRESS 0x00945FA8 /end MEASUREMENT
/begin MEASUREMENT speedgoat_test_SN5659_R2021b_DW.CANPack1_ModeSignalID "" SLONG speedgoat_test_SN5659_R2021b_CM_int_T 0 0 -2147483648 2147483647 ECU_ADDRESS 0x00945AF0 /end MEASUREMENT
/begin MEASUREMENT speedgoat_test_SN5659_R2021b_DW.CANPack2_ModeSignalID "" SLONG speedgoat_test_SN5659_R2021b_CM_int_T 0 0 -2147483648 2147483647 ECU_ADDRESS 0x00945AF8 /end MEASUREMENT
/begin MEASUREMENT speedgoat_test_SN5659_R2021b_DW.CANPack3_ModeSignalID "" SLONG speedgoat_test_SN5659_R2021b_CM_int_T 0 0 -2147483648 2147483647 ECU_ADDRESS 0x00945B00 /end MEASUREMENT
/begin MEASUREMENT speedgoat_test_SN5659_R2021b_DW.CANPack4_ModeSignalID "" SLONG speedgoat_test_SN5659_R2021b_CM_int_T 0 0 -2147483648 2147483647 ECU_ADDRESS 0x00945B08 /end MEASUREMENT
/begin MEASUREMENT speedgoat_test_SN5659_R2021b_DW.CANPack5_ModeSignalID "" SLONG speedgoat_test_SN5659_R2021b_CM_int_T 0 0 -2147483648 2147483647 ECU_ADDRESS 0x00945B10 /end MEASUREMENT
/begin MEASUREMENT speedgoat_test_SN5659_R2021b_DW.CANPack_ModeSignalID "" SLONG speedgoat_test_SN5659_R2021b_CM_int_T 0 0 -2147483648 2147483647 ECU_ADDRESS 0x00945AE8 /end MEASUREMENT
/begin MEASUREMENT speedgoat_test_SN5659_R2021b_DW.CANUnpack1_ModeSignalID "" SLONG speedgoat_test_SN5659_R2021b_CM_int_T 0 0 -2147483648 2147483647 ECU_ADDRESS 0x00945D44 /end MEASUREMENT
/begin MEASUREMENT speedgoat_test_SN5659_R2021b_DW.CANUnpack1_ModeSignalID_i "" SLONG speedgoat_test_SN5659_R2021b_CM_int_T 0 0 -2147483648 2147483647 ECU_ADDRESS 0x00945D60 /end MEASUREMENT
/begin MEASUREMENT speedgoat_test_SN5659_R2021b_DW.CANUnpack1_StatusPortID "" SLONG speedgoat_test_SN5659_R2021b_CM_int_T 0 0 -2147483648 2147483647 ECU_ADDRESS 0x00945D48 /end MEASUREMENT
/begin MEASUREMENT speedgoat_test_SN5659_R2021b_DW.CANUnpack1_StatusPortID_o "" SLONG speedgoat_test_SN5659_R2021b_CM_int_T 0 0 -2147483648 2147483647 ECU_ADDRESS 0x00945D64 /end MEASUREMENT
/begin MEASUREMENT speedgoat_test_SN5659_R2021b_DW.CANUnpack2_ModeSignalID "" SLONG speedgoat_test_SN5659_R2021b_CM_int_T 0 0 -2147483648 2147483647 ECU_ADDRESS 0x00945D4C /end MEASUREMENT
/begin MEASUREMENT speedgoat_test_SN5659_R2021b_DW.CANUnpack2_ModeSignalID_g "" SLONG speedgoat_test_SN5659_R2021b_CM_int_T 0 0 -2147483648 2147483647 ECU_ADDRESS 0x00945D68 /end MEASUREMENT
/begin MEASUREMENT speedgoat_test_SN5659_R2021b_DW.CANUnpack2_StatusPortID "" SLONG speedgoat_test_SN5659_R2021b_CM_int_T 0 0 -2147483648 2147483647 ECU_ADDRESS 0x00945D50 /end MEASUREMENT
/begin MEASUREMENT speedgoat_test_SN5659_R2021b_DW.CANUnpack2_StatusPortID_m "" SLONG speedgoat_test_SN5659_R2021b_CM_int_T 0 0 -2147483648 2147483647 ECU_ADDRESS 0x00945D6C /end MEASUREMENT
/begin MEASUREMENT speedgoat_test_SN5659_R2021b_DW.CANUnpack_ModeSignalID "" SLONG speedgoat_test_SN5659_R2021b_CM_int_T 0 0 -2147483648 2147483647 ECU_ADDRESS 0x00945D3C /end MEASUREMENT
/begin MEASUREMENT speedgoat_test_SN5659_R2021b_DW.CANUnpack_ModeSignalID_b "" SLONG speedgoat_test_SN5659_R2021b_CM_int_T 0 0 -2147483648 2147483647 ECU_ADDRESS 0x00945D58 /end MEASUREMENT
/begin MEASUREMENT speedgoat_test_SN5659_R2021b_DW.CANUnpack_StatusPortID "" SLONG speedgoat_test_SN5659_R2021b_CM_int_T 0 0 -2147483648 2147483647 ECU_ADDRESS 0x00945D40 /end MEASUREMENT
/begin MEASUREMENT speedgoat_test_SN5659_R2021b_DW.CANUnpack_StatusPortID_g "" SLONG speedgoat_test_SN5659_R2021b_CM_int_T 0 0 -2147483648 2147483647 ECU_ADDRESS 0x00945D5C /end MEASUREMENT
/begin MEASUREMENT speedgoat_test_SN5659_R2021b_DW.clockTickCounter "" SLONG speedgoat_test_SN5659_R2021b_CM_int32 0 0 -2147483648 2147483647 ECU_ADDRESS 0x00945A28 /end MEASUREMENT
/begin MEASUREMENT speedgoat_test_SN5659_R2021b_DW.clockTickCounter_b "" SLONG speedgoat_test_SN5659_R2021b_CM_int32 0 0 -2147483648 2147483647 ECU_ADDRESS 0x00945A30 /end MEASUREMENT
/begin MEASUREMENT speedgoat_test_SN5659_R2021b_DW.clockTickCounter_c "" SLONG speedgoat_test_SN5659_R2021b_CM_int32 0 0 -2147483648 2147483647 ECU_ADDRESS 0x00945A2C /end MEASUREMENT
/begin MEASUREMENT speedgoat_test_SN5659_R2021b_DW.lastCos "" FLOAT64_IEEE speedgoat_test_SN5659_R2021b_CM_double 0 0 -1.7E+308 1.7E+308 ECU_ADDRESS 0x00945028 /end MEASUREMENT
/begin MEASUREMENT speedgoat_test_SN5659_R2021b_DW.lastCos_b "" FLOAT64_IEEE speedgoat_test_SN5659_R2021b_CM_double 0 0 -1.7E+308 1.7E+308 ECU_ADDRESS 0x00945058 /end MEASUREMENT
/begin MEASUREMENT speedgoat_test_SN5659_R2021b_DW.lastCos_c "" FLOAT64_IEEE speedgoat_test_SN5659_R2021b_CM_double 0 0 -1.7E+308 1.7E+308 ECU_ADDRESS 0x00945078 /end MEASUREMENT
/begin MEASUREMENT speedgoat_test_SN5659_R2021b_DW.lastCos_g "" FLOAT64_IEEE speedgoat_test_SN5659_R2021b_CM_double 0 0 -1.7E+308 1.7E+308 ECU_ADDRESS 0x00945038 /end MEASUREMENT
/begin MEASUREMENT speedgoat_test_SN5659_R2021b_DW.lastCos_i "" FLOAT64_IEEE speedgoat_test_SN5659_R2021b_CM_double 0 0 -1.7E+308 1.7E+308 ECU_ADDRESS 0x00945048 /end MEASUREMENT
/begin MEASUREMENT speedgoat_test_SN5659_R2021b_DW.lastCos_i1 "" FLOAT64_IEEE speedgoat_test_SN5659_R2021b_CM_double 0 0 -1.7E+308 1.7E+308 ECU_ADDRESS 0x00945088 /end MEASUREMENT
/begin MEASUREMENT speedgoat_test_SN5659_R2021b_DW.lastCos_j "" FLOAT64_IEEE speedgoat_test_SN5659_R2021b_CM_double 0 0 -1.7E+308 1.7E+308 ECU_ADDRESS 0x00945068 /end MEASUREMENT
/begin MEASUREMENT speedgoat_test_SN5659_R2021b_DW.lastCos_o "" FLOAT64_IEEE speedgoat_test_SN5659_R2021b_CM_double 0 0 -1.7E+308 1.7E+308 ECU_ADDRESS 0x00945098 /end MEASUREMENT
/begin MEASUREMENT speedgoat_test_SN5659_R2021b_DW.lastSin "" FLOAT64_IEEE speedgoat_test_SN5659_R2021b_CM_double 0 0 -1.7E+308 1.7E+308 ECU_ADDRESS 0x00945020 /end MEASUREMENT
/begin MEASUREMENT speedgoat_test_SN5659_R2021b_DW.lastSin_c "" FLOAT64_IEEE speedgoat_test_SN5659_R2021b_CM_double 0 0 -1.7E+308 1.7E+308 ECU_ADDRESS 0x00945030 /end MEASUREMENT
/begin MEASUREMENT speedgoat_test_SN5659_R2021b_DW.lastSin_cd "" FLOAT64_IEEE speedgoat_test_SN5659_R2021b_CM_double 0 0 -1.7E+308 1.7E+308 ECU_ADDRESS 0x00945070 /end MEASUREMENT
/begin MEASUREMENT speedgoat_test_SN5659_R2021b_DW.lastSin_d "" FLOAT64_IEEE speedgoat_test_SN5659_R2021b_CM_double 0 0 -1.7E+308 1.7E+308 ECU_ADDRESS 0x00945050 /end MEASUREMENT
/begin MEASUREMENT speedgoat_test_SN5659_R2021b_DW.lastSin_d2 "" FLOAT64_IEEE speedgoat_test_SN5659_R2021b_CM_double 0 0 -1.7E+308 1.7E+308 ECU_ADDRESS 0x00945090 /end MEASUREMENT
/begin MEASUREMENT speedgoat_test_SN5659_R2021b_DW.lastSin_h "" FLOAT64_IEEE speedgoat_test_SN5659_R2021b_CM_double 0 0 -1.7E+308 1.7E+308 ECU_ADDRESS 0x00945060 /end MEASUREMENT
/begin MEASUREMENT speedgoat_test_SN5659_R2021b_DW.lastSin_i "" FLOAT64_IEEE speedgoat_test_SN5659_R2021b_CM_double 0 0 -1.7E+308 1.7E+308 ECU_ADDRESS 0x00945040 /end MEASUREMENT
/begin MEASUREMENT speedgoat_test_SN5659_R2021b_DW.lastSin_ib "" FLOAT64_IEEE speedgoat_test_SN5659_R2021b_CM_double 0 0 -1.7E+308 1.7E+308 ECU_ADDRESS 0x00945080 /end MEASUREMENT
/begin MEASUREMENT speedgoat_test_SN5659_R2021b_DW.systemEnable "" SLONG speedgoat_test_SN5659_R2021b_CM_int32 0 0 -2147483648 2147483647 ECU_ADDRESS 0x00945A34 /end MEASUREMENT
/begin MEASUREMENT speedgoat_test_SN5659_R2021b_DW.systemEnable_b "" SLONG speedgoat_test_SN5659_R2021b_CM_int32 0 0 -2147483648 2147483647 ECU_ADDRESS 0x00945A44 /end MEASUREMENT
/begin MEASUREMENT speedgoat_test_SN5659_R2021b_DW.systemEnable_bc "" SLONG speedgoat_test_SN5659_R2021b_CM_int32 0 0 -2147483648 2147483647 ECU_ADDRESS 0x00945A4C /end MEASUREMENT
/begin MEASUREMENT speedgoat_test_SN5659_R2021b_DW.systemEnable_h "" SLONG speedgoat_test_SN5659_R2021b_CM_int32 0 0 -2147483648 2147483647 ECU_ADDRESS 0x00945A40 /end MEASUREMENT
/begin MEASUREMENT speedgoat_test_SN5659_R2021b_DW.systemEnable_i "" SLONG speedgoat_test_SN5659_R2021b_CM_int32 0 0 -2147483648 2147483647 ECU_ADDRESS 0x00945A3C /end MEASUREMENT
/begin MEASUREMENT speedgoat_test_SN5659_R2021b_DW.systemEnable_o "" SLONG speedgoat_test_SN5659_R2021b_CM_int32 0 0 -2147483648 2147483647 ECU_ADDRESS 0x00945A50 /end MEASUREMENT
/begin MEASUREMENT speedgoat_test_SN5659_R2021b_DW.systemEnable_p "" SLONG speedgoat_test_SN5659_R2021b_CM_int32 0 0 -2147483648 2147483647 ECU_ADDRESS 0x00945A38 /end MEASUREMENT
/begin MEASUREMENT speedgoat_test_SN5659_R2021b_DW.systemEnable_py "" SLONG speedgoat_test_SN5659_R2021b_CM_int32 0 0 -2147483648 2147483647 ECU_ADDRESS 0x00945A48 /end MEASUREMENT
/begin COMPU_METHOD speedgoat_test_SN5659_R2021b_CM_double "" IDENTICAL "%15.10" "" /end COMPU_METHOD
/begin COMPU_METHOD speedgoat_test_SN5659_R2021b_CM_int32 "" IDENTICAL "%10.0" "" /end COMPU_METHOD
/begin COMPU_METHOD speedgoat_test_SN5659_R2021b_CM_int_T "" IDENTICAL "customformat" "" /end COMPU_METHOD
/begin COMPU_METHOD speedgoat_test_SN5659_R2021b_CM_logical "" IDENTICAL "%1.0" "" /end COMPU_METHOD
/begin RECORD_LAYOUT Scalar_FLOAT64_IEEE FNC_VALUES 1 FLOAT64_IEEE COLUMN_DIR DIRECT /end RECORD_LAYOUT
/begin GROUP speedgoat_test_SN5659_R2021b "speedgoat_test_SN5659_R2021b" ROOT
 /begin SUB_GROUP speedgoat_test_SN5659_R2021b_IO107__1_2_ speedgoat_test_SN5659_R2021b_IO133 speedgoat_test_SN5659_R2021b_IO204 speedgoat_test_SN5659_R2021b_IO421_1 speedgoat_test_SN5659_R2021b_IO612 speedgoat_test_SN5659_R2021b_IO682 speedgoat_test_SN5659_R2021b_IO941_SPDT_64 /end SUB_GROUP
/end GROUP
/begin GROUP speedgoat_test_SN5659_R2021b_IO107__1_2_ "speedgoat_test_SN5659_R2021b/IO107 (1-2)"
 /begin REF_CHARACTERISTIC speedgoat_test_SN5659__cal_impl.Analogoutput1_P1 speedgoat_test_SN5659__cal_impl.Analogoutput1_P2 speedgoat_test_SN5659__cal_impl.Analogoutput1_P3 speedgoat_test_SN5659__cal_impl.Analogoutput1_P4 speedgoat_test_SN5659__cal_impl.Analogoutput1_P5 speedgoat_test_SN5659__cal_impl.Analogoutput1_P6 speedgoat_test_SN5659__cal_impl.Analogoutput1_P7 speedgoat_test_SN5659__cal_impl.Analogoutput_P1 speedgoat_test_SN5659__cal_impl.Analogoutput_P2 speedgoat_test_SN5659__cal_impl.Analogoutput_P3 speedgoat_test_SN5659__cal_impl.Analogoutput_P4 speedgoat_test_SN5659__cal_impl.Analogoutput_P5 speedgoat_test_SN5659__cal_impl.Analogoutput_P6 speedgoat_test_SN5659__cal_impl.Analogoutput_P7 speedgoat_test_SN5659__cal_impl.Setup1_P1 speedgoat_test_SN5659__cal_impl.Setup1_P10 speedgoat_test_SN5659__cal_impl.Setup1_P11 speedgoat_test_SN5659__cal_impl.Setup1_P2 speedgoat_test_SN5659__cal_impl.Setup1_P3 speedgoat_test_SN5659__cal_impl.Setup1_P4 speedgoat_test_SN5659__cal_impl.Setup1_P5 speedgoat_test_SN5659__cal_impl.Setup1_P6 speedgoat_test_SN5659__cal_impl.Setup1_P7 speedgoat_test_SN5659__cal_impl.Setup1_P8 speedgoat_test_SN5659__cal_impl.Setup1_P9 speedgoat_test_SN5659__cal_impl.Setup_P10 speedgoat_test_SN5659__cal_impl.Setup_P11 speedgoat_test_SN5659__cal_impl.Setup_P1_c speedgoat_test_SN5659__cal_impl.Setup_P2_j speedgoat_test_SN5659__cal_impl.Setup_P3_p speedgoat_test_SN5659__cal_impl.Setup_P4_h speedgoat_test_SN5659__cal_impl.Setup_P5_k speedgoat_test_SN5659__cal_impl.Setup_P6 speedgoat_test_SN5659__cal_impl.Setup_P7 speedgoat_test_SN5659__cal_impl.Setup_P8 speedgoat_test_SN5659__cal_impl.Setup_P9 speedgoat_test_SN5659__cal_impl.SineWave1_Amp_d speedgoat_test_SN5659__cal_impl.SineWave1_Bias_d speedgoat_test_SN5659__cal_impl.SineWave1_Freq_c speedgoat_test_SN5659__cal_impl.SineWave1_HCos_j speedgoat_test_SN5659__cal_impl.SineWave1_Hsin_m speedgoat_test_SN5659__cal_impl.SineWave1_PCos_o speedgoat_test_SN5659__cal_impl.SineWave1_PSin_n speedgoat_test_SN5659__cal_impl.SineWave_Amp_l speedgoat_test_SN5659__cal_impl.SineWave_Bias_d speedgoat_test_SN5659__cal_impl.SineWave_Freq_f speedgoat_test_SN5659__cal_impl.SineWave_HCos_b speedgoat_test_SN5659__cal_impl.SineWave_Hsin_c speedgoat_test_SN5659__cal_impl.SineWave_PCos_l speedgoat_test_SN5659__cal_impl.SineWave_PSin_o /end REF_CHARACTERISTIC
 /begin REF_MEASUREMENT speedgoat_test_SN5659_R2021b_B.SineWave1_c speedgoat_test_SN5659_R2021b_B.SineWave_h speedgoat_test_SN5659_R2021b_DW.Analogoutput1_PWORK speedgoat_test_SN5659_R2021b_DW.Analogoutput_PWORK speedgoat_test_SN5659_R2021b_DW.Setup1_PWORK speedgoat_test_SN5659_R2021b_DW.Setup_PWORK_d speedgoat_test_SN5659_R2021b_DW.lastCos_i1 speedgoat_test_SN5659_R2021b_DW.lastCos_o speedgoat_test_SN5659_R2021b_DW.lastSin_d2 speedgoat_test_SN5659_R2021b_DW.lastSin_ib speedgoat_test_SN5659_R2021b_DW.systemEnable_bc speedgoat_test_SN5659_R2021b_DW.systemEnable_o /end REF_MEASUREMENT
/end GROUP
/begin GROUP speedgoat_test_SN5659_R2021b_IO133 "speedgoat_test_SN5659_R2021b/IO133"
 /begin REF_CHARACTERISTIC speedgoat_test_SN5659__cal_impl.Analoginputv2_P1 speedgoat_test_SN5659__cal_impl.Analoginputv2_P10 speedgoat_test_SN5659__cal_impl.Analoginputv2_P11 speedgoat_test_SN5659__cal_impl.Analoginputv2_P2 speedgoat_test_SN5659__cal_impl.Analoginputv2_P3 speedgoat_test_SN5659__cal_impl.Analoginputv2_P4 speedgoat_test_SN5659__cal_impl.Analoginputv2_P5 speedgoat_test_SN5659__cal_impl.Analoginputv2_P6 speedgoat_test_SN5659__cal_impl.Analoginputv2_P7 speedgoat_test_SN5659__cal_impl.Analoginputv2_P8 speedgoat_test_SN5659__cal_impl.Analoginputv2_P9 speedgoat_test_SN5659__cal_impl.Analogoutputv2_P1 speedgoat_test_SN5659__cal_impl.Analogoutputv2_P10 speedgoat_test_SN5659__cal_impl.Analogoutputv2_P11 speedgoat_test_SN5659__cal_impl.Analogoutputv2_P12 speedgoat_test_SN5659__cal_impl.Analogoutputv2_P13 speedgoat_test_SN5659__cal_impl.Analogoutputv2_P2 speedgoat_test_SN5659__cal_impl.Analogoutputv2_P3 speedgoat_test_SN5659__cal_impl.Analogoutputv2_P4 speedgoat_test_SN5659__cal_impl.Analogoutputv2_P5 speedgoat_test_SN5659__cal_impl.Analogoutputv2_P6 speedgoat_test_SN5659__cal_impl.Analogoutputv2_P7 speedgoat_test_SN5659__cal_impl.Analogoutputv2_P8 speedgoat_test_SN5659__cal_impl.Analogoutputv2_P9 speedgoat_test_SN5659__cal_impl.Digitalinputv2_P1 speedgoat_test_SN5659__cal_impl.Digitalinputv2_P2 speedgoat_test_SN5659__cal_impl.Digitalinputv2_P3 speedgoat_test_SN5659__cal_impl.Digitalinputv2_P4 speedgoat_test_SN5659__cal_impl.Digitalinputv2_P5 speedgoat_test_SN5659__cal_impl.Digitaloutputv2_P1 speedgoat_test_SN5659__cal_impl.Digitaloutputv2_P2 speedgoat_test_SN5659__cal_impl.Digitaloutputv2_P3 speedgoat_test_SN5659__cal_impl.Digitaloutputv2_P4 speedgoat_test_SN5659__cal_impl.Digitaloutputv2_P5 speedgoat_test_SN5659__cal_impl.Digitaloutputv2_P6 speedgoat_test_SN5659__cal_impl.Digitaloutputv2_P7 speedgoat_test_SN5659__cal_impl.Gain1_Gain speedgoat_test_SN5659__cal_impl.Gain2_Gain speedgoat_test_SN5659__cal_impl.Gain3_Gain speedgoat_test_SN5659__cal_impl.Gain_Gain speedgoat_test_SN5659__cal_impl.PulseGenerator1_Amp speedgoat_test_SN5659__cal_impl.PulseGenerator1_Duty speedgoat_test_SN5659__cal_impl.PulseGenerator1_Period speedgoat_test_SN5659__cal_impl.PulseGenerator1_PhaseDelay speedgoat_test_SN5659__cal_impl.PulseGenerator_Amp speedgoat_test_SN5659__cal_impl.PulseGenerator_Duty speedgoat_test_SN5659__cal_impl.PulseGenerator_Period speedgoat_test_SN5659__cal_impl.PulseGenerator_PhaseDelay speedgoat_test_SN5659__cal_impl.Setupv2_P1 speedgoat_test_SN5659__cal_impl.Setupv2_P10 speedgoat_test_SN5659__cal_impl.Setupv2_P11 speedgoat_test_SN5659__cal_impl.Setupv2_P12 speedgoat_test_SN5659__cal_impl.Setupv2_P13 speedgoat_test_SN5659__cal_impl.Setupv2_P14 speedgoat_test_SN5659__cal_impl.Setupv2_P15 speedgoat_test_SN5659__cal_impl.Setupv2_P16 speedgoat_test_SN5659__cal_impl.Setupv2_P17 speedgoat_test_SN5659__cal_impl.Setupv2_P18 speedgoat_test_SN5659__cal_impl.Setupv2_P19 speedgoat_test_SN5659__cal_impl.Setupv2_P2 speedgoat_test_SN5659__cal_impl.Setupv2_P20 speedgoat_test_SN5659__cal_impl.Setupv2_P21 speedgoat_test_SN5659__cal_impl.Setupv2_P22 speedgoat_test_SN5659__cal_impl.Setupv2_P23 speedgoat_test_SN5659__cal_impl.Setupv2_P24 speedgoat_test_SN5659__cal_impl.Setupv2_P25 speedgoat_test_SN5659__cal_impl.Setupv2_P26 speedgoat_test_SN5659__cal_impl.Setupv2_P27 speedgoat_test_SN5659__cal_impl.Setupv2_P28 speedgoat_test_SN5659__cal_impl.Setupv2_P29 speedgoat_test_SN5659__cal_impl.Setupv2_P3 speedgoat_test_SN5659__cal_impl.Setupv2_P30 speedgoat_test_SN5659__cal_impl.Setupv2_P31 speedgoat_test_SN5659__cal_impl.Setupv2_P32 speedgoat_test_SN5659__cal_impl.Setupv2_P33 speedgoat_test_SN5659__cal_impl.Setupv2_P34 speedgoat_test_SN5659__cal_impl.Setupv2_P35 speedgoat_test_SN5659__cal_impl.Setupv2_P4 speedgoat_test_SN5659__cal_impl.Setupv2_P5 speedgoat_test_SN5659__cal_impl.Setupv2_P6 speedgoat_test_SN5659__cal_impl.Setupv2_P7 speedgoat_test_SN5659__cal_impl.Setupv2_P8 speedgoat_test_SN5659__cal_impl.Setupv2_P9 speedgoat_test_SN5659__cal_impl.SineWave_Amp speedgoat_test_SN5659__cal_impl.SineWave_Bias speedgoat_test_SN5659__cal_impl.SineWave_Freq speedgoat_test_SN5659__cal_impl.SineWave_Phase /end REF_CHARACTERISTIC
 /begin REF_MEASUREMENT speedgoat_test_SN5659_R2021b_B.Gain speedgoat_test_SN5659_R2021b_B.Gain1 speedgoat_test_SN5659_R2021b_B.Gain2 speedgoat_test_SN5659_R2021b_B.Gain3 speedgoat_test_SN5659_R2021b_B.IO133_AI_CH1 speedgoat_test_SN5659_R2021b_B.IO133_AI_CH2 speedgoat_test_SN5659_R2021b_B.IO133_AI_CH3 speedgoat_test_SN5659_R2021b_B.IO133_AI_CH4 speedgoat_test_SN5659_R2021b_B.IO133_DI_CH8 speedgoat_test_SN5659_R2021b_B.IO133_DI_CH9 speedgoat_test_SN5659_R2021b_B.PulseGenerator speedgoat_test_SN5659_R2021b_B.PulseGenerator1 speedgoat_test_SN5659_R2021b_B.SineWave speedgoat_test_SN5659_R2021b_DW.Analoginputv2_PWORK speedgoat_test_SN5659_R2021b_DW.Analogoutputv2_PWORK speedgoat_test_SN5659_R2021b_DW.Digitalinputv2_PWORK speedgoat_test_SN5659_R2021b_DW.Digitaloutputv2_PWORK speedgoat_test_SN5659_R2021b_DW.Scope2_PWORK speedgoat_test_SN5659_R2021b_DW.Scope4_PWORK speedgoat_test_SN5659_R2021b_DW.clockTickCounter speedgoat_test_SN5659_R2021b_DW.clockTickCounter_c /end REF_MEASUREMENT
/end GROUP
/begin GROUP speedgoat_test_SN5659_R2021b_IO204 "speedgoat_test_SN5659_R2021b/IO204"
 /begin REF_CHARACTERISTIC speedgoat_test_SN5659__cal_impl.Gain1_Gain_o speedgoat_test_SN5659__cal_impl.Gain2_Gain_j speedgoat_test_SN5659__cal_impl.Gain_Gain_i speedgoat_test_SN5659__cal_impl.PulseGenerator_Amp_g speedgoat_test_SN5659__cal_impl.PulseGenerator_Duty_i speedgoat_test_SN5659__cal_impl.PulseGenerator_Period_i speedgoat_test_SN5659__cal_impl.PulseGenerator_PhaseDelay_l speedgoat_test_SN5659__cal_impl.Read_P1 speedgoat_test_SN5659__cal_impl.Read_P2 speedgoat_test_SN5659__cal_impl.Read_P3 speedgoat_test_SN5659__cal_impl.Read_P4 speedgoat_test_SN5659__cal_impl.Read_P5 speedgoat_test_SN5659__cal_impl.Setup_P1 speedgoat_test_SN5659__cal_impl.Setup_P2 speedgoat_test_SN5659__cal_impl.Setup_P3 speedgoat_test_SN5659__cal_impl.Setup_P4 speedgoat_test_SN5659__cal_impl.Setup_P5 speedgoat_test_SN5659__cal_impl.Write_P1 speedgoat_test_SN5659__cal_impl.Write_P2 speedgoat_test_SN5659__cal_impl.Write_P3 speedgoat_test_SN5659__cal_impl.Write_P4 /end REF_CHARACTERISTIC
 /begin REF_MEASUREMENT speedgoat_test_SN5659_R2021b_B.IO204_CH1 speedgoat_test_SN5659_R2021b_B.IO204_CH11 speedgoat_test_SN5659_R2021b_B.IO204_CH16 speedgoat_test_SN5659_R2021b_B.IO204_CH6 speedgoat_test_SN5659_R2021b_B.PulseGenerator_k speedgoat_test_SN5659_R2021b_B.Read_o11 speedgoat_test_SN5659_R2021b_B.Read_o16 speedgoat_test_SN5659_R2021b_B.Read_o6 speedgoat_test_SN5659_R2021b_DW.Read_PWORK speedgoat_test_SN5659_R2021b_DW.ScopexPC_PWORK speedgoat_test_SN5659_R2021b_DW.Setup_PWORK speedgoat_test_SN5659_R2021b_DW.Write_PWORK speedgoat_test_SN5659_R2021b_DW.clockTickCounter_b /end REF_MEASUREMENT
/end GROUP
/begin GROUP speedgoat_test_SN5659_R2021b_IO421_1 "speedgoat_test_SN5659_R2021b/IO421-1"
 /begin REF_CHARACTERISTIC speedgoat_test_SN5659__cal_impl.LVDTread1_P1 speedgoat_test_SN5659__cal_impl.LVDTread1_P2 speedgoat_test_SN5659__cal_impl.LVDTread1_P3 speedgoat_test_SN5659__cal_impl.LVDTread1_P4 speedgoat_test_SN5659__cal_impl.LVDTread1_P5 speedgoat_test_SN5659__cal_impl.LVDTread1_P6 speedgoat_test_SN5659__cal_impl.LVDTread1_P7 speedgoat_test_SN5659__cal_impl.LVDTread1_P8 speedgoat_test_SN5659__cal_impl.LVDTread_P1 speedgoat_test_SN5659__cal_impl.LVDTread_P2 speedgoat_test_SN5659__cal_impl.LVDTread_P3 speedgoat_test_SN5659__cal_impl.LVDTread_P4 speedgoat_test_SN5659__cal_impl.LVDTread_P5 speedgoat_test_SN5659__cal_impl.LVDTread_P6 speedgoat_test_SN5659__cal_impl.LVDTread_P7 speedgoat_test_SN5659__cal_impl.LVDTread_P8 speedgoat_test_SN5659__cal_impl.REF_P1 speedgoat_test_SN5659__cal_impl.REF_P2 speedgoat_test_SN5659__cal_impl.REF_P3 speedgoat_test_SN5659__cal_impl.REF_P4 speedgoat_test_SN5659__cal_impl.REF_P5 /end REF_CHARACTERISTIC
 /begin REF_MEASUREMENT speedgoat_test_SN5659_R2021b_B.IO421_LVDT_POS1 speedgoat_test_SN5659_R2021b_B.IO421_LVDT_POS2 speedgoat_test_SN5659_R2021b_DW.LVDTread1_PWORK speedgoat_test_SN5659_R2021b_DW.LVDTread_PWORK speedgoat_test_SN5659_R2021b_DW.REF_PWORK speedgoat_test_SN5659_R2021b_DW.Scope1_PWORK speedgoat_test_SN5659_R2021b_DW.Scope_PWORK_p /end REF_MEASUREMENT
/end GROUP
/begin GROUP speedgoat_test_SN5659_R2021b_IO612 "speedgoat_test_SN5659_R2021b/IO612"
 /begin SUB_GROUP speedgoat_test_SN5659_R2021b_IO612_CAN_Read_Loop___Port_3 speedgoat_test_SN5659_R2021b_IO612_CAN_Read_Loop___Port_4 /end SUB_GROUP
 /begin REF_CHARACTERISTIC speedgoat_test_SN5659__cal_impl.CANSetup_P1 speedgoat_test_SN5659__cal_impl.CANSetup_P10 speedgoat_test_SN5659__cal_impl.CANSetup_P11 speedgoat_test_SN5659__cal_impl.CANSetup_P12 speedgoat_test_SN5659__cal_impl.CANSetup_P13 speedgoat_test_SN5659__cal_impl.CANSetup_P14 speedgoat_test_SN5659__cal_impl.CANSetup_P15 speedgoat_test_SN5659__cal_impl.CANSetup_P16 speedgoat_test_SN5659__cal_impl.CANSetup_P17 speedgoat_test_SN5659__cal_impl.CANSetup_P18 speedgoat_test_SN5659__cal_impl.CANSetup_P19 speedgoat_test_SN5659__cal_impl.CANSetup_P2 speedgoat_test_SN5659__cal_impl.CANSetup_P20 speedgoat_test_SN5659__cal_impl.CANSetup_P21 speedgoat_test_SN5659__cal_impl.CANSetup_P22 speedgoat_test_SN5659__cal_impl.CANSetup_P23 speedgoat_test_SN5659__cal_impl.CANSetup_P24 speedgoat_test_SN5659__cal_impl.CANSetup_P25 speedgoat_test_SN5659__cal_impl.CANSetup_P26 speedgoat_test_SN5659__cal_impl.CANSetup_P27 speedgoat_test_SN5659__cal_impl.CANSetup_P28 speedgoat_test_SN5659__cal_impl.CANSetup_P29 speedgoat_test_SN5659__cal_impl.CANSetup_P3 speedgoat_test_SN5659__cal_impl.CANSetup_P30 speedgoat_test_SN5659__cal_impl.CANSetup_P31 speedgoat_test_SN5659__cal_impl.CANSetup_P4 speedgoat_test_SN5659__cal_impl.CANSetup_P5 speedgoat_test_SN5659__cal_impl.CANSetup_P6 speedgoat_test_SN5659__cal_impl.CANSetup_P7 speedgoat_test_SN5659__cal_impl.CANSetup_P8 speedgoat_test_SN5659__cal_impl.CANSetup_P9 speedgoat_test_SN5659__cal_impl.CANWrite1_P1 speedgoat_test_SN5659__cal_impl.CANWrite1_P2 speedgoat_test_SN5659__cal_impl.CANWrite1_P3 speedgoat_test_SN5659__cal_impl.CANWrite1_P4 speedgoat_test_SN5659__cal_impl.CANWrite1_P5 speedgoat_test_SN5659__cal_impl.CANWrite1_P6 speedgoat_test_SN5659__cal_impl.CANWrite1_P7 speedgoat_test_SN5659__cal_impl.CANWrite1_P8 speedgoat_test_SN5659__cal_impl.CANWrite2_P1 speedgoat_test_SN5659__cal_impl.CANWrite2_P2 speedgoat_test_SN5659__cal_impl.CANWrite2_P3 speedgoat_test_SN5659__cal_impl.CANWrite2_P4 speedgoat_test_SN5659__cal_impl.CANWrite2_P5 speedgoat_test_SN5659__cal_impl.CANWrite2_P6 speedgoat_test_SN5659__cal_impl.CANWrite2_P7 speedgoat_test_SN5659__cal_impl.CANWrite2_P8 speedgoat_test_SN5659__cal_impl.CANWrite3_P1 speedgoat_test_SN5659__cal_impl.CANWrite3_P2 speedgoat_test_SN5659__cal_impl.CANWrite3_P3 speedgoat_test_SN5659__cal_impl.CANWrite3_P4 speedgoat_test_SN5659__cal_impl.CANWrite3_P5 speedgoat_test_SN5659__cal_impl.CANWrite3_P6 speedgoat_test_SN5659__cal_impl.CANWrite3_P7 speedgoat_test_SN5659__cal_impl.CANWrite3_P8 speedgoat_test_SN5659__cal_impl.CANWrite4_P1 speedgoat_test_SN5659__cal_impl.CANWrite4_P2 speedgoat_test_SN5659__cal_impl.CANWrite4_P3 speedgoat_test_SN5659__cal_impl.CANWrite4_P4 speedgoat_test_SN5659__cal_impl.CANWrite4_P5 speedgoat_test_SN5659__cal_impl.CANWrite4_P6 speedgoat_test_SN5659__cal_impl.CANWrite4_P7 speedgoat_test_SN5659__cal_impl.CANWrite4_P8 speedgoat_test_SN5659__cal_impl.CANWrite5_P1 speedgoat_test_SN5659__cal_impl.CANWrite5_P2 speedgoat_test_SN5659__cal_impl.CANWrite5_P3 speedgoat_test_SN5659__cal_impl.CANWrite5_P4 speedgoat_test_SN5659__cal_impl.CANWrite5_P5 speedgoat_test_SN5659__cal_impl.CANWrite5_P6 speedgoat_test_SN5659__cal_impl.CANWrite5_P7 speedgoat_test_SN5659__cal_impl.CANWrite5_P8 speedgoat_test_SN5659__cal_impl.CANWrite_P1 speedgoat_test_SN5659__cal_impl.CANWrite_P2 speedgoat_test_SN5659__cal_impl.CANWrite_P3 speedgoat_test_SN5659__cal_impl.CANWrite_P4 speedgoat_test_SN5659__cal_impl.CANWrite_P5 speedgoat_test_SN5659__cal_impl.CANWrite_P6 speedgoat_test_SN5659__cal_impl.CANWrite_P7 speedgoat_test_SN5659__cal_impl.CANWrite_P8 speedgoat_test_SN5659__cal_impl.RXSampleTime1_Value speedgoat_test_SN5659__cal_impl.RXSampleTime_Value speedgoat_test_SN5659__cal_impl.SineWave1_Amp speedgoat_test_SN5659__cal_impl.SineWave1_Bias speedgoat_test_SN5659__cal_impl.SineWave1_Freq speedgoat_test_SN5659__cal_impl.SineWave1_HCos speedgoat_test_SN5659__cal_impl.SineWave1_Hsin speedgoat_test_SN5659__cal_impl.SineWave1_PCos speedgoat_test_SN5659__cal_impl.SineWave1_PSin speedgoat_test_SN5659__cal_impl.SineWave2_Amp speedgoat_test_SN5659__cal_impl.SineWave2_Bias speedgoat_test_SN5659__cal_impl.SineWave2_Freq speedgoat_test_SN5659__cal_impl.SineWave2_HCos speedgoat_test_SN5659__cal_impl.SineWave2_Hsin speedgoat_test_SN5659__cal_impl.SineWave2_PCos speedgoat_test_SN5659__cal_impl.SineWave2_PSin speedgoat_test_SN5659__cal_impl.SineWave3_Amp speedgoat_test_SN5659__cal_impl.SineWave3_Bias speedgoat_test_SN5659__cal_impl.SineWave3_Freq speedgoat_test_SN5659__cal_impl.SineWave3_HCos speedgoat_test_SN5659__cal_impl.SineWave3_Hsin speedgoat_test_SN5659__cal_impl.SineWave3_PCos speedgoat_test_SN5659__cal_impl.SineWave3_PSin speedgoat_test_SN5659__cal_impl.SineWave4_Amp speedgoat_test_SN5659__cal_impl.SineWave4_Bias speedgoat_test_SN5659__cal_impl.SineWave4_Freq speedgoat_test_SN5659__cal_impl.SineWave4_HCos speedgoat_test_SN5659__cal_impl.SineWave4_Hsin speedgoat_test_SN5659__cal_impl.SineWave4_PCos speedgoat_test_SN5659__cal_impl.SineWave4_PSin speedgoat_test_SN5659__cal_impl.SineWave5_Amp speedgoat_test_SN5659__cal_impl.SineWave5_Bias speedgoat_test_SN5659__cal_impl.SineWave5_Freq speedgoat_test_SN5659__cal_impl.SineWave5_HCos speedgoat_test_SN5659__cal_impl.SineWave5_Hsin speedgoat_test_SN5659__cal_impl.SineWave5_PCos speedgoat_test_SN5659__cal_impl.SineWave5_PSin speedgoat_test_SN5659__cal_impl.SineWave_Amp_i speedgoat_test_SN5659__cal_impl.SineWave_Bias_e speedgoat_test_SN5659__cal_impl.SineWave_Freq_k speedgoat_test_SN5659__cal_impl.SineWave_HCos speedgoat_test_SN5659__cal_impl.SineWave_Hsin speedgoat_test_SN5659__cal_impl.SineWave_PCos speedgoat_test_SN5659__cal_impl.SineWave_PSin /end REF_CHARACTERISTIC
 /begin REF_MEASUREMENT speedgoat_test_SN5659_R2021b_B.CANUnpack speedgoat_test_SN5659_R2021b_B.CANUnpack1 speedgoat_test_SN5659_R2021b_B.CANUnpack1_o speedgoat_test_SN5659_R2021b_B.CANUnpack2 speedgoat_test_SN5659_R2021b_B.CANUnpack2_j speedgoat_test_SN5659_R2021b_B.CANUnpack_c speedgoat_test_SN5659_R2021b_B.RXSampleTime speedgoat_test_SN5659_R2021b_B.RXSampleTime1 speedgoat_test_SN5659_R2021b_B.SineWave1 speedgoat_test_SN5659_R2021b_B.SineWave2 speedgoat_test_SN5659_R2021b_B.SineWave3 speedgoat_test_SN5659_R2021b_B.SineWave4 speedgoat_test_SN5659_R2021b_B.SineWave5 speedgoat_test_SN5659_R2021b_B.SineWave_e speedgoat_test_SN5659_R2021b_DW.CANPack1_ModeSignalID speedgoat_test_SN5659_R2021b_DW.CANPack2_ModeSignalID speedgoat_test_SN5659_R2021b_DW.CANPack3_ModeSignalID speedgoat_test_SN5659_R2021b_DW.CANPack4_ModeSignalID speedgoat_test_SN5659_R2021b_DW.CANPack5_ModeSignalID speedgoat_test_SN5659_R2021b_DW.CANPack_ModeSignalID speedgoat_test_SN5659_R2021b_DW.CANWrite1_PWORK speedgoat_test_SN5659_R2021b_DW.CANWrite2_PWORK speedgoat_test_SN5659_R2021b_DW.CANWrite3_PWORK speedgoat_test_SN5659_R2021b_DW.CANWrite4_PWORK speedgoat_test_SN5659_R2021b_DW.CANWrite5_PWORK speedgoat_test_SN5659_R2021b_DW.CANWrite_PWORK speedgoat_test_SN5659_R2021b_DW.Scope_PWORK speedgoat_test_SN5659_R2021b_DW.lastCos speedgoat_test_SN5659_R2021b_DW.lastCos_b speedgoat_test_SN5659_R2021b_DW.lastCos_c speedgoat_test_SN5659_R2021b_DW.lastCos_g speedgoat_test_SN5659_R2021b_DW.lastCos_i speedgoat_test_SN5659_R2021b_DW.lastCos_j speedgoat_test_SN5659_R2021b_DW.lastSin speedgoat_test_SN5659_R2021b_DW.lastSin_c speedgoat_test_SN5659_R2021b_DW.lastSin_cd speedgoat_test_SN5659_R2021b_DW.lastSin_d speedgoat_test_SN5659_R2021b_DW.lastSin_h speedgoat_test_SN5659_R2021b_DW.lastSin_i speedgoat_test_SN5659_R2021b_DW.systemEnable speedgoat_test_SN5659_R2021b_DW.systemEnable_b speedgoat_test_SN5659_R2021b_DW.systemEnable_h speedgoat_test_SN5659_R2021b_DW.systemEnable_i speedgoat_test_SN5659_R2021b_DW.systemEnable_p speedgoat_test_SN5659_R2021b_DW.systemEnable_py /end REF_MEASUREMENT
/end GROUP
/begin GROUP speedgoat_test_SN5659_R2021b_IO612_CAN_Read_Loop___Port_3 "speedgoat_test_SN5659_R2021b/IO612/CAN Read Loop - Port 3"
 /begin REF_CHARACTERISTIC speedgoat_test_SN5659__cal_impl.CANRead_P1 speedgoat_test_SN5659__cal_impl.CANRead_P2 speedgoat_test_SN5659__cal_impl.CANRead_P3 speedgoat_test_SN5659__cal_impl.CANRead_P4 speedgoat_test_SN5659__cal_impl.CANRead_P5 speedgoat_test_SN5659__cal_impl.CANRead_P6 speedgoat_test_SN5659__cal_impl.CANRead_P7 speedgoat_test_SN5659__cal_impl.ID100_Signal1_Y0 speedgoat_test_SN5659__cal_impl.ID101_Signal1_Y0 speedgoat_test_SN5659__cal_impl.ID102_Signal1_Y0 /end REF_CHARACTERISTIC
 /begin REF_MEASUREMENT speedgoat_test_SN5659_R2021b_B.CANRead_o1 speedgoat_test_SN5659_R2021b_B.CANUnpack1_o speedgoat_test_SN5659_R2021b_B.CANUnpack2_j speedgoat_test_SN5659_R2021b_B.CANUnpack_c speedgoat_test_SN5659_R2021b_DW.CANUnpack1_ModeSignalID_i speedgoat_test_SN5659_R2021b_DW.CANUnpack1_StatusPortID_o speedgoat_test_SN5659_R2021b_DW.CANUnpack2_ModeSignalID_g speedgoat_test_SN5659_R2021b_DW.CANUnpack2_StatusPortID_m speedgoat_test_SN5659_R2021b_DW.CANUnpack_ModeSignalID_b speedgoat_test_SN5659_R2021b_DW.CANUnpack_StatusPortID_g /end REF_MEASUREMENT
/end GROUP
/begin GROUP speedgoat_test_SN5659_R2021b_IO612_CAN_Read_Loop___Port_4 "speedgoat_test_SN5659_R2021b/IO612/CAN Read Loop - Port 4"
 /begin REF_CHARACTERISTIC speedgoat_test_SN5659__cal_impl.CANRead1_P1 speedgoat_test_SN5659__cal_impl.CANRead1_P2 speedgoat_test_SN5659__cal_impl.CANRead1_P3 speedgoat_test_SN5659__cal_impl.CANRead1_P4 speedgoat_test_SN5659__cal_impl.CANRead1_P5 speedgoat_test_SN5659__cal_impl.CANRead1_P6 speedgoat_test_SN5659__cal_impl.CANRead1_P7 speedgoat_test_SN5659__cal_impl.ID100_Signal1_Y0_j speedgoat_test_SN5659__cal_impl.ID101_Signal1_Y0_o speedgoat_test_SN5659__cal_impl.ID102_Signal1_Y0_i /end REF_CHARACTERISTIC
 /begin REF_MEASUREMENT speedgoat_test_SN5659_R2021b_B.CANRead1_o1 speedgoat_test_SN5659_R2021b_B.CANUnpack speedgoat_test_SN5659_R2021b_B.CANUnpack1 speedgoat_test_SN5659_R2021b_B.CANUnpack2 speedgoat_test_SN5659_R2021b_DW.CANUnpack1_ModeSignalID speedgoat_test_SN5659_R2021b_DW.CANUnpack1_StatusPortID speedgoat_test_SN5659_R2021b_DW.CANUnpack2_ModeSignalID speedgoat_test_SN5659_R2021b_DW.CANUnpack2_StatusPortID speedgoat_test_SN5659_R2021b_DW.CANUnpack_ModeSignalID speedgoat_test_SN5659_R2021b_DW.CANUnpack_StatusPortID /end REF_MEASUREMENT
/end GROUP
/begin GROUP speedgoat_test_SN5659_R2021b_IO682 "speedgoat_test_SN5659_R2021b/IO682"
 /begin SUB_GROUP speedgoat_test_SN5659_R2021b_IO682_Decode_Channel_1 speedgoat_test_SN5659_R2021b_IO682_Decode_Channel_10 speedgoat_test_SN5659_R2021b_IO682_Decode_Channel_11 speedgoat_test_SN5659_R2021b_IO682_Decode_Channel_12 speedgoat_test_SN5659_R2021b_IO682_Decode_Channel_13 speedgoat_test_SN5659_R2021b_IO682_Decode_Channel_14 speedgoat_test_SN5659_R2021b_IO682_Decode_Channel_15 speedgoat_test_SN5659_R2021b_IO682_Decode_Channel_16 speedgoat_test_SN5659_R2021b_IO682_Decode_Channel_2 speedgoat_test_SN5659_R2021b_IO682_Decode_Channel_3 speedgoat_test_SN5659_R2021b_IO682_Decode_Channel_4 speedgoat_test_SN5659_R2021b_IO682_Decode_Channel_5 speedgoat_test_SN5659_R2021b_IO682_Decode_Channel_6 speedgoat_test_SN5659_R2021b_IO682_Decode_Channel_7 speedgoat_test_SN5659_R2021b_IO682_Decode_Channel_8 speedgoat_test_SN5659_R2021b_IO682_Decode_Channel_9 speedgoat_test_SN5659_R2021b_IO682_Encode_Channel_1 speedgoat_test_SN5659_R2021b_IO682_Encode_Channel_10 speedgoat_test_SN5659_R2021b_IO682_Encode_Channel_11 speedgoat_test_SN5659_R2021b_IO682_Encode_Channel_12 speedgoat_test_SN5659_R2021b_IO682_Encode_Channel_13 speedgoat_test_SN5659_R2021b_IO682_Encode_Channel_14 speedgoat_test_SN5659_R2021b_IO682_Encode_Channel_15 speedgoat_test_SN5659_R2021b_IO682_Encode_Channel_16 speedgoat_test_SN5659_R2021b_IO682_Encode_Channel_2 speedgoat_test_SN5659_R2021b_IO682_Encode_Channel_3 speedgoat_test_SN5659_R2021b_IO682_Encode_Channel_4 speedgoat_test_SN5659_R2021b_IO682_Encode_Channel_5 speedgoat_test_SN5659_R2021b_IO682_Encode_Channel_6 speedgoat_test_SN5659_R2021b_IO682_Encode_Channel_7 speedgoat_test_SN5659_R2021b_IO682_Encode_Channel_8 speedgoat_test_SN5659_R2021b_IO682_Encode_Channel_9 /end SUB_GROUP
 /begin REF_CHARACTERISTIC speedgoat_test_SN5659__cal_impl.Receivev210_P1 speedgoat_test_SN5659__cal_impl.Receivev210_P2 speedgoat_test_SN5659__cal_impl.Receivev210_P3 speedgoat_test_SN5659__cal_impl.Receivev210_P4 speedgoat_test_SN5659__cal_impl.Receivev210_P5 speedgoat_test_SN5659__cal_impl.Receivev211_P1 speedgoat_test_SN5659__cal_impl.Receivev211_P2 speedgoat_test_SN5659__cal_impl.Receivev211_P3 speedgoat_test_SN5659__cal_impl.Receivev211_P4 speedgoat_test_SN5659__cal_impl.Receivev211_P5 speedgoat_test_SN5659__cal_impl.Receivev212_P1 speedgoat_test_SN5659__cal_impl.Receivev212_P2 speedgoat_test_SN5659__cal_impl.Receivev212_P3 speedgoat_test_SN5659__cal_impl.Receivev212_P4 speedgoat_test_SN5659__cal_impl.Receivev212_P5 speedgoat_test_SN5659__cal_impl.Receivev213_P1 speedgoat_test_SN5659__cal_impl.Receivev213_P2 speedgoat_test_SN5659__cal_impl.Receivev213_P3 speedgoat_test_SN5659__cal_impl.Receivev213_P4 speedgoat_test_SN5659__cal_impl.Receivev213_P5 speedgoat_test_SN5659__cal_impl.Receivev214_P1 speedgoat_test_SN5659__cal_impl.Receivev214_P2 speedgoat_test_SN5659__cal_impl.Receivev214_P3 speedgoat_test_SN5659__cal_impl.Receivev214_P4 speedgoat_test_SN5659__cal_impl.Receivev214_P5 speedgoat_test_SN5659__cal_impl.Receivev215_P1 speedgoat_test_SN5659__cal_impl.Receivev215_P2 speedgoat_test_SN5659__cal_impl.Receivev215_P3 speedgoat_test_SN5659__cal_impl.Receivev215_P4 speedgoat_test_SN5659__cal_impl.Receivev215_P5 speedgoat_test_SN5659__cal_impl.Receivev21_P1 speedgoat_test_SN5659__cal_impl.Receivev21_P2 speedgoat_test_SN5659__cal_impl.Receivev21_P3 speedgoat_test_SN5659__cal_impl.Receivev21_P4 speedgoat_test_SN5659__cal_impl.Receivev21_P5 speedgoat_test_SN5659__cal_impl.Receivev22_P1 speedgoat_test_SN5659__cal_impl.Receivev22_P2 speedgoat_test_SN5659__cal_impl.Receivev22_P3 speedgoat_test_SN5659__cal_impl.Receivev22_P4 speedgoat_test_SN5659__cal_impl.Receivev22_P5 speedgoat_test_SN5659__cal_impl.Receivev23_P1 speedgoat_test_SN5659__cal_impl.Receivev23_P2 speedgoat_test_SN5659__cal_impl.Receivev23_P3 speedgoat_test_SN5659__cal_impl.Receivev23_P4 speedgoat_test_SN5659__cal_impl.Receivev23_P5 speedgoat_test_SN5659__cal_impl.Receivev24_P1 speedgoat_test_SN5659__cal_impl.Receivev24_P2 speedgoat_test_SN5659__cal_impl.Receivev24_P3 speedgoat_test_SN5659__cal_impl.Receivev24_P4 speedgoat_test_SN5659__cal_impl.Receivev24_P5 speedgoat_test_SN5659__cal_impl.Receivev25_P1 speedgoat_test_SN5659__cal_impl.Receivev25_P2 speedgoat_test_SN5659__cal_impl.Receivev25_P3 speedgoat_test_SN5659__cal_impl.Receivev25_P4 speedgoat_test_SN5659__cal_impl.Receivev25_P5 speedgoat_test_SN5659__cal_impl.Receivev26_P1 speedgoat_test_SN5659__cal_impl.Receivev26_P2 speedgoat_test_SN5659__cal_impl.Receivev26_P3 speedgoat_test_SN5659__cal_impl.Receivev26_P4 speedgoat_test_SN5659__cal_impl.Receivev26_P5 speedgoat_test_SN5659__cal_impl.Receivev27_P1 speedgoat_test_SN5659__cal_impl.Receivev27_P2 speedgoat_test_SN5659__cal_impl.Receivev27_P3 speedgoat_test_SN5659__cal_impl.Receivev27_P4 speedgoat_test_SN5659__cal_impl.Receivev27_P5 speedgoat_test_SN5659__cal_impl.Receivev28_P1 speedgoat_test_SN5659__cal_impl.Receivev28_P2 speedgoat_test_SN5659__cal_impl.Receivev28_P3 speedgoat_test_SN5659__cal_impl.Receivev28_P4 speedgoat_test_SN5659__cal_impl.Receivev28_P5 speedgoat_test_SN5659__cal_impl.Receivev29_P1 speedgoat_test_SN5659__cal_impl.Receivev29_P2 speedgoat_test_SN5659__cal_impl.Receivev29_P3 speedgoat_test_SN5659__cal_impl.Receivev29_P4 speedgoat_test_SN5659__cal_impl.Receivev29_P5 speedgoat_test_SN5659__cal_impl.Receivev2_P1 speedgoat_test_SN5659__cal_impl.Receivev2_P2 speedgoat_test_SN5659__cal_impl.Receivev2_P3 speedgoat_test_SN5659__cal_impl.Receivev2_P4 speedgoat_test_SN5659__cal_impl.Receivev2_P5 speedgoat_test_SN5659__cal_impl.Sendv210_P1 speedgoat_test_SN5659__cal_impl.Sendv210_P2 speedgoat_test_SN5659__cal_impl.Sendv210_P3 speedgoat_test_SN5659__cal_impl.Sendv211_P1 speedgoat_test_SN5659__cal_impl.Sendv211_P2 speedgoat_test_SN5659__cal_impl.Sendv211_P3 speedgoat_test_SN5659__cal_impl.Sendv212_P1 speedgoat_test_SN5659__cal_impl.Sendv212_P2 speedgoat_test_SN5659__cal_impl.Sendv212_P3 speedgoat_test_SN5659__cal_impl.Sendv213_P1 speedgoat_test_SN5659__cal_impl.Sendv213_P2 speedgoat_test_SN5659__cal_impl.Sendv213_P3 speedgoat_test_SN5659__cal_impl.Sendv214_P1 speedgoat_test_SN5659__cal_impl.Sendv214_P2 speedgoat_test_SN5659__cal_impl.Sendv214_P3 speedgoat_test_SN5659__cal_impl.Sendv215_P1 speedgoat_test_SN5659__cal_impl.Sendv215_P2 speedgoat_test_SN5659__cal_impl.Sendv215_P3 speedgoat_test_SN5659__cal_impl.Sendv21_P1 speedgoat_test_SN5659__cal_impl.Sendv21_P2 speedgoat_test_SN5659__cal_impl.Sendv21_P3 speedgoat_test_SN5659__cal_impl.Sendv22_P1 speedgoat_test_SN5659__cal_impl.Sendv22_P2 speedgoat_test_SN5659__cal_impl.Sendv22_P3 speedgoat_test_SN5659__cal_impl.Sendv23_P1 speedgoat_test_SN5659__cal_impl.Sendv23_P2 speedgoat_test_SN5659__cal_impl.Sendv23_P3 speedgoat_test_SN5659__cal_impl.Sendv24_P1 speedgoat_test_SN5659__cal_impl.Sendv24_P2 speedgoat_test_SN5659__cal_impl.Sendv24_P3 speedgoat_test_SN5659__cal_impl.Sendv25_P1 speedgoat_test_SN5659__cal_impl.Sendv25_P2 speedgoat_test_SN5659__cal_impl.Sendv25_P3 speedgoat_test_SN5659__cal_impl.Sendv26_P1 speedgoat_test_SN5659__cal_impl.Sendv26_P2 speedgoat_test_SN5659__cal_impl.Sendv26_P3 speedgoat_test_SN5659__cal_impl.Sendv27_P1 speedgoat_test_SN5659__cal_impl.Sendv27_P2 speedgoat_test_SN5659__cal_impl.Sendv27_P3 speedgoat_test_SN5659__cal_impl.Sendv28_P1 speedgoat_test_SN5659__cal_impl.Sendv28_P2 speedgoat_test_SN5659__cal_impl.Sendv28_P3 speedgoat_test_SN5659__cal_impl.Sendv29_P1 speedgoat_test_SN5659__cal_impl.Sendv29_P2 speedgoat_test_SN5659__cal_impl.Sendv29_P3 speedgoat_test_SN5659__cal_impl.Sendv2_P1 speedgoat_test_SN5659__cal_impl.Sendv2_P2 speedgoat_test_SN5659__cal_impl.Sendv2_P3 speedgoat_test_SN5659__cal_impl.Setupv2_P1_p speedgoat_test_SN5659__cal_impl.Setupv2_P2_h speedgoat_test_SN5659__cal_impl.Setupv2_P3_o speedgoat_test_SN5659__cal_impl.Setupv2_P4_p speedgoat_test_SN5659__cal_impl.Setupv2_P5_p speedgoat_test_SN5659__cal_impl.Setupv2_P6_a speedgoat_test_SN5659__cal_impl.Setupv2_P7_c speedgoat_test_SN5659__cal_impl.Setupv2_P8_o /end REF_CHARACTERISTIC
 /begin REF_MEASUREMENT speedgoat_test_SN5659_R2021b_B.IO682_SerialIN_CH1 speedgoat_test_SN5659_R2021b_B.IO682_SerialIN_CH10 speedgoat_test_SN5659_R2021b_B.IO682_SerialIN_CH11 speedgoat_test_SN5659_R2021b_B.IO682_SerialIN_CH12 speedgoat_test_SN5659_R2021b_B.IO682_SerialIN_CH13 speedgoat_test_SN5659_R2021b_B.IO682_SerialIN_CH14 speedgoat_test_SN5659_R2021b_B.IO682_SerialIN_CH15 speedgoat_test_SN5659_R2021b_B.IO682_SerialIN_CH16 speedgoat_test_SN5659_R2021b_B.IO682_SerialIN_CH2 speedgoat_test_SN5659_R2021b_B.IO682_SerialIN_CH3 speedgoat_test_SN5659_R2021b_B.IO682_SerialIN_CH4 speedgoat_test_SN5659_R2021b_B.IO682_SerialIN_CH5 speedgoat_test_SN5659_R2021b_B.IO682_SerialIN_CH6 speedgoat_test_SN5659_R2021b_B.IO682_SerialIN_CH7 speedgoat_test_SN5659_R2021b_B.IO682_SerialIN_CH8 speedgoat_test_SN5659_R2021b_B.IO682_SerialIN_CH9 speedgoat_test_SN5659_R2021b_B.Receivev2 speedgoat_test_SN5659_R2021b_B.Receivev21 speedgoat_test_SN5659_R2021b_B.Receivev210 speedgoat_test_SN5659_R2021b_B.Receivev211 speedgoat_test_SN5659_R2021b_B.Receivev212 speedgoat_test_SN5659_R2021b_B.Receivev213 speedgoat_test_SN5659_R2021b_B.Receivev214 speedgoat_test_SN5659_R2021b_B.Receivev215 speedgoat_test_SN5659_R2021b_B.Receivev22 speedgoat_test_SN5659_R2021b_B.Receivev23 speedgoat_test_SN5659_R2021b_B.Receivev24 speedgoat_test_SN5659_R2021b_B.Receivev25 speedgoat_test_SN5659_R2021b_B.Receivev26 speedgoat_test_SN5659_R2021b_B.Receivev27 speedgoat_test_SN5659_R2021b_B.Receivev28 speedgoat_test_SN5659_R2021b_B.Receivev29 speedgoat_test_SN5659_R2021b_DW.Receivev210_PWORK speedgoat_test_SN5659_R2021b_DW.Receivev211_PWORK speedgoat_test_SN5659_R2021b_DW.Receivev212_PWORK speedgoat_test_SN5659_R2021b_DW.Receivev213_PWORK speedgoat_test_SN5659_R2021b_DW.Receivev214_PWORK speedgoat_test_SN5659_R2021b_DW.Receivev215_PWORK speedgoat_test_SN5659_R2021b_DW.Receivev21_PWORK speedgoat_test_SN5659_R2021b_DW.Receivev22_PWORK speedgoat_test_SN5659_R2021b_DW.Receivev23_PWORK speedgoat_test_SN5659_R2021b_DW.Receivev24_PWORK speedgoat_test_SN5659_R2021b_DW.Receivev25_PWORK speedgoat_test_SN5659_R2021b_DW.Receivev26_PWORK speedgoat_test_SN5659_R2021b_DW.Receivev27_PWORK speedgoat_test_SN5659_R2021b_DW.Receivev28_PWORK speedgoat_test_SN5659_R2021b_DW.Receivev29_PWORK speedgoat_test_SN5659_R2021b_DW.Receivev2_PWORK speedgoat_test_SN5659_R2021b_DW.Scope10_PWORK speedgoat_test_SN5659_R2021b_DW.Scope11_PWORK speedgoat_test_SN5659_R2021b_DW.Scope4_PWORK_l speedgoat_test_SN5659_R2021b_DW.Scope5_PWORK speedgoat_test_SN5659_R2021b_DW.Scope6_PWORK speedgoat_test_SN5659_R2021b_DW.Scope7_PWORK speedgoat_test_SN5659_R2021b_DW.Scope8_PWORK speedgoat_test_SN5659_R2021b_DW.Scope9_PWORK speedgoat_test_SN5659_R2021b_DW.Sendv210_PWORK speedgoat_test_SN5659_R2021b_DW.Sendv211_PWORK speedgoat_test_SN5659_R2021b_DW.Sendv212_PWORK speedgoat_test_SN5659_R2021b_DW.Sendv213_PWORK speedgoat_test_SN5659_R2021b_DW.Sendv214_PWORK speedgoat_test_SN5659_R2021b_DW.Sendv215_PWORK speedgoat_test_SN5659_R2021b_DW.Sendv21_PWORK speedgoat_test_SN5659_R2021b_DW.Sendv22_PWORK speedgoat_test_SN5659_R2021b_DW.Sendv23_PWORK speedgoat_test_SN5659_R2021b_DW.Sendv24_PWORK speedgoat_test_SN5659_R2021b_DW.Sendv25_PWORK speedgoat_test_SN5659_R2021b_DW.Sendv26_PWORK speedgoat_test_SN5659_R2021b_DW.Sendv27_PWORK speedgoat_test_SN5659_R2021b_DW.Sendv28_PWORK speedgoat_test_SN5659_R2021b_DW.Sendv29_PWORK speedgoat_test_SN5659_R2021b_DW.Sendv2_PWORK speedgoat_test_SN5659_R2021b_DW.Setupv2_PWORK /end REF_MEASUREMENT
/end GROUP
/begin GROUP speedgoat_test_SN5659_R2021b_IO682_Decode_Channel_1 "speedgoat_test_SN5659_R2021b/IO682/Decode Channel 1"
 /begin REF_CHARACTERISTIC speedgoat_test_SN5659__cal_impl.Decode1_P1 speedgoat_test_SN5659__cal_impl.Decode1_P10 speedgoat_test_SN5659__cal_impl.Decode1_P11 speedgoat_test_SN5659__cal_impl.Decode1_P12 speedgoat_test_SN5659__cal_impl.Decode1_P13 speedgoat_test_SN5659__cal_impl.Decode1_P14 speedgoat_test_SN5659__cal_impl.Decode1_P15 speedgoat_test_SN5659__cal_impl.Decode1_P16 speedgoat_test_SN5659__cal_impl.Decode1_P2 speedgoat_test_SN5659__cal_impl.Decode1_P3 speedgoat_test_SN5659__cal_impl.Decode1_P4 speedgoat_test_SN5659__cal_impl.Decode1_P5 speedgoat_test_SN5659__cal_impl.Decode1_P6 speedgoat_test_SN5659__cal_impl.Decode1_P7 speedgoat_test_SN5659__cal_impl.Decode1_P8 speedgoat_test_SN5659__cal_impl.Decode1_P9 speedgoat_test_SN5659__cal_impl.Decode3_P1 speedgoat_test_SN5659__cal_impl.Decode3_P10 speedgoat_test_SN5659__cal_impl.Decode3_P11 speedgoat_test_SN5659__cal_impl.Decode3_P12 speedgoat_test_SN5659__cal_impl.Decode3_P13 speedgoat_test_SN5659__cal_impl.Decode3_P14 speedgoat_test_SN5659__cal_impl.Decode3_P15 speedgoat_test_SN5659__cal_impl.Decode3_P16 speedgoat_test_SN5659__cal_impl.Decode3_P2 speedgoat_test_SN5659__cal_impl.Decode3_P3 speedgoat_test_SN5659__cal_impl.Decode3_P4 speedgoat_test_SN5659__cal_impl.Decode3_P5 speedgoat_test_SN5659__cal_impl.Decode3_P6 speedgoat_test_SN5659__cal_impl.Decode3_P7 speedgoat_test_SN5659__cal_impl.Decode3_P8 speedgoat_test_SN5659__cal_impl.Decode3_P9 speedgoat_test_SN5659__cal_impl.Decode4_P1 speedgoat_test_SN5659__cal_impl.Decode4_P10 speedgoat_test_SN5659__cal_impl.Decode4_P11 speedgoat_test_SN5659__cal_impl.Decode4_P12 speedgoat_test_SN5659__cal_impl.Decode4_P13 speedgoat_test_SN5659__cal_impl.Decode4_P14 speedgoat_test_SN5659__cal_impl.Decode4_P15 speedgoat_test_SN5659__cal_impl.Decode4_P16 speedgoat_test_SN5659__cal_impl.Decode4_P2 speedgoat_test_SN5659__cal_impl.Decode4_P3 speedgoat_test_SN5659__cal_impl.Decode4_P4 speedgoat_test_SN5659__cal_impl.Decode4_P5 speedgoat_test_SN5659__cal_impl.Decode4_P6 speedgoat_test_SN5659__cal_impl.Decode4_P7 speedgoat_test_SN5659__cal_impl.Decode4_P8 speedgoat_test_SN5659__cal_impl.Decode4_P9 speedgoat_test_SN5659__cal_impl.Decode5_P1 speedgoat_test_SN5659__cal_impl.Decode5_P10 speedgoat_test_SN5659__cal_impl.Decode5_P11 speedgoat_test_SN5659__cal_impl.Decode5_P12 speedgoat_test_SN5659__cal_impl.Decode5_P13 speedgoat_test_SN5659__cal_impl.Decode5_P14 speedgoat_test_SN5659__cal_impl.Decode5_P15 speedgoat_test_SN5659__cal_impl.Decode5_P16 speedgoat_test_SN5659__cal_impl.Decode5_P2 speedgoat_test_SN5659__cal_impl.Decode5_P3 speedgoat_test_SN5659__cal_impl.Decode5_P4 speedgoat_test_SN5659__cal_impl.Decode5_P5 speedgoat_test_SN5659__cal_impl.Decode5_P6 speedgoat_test_SN5659__cal_impl.Decode5_P7 speedgoat_test_SN5659__cal_impl.Decode5_P8 speedgoat_test_SN5659__cal_impl.Decode5_P9 /end REF_CHARACTERISTIC
 /begin REF_MEASUREMENT speedgoat_test_SN5659_R2021b_B.Decode1 speedgoat_test_SN5659_R2021b_B.Decode3 speedgoat_test_SN5659_R2021b_B.Decode4 speedgoat_test_SN5659_R2021b_B.Decode5 speedgoat_test_SN5659_R2021b_B.Receivev2 /end REF_MEASUREMENT
/end GROUP
/begin GROUP speedgoat_test_SN5659_R2021b_IO682_Decode_Channel_10 "speedgoat_test_SN5659_R2021b/IO682/Decode Channel 10" /begin REF_MEASUREMENT speedgoat_test_SN5659_R2021b_B.Receivev29 /end REF_MEASUREMENT /end GROUP
/begin GROUP speedgoat_test_SN5659_R2021b_IO682_Decode_Channel_11 "speedgoat_test_SN5659_R2021b/IO682/Decode Channel 11" /begin REF_MEASUREMENT speedgoat_test_SN5659_R2021b_B.Receivev210 /end REF_MEASUREMENT /end GROUP
/begin GROUP speedgoat_test_SN5659_R2021b_IO682_Decode_Channel_12 "speedgoat_test_SN5659_R2021b/IO682/Decode Channel 12" /begin REF_MEASUREMENT speedgoat_test_SN5659_R2021b_B.Receivev211 /end REF_MEASUREMENT /end GROUP
/begin GROUP speedgoat_test_SN5659_R2021b_IO682_Decode_Channel_13 "speedgoat_test_SN5659_R2021b/IO682/Decode Channel 13" /begin REF_MEASUREMENT speedgoat_test_SN5659_R2021b_B.Receivev212 /end REF_MEASUREMENT /end GROUP
/begin GROUP speedgoat_test_SN5659_R2021b_IO682_Decode_Channel_14 "speedgoat_test_SN5659_R2021b/IO682/Decode Channel 14" /begin REF_MEASUREMENT speedgoat_test_SN5659_R2021b_B.Receivev213 /end REF_MEASUREMENT /end GROUP
/begin GROUP speedgoat_test_SN5659_R2021b_IO682_Decode_Channel_15 "speedgoat_test_SN5659_R2021b/IO682/Decode Channel 15" /begin REF_MEASUREMENT speedgoat_test_SN5659_R2021b_B.Receivev214 /end REF_MEASUREMENT /end GROUP
/begin GROUP speedgoat_test_SN5659_R2021b_IO682_Decode_Channel_16 "speedgoat_test_SN5659_R2021b/IO682/Decode Channel 16" /begin REF_MEASUREMENT speedgoat_test_SN5659_R2021b_B.Receivev215 /end REF_MEASUREMENT /end GROUP
/begin GROUP speedgoat_test_SN5659_R2021b_IO682_Decode_Channel_2 "speedgoat_test_SN5659_R2021b/IO682/Decode Channel 2" /begin REF_MEASUREMENT speedgoat_test_SN5659_R2021b_B.Receivev21 /end REF_MEASUREMENT /end GROUP
/begin GROUP speedgoat_test_SN5659_R2021b_IO682_Decode_Channel_3 "speedgoat_test_SN5659_R2021b/IO682/Decode Channel 3" /begin REF_MEASUREMENT speedgoat_test_SN5659_R2021b_B.Receivev22 /end REF_MEASUREMENT /end GROUP
/begin GROUP speedgoat_test_SN5659_R2021b_IO682_Decode_Channel_4 "speedgoat_test_SN5659_R2021b/IO682/Decode Channel 4" /begin REF_MEASUREMENT speedgoat_test_SN5659_R2021b_B.Receivev23 /end REF_MEASUREMENT /end GROUP
/begin GROUP speedgoat_test_SN5659_R2021b_IO682_Decode_Channel_5 "speedgoat_test_SN5659_R2021b/IO682/Decode Channel 5" /begin REF_MEASUREMENT speedgoat_test_SN5659_R2021b_B.Receivev24 /end REF_MEASUREMENT /end GROUP
/begin GROUP speedgoat_test_SN5659_R2021b_IO682_Decode_Channel_6 "speedgoat_test_SN5659_R2021b/IO682/Decode Channel 6" /begin REF_MEASUREMENT speedgoat_test_SN5659_R2021b_B.Receivev25 /end REF_MEASUREMENT /end GROUP
/begin GROUP speedgoat_test_SN5659_R2021b_IO682_Decode_Channel_7 "speedgoat_test_SN5659_R2021b/IO682/Decode Channel 7" /begin REF_MEASUREMENT speedgoat_test_SN5659_R2021b_B.Receivev26 /end REF_MEASUREMENT /end GROUP
/begin GROUP speedgoat_test_SN5659_R2021b_IO682_Decode_Channel_8 "speedgoat_test_SN5659_R2021b/IO682/Decode Channel 8" /begin REF_MEASUREMENT speedgoat_test_SN5659_R2021b_B.Receivev27 /end REF_MEASUREMENT /end GROUP
/begin GROUP speedgoat_test_SN5659_R2021b_IO682_Decode_Channel_9 "speedgoat_test_SN5659_R2021b/IO682/Decode Channel 9" /begin REF_MEASUREMENT speedgoat_test_SN5659_R2021b_B.Receivev28 /end REF_MEASUREMENT /end GROUP
/end MODULE
/end PROJECT
