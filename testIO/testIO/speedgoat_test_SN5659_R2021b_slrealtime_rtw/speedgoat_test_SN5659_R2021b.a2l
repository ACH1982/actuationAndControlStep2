ASAP2_VERSION 1 71
/begin PROJECT ProjectName "Project Comment Goes Here"
/begin HEADER "Header Comments go here" /end HEADER
/begin MODULE ModuleName "Module Comment Goes Here"
/begin MOD_COMMON "Mod Common Comment Here" BYTE_ORDER MSB_LAST ALIGNMENT_BYTE 1 ALIGNMENT_WORD 2 ALIGNMENT_LONG 4 ALIGNMENT_FLOAT32_IEEE 4 ALIGNMENT_FLOAT64_IEEE 8 ALIGNMENT_INT64 8 /end MOD_COMMON
/begin CHARACTERISTIC speedgoat_test_SN5659__cal_impl.Constant_Value_b2 "" VALUE 0x008E4DD2 Scalar_UWORD 0 speedgoat_test_SN5659_R2021b_CM_uint16 0 65535 /end CHARACTERISTIC
/begin CHARACTERISTIC speedgoat_test_SN5659__cal_impl.Constant_Value_b5 "" VALUE 0x008E40C0 Scalar_FLOAT64_IEEE 0 speedgoat_test_SN5659_R2021b_CM_double -1.7E+308 1.7E+308 /end CHARACTERISTIC
/begin CHARACTERISTIC speedgoat_test_SN5659__cal_impl.Constant_Value_bz "" VALUE 0x008E3A50 Scalar_FLOAT64_IEEE 0 speedgoat_test_SN5659_R2021b_CM_double -1.7E+308 1.7E+308 /end CHARACTERISTIC
/begin CHARACTERISTIC speedgoat_test_SN5659__cal_impl.Constant_Value_f "" VALUE 0x008E33E0 Scalar_FLOAT64_IEEE 0 speedgoat_test_SN5659_R2021b_CM_double -1.7E+308 1.7E+308 /end CHARACTERISTIC
/begin CHARACTERISTIC speedgoat_test_SN5659__cal_impl.Constant_Value_gg "" VALUE 0x008E2700 Scalar_FLOAT64_IEEE 0 speedgoat_test_SN5659_R2021b_CM_double -1.7E+308 1.7E+308 /end CHARACTERISTIC
/begin CHARACTERISTIC speedgoat_test_SN5659__cal_impl.Constant_Value_h "" VALUE 0x008E2D70 Scalar_FLOAT64_IEEE 0 speedgoat_test_SN5659_R2021b_CM_double -1.7E+308 1.7E+308 /end CHARACTERISTIC
/begin CHARACTERISTIC speedgoat_test_SN5659__cal_impl.Constant_Value_le "" VALUE 0x008E4730 Scalar_FLOAT64_IEEE 0 speedgoat_test_SN5659_R2021b_CM_double -1.7E+308 1.7E+308 /end CHARACTERISTIC
/begin CHARACTERISTIC speedgoat_test_SN5659__cal_impl.Constant_Value_ly "" VALUE 0x008E4DB4 Scalar_UWORD 0 speedgoat_test_SN5659_R2021b_CM_uint16 0 65535 /end CHARACTERISTIC
/begin CHARACTERISTIC speedgoat_test_SN5659__cal_impl.Constant_Value_ng "" VALUE 0x008E4DBA Scalar_UWORD 0 speedgoat_test_SN5659_R2021b_CM_uint16 0 65535 /end CHARACTERISTIC
/begin CHARACTERISTIC speedgoat_test_SN5659__cal_impl.Constant_Value_oy "" VALUE 0x008E4DC0 Scalar_UWORD 0 speedgoat_test_SN5659_R2021b_CM_uint16 0 65535 /end CHARACTERISTIC
/begin CHARACTERISTIC speedgoat_test_SN5659__cal_impl.Constant_Value_pl "" VALUE 0x008E4DC6 Scalar_UWORD 0 speedgoat_test_SN5659_R2021b_CM_uint16 0 65535 /end CHARACTERISTIC
/begin CHARACTERISTIC speedgoat_test_SN5659__cal_impl.Constant_Value_pv "" VALUE 0x008E4DCC Scalar_UWORD 0 speedgoat_test_SN5659_R2021b_CM_uint16 0 65535 /end CHARACTERISTIC
/begin CHARACTERISTIC speedgoat_test_SN5659__cal_impl.CounterLimited_uplimit_a "" VALUE 0x008D507A Scalar_UWORD 0 speedgoat_test_SN5659_R2021b_CM_uint16 0 65535 /end CHARACTERISTIC
/begin CHARACTERISTIC speedgoat_test_SN5659__cal_impl.CounterLimited_uplimit_b "" VALUE 0x008D5078 Scalar_UWORD 0 speedgoat_test_SN5659_R2021b_CM_uint16 0 65535 /end CHARACTERISTIC
/begin CHARACTERISTIC speedgoat_test_SN5659__cal_impl.CounterLimited_uplimit_ck "" VALUE 0x008D5072 Scalar_UWORD 0 speedgoat_test_SN5659_R2021b_CM_uint16 0 65535 /end CHARACTERISTIC
/begin CHARACTERISTIC speedgoat_test_SN5659__cal_impl.CounterLimited_uplimit_du "" VALUE 0x008D5076 Scalar_UWORD 0 speedgoat_test_SN5659_R2021b_CM_uint16 0 65535 /end CHARACTERISTIC
/begin CHARACTERISTIC speedgoat_test_SN5659__cal_impl.CounterLimited_uplimit_l "" VALUE 0x008D5074 Scalar_UWORD 0 speedgoat_test_SN5659_R2021b_CM_uint16 0 65535 /end CHARACTERISTIC
/begin CHARACTERISTIC speedgoat_test_SN5659__cal_impl.CounterLimited_uplimit_p "" VALUE 0x008D5070 Scalar_UWORD 0 speedgoat_test_SN5659_R2021b_CM_uint16 0 65535 /end CHARACTERISTIC
/begin CHARACTERISTIC speedgoat_test_SN5659__cal_impl.Encode1_P10_d "" VALUE 0x008E4390 Scalar_FLOAT64_IEEE 0 speedgoat_test_SN5659_R2021b_CM_double -1.7E+308 1.7E+308 /end CHARACTERISTIC
/begin CHARACTERISTIC speedgoat_test_SN5659__cal_impl.Encode1_P10_g "" VALUE 0x008E29D0 Scalar_FLOAT64_IEEE 0 speedgoat_test_SN5659_R2021b_CM_double -1.7E+308 1.7E+308 /end CHARACTERISTIC
/begin CHARACTERISTIC speedgoat_test_SN5659__cal_impl.Encode1_P10_i0 "" VALUE 0x008E3040 Scalar_FLOAT64_IEEE 0 speedgoat_test_SN5659_R2021b_CM_double -1.7E+308 1.7E+308 /end CHARACTERISTIC
/begin CHARACTERISTIC speedgoat_test_SN5659__cal_impl.Encode1_P10_i5 "" VALUE 0x008E36B0 Scalar_FLOAT64_IEEE 0 speedgoat_test_SN5659_R2021b_CM_double -1.7E+308 1.7E+308 /end CHARACTERISTIC
/begin CHARACTERISTIC speedgoat_test_SN5659__cal_impl.Encode1_P10_j "" VALUE 0x008E2360 Scalar_FLOAT64_IEEE 0 speedgoat_test_SN5659_R2021b_CM_double -1.7E+308 1.7E+308 /end CHARACTERISTIC
/begin CHARACTERISTIC speedgoat_test_SN5659__cal_impl.Encode1_P10_pr "" VALUE 0x008E3D20 Scalar_FLOAT64_IEEE 0 speedgoat_test_SN5659_R2021b_CM_double -1.7E+308 1.7E+308 /end CHARACTERISTIC
/begin CHARACTERISTIC speedgoat_test_SN5659__cal_impl.Encode1_P11_am "" VAL_BLK 0x008E36C8 Scalar_FLOAT64_IEEE 0 speedgoat_test_SN5659_R2021b_CM_double -1.7E+308 1.7E+308 MATRIX_DIM 2 1 /end CHARACTERISTIC
/begin CHARACTERISTIC speedgoat_test_SN5659__cal_impl.Encode1_P11_c "" VAL_BLK 0x008E3058 Scalar_FLOAT64_IEEE 0 speedgoat_test_SN5659_R2021b_CM_double -1.7E+308 1.7E+308 MATRIX_DIM 2 1 /end CHARACTERISTIC
/begin CHARACTERISTIC speedgoat_test_SN5659__cal_impl.Encode1_P11_d "" VAL_BLK 0x008E3D38 Scalar_FLOAT64_IEEE 0 speedgoat_test_SN5659_R2021b_CM_double -1.7E+308 1.7E+308 MATRIX_DIM 2 1 /end CHARACTERISTIC
/begin CHARACTERISTIC speedgoat_test_SN5659__cal_impl.Encode1_P11_fp "" VAL_BLK 0x008E2378 Scalar_FLOAT64_IEEE 0 speedgoat_test_SN5659_R2021b_CM_double -1.7E+308 1.7E+308 MATRIX_DIM 2 1 /end CHARACTERISTIC
/begin CHARACTERISTIC speedgoat_test_SN5659__cal_impl.Encode1_P11_gb "" VAL_BLK 0x008E29E8 Scalar_FLOAT64_IEEE 0 speedgoat_test_SN5659_R2021b_CM_double -1.7E+308 1.7E+308 MATRIX_DIM 2 1 /end CHARACTERISTIC
/begin CHARACTERISTIC speedgoat_test_SN5659__cal_impl.Encode1_P11_i "" VAL_BLK 0x008E43A8 Scalar_FLOAT64_IEEE 0 speedgoat_test_SN5659_R2021b_CM_double -1.7E+308 1.7E+308 MATRIX_DIM 2 1 /end CHARACTERISTIC
/begin CHARACTERISTIC speedgoat_test_SN5659__cal_impl.Encode1_P12_a2 "" VALUE 0x008E3D58 Scalar_FLOAT64_IEEE 0 speedgoat_test_SN5659_R2021b_CM_double -1.7E+308 1.7E+308 /end CHARACTERISTIC
/begin CHARACTERISTIC speedgoat_test_SN5659__cal_impl.Encode1_P12_as "" VALUE 0x008E3078 Scalar_FLOAT64_IEEE 0 speedgoat_test_SN5659_R2021b_CM_double -1.7E+308 1.7E+308 /end CHARACTERISTIC
/begin CHARACTERISTIC speedgoat_test_SN5659__cal_impl.Encode1_P12_i "" VALUE 0x008E2A08 Scalar_FLOAT64_IEEE 0 speedgoat_test_SN5659_R2021b_CM_double -1.7E+308 1.7E+308 /end CHARACTERISTIC
/begin CHARACTERISTIC speedgoat_test_SN5659__cal_impl.Encode1_P12_jx "" VALUE 0x008E43C8 Scalar_FLOAT64_IEEE 0 speedgoat_test_SN5659_R2021b_CM_double -1.7E+308 1.7E+308 /end CHARACTERISTIC
/begin CHARACTERISTIC speedgoat_test_SN5659__cal_impl.Encode1_P12_kd "" VALUE 0x008E2398 Scalar_FLOAT64_IEEE 0 speedgoat_test_SN5659_R2021b_CM_double -1.7E+308 1.7E+308 /end CHARACTERISTIC
/begin CHARACTERISTIC speedgoat_test_SN5659__cal_impl.Encode1_P12_mt "" VALUE 0x008E36E8 Scalar_FLOAT64_IEEE 0 speedgoat_test_SN5659_R2021b_CM_double -1.7E+308 1.7E+308 /end CHARACTERISTIC
/begin CHARACTERISTIC speedgoat_test_SN5659__cal_impl.Encode1_P13_b "" VALUE 0x008E3090 Scalar_FLOAT64_IEEE 0 speedgoat_test_SN5659_R2021b_CM_double -1.7E+308 1.7E+308 /end CHARACTERISTIC
/begin CHARACTERISTIC speedgoat_test_SN5659__cal_impl.Encode1_P13_g "" VALUE 0x008E3D70 Scalar_FLOAT64_IEEE 0 speedgoat_test_SN5659_R2021b_CM_double -1.7E+308 1.7E+308 /end CHARACTERISTIC
/begin CHARACTERISTIC speedgoat_test_SN5659__cal_impl.Encode1_P13_gu "" VALUE 0x008E43E0 Scalar_FLOAT64_IEEE 0 speedgoat_test_SN5659_R2021b_CM_double -1.7E+308 1.7E+308 /end CHARACTERISTIC
/begin CHARACTERISTIC speedgoat_test_SN5659__cal_impl.Encode1_P13_h "" VALUE 0x008E23B0 Scalar_FLOAT64_IEEE 0 speedgoat_test_SN5659_R2021b_CM_double -1.7E+308 1.7E+308 /end CHARACTERISTIC
/begin CHARACTERISTIC speedgoat_test_SN5659__cal_impl.Encode1_P13_hz "" VALUE 0x008E2A20 Scalar_FLOAT64_IEEE 0 speedgoat_test_SN5659_R2021b_CM_double -1.7E+308 1.7E+308 /end CHARACTERISTIC
/begin CHARACTERISTIC speedgoat_test_SN5659__cal_impl.Encode1_P13_is "" VALUE 0x008E3700 Scalar_FLOAT64_IEEE 0 speedgoat_test_SN5659_R2021b_CM_double -1.7E+308 1.7E+308 /end CHARACTERISTIC
/begin CHARACTERISTIC speedgoat_test_SN5659__cal_impl.Encode1_P14_av "" VALUE 0x008E3D88 Scalar_FLOAT64_IEEE 0 speedgoat_test_SN5659_R2021b_CM_double -1.7E+308 1.7E+308 /end CHARACTERISTIC
/begin CHARACTERISTIC speedgoat_test_SN5659__cal_impl.Encode1_P14_cd "" VALUE 0x008E3718 Scalar_FLOAT64_IEEE 0 speedgoat_test_SN5659_R2021b_CM_double -1.7E+308 1.7E+308 /end CHARACTERISTIC
/begin CHARACTERISTIC speedgoat_test_SN5659__cal_impl.Encode1_P14_f "" VALUE 0x008E2A38 Scalar_FLOAT64_IEEE 0 speedgoat_test_SN5659_R2021b_CM_double -1.7E+308 1.7E+308 /end CHARACTERISTIC
/begin CHARACTERISTIC speedgoat_test_SN5659__cal_impl.Encode1_P14_fh "" VALUE 0x008E30A8 Scalar_FLOAT64_IEEE 0 speedgoat_test_SN5659_R2021b_CM_double -1.7E+308 1.7E+308 /end CHARACTERISTIC
/begin CHARACTERISTIC speedgoat_test_SN5659__cal_impl.Encode1_P14_fz "" VALUE 0x008E43F8 Scalar_FLOAT64_IEEE 0 speedgoat_test_SN5659_R2021b_CM_double -1.7E+308 1.7E+308 /end CHARACTERISTIC
/begin CHARACTERISTIC speedgoat_test_SN5659__cal_impl.Encode1_P14_ov "" VALUE 0x008E23C8 Scalar_FLOAT64_IEEE 0 speedgoat_test_SN5659_R2021b_CM_double -1.7E+308 1.7E+308 /end CHARACTERISTIC
/begin CHARACTERISTIC speedgoat_test_SN5659__cal_impl.Encode1_P15_c "" VALUE 0x008E3DA0 Scalar_FLOAT64_IEEE 0 speedgoat_test_SN5659_R2021b_CM_double -1.7E+308 1.7E+308 /end CHARACTERISTIC
/begin CHARACTERISTIC speedgoat_test_SN5659__cal_impl.Encode1_P15_d "" VALUE 0x008E4410 Scalar_FLOAT64_IEEE 0 speedgoat_test_SN5659_R2021b_CM_double -1.7E+308 1.7E+308 /end CHARACTERISTIC
/begin CHARACTERISTIC speedgoat_test_SN5659__cal_impl.Encode1_P15_h1 "" VALUE 0x008E30C0 Scalar_FLOAT64_IEEE 0 speedgoat_test_SN5659_R2021b_CM_double -1.7E+308 1.7E+308 /end CHARACTERISTIC
/begin CHARACTERISTIC speedgoat_test_SN5659__cal_impl.Encode1_P15_ka "" VALUE 0x008E23E0 Scalar_FLOAT64_IEEE 0 speedgoat_test_SN5659_R2021b_CM_double -1.7E+308 1.7E+308 /end CHARACTERISTIC
/begin CHARACTERISTIC speedgoat_test_SN5659__cal_impl.Encode1_P15_kak "" VALUE 0x008E3730 Scalar_FLOAT64_IEEE 0 speedgoat_test_SN5659_R2021b_CM_double -1.7E+308 1.7E+308 /end CHARACTERISTIC
/begin CHARACTERISTIC speedgoat_test_SN5659__cal_impl.Encode1_P15_n "" VALUE 0x008E2A50 Scalar_FLOAT64_IEEE 0 speedgoat_test_SN5659_R2021b_CM_double -1.7E+308 1.7E+308 /end CHARACTERISTIC
/begin CHARACTERISTIC speedgoat_test_SN5659__cal_impl.Encode1_P1_cy "" VALUE 0x008E35D8 Scalar_FLOAT64_IEEE 0 speedgoat_test_SN5659_R2021b_CM_double -1.7E+308 1.7E+308 /end CHARACTERISTIC
/begin CHARACTERISTIC speedgoat_test_SN5659__cal_impl.Encode1_P1_d "" VALUE 0x008E3C48 Scalar_FLOAT64_IEEE 0 speedgoat_test_SN5659_R2021b_CM_double -1.7E+308 1.7E+308 /end CHARACTERISTIC
/begin CHARACTERISTIC speedgoat_test_SN5659__cal_impl.Encode1_P1_gb "" VALUE 0x008E2F68 Scalar_FLOAT64_IEEE 0 speedgoat_test_SN5659_R2021b_CM_double -1.7E+308 1.7E+308 /end CHARACTERISTIC
/begin CHARACTERISTIC speedgoat_test_SN5659__cal_impl.Encode1_P1_k "" VALUE 0x008E2288 Scalar_FLOAT64_IEEE 0 speedgoat_test_SN5659_R2021b_CM_double -1.7E+308 1.7E+308 /end CHARACTERISTIC
/begin CHARACTERISTIC speedgoat_test_SN5659__cal_impl.Encode1_P1_kw "" VALUE 0x008E42B8 Scalar_FLOAT64_IEEE 0 speedgoat_test_SN5659_R2021b_CM_double -1.7E+308 1.7E+308 /end CHARACTERISTIC
/begin CHARACTERISTIC speedgoat_test_SN5659__cal_impl.Encode1_P1_n "" VALUE 0x008E28F8 Scalar_FLOAT64_IEEE 0 speedgoat_test_SN5659_R2021b_CM_double -1.7E+308 1.7E+308 /end CHARACTERISTIC
/begin CHARACTERISTIC speedgoat_test_SN5659__cal_impl.Encode1_P2_a "" VALUE 0x008E35F0 Scalar_FLOAT64_IEEE 0 speedgoat_test_SN5659_R2021b_CM_double -1.7E+308 1.7E+308 /end CHARACTERISTIC
/begin CHARACTERISTIC speedgoat_test_SN5659__cal_impl.Encode1_P2_c "" VALUE 0x008E22A0 Scalar_FLOAT64_IEEE 0 speedgoat_test_SN5659_R2021b_CM_double -1.7E+308 1.7E+308 /end CHARACTERISTIC
/begin CHARACTERISTIC speedgoat_test_SN5659__cal_impl.Encode1_P2_cw "" VALUE 0x008E3C60 Scalar_FLOAT64_IEEE 0 speedgoat_test_SN5659_R2021b_CM_double -1.7E+308 1.7E+308 /end CHARACTERISTIC
/begin CHARACTERISTIC speedgoat_test_SN5659__cal_impl.Encode1_P2_d "" VALUE 0x008E2910 Scalar_FLOAT64_IEEE 0 speedgoat_test_SN5659_R2021b_CM_double -1.7E+308 1.7E+308 /end CHARACTERISTIC
/begin CHARACTERISTIC speedgoat_test_SN5659__cal_impl.Encode1_P2_es "" VALUE 0x008E2F80 Scalar_FLOAT64_IEEE 0 speedgoat_test_SN5659_R2021b_CM_double -1.7E+308 1.7E+308 /end CHARACTERISTIC
/begin CHARACTERISTIC speedgoat_test_SN5659__cal_impl.Encode1_P2_ho "" VALUE 0x008E42D0 Scalar_FLOAT64_IEEE 0 speedgoat_test_SN5659_R2021b_CM_double -1.7E+308 1.7E+308 /end CHARACTERISTIC
/begin CHARACTERISTIC speedgoat_test_SN5659__cal_impl.Encode1_P3_eh "" VALUE 0x008E2F98 Scalar_FLOAT64_IEEE 0 speedgoat_test_SN5659_R2021b_CM_double -1.7E+308 1.7E+308 /end CHARACTERISTIC
/begin CHARACTERISTIC speedgoat_test_SN5659__cal_impl.Encode1_P3_em "" VALUE 0x008E3608 Scalar_FLOAT64_IEEE 0 speedgoat_test_SN5659_R2021b_CM_double -1.7E+308 1.7E+308 /end CHARACTERISTIC
/begin CHARACTERISTIC speedgoat_test_SN5659__cal_impl.Encode1_P3_g "" VALUE 0x008E22B8 Scalar_FLOAT64_IEEE 0 speedgoat_test_SN5659_R2021b_CM_double -1.7E+308 1.7E+308 /end CHARACTERISTIC
/begin CHARACTERISTIC speedgoat_test_SN5659__cal_impl.Encode1_P3_hc "" VALUE 0x008E3C78 Scalar_FLOAT64_IEEE 0 speedgoat_test_SN5659_R2021b_CM_double -1.7E+308 1.7E+308 /end CHARACTERISTIC
/begin CHARACTERISTIC speedgoat_test_SN5659__cal_impl.Encode1_P3_lm "" VALUE 0x008E42E8 Scalar_FLOAT64_IEEE 0 speedgoat_test_SN5659_R2021b_CM_double -1.7E+308 1.7E+308 /end CHARACTERISTIC
/begin CHARACTERISTIC speedgoat_test_SN5659__cal_impl.Encode1_P3_n "" VALUE 0x008E2928 Scalar_FLOAT64_IEEE 0 speedgoat_test_SN5659_R2021b_CM_double -1.7E+308 1.7E+308 /end CHARACTERISTIC
/begin CHARACTERISTIC speedgoat_test_SN5659__cal_impl.Encode1_P4_b "" VALUE 0x008E2940 Scalar_FLOAT64_IEEE 0 speedgoat_test_SN5659_R2021b_CM_double -1.7E+308 1.7E+308 /end CHARACTERISTIC
/begin CHARACTERISTIC speedgoat_test_SN5659__cal_impl.Encode1_P4_cs "" VALUE 0x008E4300 Scalar_FLOAT64_IEEE 0 speedgoat_test_SN5659_R2021b_CM_double -1.7E+308 1.7E+308 /end CHARACTERISTIC
/begin CHARACTERISTIC speedgoat_test_SN5659__cal_impl.Encode1_P4_eq "" VALUE 0x008E22D0 Scalar_FLOAT64_IEEE 0 speedgoat_test_SN5659_R2021b_CM_double -1.7E+308 1.7E+308 /end CHARACTERISTIC
/begin CHARACTERISTIC speedgoat_test_SN5659__cal_impl.Encode1_P4_f "" VALUE 0x008E3C90 Scalar_FLOAT64_IEEE 0 speedgoat_test_SN5659_R2021b_CM_double -1.7E+308 1.7E+308 /end CHARACTERISTIC
/begin CHARACTERISTIC speedgoat_test_SN5659__cal_impl.Encode1_P4_h "" VALUE 0x008E2FB0 Scalar_FLOAT64_IEEE 0 speedgoat_test_SN5659_R2021b_CM_double -1.7E+308 1.7E+308 /end CHARACTERISTIC
/begin CHARACTERISTIC speedgoat_test_SN5659__cal_impl.Encode1_P4_m "" VALUE 0x008E3620 Scalar_FLOAT64_IEEE 0 speedgoat_test_SN5659_R2021b_CM_double -1.7E+308 1.7E+308 /end CHARACTERISTIC
/begin CHARACTERISTIC speedgoat_test_SN5659__cal_impl.Encode1_P5_d "" VALUE 0x008E2FC8 Scalar_FLOAT64_IEEE 0 speedgoat_test_SN5659_R2021b_CM_double -1.7E+308 1.7E+308 /end CHARACTERISTIC
/begin CHARACTERISTIC speedgoat_test_SN5659__cal_impl.Encode1_P5_dq "" VALUE 0x008E3638 Scalar_FLOAT64_IEEE 0 speedgoat_test_SN5659_R2021b_CM_double -1.7E+308 1.7E+308 /end CHARACTERISTIC
/begin CHARACTERISTIC speedgoat_test_SN5659__cal_impl.Encode1_P5_gx "" VALUE 0x008E2958 Scalar_FLOAT64_IEEE 0 speedgoat_test_SN5659_R2021b_CM_double -1.7E+308 1.7E+308 /end CHARACTERISTIC
/begin CHARACTERISTIC speedgoat_test_SN5659__cal_impl.Encode1_P5_jf "" VALUE 0x008E22E8 Scalar_FLOAT64_IEEE 0 speedgoat_test_SN5659_R2021b_CM_double -1.7E+308 1.7E+308 /end CHARACTERISTIC
/begin CHARACTERISTIC speedgoat_test_SN5659__cal_impl.Encode1_P5_m "" VALUE 0x008E4318 Scalar_FLOAT64_IEEE 0 speedgoat_test_SN5659_R2021b_CM_double -1.7E+308 1.7E+308 /end CHARACTERISTIC
/begin CHARACTERISTIC speedgoat_test_SN5659__cal_impl.Encode1_P5_p "" VALUE 0x008E3CA8 Scalar_FLOAT64_IEEE 0 speedgoat_test_SN5659_R2021b_CM_double -1.7E+308 1.7E+308 /end CHARACTERISTIC
/begin CHARACTERISTIC speedgoat_test_SN5659__cal_impl.Encode1_P6_ad "" VALUE 0x008E3650 Scalar_FLOAT64_IEEE 0 speedgoat_test_SN5659_R2021b_CM_double -1.7E+308 1.7E+308 /end CHARACTERISTIC
/begin CHARACTERISTIC speedgoat_test_SN5659__cal_impl.Encode1_P6_am "" VALUE 0x008E4330 Scalar_FLOAT64_IEEE 0 speedgoat_test_SN5659_R2021b_CM_double -1.7E+308 1.7E+308 /end CHARACTERISTIC
/begin CHARACTERISTIC speedgoat_test_SN5659__cal_impl.Encode1_P6_g "" VALUE 0x008E2FE0 Scalar_FLOAT64_IEEE 0 speedgoat_test_SN5659_R2021b_CM_double -1.7E+308 1.7E+308 /end CHARACTERISTIC
/begin CHARACTERISTIC speedgoat_test_SN5659__cal_impl.Encode1_P6_gn "" VALUE 0x008E3CC0 Scalar_FLOAT64_IEEE 0 speedgoat_test_SN5659_R2021b_CM_double -1.7E+308 1.7E+308 /end CHARACTERISTIC
/begin CHARACTERISTIC speedgoat_test_SN5659__cal_impl.Encode1_P6_k "" VALUE 0x008E2300 Scalar_FLOAT64_IEEE 0 speedgoat_test_SN5659_R2021b_CM_double -1.7E+308 1.7E+308 /end CHARACTERISTIC
/begin CHARACTERISTIC speedgoat_test_SN5659__cal_impl.Encode1_P6_mt "" VALUE 0x008E2970 Scalar_FLOAT64_IEEE 0 speedgoat_test_SN5659_R2021b_CM_double -1.7E+308 1.7E+308 /end CHARACTERISTIC
/begin CHARACTERISTIC speedgoat_test_SN5659__cal_impl.Encode1_P7_b3 "" VALUE 0x008E4348 Scalar_FLOAT64_IEEE 0 speedgoat_test_SN5659_R2021b_CM_double -1.7E+308 1.7E+308 /end CHARACTERISTIC
/begin CHARACTERISTIC speedgoat_test_SN5659__cal_impl.Encode1_P7_eo "" VALUE 0x008E3668 Scalar_FLOAT64_IEEE 0 speedgoat_test_SN5659_R2021b_CM_double -1.7E+308 1.7E+308 /end CHARACTERISTIC
/begin CHARACTERISTIC speedgoat_test_SN5659__cal_impl.Encode1_P7_h "" VALUE 0x008E3CD8 Scalar_FLOAT64_IEEE 0 speedgoat_test_SN5659_R2021b_CM_double -1.7E+308 1.7E+308 /end CHARACTERISTIC
/begin CHARACTERISTIC speedgoat_test_SN5659__cal_impl.Encode1_P7_k "" VALUE 0x008E2988 Scalar_FLOAT64_IEEE 0 speedgoat_test_SN5659_R2021b_CM_double -1.7E+308 1.7E+308 /end CHARACTERISTIC
/begin CHARACTERISTIC speedgoat_test_SN5659__cal_impl.Encode1_P7_n "" VALUE 0x008E2FF8 Scalar_FLOAT64_IEEE 0 speedgoat_test_SN5659_R2021b_CM_double -1.7E+308 1.7E+308 /end CHARACTERISTIC
/begin CHARACTERISTIC speedgoat_test_SN5659__cal_impl.Encode1_P7_p "" VALUE 0x008E2318 Scalar_FLOAT64_IEEE 0 speedgoat_test_SN5659_R2021b_CM_double -1.7E+308 1.7E+308 /end CHARACTERISTIC
/begin CHARACTERISTIC speedgoat_test_SN5659__cal_impl.Encode1_P8_bi "" VALUE 0x008E3CF0 Scalar_FLOAT64_IEEE 0 speedgoat_test_SN5659_R2021b_CM_double -1.7E+308 1.7E+308 /end CHARACTERISTIC
/begin CHARACTERISTIC speedgoat_test_SN5659__cal_impl.Encode1_P8_bu "" VALUE 0x008E29A0 Scalar_FLOAT64_IEEE 0 speedgoat_test_SN5659_R2021b_CM_double -1.7E+308 1.7E+308 /end CHARACTERISTIC
/begin CHARACTERISTIC speedgoat_test_SN5659__cal_impl.Encode1_P8_cc "" VALUE 0x008E3010 Scalar_FLOAT64_IEEE 0 speedgoat_test_SN5659_R2021b_CM_double -1.7E+308 1.7E+308 /end CHARACTERISTIC
/begin CHARACTERISTIC speedgoat_test_SN5659__cal_impl.Encode1_P8_j "" VALUE 0x008E4360 Scalar_FLOAT64_IEEE 0 speedgoat_test_SN5659_R2021b_CM_double -1.7E+308 1.7E+308 /end CHARACTERISTIC
/begin CHARACTERISTIC speedgoat_test_SN5659__cal_impl.Encode1_P8_n "" VALUE 0x008E3680 Scalar_FLOAT64_IEEE 0 speedgoat_test_SN5659_R2021b_CM_double -1.7E+308 1.7E+308 /end CHARACTERISTIC
/begin CHARACTERISTIC speedgoat_test_SN5659__cal_impl.Encode1_P8_o "" VALUE 0x008E2330 Scalar_FLOAT64_IEEE 0 speedgoat_test_SN5659_R2021b_CM_double -1.7E+308 1.7E+308 /end CHARACTERISTIC
/begin CHARACTERISTIC speedgoat_test_SN5659__cal_impl.Encode1_P9_a2 "" VALUE 0x008E3698 Scalar_FLOAT64_IEEE 0 speedgoat_test_SN5659_R2021b_CM_double -1.7E+308 1.7E+308 /end CHARACTERISTIC
/begin CHARACTERISTIC speedgoat_test_SN5659__cal_impl.Encode1_P9_f "" VALUE 0x008E3028 Scalar_FLOAT64_IEEE 0 speedgoat_test_SN5659_R2021b_CM_double -1.7E+308 1.7E+308 /end CHARACTERISTIC
/begin CHARACTERISTIC speedgoat_test_SN5659__cal_impl.Encode1_P9_h "" VALUE 0x008E2348 Scalar_FLOAT64_IEEE 0 speedgoat_test_SN5659_R2021b_CM_double -1.7E+308 1.7E+308 /end CHARACTERISTIC
/begin CHARACTERISTIC speedgoat_test_SN5659__cal_impl.Encode1_P9_i "" VALUE 0x008E3D08 Scalar_FLOAT64_IEEE 0 speedgoat_test_SN5659_R2021b_CM_double -1.7E+308 1.7E+308 /end CHARACTERISTIC
/begin CHARACTERISTIC speedgoat_test_SN5659__cal_impl.Encode1_P9_ju "" VALUE 0x008E29B8 Scalar_FLOAT64_IEEE 0 speedgoat_test_SN5659_R2021b_CM_double -1.7E+308 1.7E+308 /end CHARACTERISTIC
/begin CHARACTERISTIC speedgoat_test_SN5659__cal_impl.Encode1_P9_oc "" VALUE 0x008E4378 Scalar_FLOAT64_IEEE 0 speedgoat_test_SN5659_R2021b_CM_double -1.7E+308 1.7E+308 /end CHARACTERISTIC
/begin CHARACTERISTIC speedgoat_test_SN5659__cal_impl.Encode2_P10_ab0 "" VALUE 0x008E24D0 Scalar_FLOAT64_IEEE 0 speedgoat_test_SN5659_R2021b_CM_double -1.7E+308 1.7E+308 /end CHARACTERISTIC
/begin CHARACTERISTIC speedgoat_test_SN5659__cal_impl.Encode2_P10_d "" VALUE 0x008E31B0 Scalar_FLOAT64_IEEE 0 speedgoat_test_SN5659_R2021b_CM_double -1.7E+308 1.7E+308 /end CHARACTERISTIC
/begin CHARACTERISTIC speedgoat_test_SN5659__cal_impl.Encode2_P10_dc "" VALUE 0x008E3820 Scalar_FLOAT64_IEEE 0 speedgoat_test_SN5659_R2021b_CM_double -1.7E+308 1.7E+308 /end CHARACTERISTIC
/begin CHARACTERISTIC speedgoat_test_SN5659__cal_impl.Encode2_P10_dz "" VALUE 0x008E4830 Scalar_FLOAT64_IEEE 0 speedgoat_test_SN5659_R2021b_CM_double -1.7E+308 1.7E+308 /end CHARACTERISTIC
/begin CHARACTERISTIC speedgoat_test_SN5659__cal_impl.Encode2_P10_im "" VALUE 0x008E2E70 Scalar_FLOAT64_IEEE 0 speedgoat_test_SN5659_R2021b_CM_double -1.7E+308 1.7E+308 /end CHARACTERISTIC
/begin CHARACTERISTIC speedgoat_test_SN5659__cal_impl.Encode2_P10_og "" VALUE 0x008E3E90 Scalar_FLOAT64_IEEE 0 speedgoat_test_SN5659_R2021b_CM_double -1.7E+308 1.7E+308 /end CHARACTERISTIC
/begin CHARACTERISTIC speedgoat_test_SN5659__cal_impl.Encode2_P11_b "" VAL_BLK 0x008E31C8 Scalar_FLOAT64_IEEE 0 speedgoat_test_SN5659_R2021b_CM_double -1.7E+308 1.7E+308 MATRIX_DIM 2 1 /end CHARACTERISTIC
/begin CHARACTERISTIC speedgoat_test_SN5659__cal_impl.Encode2_P11_df "" VAL_BLK 0x008E3EA8 Scalar_FLOAT64_IEEE 0 speedgoat_test_SN5659_R2021b_CM_double -1.7E+308 1.7E+308 MATRIX_DIM 2 1 /end CHARACTERISTIC
/begin CHARACTERISTIC speedgoat_test_SN5659__cal_impl.Encode2_P11_dm "" VAL_BLK 0x008E4848 Scalar_FLOAT64_IEEE 0 speedgoat_test_SN5659_R2021b_CM_double -1.7E+308 1.7E+308 MATRIX_DIM 2 1 /end CHARACTERISTIC
/begin CHARACTERISTIC speedgoat_test_SN5659__cal_impl.Encode2_P11_hq "" VAL_BLK 0x008E3838 Scalar_FLOAT64_IEEE 0 speedgoat_test_SN5659_R2021b_CM_double -1.7E+308 1.7E+308 MATRIX_DIM 2 1 /end CHARACTERISTIC
/begin CHARACTERISTIC speedgoat_test_SN5659__cal_impl.Encode2_P11_o "" VAL_BLK 0x008E2E88 Scalar_FLOAT64_IEEE 0 speedgoat_test_SN5659_R2021b_CM_double -1.7E+308 1.7E+308 MATRIX_DIM 2 1 /end CHARACTERISTIC
/begin CHARACTERISTIC speedgoat_test_SN5659__cal_impl.Encode2_P11_p "" VAL_BLK 0x008E24E8 Scalar_FLOAT64_IEEE 0 speedgoat_test_SN5659_R2021b_CM_double -1.7E+308 1.7E+308 MATRIX_DIM 2 1 /end CHARACTERISTIC
/begin CHARACTERISTIC speedgoat_test_SN5659__cal_impl.Encode2_P12_c "" VALUE 0x008E2508 Scalar_FLOAT64_IEEE 0 speedgoat_test_SN5659_R2021b_CM_double -1.7E+308 1.7E+308 /end CHARACTERISTIC
/begin CHARACTERISTIC speedgoat_test_SN5659__cal_impl.Encode2_P12_ek "" VALUE 0x008E3858 Scalar_FLOAT64_IEEE 0 speedgoat_test_SN5659_R2021b_CM_double -1.7E+308 1.7E+308 /end CHARACTERISTIC
/begin CHARACTERISTIC speedgoat_test_SN5659__cal_impl.Encode2_P12_j "" VALUE 0x008E4868 Scalar_FLOAT64_IEEE 0 speedgoat_test_SN5659_R2021b_CM_double -1.7E+308 1.7E+308 /end CHARACTERISTIC
/begin CHARACTERISTIC speedgoat_test_SN5659__cal_impl.Encode2_P12_k3 "" VALUE 0x008E2EA8 Scalar_FLOAT64_IEEE 0 speedgoat_test_SN5659_R2021b_CM_double -1.7E+308 1.7E+308 /end CHARACTERISTIC
/begin CHARACTERISTIC speedgoat_test_SN5659__cal_impl.Encode2_P12_l "" VALUE 0x008E3EC8 Scalar_FLOAT64_IEEE 0 speedgoat_test_SN5659_R2021b_CM_double -1.7E+308 1.7E+308 /end CHARACTERISTIC
/begin CHARACTERISTIC speedgoat_test_SN5659__cal_impl.Encode2_P12_mp "" VALUE 0x008E31E8 Scalar_FLOAT64_IEEE 0 speedgoat_test_SN5659_R2021b_CM_double -1.7E+308 1.7E+308 /end CHARACTERISTIC
/begin CHARACTERISTIC speedgoat_test_SN5659__cal_impl.Encode2_P13_a "" VALUE 0x008E2520 Scalar_FLOAT64_IEEE 0 speedgoat_test_SN5659_R2021b_CM_double -1.7E+308 1.7E+308 /end CHARACTERISTIC
/begin CHARACTERISTIC speedgoat_test_SN5659__cal_impl.Encode2_P13_b "" VALUE 0x008E3200 Scalar_FLOAT64_IEEE 0 speedgoat_test_SN5659_R2021b_CM_double -1.7E+308 1.7E+308 /end CHARACTERISTIC
/begin CHARACTERISTIC speedgoat_test_SN5659__cal_impl.Encode2_P13_g "" VALUE 0x008E4880 Scalar_FLOAT64_IEEE 0 speedgoat_test_SN5659_R2021b_CM_double -1.7E+308 1.7E+308 /end CHARACTERISTIC
/begin CHARACTERISTIC speedgoat_test_SN5659__cal_impl.Encode2_P13_m "" VALUE 0x008E2EC0 Scalar_FLOAT64_IEEE 0 speedgoat_test_SN5659_R2021b_CM_double -1.7E+308 1.7E+308 /end CHARACTERISTIC
/begin CHARACTERISTIC speedgoat_test_SN5659__cal_impl.Encode2_P13_ol "" VALUE 0x008E3EE0 Scalar_FLOAT64_IEEE 0 speedgoat_test_SN5659_R2021b_CM_double -1.7E+308 1.7E+308 /end CHARACTERISTIC
/begin CHARACTERISTIC speedgoat_test_SN5659__cal_impl.Encode2_P13_oo "" VALUE 0x008E3870 Scalar_FLOAT64_IEEE 0 speedgoat_test_SN5659_R2021b_CM_double -1.7E+308 1.7E+308 /end CHARACTERISTIC
/begin CHARACTERISTIC speedgoat_test_SN5659__cal_impl.Encode2_P14_db "" VALUE 0x008E2538 Scalar_FLOAT64_IEEE 0 speedgoat_test_SN5659_R2021b_CM_double -1.7E+308 1.7E+308 /end CHARACTERISTIC
/begin CHARACTERISTIC speedgoat_test_SN5659__cal_impl.Encode2_P14_dr "" VALUE 0x008E3EF8 Scalar_FLOAT64_IEEE 0 speedgoat_test_SN5659_R2021b_CM_double -1.7E+308 1.7E+308 /end CHARACTERISTIC
/begin CHARACTERISTIC speedgoat_test_SN5659__cal_impl.Encode2_P14_h "" VALUE 0x008E3218 Scalar_FLOAT64_IEEE 0 speedgoat_test_SN5659_R2021b_CM_double -1.7E+308 1.7E+308 /end CHARACTERISTIC
/begin CHARACTERISTIC speedgoat_test_SN5659__cal_impl.Encode2_P14_hh "" VALUE 0x008E4898 Scalar_FLOAT64_IEEE 0 speedgoat_test_SN5659_R2021b_CM_double -1.7E+308 1.7E+308 /end CHARACTERISTIC
/begin CHARACTERISTIC speedgoat_test_SN5659__cal_impl.Encode2_P14_j "" VALUE 0x008E3888 Scalar_FLOAT64_IEEE 0 speedgoat_test_SN5659_R2021b_CM_double -1.7E+308 1.7E+308 /end CHARACTERISTIC
/begin CHARACTERISTIC speedgoat_test_SN5659__cal_impl.Encode2_P14_k "" VALUE 0x008E2ED8 Scalar_FLOAT64_IEEE 0 speedgoat_test_SN5659_R2021b_CM_double -1.7E+308 1.7E+308 /end CHARACTERISTIC
/begin CHARACTERISTIC speedgoat_test_SN5659__cal_impl.Encode2_P15_a "" VALUE 0x008E2550 Scalar_FLOAT64_IEEE 0 speedgoat_test_SN5659_R2021b_CM_double -1.7E+308 1.7E+308 /end CHARACTERISTIC
/begin CHARACTERISTIC speedgoat_test_SN5659__cal_impl.Encode2_P15_d "" VALUE 0x008E3230 Scalar_FLOAT64_IEEE 0 speedgoat_test_SN5659_R2021b_CM_double -1.7E+308 1.7E+308 /end CHARACTERISTIC
/begin CHARACTERISTIC speedgoat_test_SN5659__cal_impl.Encode2_P15_e1 "" VALUE 0x008E2EF0 Scalar_FLOAT64_IEEE 0 speedgoat_test_SN5659_R2021b_CM_double -1.7E+308 1.7E+308 /end CHARACTERISTIC
/begin CHARACTERISTIC speedgoat_test_SN5659__cal_impl.Encode2_P15_f "" VALUE 0x008E3F10 Scalar_FLOAT64_IEEE 0 speedgoat_test_SN5659_R2021b_CM_double -1.7E+308 1.7E+308 /end CHARACTERISTIC
/begin CHARACTERISTIC speedgoat_test_SN5659__cal_impl.Encode2_P15_km "" VALUE 0x008E48B0 Scalar_FLOAT64_IEEE 0 speedgoat_test_SN5659_R2021b_CM_double -1.7E+308 1.7E+308 /end CHARACTERISTIC
/begin CHARACTERISTIC speedgoat_test_SN5659__cal_impl.Encode2_P15_n "" VALUE 0x008E38A0 Scalar_FLOAT64_IEEE 0 speedgoat_test_SN5659_R2021b_CM_double -1.7E+308 1.7E+308 /end CHARACTERISTIC
/begin CHARACTERISTIC speedgoat_test_SN5659__cal_impl.Encode2_P1_b "" VALUE 0x008E2D98 Scalar_FLOAT64_IEEE 0 speedgoat_test_SN5659_R2021b_CM_double -1.7E+308 1.7E+308 /end CHARACTERISTIC
/begin CHARACTERISTIC speedgoat_test_SN5659__cal_impl.Encode2_P1_bc "" VALUE 0x008E4758 Scalar_FLOAT64_IEEE 0 speedgoat_test_SN5659_R2021b_CM_double -1.7E+308 1.7E+308 /end CHARACTERISTIC
/begin CHARACTERISTIC speedgoat_test_SN5659__cal_impl.Encode2_P1_f "" VALUE 0x008E23F8 Scalar_FLOAT64_IEEE 0 speedgoat_test_SN5659_R2021b_CM_double -1.7E+308 1.7E+308 /end CHARACTERISTIC
/begin CHARACTERISTIC speedgoat_test_SN5659__cal_impl.Encode2_P1_ga "" VALUE 0x008E30D8 Scalar_FLOAT64_IEEE 0 speedgoat_test_SN5659_R2021b_CM_double -1.7E+308 1.7E+308 /end CHARACTERISTIC
/begin CHARACTERISTIC speedgoat_test_SN5659__cal_impl.Encode2_P1_i "" VALUE 0x008E3DB8 Scalar_FLOAT64_IEEE 0 speedgoat_test_SN5659_R2021b_CM_double -1.7E+308 1.7E+308 /end CHARACTERISTIC
/begin CHARACTERISTIC speedgoat_test_SN5659__cal_impl.Encode2_P1_o "" VALUE 0x008E3748 Scalar_FLOAT64_IEEE 0 speedgoat_test_SN5659_R2021b_CM_double -1.7E+308 1.7E+308 /end CHARACTERISTIC
/begin CHARACTERISTIC speedgoat_test_SN5659__cal_impl.Encode2_P2_di "" VALUE 0x008E2DB0 Scalar_FLOAT64_IEEE 0 speedgoat_test_SN5659_R2021b_CM_double -1.7E+308 1.7E+308 /end CHARACTERISTIC
/begin CHARACTERISTIC speedgoat_test_SN5659__cal_impl.Encode2_P2_g "" VALUE 0x008E3760 Scalar_FLOAT64_IEEE 0 speedgoat_test_SN5659_R2021b_CM_double -1.7E+308 1.7E+308 /end CHARACTERISTIC
/begin CHARACTERISTIC speedgoat_test_SN5659__cal_impl.Encode2_P2_gi "" VALUE 0x008E3DD0 Scalar_FLOAT64_IEEE 0 speedgoat_test_SN5659_R2021b_CM_double -1.7E+308 1.7E+308 /end CHARACTERISTIC
/begin CHARACTERISTIC speedgoat_test_SN5659__cal_impl.Encode2_P2_hl "" VALUE 0x008E4770 Scalar_FLOAT64_IEEE 0 speedgoat_test_SN5659_R2021b_CM_double -1.7E+308 1.7E+308 /end CHARACTERISTIC
/begin CHARACTERISTIC speedgoat_test_SN5659__cal_impl.Encode2_P2_ka "" VALUE 0x008E30F0 Scalar_FLOAT64_IEEE 0 speedgoat_test_SN5659_R2021b_CM_double -1.7E+308 1.7E+308 /end CHARACTERISTIC
/begin CHARACTERISTIC speedgoat_test_SN5659__cal_impl.Encode2_P2_kra "" VALUE 0x008E2410 Scalar_FLOAT64_IEEE 0 speedgoat_test_SN5659_R2021b_CM_double -1.7E+308 1.7E+308 /end CHARACTERISTIC
/begin CHARACTERISTIC speedgoat_test_SN5659__cal_impl.Encode2_P3_d "" VALUE 0x008E2428 Scalar_FLOAT64_IEEE 0 speedgoat_test_SN5659_R2021b_CM_double -1.7E+308 1.7E+308 /end CHARACTERISTIC
/begin CHARACTERISTIC speedgoat_test_SN5659__cal_impl.Encode2_P3_dm "" VALUE 0x008E4788 Scalar_FLOAT64_IEEE 0 speedgoat_test_SN5659_R2021b_CM_double -1.7E+308 1.7E+308 /end CHARACTERISTIC
/begin CHARACTERISTIC speedgoat_test_SN5659__cal_impl.Encode2_P3_fe "" VALUE 0x008E3108 Scalar_FLOAT64_IEEE 0 speedgoat_test_SN5659_R2021b_CM_double -1.7E+308 1.7E+308 /end CHARACTERISTIC
/begin CHARACTERISTIC speedgoat_test_SN5659__cal_impl.Encode2_P3_kx "" VALUE 0x008E3778 Scalar_FLOAT64_IEEE 0 speedgoat_test_SN5659_R2021b_CM_double -1.7E+308 1.7E+308 /end CHARACTERISTIC
/begin CHARACTERISTIC speedgoat_test_SN5659__cal_impl.Encode2_P3_ln "" VALUE 0x008E2DC8 Scalar_FLOAT64_IEEE 0 speedgoat_test_SN5659_R2021b_CM_double -1.7E+308 1.7E+308 /end CHARACTERISTIC
/begin CHARACTERISTIC speedgoat_test_SN5659__cal_impl.Encode2_P3_oj "" VALUE 0x008E3DE8 Scalar_FLOAT64_IEEE 0 speedgoat_test_SN5659_R2021b_CM_double -1.7E+308 1.7E+308 /end CHARACTERISTIC
/begin CHARACTERISTIC speedgoat_test_SN5659__cal_impl.Encode2_P4_a "" VALUE 0x008E3790 Scalar_FLOAT64_IEEE 0 speedgoat_test_SN5659_R2021b_CM_double -1.7E+308 1.7E+308 /end CHARACTERISTIC
/begin CHARACTERISTIC speedgoat_test_SN5659__cal_impl.Encode2_P4_lk "" VALUE 0x008E3120 Scalar_FLOAT64_IEEE 0 speedgoat_test_SN5659_R2021b_CM_double -1.7E+308 1.7E+308 /end CHARACTERISTIC
/begin CHARACTERISTIC speedgoat_test_SN5659__cal_impl.Encode2_P4_lw "" VALUE 0x008E2440 Scalar_FLOAT64_IEEE 0 speedgoat_test_SN5659_R2021b_CM_double -1.7E+308 1.7E+308 /end CHARACTERISTIC
/begin CHARACTERISTIC speedgoat_test_SN5659__cal_impl.Encode2_P4_n "" VALUE 0x008E2DE0 Scalar_FLOAT64_IEEE 0 speedgoat_test_SN5659_R2021b_CM_double -1.7E+308 1.7E+308 /end CHARACTERISTIC
/begin CHARACTERISTIC speedgoat_test_SN5659__cal_impl.Encode2_P4_nt "" VALUE 0x008E3E00 Scalar_FLOAT64_IEEE 0 speedgoat_test_SN5659_R2021b_CM_double -1.7E+308 1.7E+308 /end CHARACTERISTIC
/begin CHARACTERISTIC speedgoat_test_SN5659__cal_impl.Encode2_P4_ny "" VALUE 0x008E47A0 Scalar_FLOAT64_IEEE 0 speedgoat_test_SN5659_R2021b_CM_double -1.7E+308 1.7E+308 /end CHARACTERISTIC
/begin CHARACTERISTIC speedgoat_test_SN5659__cal_impl.Encode2_P5_a "" VALUE 0x008E2DF8 Scalar_FLOAT64_IEEE 0 speedgoat_test_SN5659_R2021b_CM_double -1.7E+308 1.7E+308 /end CHARACTERISTIC
/begin CHARACTERISTIC speedgoat_test_SN5659__cal_impl.Encode2_P5_af "" VALUE 0x008E3E18 Scalar_FLOAT64_IEEE 0 speedgoat_test_SN5659_R2021b_CM_double -1.7E+308 1.7E+308 /end CHARACTERISTIC
/begin CHARACTERISTIC speedgoat_test_SN5659__cal_impl.Encode2_P5_im "" VALUE 0x008E47B8 Scalar_FLOAT64_IEEE 0 speedgoat_test_SN5659_R2021b_CM_double -1.7E+308 1.7E+308 /end CHARACTERISTIC
/begin CHARACTERISTIC speedgoat_test_SN5659__cal_impl.Encode2_P5_mc "" VALUE 0x008E2458 Scalar_FLOAT64_IEEE 0 speedgoat_test_SN5659_R2021b_CM_double -1.7E+308 1.7E+308 /end CHARACTERISTIC
/begin CHARACTERISTIC speedgoat_test_SN5659__cal_impl.Encode2_P5_n "" VALUE 0x008E3138 Scalar_FLOAT64_IEEE 0 speedgoat_test_SN5659_R2021b_CM_double -1.7E+308 1.7E+308 /end CHARACTERISTIC
/begin CHARACTERISTIC speedgoat_test_SN5659__cal_impl.Encode2_P5_pz "" VALUE 0x008E37A8 Scalar_FLOAT64_IEEE 0 speedgoat_test_SN5659_R2021b_CM_double -1.7E+308 1.7E+308 /end CHARACTERISTIC
/begin CHARACTERISTIC speedgoat_test_SN5659__cal_impl.Encode2_P6_c "" VALUE 0x008E2E10 Scalar_FLOAT64_IEEE 0 speedgoat_test_SN5659_R2021b_CM_double -1.7E+308 1.7E+308 /end CHARACTERISTIC
/begin CHARACTERISTIC speedgoat_test_SN5659__cal_impl.Encode2_P6_f "" VALUE 0x008E2470 Scalar_FLOAT64_IEEE 0 speedgoat_test_SN5659_R2021b_CM_double -1.7E+308 1.7E+308 /end CHARACTERISTIC
/begin CHARACTERISTIC speedgoat_test_SN5659__cal_impl.Encode2_P6_fn "" VALUE 0x008E3150 Scalar_FLOAT64_IEEE 0 speedgoat_test_SN5659_R2021b_CM_double -1.7E+308 1.7E+308 /end CHARACTERISTIC
/begin CHARACTERISTIC speedgoat_test_SN5659__cal_impl.Encode2_P6_g "" VALUE 0x008E47D0 Scalar_FLOAT64_IEEE 0 speedgoat_test_SN5659_R2021b_CM_double -1.7E+308 1.7E+308 /end CHARACTERISTIC
/begin CHARACTERISTIC speedgoat_test_SN5659__cal_impl.Encode2_P6_k "" VALUE 0x008E37C0 Scalar_FLOAT64_IEEE 0 speedgoat_test_SN5659_R2021b_CM_double -1.7E+308 1.7E+308 /end CHARACTERISTIC
/begin CHARACTERISTIC speedgoat_test_SN5659__cal_impl.Encode2_P6_ny "" VALUE 0x008E3E30 Scalar_FLOAT64_IEEE 0 speedgoat_test_SN5659_R2021b_CM_double -1.7E+308 1.7E+308 /end CHARACTERISTIC
/begin CHARACTERISTIC speedgoat_test_SN5659__cal_impl.Encode2_P7_g "" VALUE 0x008E3E48 Scalar_FLOAT64_IEEE 0 speedgoat_test_SN5659_R2021b_CM_double -1.7E+308 1.7E+308 /end CHARACTERISTIC
/begin CHARACTERISTIC speedgoat_test_SN5659__cal_impl.Encode2_P7_iq "" VALUE 0x008E2E28 Scalar_FLOAT64_IEEE 0 speedgoat_test_SN5659_R2021b_CM_double -1.7E+308 1.7E+308 /end CHARACTERISTIC
/begin CHARACTERISTIC speedgoat_test_SN5659__cal_impl.Encode2_P7_jb "" VALUE 0x008E3168 Scalar_FLOAT64_IEEE 0 speedgoat_test_SN5659_R2021b_CM_double -1.7E+308 1.7E+308 /end CHARACTERISTIC
/begin CHARACTERISTIC speedgoat_test_SN5659__cal_impl.Encode2_P7_k5 "" VALUE 0x008E47E8 Scalar_FLOAT64_IEEE 0 speedgoat_test_SN5659_R2021b_CM_double -1.7E+308 1.7E+308 /end CHARACTERISTIC
/begin CHARACTERISTIC speedgoat_test_SN5659__cal_impl.Encode2_P7_oo "" VALUE 0x008E2488 Scalar_FLOAT64_IEEE 0 speedgoat_test_SN5659_R2021b_CM_double -1.7E+308 1.7E+308 /end CHARACTERISTIC
/begin CHARACTERISTIC speedgoat_test_SN5659__cal_impl.Encode2_P7_p "" VALUE 0x008E37D8 Scalar_FLOAT64_IEEE 0 speedgoat_test_SN5659_R2021b_CM_double -1.7E+308 1.7E+308 /end CHARACTERISTIC
/begin CHARACTERISTIC speedgoat_test_SN5659__cal_impl.Encode2_P8_a "" VALUE 0x008E24A0 Scalar_FLOAT64_IEEE 0 speedgoat_test_SN5659_R2021b_CM_double -1.7E+308 1.7E+308 /end CHARACTERISTIC
/begin CHARACTERISTIC speedgoat_test_SN5659__cal_impl.Encode2_P8_b "" VALUE 0x008E2E40 Scalar_FLOAT64_IEEE 0 speedgoat_test_SN5659_R2021b_CM_double -1.7E+308 1.7E+308 /end CHARACTERISTIC
/begin CHARACTERISTIC speedgoat_test_SN5659__cal_impl.Encode2_P8_hl "" VALUE 0x008E3180 Scalar_FLOAT64_IEEE 0 speedgoat_test_SN5659_R2021b_CM_double -1.7E+308 1.7E+308 /end CHARACTERISTIC
/begin CHARACTERISTIC speedgoat_test_SN5659__cal_impl.Encode2_P8_ig "" VALUE 0x008E4800 Scalar_FLOAT64_IEEE 0 speedgoat_test_SN5659_R2021b_CM_double -1.7E+308 1.7E+308 /end CHARACTERISTIC
/begin CHARACTERISTIC speedgoat_test_SN5659__cal_impl.Encode2_P8_ip "" VALUE 0x008E37F0 Scalar_FLOAT64_IEEE 0 speedgoat_test_SN5659_R2021b_CM_double -1.7E+308 1.7E+308 /end CHARACTERISTIC
/begin CHARACTERISTIC speedgoat_test_SN5659__cal_impl.Encode2_P8_m "" VALUE 0x008E3E60 Scalar_FLOAT64_IEEE 0 speedgoat_test_SN5659_R2021b_CM_double -1.7E+308 1.7E+308 /end CHARACTERISTIC
/begin CHARACTERISTIC speedgoat_test_SN5659__cal_impl.Encode2_P9_dn "" VALUE 0x008E3198 Scalar_FLOAT64_IEEE 0 speedgoat_test_SN5659_R2021b_CM_double -1.7E+308 1.7E+308 /end CHARACTERISTIC
/begin CHARACTERISTIC speedgoat_test_SN5659__cal_impl.Encode2_P9_f "" VALUE 0x008E3E78 Scalar_FLOAT64_IEEE 0 speedgoat_test_SN5659_R2021b_CM_double -1.7E+308 1.7E+308 /end CHARACTERISTIC
/begin CHARACTERISTIC speedgoat_test_SN5659__cal_impl.Encode2_P9_g "" VALUE 0x008E4818 Scalar_FLOAT64_IEEE 0 speedgoat_test_SN5659_R2021b_CM_double -1.7E+308 1.7E+308 /end CHARACTERISTIC
/begin CHARACTERISTIC speedgoat_test_SN5659__cal_impl.Encode2_P9_hv "" VALUE 0x008E3808 Scalar_FLOAT64_IEEE 0 speedgoat_test_SN5659_R2021b_CM_double -1.7E+308 1.7E+308 /end CHARACTERISTIC
/begin CHARACTERISTIC speedgoat_test_SN5659__cal_impl.Encode2_P9_l "" VALUE 0x008E2E58 Scalar_FLOAT64_IEEE 0 speedgoat_test_SN5659_R2021b_CM_double -1.7E+308 1.7E+308 /end CHARACTERISTIC
/begin CHARACTERISTIC speedgoat_test_SN5659__cal_impl.Encode2_P9_ni "" VALUE 0x008E24B8 Scalar_FLOAT64_IEEE 0 speedgoat_test_SN5659_R2021b_CM_double -1.7E+308 1.7E+308 /end CHARACTERISTIC
/begin CHARACTERISTIC speedgoat_test_SN5659__cal_impl.Encode3_P10_f "" VALUE 0x008E2CE8 Scalar_FLOAT64_IEEE 0 speedgoat_test_SN5659_R2021b_CM_double -1.7E+308 1.7E+308 /end CHARACTERISTIC
/begin CHARACTERISTIC speedgoat_test_SN5659__cal_impl.Encode3_P10_g "" VALUE 0x008E3358 Scalar_FLOAT64_IEEE 0 speedgoat_test_SN5659_R2021b_CM_double -1.7E+308 1.7E+308 /end CHARACTERISTIC
/begin CHARACTERISTIC speedgoat_test_SN5659__cal_impl.Encode3_P10_k "" VALUE 0x008E4038 Scalar_FLOAT64_IEEE 0 speedgoat_test_SN5659_R2021b_CM_double -1.7E+308 1.7E+308 /end CHARACTERISTIC
/begin CHARACTERISTIC speedgoat_test_SN5659__cal_impl.Encode3_P10_l15 "" VALUE 0x008E46A8 Scalar_FLOAT64_IEEE 0 speedgoat_test_SN5659_R2021b_CM_double -1.7E+308 1.7E+308 /end CHARACTERISTIC
/begin CHARACTERISTIC speedgoat_test_SN5659__cal_impl.Encode3_P10_od "" VALUE 0x008E2678 Scalar_FLOAT64_IEEE 0 speedgoat_test_SN5659_R2021b_CM_double -1.7E+308 1.7E+308 /end CHARACTERISTIC
/begin CHARACTERISTIC speedgoat_test_SN5659__cal_impl.Encode3_P10_oe "" VALUE 0x008E39C8 Scalar_FLOAT64_IEEE 0 speedgoat_test_SN5659_R2021b_CM_double -1.7E+308 1.7E+308 /end CHARACTERISTIC
/begin CHARACTERISTIC speedgoat_test_SN5659__cal_impl.Encode3_P11_a "" VAL_BLK 0x008E39E0 Scalar_FLOAT64_IEEE 0 speedgoat_test_SN5659_R2021b_CM_double -1.7E+308 1.7E+308 MATRIX_DIM 2 1 /end CHARACTERISTIC
/begin CHARACTERISTIC speedgoat_test_SN5659__cal_impl.Encode3_P11_ic "" VAL_BLK 0x008E2D00 Scalar_FLOAT64_IEEE 0 speedgoat_test_SN5659_R2021b_CM_double -1.7E+308 1.7E+308 MATRIX_DIM 2 1 /end CHARACTERISTIC
/begin CHARACTERISTIC speedgoat_test_SN5659__cal_impl.Encode3_P11_jg "" VAL_BLK 0x008E46C0 Scalar_FLOAT64_IEEE 0 speedgoat_test_SN5659_R2021b_CM_double -1.7E+308 1.7E+308 MATRIX_DIM 2 1 /end CHARACTERISTIC
/begin CHARACTERISTIC speedgoat_test_SN5659__cal_impl.Encode3_P11_lg "" VAL_BLK 0x008E4050 Scalar_FLOAT64_IEEE 0 speedgoat_test_SN5659_R2021b_CM_double -1.7E+308 1.7E+308 MATRIX_DIM 2 1 /end CHARACTERISTIC
/begin CHARACTERISTIC speedgoat_test_SN5659__cal_impl.Encode3_P11_o "" VAL_BLK 0x008E2690 Scalar_FLOAT64_IEEE 0 speedgoat_test_SN5659_R2021b_CM_double -1.7E+308 1.7E+308 MATRIX_DIM 2 1 /end CHARACTERISTIC
/begin CHARACTERISTIC speedgoat_test_SN5659__cal_impl.Encode3_P11_ox "" VAL_BLK 0x008E3370 Scalar_FLOAT64_IEEE 0 speedgoat_test_SN5659_R2021b_CM_double -1.7E+308 1.7E+308 MATRIX_DIM 2 1 /end CHARACTERISTIC
/begin CHARACTERISTIC speedgoat_test_SN5659__cal_impl.Encode3_P12_a "" VALUE 0x008E4070 Scalar_FLOAT64_IEEE 0 speedgoat_test_SN5659_R2021b_CM_double -1.7E+308 1.7E+308 /end CHARACTERISTIC
/begin CHARACTERISTIC speedgoat_test_SN5659__cal_impl.Encode3_P12_d3 "" VALUE 0x008E3390 Scalar_FLOAT64_IEEE 0 speedgoat_test_SN5659_R2021b_CM_double -1.7E+308 1.7E+308 /end CHARACTERISTIC
/begin CHARACTERISTIC speedgoat_test_SN5659__cal_impl.Encode3_P12_et "" VALUE 0x008E3A00 Scalar_FLOAT64_IEEE 0 speedgoat_test_SN5659_R2021b_CM_double -1.7E+308 1.7E+308 /end CHARACTERISTIC
/begin CHARACTERISTIC speedgoat_test_SN5659__cal_impl.Encode3_P12_f "" VALUE 0x008E26B0 Scalar_FLOAT64_IEEE 0 speedgoat_test_SN5659_R2021b_CM_double -1.7E+308 1.7E+308 /end CHARACTERISTIC
/begin CHARACTERISTIC speedgoat_test_SN5659__cal_impl.Encode3_P12_m "" VALUE 0x008E2D20 Scalar_FLOAT64_IEEE 0 speedgoat_test_SN5659_R2021b_CM_double -1.7E+308 1.7E+308 /end CHARACTERISTIC
/begin CHARACTERISTIC speedgoat_test_SN5659__cal_impl.Encode3_P12_n "" VALUE 0x008E46E0 Scalar_FLOAT64_IEEE 0 speedgoat_test_SN5659_R2021b_CM_double -1.7E+308 1.7E+308 /end CHARACTERISTIC
/begin CHARACTERISTIC speedgoat_test_SN5659__cal_impl.Encode3_P13_a "" VALUE 0x008E26C8 Scalar_FLOAT64_IEEE 0 speedgoat_test_SN5659_R2021b_CM_double -1.7E+308 1.7E+308 /end CHARACTERISTIC
/begin CHARACTERISTIC speedgoat_test_SN5659__cal_impl.Encode3_P13_d "" VALUE 0x008E3A18 Scalar_FLOAT64_IEEE 0 speedgoat_test_SN5659_R2021b_CM_double -1.7E+308 1.7E+308 /end CHARACTERISTIC
/begin CHARACTERISTIC speedgoat_test_SN5659__cal_impl.Encode3_P13_f "" VALUE 0x008E46F8 Scalar_FLOAT64_IEEE 0 speedgoat_test_SN5659_R2021b_CM_double -1.7E+308 1.7E+308 /end CHARACTERISTIC
/begin CHARACTERISTIC speedgoat_test_SN5659__cal_impl.Encode3_P13_hi "" VALUE 0x008E2D38 Scalar_FLOAT64_IEEE 0 speedgoat_test_SN5659_R2021b_CM_double -1.7E+308 1.7E+308 /end CHARACTERISTIC
/begin CHARACTERISTIC speedgoat_test_SN5659__cal_impl.Encode3_P13_n "" VALUE 0x008E33A8 Scalar_FLOAT64_IEEE 0 speedgoat_test_SN5659_R2021b_CM_double -1.7E+308 1.7E+308 /end CHARACTERISTIC
/begin CHARACTERISTIC speedgoat_test_SN5659__cal_impl.Encode3_P13_ov "" VALUE 0x008E4088 Scalar_FLOAT64_IEEE 0 speedgoat_test_SN5659_R2021b_CM_double -1.7E+308 1.7E+308 /end CHARACTERISTIC
/begin CHARACTERISTIC speedgoat_test_SN5659__cal_impl.Encode3_P14_bl "" VALUE 0x008E33C0 Scalar_FLOAT64_IEEE 0 speedgoat_test_SN5659_R2021b_CM_double -1.7E+308 1.7E+308 /end CHARACTERISTIC
/begin CHARACTERISTIC speedgoat_test_SN5659__cal_impl.Encode3_P14_g "" VALUE 0x008E26E0 Scalar_FLOAT64_IEEE 0 speedgoat_test_SN5659_R2021b_CM_double -1.7E+308 1.7E+308 /end CHARACTERISTIC
/begin CHARACTERISTIC speedgoat_test_SN5659__cal_impl.Encode3_P14_m5 "" VALUE 0x008E40A0 Scalar_FLOAT64_IEEE 0 speedgoat_test_SN5659_R2021b_CM_double -1.7E+308 1.7E+308 /end CHARACTERISTIC
/begin CHARACTERISTIC speedgoat_test_SN5659__cal_impl.Encode3_P14_nc "" VALUE 0x008E4710 Scalar_FLOAT64_IEEE 0 speedgoat_test_SN5659_R2021b_CM_double -1.7E+308 1.7E+308 /end CHARACTERISTIC
/begin CHARACTERISTIC speedgoat_test_SN5659__cal_impl.Encode3_P14_op "" VALUE 0x008E2D50 Scalar_FLOAT64_IEEE 0 speedgoat_test_SN5659_R2021b_CM_double -1.7E+308 1.7E+308 /end CHARACTERISTIC
/begin CHARACTERISTIC speedgoat_test_SN5659__cal_impl.Encode3_P14_p "" VALUE 0x008E3A30 Scalar_FLOAT64_IEEE 0 speedgoat_test_SN5659_R2021b_CM_double -1.7E+308 1.7E+308 /end CHARACTERISTIC
/begin CHARACTERISTIC speedgoat_test_SN5659__cal_impl.Encode3_P15_a "" VALUE 0x008E26F8 Scalar_FLOAT64_IEEE 0 speedgoat_test_SN5659_R2021b_CM_double -1.7E+308 1.7E+308 /end CHARACTERISTIC
/begin CHARACTERISTIC speedgoat_test_SN5659__cal_impl.Encode3_P15_f "" VALUE 0x008E2D68 Scalar_FLOAT64_IEEE 0 speedgoat_test_SN5659_R2021b_CM_double -1.7E+308 1.7E+308 /end CHARACTERISTIC
/begin CHARACTERISTIC speedgoat_test_SN5659__cal_impl.Encode3_P15_gy "" VALUE 0x008E33D8 Scalar_FLOAT64_IEEE 0 speedgoat_test_SN5659_R2021b_CM_double -1.7E+308 1.7E+308 /end CHARACTERISTIC
/begin CHARACTERISTIC speedgoat_test_SN5659__cal_impl.Encode3_P15_l "" VALUE 0x008E3A48 Scalar_FLOAT64_IEEE 0 speedgoat_test_SN5659_R2021b_CM_double -1.7E+308 1.7E+308 /end CHARACTERISTIC
/begin CHARACTERISTIC speedgoat_test_SN5659__cal_impl.Encode3_P15_o "" VALUE 0x008E4728 Scalar_FLOAT64_IEEE 0 speedgoat_test_SN5659_R2021b_CM_double -1.7E+308 1.7E+308 /end CHARACTERISTIC
/begin CHARACTERISTIC speedgoat_test_SN5659__cal_impl.Encode3_P15_pd "" VALUE 0x008E40B8 Scalar_FLOAT64_IEEE 0 speedgoat_test_SN5659_R2021b_CM_double -1.7E+308 1.7E+308 /end CHARACTERISTIC
/begin CHARACTERISTIC speedgoat_test_SN5659__cal_impl.Encode3_P1_ad "" VALUE 0x008E25A0 Scalar_FLOAT64_IEEE 0 speedgoat_test_SN5659_R2021b_CM_double -1.7E+308 1.7E+308 /end CHARACTERISTIC
/begin CHARACTERISTIC speedgoat_test_SN5659__cal_impl.Encode3_P1_d "" VALUE 0x008E3F60 Scalar_FLOAT64_IEEE 0 speedgoat_test_SN5659_R2021b_CM_double -1.7E+308 1.7E+308 /end CHARACTERISTIC
/begin CHARACTERISTIC speedgoat_test_SN5659__cal_impl.Encode3_P1_j "" VALUE 0x008E3280 Scalar_FLOAT64_IEEE 0 speedgoat_test_SN5659_R2021b_CM_double -1.7E+308 1.7E+308 /end CHARACTERISTIC
/begin CHARACTERISTIC speedgoat_test_SN5659__cal_impl.Encode3_P1_jy "" VALUE 0x008E38F0 Scalar_FLOAT64_IEEE 0 speedgoat_test_SN5659_R2021b_CM_double -1.7E+308 1.7E+308 /end CHARACTERISTIC
/begin CHARACTERISTIC speedgoat_test_SN5659__cal_impl.Encode3_P1_lu "" VALUE 0x008E45D0 Scalar_FLOAT64_IEEE 0 speedgoat_test_SN5659_R2021b_CM_double -1.7E+308 1.7E+308 /end CHARACTERISTIC
/begin CHARACTERISTIC speedgoat_test_SN5659__cal_impl.Encode3_P1_o "" VALUE 0x008E2C10 Scalar_FLOAT64_IEEE 0 speedgoat_test_SN5659_R2021b_CM_double -1.7E+308 1.7E+308 /end CHARACTERISTIC
/begin CHARACTERISTIC speedgoat_test_SN5659__cal_impl.Encode3_P2_b0 "" VALUE 0x008E2C28 Scalar_FLOAT64_IEEE 0 speedgoat_test_SN5659_R2021b_CM_double -1.7E+308 1.7E+308 /end CHARACTERISTIC
/begin CHARACTERISTIC speedgoat_test_SN5659__cal_impl.Encode3_P2_d "" VALUE 0x008E3908 Scalar_FLOAT64_IEEE 0 speedgoat_test_SN5659_R2021b_CM_double -1.7E+308 1.7E+308 /end CHARACTERISTIC
/begin CHARACTERISTIC speedgoat_test_SN5659__cal_impl.Encode3_P2_dl "" VALUE 0x008E45E8 Scalar_FLOAT64_IEEE 0 speedgoat_test_SN5659_R2021b_CM_double -1.7E+308 1.7E+308 /end CHARACTERISTIC
/begin CHARACTERISTIC speedgoat_test_SN5659__cal_impl.Encode3_P2_fg "" VALUE 0x008E25B8 Scalar_FLOAT64_IEEE 0 speedgoat_test_SN5659_R2021b_CM_double -1.7E+308 1.7E+308 /end CHARACTERISTIC
/begin CHARACTERISTIC speedgoat_test_SN5659__cal_impl.Encode3_P2_ni "" VALUE 0x008E3F78 Scalar_FLOAT64_IEEE 0 speedgoat_test_SN5659_R2021b_CM_double -1.7E+308 1.7E+308 /end CHARACTERISTIC
/begin CHARACTERISTIC speedgoat_test_SN5659__cal_impl.Encode3_P2_p "" VALUE 0x008E3298 Scalar_FLOAT64_IEEE 0 speedgoat_test_SN5659_R2021b_CM_double -1.7E+308 1.7E+308 /end CHARACTERISTIC
/begin CHARACTERISTIC speedgoat_test_SN5659__cal_impl.Encode3_P3_e "" VALUE 0x008E3F90 Scalar_FLOAT64_IEEE 0 speedgoat_test_SN5659_R2021b_CM_double -1.7E+308 1.7E+308 /end CHARACTERISTIC
/begin CHARACTERISTIC speedgoat_test_SN5659__cal_impl.Encode3_P3_f "" VALUE 0x008E3920 Scalar_FLOAT64_IEEE 0 speedgoat_test_SN5659_R2021b_CM_double -1.7E+308 1.7E+308 /end CHARACTERISTIC
/begin CHARACTERISTIC speedgoat_test_SN5659__cal_impl.Encode3_P3_k "" VALUE 0x008E4600 Scalar_FLOAT64_IEEE 0 speedgoat_test_SN5659_R2021b_CM_double -1.7E+308 1.7E+308 /end CHARACTERISTIC
/begin CHARACTERISTIC speedgoat_test_SN5659__cal_impl.Encode3_P3_nx "" VALUE 0x008E25D0 Scalar_FLOAT64_IEEE 0 speedgoat_test_SN5659_R2021b_CM_double -1.7E+308 1.7E+308 /end CHARACTERISTIC
/begin CHARACTERISTIC speedgoat_test_SN5659__cal_impl.Encode3_P3_p "" VALUE 0x008E2C40 Scalar_FLOAT64_IEEE 0 speedgoat_test_SN5659_R2021b_CM_double -1.7E+308 1.7E+308 /end CHARACTERISTIC
/begin CHARACTERISTIC speedgoat_test_SN5659__cal_impl.Encode3_P3_pb "" VALUE 0x008E32B0 Scalar_FLOAT64_IEEE 0 speedgoat_test_SN5659_R2021b_CM_double -1.7E+308 1.7E+308 /end CHARACTERISTIC
/begin CHARACTERISTIC speedgoat_test_SN5659__cal_impl.Encode3_P4_ga "" VALUE 0x008E4618 Scalar_FLOAT64_IEEE 0 speedgoat_test_SN5659_R2021b_CM_double -1.7E+308 1.7E+308 /end CHARACTERISTIC
/begin CHARACTERISTIC speedgoat_test_SN5659__cal_impl.Encode3_P4_go "" VALUE 0x008E25E8 Scalar_FLOAT64_IEEE 0 speedgoat_test_SN5659_R2021b_CM_double -1.7E+308 1.7E+308 /end CHARACTERISTIC
/begin CHARACTERISTIC speedgoat_test_SN5659__cal_impl.Encode3_P4_he "" VALUE 0x008E3FA8 Scalar_FLOAT64_IEEE 0 speedgoat_test_SN5659_R2021b_CM_double -1.7E+308 1.7E+308 /end CHARACTERISTIC
/begin CHARACTERISTIC speedgoat_test_SN5659__cal_impl.Encode3_P4_hs "" VALUE 0x008E2C58 Scalar_FLOAT64_IEEE 0 speedgoat_test_SN5659_R2021b_CM_double -1.7E+308 1.7E+308 /end CHARACTERISTIC
/begin CHARACTERISTIC speedgoat_test_SN5659__cal_impl.Encode3_P4_hu "" VALUE 0x008E32C8 Scalar_FLOAT64_IEEE 0 speedgoat_test_SN5659_R2021b_CM_double -1.7E+308 1.7E+308 /end CHARACTERISTIC
/begin CHARACTERISTIC speedgoat_test_SN5659__cal_impl.Encode3_P4_mc "" VALUE 0x008E3938 Scalar_FLOAT64_IEEE 0 speedgoat_test_SN5659_R2021b_CM_double -1.7E+308 1.7E+308 /end CHARACTERISTIC
/begin CHARACTERISTIC speedgoat_test_SN5659__cal_impl.Encode3_P5_d0 "" VALUE 0x008E3950 Scalar_FLOAT64_IEEE 0 speedgoat_test_SN5659_R2021b_CM_double -1.7E+308 1.7E+308 /end CHARACTERISTIC
/begin CHARACTERISTIC speedgoat_test_SN5659__cal_impl.Encode3_P5_g "" VALUE 0x008E2C70 Scalar_FLOAT64_IEEE 0 speedgoat_test_SN5659_R2021b_CM_double -1.7E+308 1.7E+308 /end CHARACTERISTIC
/begin CHARACTERISTIC speedgoat_test_SN5659__cal_impl.Encode3_P5_i0 "" VALUE 0x008E2600 Scalar_FLOAT64_IEEE 0 speedgoat_test_SN5659_R2021b_CM_double -1.7E+308 1.7E+308 /end CHARACTERISTIC
/begin CHARACTERISTIC speedgoat_test_SN5659__cal_impl.Encode3_P5_j "" VALUE 0x008E4630 Scalar_FLOAT64_IEEE 0 speedgoat_test_SN5659_R2021b_CM_double -1.7E+308 1.7E+308 /end CHARACTERISTIC
/begin CHARACTERISTIC speedgoat_test_SN5659__cal_impl.Encode3_P5_kk "" VALUE 0x008E32E0 Scalar_FLOAT64_IEEE 0 speedgoat_test_SN5659_R2021b_CM_double -1.7E+308 1.7E+308 /end CHARACTERISTIC
/begin CHARACTERISTIC speedgoat_test_SN5659__cal_impl.Encode3_P5_l "" VALUE 0x008E3FC0 Scalar_FLOAT64_IEEE 0 speedgoat_test_SN5659_R2021b_CM_double -1.7E+308 1.7E+308 /end CHARACTERISTIC
/begin CHARACTERISTIC speedgoat_test_SN5659__cal_impl.Encode3_P6_a0 "" VALUE 0x008E2618 Scalar_FLOAT64_IEEE 0 speedgoat_test_SN5659_R2021b_CM_double -1.7E+308 1.7E+308 /end CHARACTERISTIC
/begin CHARACTERISTIC speedgoat_test_SN5659__cal_impl.Encode3_P6_gz "" VALUE 0x008E4648 Scalar_FLOAT64_IEEE 0 speedgoat_test_SN5659_R2021b_CM_double -1.7E+308 1.7E+308 /end CHARACTERISTIC
/begin CHARACTERISTIC speedgoat_test_SN5659__cal_impl.Encode3_P6_hf "" VALUE 0x008E3968 Scalar_FLOAT64_IEEE 0 speedgoat_test_SN5659_R2021b_CM_double -1.7E+308 1.7E+308 /end CHARACTERISTIC
/begin CHARACTERISTIC speedgoat_test_SN5659__cal_impl.Encode3_P6_hi "" VALUE 0x008E2C88 Scalar_FLOAT64_IEEE 0 speedgoat_test_SN5659_R2021b_CM_double -1.7E+308 1.7E+308 /end CHARACTERISTIC
/begin CHARACTERISTIC speedgoat_test_SN5659__cal_impl.Encode3_P6_iy "" VALUE 0x008E32F8 Scalar_FLOAT64_IEEE 0 speedgoat_test_SN5659_R2021b_CM_double -1.7E+308 1.7E+308 /end CHARACTERISTIC
/begin CHARACTERISTIC speedgoat_test_SN5659__cal_impl.Encode3_P6_o "" VALUE 0x008E3FD8 Scalar_FLOAT64_IEEE 0 speedgoat_test_SN5659_R2021b_CM_double -1.7E+308 1.7E+308 /end CHARACTERISTIC
/begin CHARACTERISTIC speedgoat_test_SN5659__cal_impl.Encode3_P7_bt "" VALUE 0x008E3FF0 Scalar_FLOAT64_IEEE 0 speedgoat_test_SN5659_R2021b_CM_double -1.7E+308 1.7E+308 /end CHARACTERISTIC
/begin CHARACTERISTIC speedgoat_test_SN5659__cal_impl.Encode3_P7_c "" VALUE 0x008E2CA0 Scalar_FLOAT64_IEEE 0 speedgoat_test_SN5659_R2021b_CM_double -1.7E+308 1.7E+308 /end CHARACTERISTIC
/begin CHARACTERISTIC speedgoat_test_SN5659__cal_impl.Encode3_P7_dw "" VALUE 0x008E4660 Scalar_FLOAT64_IEEE 0 speedgoat_test_SN5659_R2021b_CM_double -1.7E+308 1.7E+308 /end CHARACTERISTIC
/begin CHARACTERISTIC speedgoat_test_SN5659__cal_impl.Encode3_P7_g "" VALUE 0x008E3310 Scalar_FLOAT64_IEEE 0 speedgoat_test_SN5659_R2021b_CM_double -1.7E+308 1.7E+308 /end CHARACTERISTIC
/begin CHARACTERISTIC speedgoat_test_SN5659__cal_impl.Encode3_P7_k "" VALUE 0x008E3980 Scalar_FLOAT64_IEEE 0 speedgoat_test_SN5659_R2021b_CM_double -1.7E+308 1.7E+308 /end CHARACTERISTIC
/begin CHARACTERISTIC speedgoat_test_SN5659__cal_impl.Encode3_P7_p "" VALUE 0x008E2630 Scalar_FLOAT64_IEEE 0 speedgoat_test_SN5659_R2021b_CM_double -1.7E+308 1.7E+308 /end CHARACTERISTIC
/begin CHARACTERISTIC speedgoat_test_SN5659__cal_impl.Encode3_P8_a "" VALUE 0x008E4678 Scalar_FLOAT64_IEEE 0 speedgoat_test_SN5659_R2021b_CM_double -1.7E+308 1.7E+308 /end CHARACTERISTIC
/begin CHARACTERISTIC speedgoat_test_SN5659__cal_impl.Encode3_P8_c "" VALUE 0x008E3328 Scalar_FLOAT64_IEEE 0 speedgoat_test_SN5659_R2021b_CM_double -1.7E+308 1.7E+308 /end CHARACTERISTIC
/begin CHARACTERISTIC speedgoat_test_SN5659__cal_impl.Encode3_P8_fe "" VALUE 0x008E2CB8 Scalar_FLOAT64_IEEE 0 speedgoat_test_SN5659_R2021b_CM_double -1.7E+308 1.7E+308 /end CHARACTERISTIC
/begin CHARACTERISTIC speedgoat_test_SN5659__cal_impl.Encode3_P8_j "" VALUE 0x008E2648 Scalar_FLOAT64_IEEE 0 speedgoat_test_SN5659_R2021b_CM_double -1.7E+308 1.7E+308 /end CHARACTERISTIC
/begin CHARACTERISTIC speedgoat_test_SN5659__cal_impl.Encode3_P8_n "" VALUE 0x008E4008 Scalar_FLOAT64_IEEE 0 speedgoat_test_SN5659_R2021b_CM_double -1.7E+308 1.7E+308 /end CHARACTERISTIC
/begin CHARACTERISTIC speedgoat_test_SN5659__cal_impl.Encode3_P8_o "" VALUE 0x008E3998 Scalar_FLOAT64_IEEE 0 speedgoat_test_SN5659_R2021b_CM_double -1.7E+308 1.7E+308 /end CHARACTERISTIC
/begin CHARACTERISTIC speedgoat_test_SN5659__cal_impl.Encode3_P9_a "" VALUE 0x008E3340 Scalar_FLOAT64_IEEE 0 speedgoat_test_SN5659_R2021b_CM_double -1.7E+308 1.7E+308 /end CHARACTERISTIC
/begin CHARACTERISTIC speedgoat_test_SN5659__cal_impl.Encode3_P9_cw "" VALUE 0x008E39B0 Scalar_FLOAT64_IEEE 0 speedgoat_test_SN5659_R2021b_CM_double -1.7E+308 1.7E+308 /end CHARACTERISTIC
/begin CHARACTERISTIC speedgoat_test_SN5659__cal_impl.Encode3_P9_e "" VALUE 0x008E4020 Scalar_FLOAT64_IEEE 0 speedgoat_test_SN5659_R2021b_CM_double -1.7E+308 1.7E+308 /end CHARACTERISTIC
/begin CHARACTERISTIC speedgoat_test_SN5659__cal_impl.Encode3_P9_l "" VALUE 0x008E2CD0 Scalar_FLOAT64_IEEE 0 speedgoat_test_SN5659_R2021b_CM_double -1.7E+308 1.7E+308 /end CHARACTERISTIC
/begin CHARACTERISTIC speedgoat_test_SN5659__cal_impl.Encode3_P9_lj "" VALUE 0x008E4690 Scalar_FLOAT64_IEEE 0 speedgoat_test_SN5659_R2021b_CM_double -1.7E+308 1.7E+308 /end CHARACTERISTIC
/begin CHARACTERISTIC speedgoat_test_SN5659__cal_impl.Encode3_P9_o "" VALUE 0x008E2660 Scalar_FLOAT64_IEEE 0 speedgoat_test_SN5659_R2021b_CM_double -1.7E+308 1.7E+308 /end CHARACTERISTIC
/begin CHARACTERISTIC speedgoat_test_SN5659__cal_impl.Encode4_P10_h3 "" VALUE 0x008E34E0 Scalar_FLOAT64_IEEE 0 speedgoat_test_SN5659_R2021b_CM_double -1.7E+308 1.7E+308 /end CHARACTERISTIC
/begin CHARACTERISTIC speedgoat_test_SN5659__cal_impl.Encode4_P10_jg "" VALUE 0x008E41C0 Scalar_FLOAT64_IEEE 0 speedgoat_test_SN5659_R2021b_CM_double -1.7E+308 1.7E+308 /end CHARACTERISTIC
/begin CHARACTERISTIC speedgoat_test_SN5659__cal_impl.Encode4_P10_l "" VALUE 0x008E3B50 Scalar_FLOAT64_IEEE 0 speedgoat_test_SN5659_R2021b_CM_double -1.7E+308 1.7E+308 /end CHARACTERISTIC
/begin CHARACTERISTIC speedgoat_test_SN5659__cal_impl.Encode4_P10_p "" VALUE 0x008E2800 Scalar_FLOAT64_IEEE 0 speedgoat_test_SN5659_R2021b_CM_double -1.7E+308 1.7E+308 /end CHARACTERISTIC
/begin CHARACTERISTIC speedgoat_test_SN5659__cal_impl.Encode4_P11_a "" VAL_BLK 0x008E2818 Scalar_FLOAT64_IEEE 0 speedgoat_test_SN5659_R2021b_CM_double -1.7E+308 1.7E+308 MATRIX_DIM 2 1 /end CHARACTERISTIC
/begin CHARACTERISTIC speedgoat_test_SN5659__cal_impl.Encode4_P11_js "" VAL_BLK 0x008E41D8 Scalar_FLOAT64_IEEE 0 speedgoat_test_SN5659_R2021b_CM_double -1.7E+308 1.7E+308 MATRIX_DIM 2 1 /end CHARACTERISTIC
/begin CHARACTERISTIC speedgoat_test_SN5659__cal_impl.Encode4_P11_l "" VAL_BLK 0x008E34F8 Scalar_FLOAT64_IEEE 0 speedgoat_test_SN5659_R2021b_CM_double -1.7E+308 1.7E+308 MATRIX_DIM 2 1 /end CHARACTERISTIC
/begin CHARACTERISTIC speedgoat_test_SN5659__cal_impl.Encode4_P11_pl "" VAL_BLK 0x008E3B68 Scalar_FLOAT64_IEEE 0 speedgoat_test_SN5659_R2021b_CM_double -1.7E+308 1.7E+308 MATRIX_DIM 2 1 /end CHARACTERISTIC
/begin CHARACTERISTIC speedgoat_test_SN5659__cal_impl.Encode4_P12_c "" VALUE 0x008E3518 Scalar_FLOAT64_IEEE 0 speedgoat_test_SN5659_R2021b_CM_double -1.7E+308 1.7E+308 /end CHARACTERISTIC
/begin CHARACTERISTIC speedgoat_test_SN5659__cal_impl.Encode4_P12_k "" VALUE 0x008E3B88 Scalar_FLOAT64_IEEE 0 speedgoat_test_SN5659_R2021b_CM_double -1.7E+308 1.7E+308 /end CHARACTERISTIC
/begin CHARACTERISTIC speedgoat_test_SN5659__cal_impl.Encode4_P12_ld "" VALUE 0x008E2838 Scalar_FLOAT64_IEEE 0 speedgoat_test_SN5659_R2021b_CM_double -1.7E+308 1.7E+308 /end CHARACTERISTIC
/begin CHARACTERISTIC speedgoat_test_SN5659__cal_impl.Encode4_P12_n "" VALUE 0x008E41F8 Scalar_FLOAT64_IEEE 0 speedgoat_test_SN5659_R2021b_CM_double -1.7E+308 1.7E+308 /end CHARACTERISTIC
/begin CHARACTERISTIC speedgoat_test_SN5659__cal_impl.Encode4_P13_g "" VALUE 0x008E2850 Scalar_FLOAT64_IEEE 0 speedgoat_test_SN5659_R2021b_CM_double -1.7E+308 1.7E+308 /end CHARACTERISTIC
/begin CHARACTERISTIC speedgoat_test_SN5659__cal_impl.Encode4_P13_hn "" VALUE 0x008E3BA0 Scalar_FLOAT64_IEEE 0 speedgoat_test_SN5659_R2021b_CM_double -1.7E+308 1.7E+308 /end CHARACTERISTIC
/begin CHARACTERISTIC speedgoat_test_SN5659__cal_impl.Encode4_P13_k "" VALUE 0x008E4210 Scalar_FLOAT64_IEEE 0 speedgoat_test_SN5659_R2021b_CM_double -1.7E+308 1.7E+308 /end CHARACTERISTIC
/begin CHARACTERISTIC speedgoat_test_SN5659__cal_impl.Encode4_P13_ml "" VALUE 0x008E3530 Scalar_FLOAT64_IEEE 0 speedgoat_test_SN5659_R2021b_CM_double -1.7E+308 1.7E+308 /end CHARACTERISTIC
/begin CHARACTERISTIC speedgoat_test_SN5659__cal_impl.Encode4_P14_f "" VALUE 0x008E4228 Scalar_FLOAT64_IEEE 0 speedgoat_test_SN5659_R2021b_CM_double -1.7E+308 1.7E+308 /end CHARACTERISTIC
/begin CHARACTERISTIC speedgoat_test_SN5659__cal_impl.Encode4_P14_k "" VALUE 0x008E3548 Scalar_FLOAT64_IEEE 0 speedgoat_test_SN5659_R2021b_CM_double -1.7E+308 1.7E+308 /end CHARACTERISTIC
/begin CHARACTERISTIC speedgoat_test_SN5659__cal_impl.Encode4_P14_ma "" VALUE 0x008E3BB8 Scalar_FLOAT64_IEEE 0 speedgoat_test_SN5659_R2021b_CM_double -1.7E+308 1.7E+308 /end CHARACTERISTIC
/begin CHARACTERISTIC speedgoat_test_SN5659__cal_impl.Encode4_P14_o "" VALUE 0x008E2868 Scalar_FLOAT64_IEEE 0 speedgoat_test_SN5659_R2021b_CM_double -1.7E+308 1.7E+308 /end CHARACTERISTIC
/begin CHARACTERISTIC speedgoat_test_SN5659__cal_impl.Encode4_P15_c "" VALUE 0x008E4240 Scalar_FLOAT64_IEEE 0 speedgoat_test_SN5659_R2021b_CM_double -1.7E+308 1.7E+308 /end CHARACTERISTIC
/begin CHARACTERISTIC speedgoat_test_SN5659__cal_impl.Encode4_P15_iu "" VALUE 0x008E3BD0 Scalar_FLOAT64_IEEE 0 speedgoat_test_SN5659_R2021b_CM_double -1.7E+308 1.7E+308 /end CHARACTERISTIC
/begin CHARACTERISTIC speedgoat_test_SN5659__cal_impl.Encode4_P15_j "" VALUE 0x008E2880 Scalar_FLOAT64_IEEE 0 speedgoat_test_SN5659_R2021b_CM_double -1.7E+308 1.7E+308 /end CHARACTERISTIC
/begin CHARACTERISTIC speedgoat_test_SN5659__cal_impl.Encode4_P15_o "" VALUE 0x008E3560 Scalar_FLOAT64_IEEE 0 speedgoat_test_SN5659_R2021b_CM_double -1.7E+308 1.7E+308 /end CHARACTERISTIC
/begin CHARACTERISTIC speedgoat_test_SN5659__cal_impl.Encode4_P1_af "" VALUE 0x008E3408 Scalar_FLOAT64_IEEE 0 speedgoat_test_SN5659_R2021b_CM_double -1.7E+308 1.7E+308 /end CHARACTERISTIC
/begin CHARACTERISTIC speedgoat_test_SN5659__cal_impl.Encode4_P1_h "" VALUE 0x008E2728 Scalar_FLOAT64_IEEE 0 speedgoat_test_SN5659_R2021b_CM_double -1.7E+308 1.7E+308 /end CHARACTERISTIC
/begin CHARACTERISTIC speedgoat_test_SN5659__cal_impl.Encode4_P1_hi "" VALUE 0x008E40E8 Scalar_FLOAT64_IEEE 0 speedgoat_test_SN5659_R2021b_CM_double -1.7E+308 1.7E+308 /end CHARACTERISTIC
/begin CHARACTERISTIC speedgoat_test_SN5659__cal_impl.Encode4_P1_o "" VALUE 0x008E3A78 Scalar_FLOAT64_IEEE 0 speedgoat_test_SN5659_R2021b_CM_double -1.7E+308 1.7E+308 /end CHARACTERISTIC
/begin CHARACTERISTIC speedgoat_test_SN5659__cal_impl.Encode4_P2_e "" VALUE 0x008E2740 Scalar_FLOAT64_IEEE 0 speedgoat_test_SN5659_R2021b_CM_double -1.7E+308 1.7E+308 /end CHARACTERISTIC
/begin CHARACTERISTIC speedgoat_test_SN5659__cal_impl.Encode4_P2_j "" VALUE 0x008E3420 Scalar_FLOAT64_IEEE 0 speedgoat_test_SN5659_R2021b_CM_double -1.7E+308 1.7E+308 /end CHARACTERISTIC
/begin CHARACTERISTIC speedgoat_test_SN5659__cal_impl.Encode4_P2_k "" VALUE 0x008E4100 Scalar_FLOAT64_IEEE 0 speedgoat_test_SN5659_R2021b_CM_double -1.7E+308 1.7E+308 /end CHARACTERISTIC
/begin CHARACTERISTIC speedgoat_test_SN5659__cal_impl.Encode4_P2_pk "" VALUE 0x008E3A90 Scalar_FLOAT64_IEEE 0 speedgoat_test_SN5659_R2021b_CM_double -1.7E+308 1.7E+308 /end CHARACTERISTIC
/begin CHARACTERISTIC speedgoat_test_SN5659__cal_impl.Encode4_P3_h5 "" VALUE 0x008E3AA8 Scalar_FLOAT64_IEEE 0 speedgoat_test_SN5659_R2021b_CM_double -1.7E+308 1.7E+308 /end CHARACTERISTIC
/begin CHARACTERISTIC speedgoat_test_SN5659__cal_impl.Encode4_P3_j "" VALUE 0x008E2758 Scalar_FLOAT64_IEEE 0 speedgoat_test_SN5659_R2021b_CM_double -1.7E+308 1.7E+308 /end CHARACTERISTIC
/begin CHARACTERISTIC speedgoat_test_SN5659__cal_impl.Encode4_P3_k "" VALUE 0x008E4118 Scalar_FLOAT64_IEEE 0 speedgoat_test_SN5659_R2021b_CM_double -1.7E+308 1.7E+308 /end CHARACTERISTIC
/begin CHARACTERISTIC speedgoat_test_SN5659__cal_impl.Encode4_P3_n5 "" VALUE 0x008E3438 Scalar_FLOAT64_IEEE 0 speedgoat_test_SN5659_R2021b_CM_double -1.7E+308 1.7E+308 /end CHARACTERISTIC
/begin CHARACTERISTIC speedgoat_test_SN5659__cal_impl.Encode4_P4_j "" VALUE 0x008E4130 Scalar_FLOAT64_IEEE 0 speedgoat_test_SN5659_R2021b_CM_double -1.7E+308 1.7E+308 /end CHARACTERISTIC
/begin CHARACTERISTIC speedgoat_test_SN5659__cal_impl.Encode4_P4_kc "" VALUE 0x008E3450 Scalar_FLOAT64_IEEE 0 speedgoat_test_SN5659_R2021b_CM_double -1.7E+308 1.7E+308 /end CHARACTERISTIC
/begin CHARACTERISTIC speedgoat_test_SN5659__cal_impl.Encode4_P4_my "" VALUE 0x008E3AC0 Scalar_FLOAT64_IEEE 0 speedgoat_test_SN5659_R2021b_CM_double -1.7E+308 1.7E+308 /end CHARACTERISTIC
/begin CHARACTERISTIC speedgoat_test_SN5659__cal_impl.Encode4_P4_o "" VALUE 0x008E2770 Scalar_FLOAT64_IEEE 0 speedgoat_test_SN5659_R2021b_CM_double -1.7E+308 1.7E+308 /end CHARACTERISTIC
/begin CHARACTERISTIC speedgoat_test_SN5659__cal_impl.Encode4_P5_d "" VALUE 0x008E3468 Scalar_FLOAT64_IEEE 0 speedgoat_test_SN5659_R2021b_CM_double -1.7E+308 1.7E+308 /end CHARACTERISTIC
/begin CHARACTERISTIC speedgoat_test_SN5659__cal_impl.Encode4_P5_g "" VALUE 0x008E4148 Scalar_FLOAT64_IEEE 0 speedgoat_test_SN5659_R2021b_CM_double -1.7E+308 1.7E+308 /end CHARACTERISTIC
/begin CHARACTERISTIC speedgoat_test_SN5659__cal_impl.Encode4_P5_pt "" VALUE 0x008E2788 Scalar_FLOAT64_IEEE 0 speedgoat_test_SN5659_R2021b_CM_double -1.7E+308 1.7E+308 /end CHARACTERISTIC
/begin CHARACTERISTIC speedgoat_test_SN5659__cal_impl.Encode4_P5_pv "" VALUE 0x008E3AD8 Scalar_FLOAT64_IEEE 0 speedgoat_test_SN5659_R2021b_CM_double -1.7E+308 1.7E+308 /end CHARACTERISTIC
/begin CHARACTERISTIC speedgoat_test_SN5659__cal_impl.Encode4_P6_ab "" VALUE 0x008E27A0 Scalar_FLOAT64_IEEE 0 speedgoat_test_SN5659_R2021b_CM_double -1.7E+308 1.7E+308 /end CHARACTERISTIC
/begin CHARACTERISTIC speedgoat_test_SN5659__cal_impl.Encode4_P6_abh "" VALUE 0x008E3480 Scalar_FLOAT64_IEEE 0 speedgoat_test_SN5659_R2021b_CM_double -1.7E+308 1.7E+308 /end CHARACTERISTIC
/begin CHARACTERISTIC speedgoat_test_SN5659__cal_impl.Encode4_P6_ed "" VALUE 0x008E3AF0 Scalar_FLOAT64_IEEE 0 speedgoat_test_SN5659_R2021b_CM_double -1.7E+308 1.7E+308 /end CHARACTERISTIC
/begin CHARACTERISTIC speedgoat_test_SN5659__cal_impl.Encode4_P6_g "" VALUE 0x008E4160 Scalar_FLOAT64_IEEE 0 speedgoat_test_SN5659_R2021b_CM_double -1.7E+308 1.7E+308 /end CHARACTERISTIC
/begin CHARACTERISTIC speedgoat_test_SN5659__cal_impl.Encode4_P7_by "" VALUE 0x008E3B08 Scalar_FLOAT64_IEEE 0 speedgoat_test_SN5659_R2021b_CM_double -1.7E+308 1.7E+308 /end CHARACTERISTIC
/begin CHARACTERISTIC speedgoat_test_SN5659__cal_impl.Encode4_P7_c3 "" VALUE 0x008E4178 Scalar_FLOAT64_IEEE 0 speedgoat_test_SN5659_R2021b_CM_double -1.7E+308 1.7E+308 /end CHARACTERISTIC
/begin CHARACTERISTIC speedgoat_test_SN5659__cal_impl.Encode4_P7_di "" VALUE 0x008E3498 Scalar_FLOAT64_IEEE 0 speedgoat_test_SN5659_R2021b_CM_double -1.7E+308 1.7E+308 /end CHARACTERISTIC
/begin CHARACTERISTIC speedgoat_test_SN5659__cal_impl.Encode4_P7_i "" VALUE 0x008E27B8 Scalar_FLOAT64_IEEE 0 speedgoat_test_SN5659_R2021b_CM_double -1.7E+308 1.7E+308 /end CHARACTERISTIC
/begin CHARACTERISTIC speedgoat_test_SN5659__cal_impl.Encode4_P8_a "" VALUE 0x008E3B20 Scalar_FLOAT64_IEEE 0 speedgoat_test_SN5659_R2021b_CM_double -1.7E+308 1.7E+308 /end CHARACTERISTIC
/begin CHARACTERISTIC speedgoat_test_SN5659__cal_impl.Encode4_P8_c "" VALUE 0x008E4190 Scalar_FLOAT64_IEEE 0 speedgoat_test_SN5659_R2021b_CM_double -1.7E+308 1.7E+308 /end CHARACTERISTIC
/begin CHARACTERISTIC speedgoat_test_SN5659__cal_impl.Encode4_P8_e "" VALUE 0x008E34B0 Scalar_FLOAT64_IEEE 0 speedgoat_test_SN5659_R2021b_CM_double -1.7E+308 1.7E+308 /end CHARACTERISTIC
/begin CHARACTERISTIC speedgoat_test_SN5659__cal_impl.Encode4_P8_hv "" VALUE 0x008E27D0 Scalar_FLOAT64_IEEE 0 speedgoat_test_SN5659_R2021b_CM_double -1.7E+308 1.7E+308 /end CHARACTERISTIC
/begin CHARACTERISTIC speedgoat_test_SN5659__cal_impl.Encode4_P9_a "" VALUE 0x008E3B38 Scalar_FLOAT64_IEEE 0 speedgoat_test_SN5659_R2021b_CM_double -1.7E+308 1.7E+308 /end CHARACTERISTIC
/begin CHARACTERISTIC speedgoat_test_SN5659__cal_impl.Encode4_P9_d "" VALUE 0x008E34C8 Scalar_FLOAT64_IEEE 0 speedgoat_test_SN5659_R2021b_CM_double -1.7E+308 1.7E+308 /end CHARACTERISTIC
/begin CHARACTERISTIC speedgoat_test_SN5659__cal_impl.Encode4_P9_l "" VALUE 0x008E27E8 Scalar_FLOAT64_IEEE 0 speedgoat_test_SN5659_R2021b_CM_double -1.7E+308 1.7E+308 /end CHARACTERISTIC
/begin CHARACTERISTIC speedgoat_test_SN5659__cal_impl.Encode4_P9_m "" VALUE 0x008E41A8 Scalar_FLOAT64_IEEE 0 speedgoat_test_SN5659_R2021b_CM_double -1.7E+308 1.7E+308 /end CHARACTERISTIC
/begin CHARACTERISTIC speedgoat_test_SN5659__cal_impl.Encode5_P10_j "" VALUE 0x008E2B40 Scalar_FLOAT64_IEEE 0 speedgoat_test_SN5659_R2021b_CM_double -1.7E+308 1.7E+308 /end CHARACTERISTIC
/begin CHARACTERISTIC speedgoat_test_SN5659__cal_impl.Encode5_P10_o "" VALUE 0x008E4500 Scalar_FLOAT64_IEEE 0 speedgoat_test_SN5659_R2021b_CM_double -1.7E+308 1.7E+308 /end CHARACTERISTIC
/begin CHARACTERISTIC speedgoat_test_SN5659__cal_impl.Encode5_P11_g "" VAL_BLK 0x008E4518 Scalar_FLOAT64_IEEE 0 speedgoat_test_SN5659_R2021b_CM_double -1.7E+308 1.7E+308 MATRIX_DIM 2 1 /end CHARACTERISTIC
/begin CHARACTERISTIC speedgoat_test_SN5659__cal_impl.Encode5_P11_h "" VAL_BLK 0x008E2B58 Scalar_FLOAT64_IEEE 0 speedgoat_test_SN5659_R2021b_CM_double -1.7E+308 1.7E+308 MATRIX_DIM 2 1 /end CHARACTERISTIC
/begin CHARACTERISTIC speedgoat_test_SN5659__cal_impl.Encode5_P12_c "" VALUE 0x008E2B78 Scalar_FLOAT64_IEEE 0 speedgoat_test_SN5659_R2021b_CM_double -1.7E+308 1.7E+308 /end CHARACTERISTIC
/begin CHARACTERISTIC speedgoat_test_SN5659__cal_impl.Encode5_P12_p "" VALUE 0x008E4538 Scalar_FLOAT64_IEEE 0 speedgoat_test_SN5659_R2021b_CM_double -1.7E+308 1.7E+308 /end CHARACTERISTIC
/begin CHARACTERISTIC speedgoat_test_SN5659__cal_impl.Encode5_P13_c "" VALUE 0x008E2B90 Scalar_FLOAT64_IEEE 0 speedgoat_test_SN5659_R2021b_CM_double -1.7E+308 1.7E+308 /end CHARACTERISTIC
/begin CHARACTERISTIC speedgoat_test_SN5659__cal_impl.Encode5_P13_m "" VALUE 0x008E4550 Scalar_FLOAT64_IEEE 0 speedgoat_test_SN5659_R2021b_CM_double -1.7E+308 1.7E+308 /end CHARACTERISTIC
/begin CHARACTERISTIC speedgoat_test_SN5659__cal_impl.Encode5_P14_e "" VALUE 0x008E2BA8 Scalar_FLOAT64_IEEE 0 speedgoat_test_SN5659_R2021b_CM_double -1.7E+308 1.7E+308 /end CHARACTERISTIC
/begin CHARACTERISTIC speedgoat_test_SN5659__cal_impl.Encode5_P14_k "" VALUE 0x008E4568 Scalar_FLOAT64_IEEE 0 speedgoat_test_SN5659_R2021b_CM_double -1.7E+308 1.7E+308 /end CHARACTERISTIC
/begin CHARACTERISTIC speedgoat_test_SN5659__cal_impl.Encode5_P15_a "" VALUE 0x008E4580 Scalar_FLOAT64_IEEE 0 speedgoat_test_SN5659_R2021b_CM_double -1.7E+308 1.7E+308 /end CHARACTERISTIC
/begin CHARACTERISTIC speedgoat_test_SN5659__cal_impl.Encode5_P15_m "" VALUE 0x008E2BC0 Scalar_FLOAT64_IEEE 0 speedgoat_test_SN5659_R2021b_CM_double -1.7E+308 1.7E+308 /end CHARACTERISTIC
/begin CHARACTERISTIC speedgoat_test_SN5659__cal_impl.Encode5_P1_a "" VALUE 0x008E2A68 Scalar_FLOAT64_IEEE 0 speedgoat_test_SN5659_R2021b_CM_double -1.7E+308 1.7E+308 /end CHARACTERISTIC
/begin CHARACTERISTIC speedgoat_test_SN5659__cal_impl.Encode5_P1_i "" VALUE 0x008E4428 Scalar_FLOAT64_IEEE 0 speedgoat_test_SN5659_R2021b_CM_double -1.7E+308 1.7E+308 /end CHARACTERISTIC
/begin CHARACTERISTIC speedgoat_test_SN5659__cal_impl.Encode5_P2_b "" VALUE 0x008E4440 Scalar_FLOAT64_IEEE 0 speedgoat_test_SN5659_R2021b_CM_double -1.7E+308 1.7E+308 /end CHARACTERISTIC
/begin CHARACTERISTIC speedgoat_test_SN5659__cal_impl.Encode5_P2_l "" VALUE 0x008E2A80 Scalar_FLOAT64_IEEE 0 speedgoat_test_SN5659_R2021b_CM_double -1.7E+308 1.7E+308 /end CHARACTERISTIC
/begin CHARACTERISTIC speedgoat_test_SN5659__cal_impl.Encode5_P3_c "" VALUE 0x008E2A98 Scalar_FLOAT64_IEEE 0 speedgoat_test_SN5659_R2021b_CM_double -1.7E+308 1.7E+308 /end CHARACTERISTIC
/begin CHARACTERISTIC speedgoat_test_SN5659__cal_impl.Encode5_P3_i "" VALUE 0x008E4458 Scalar_FLOAT64_IEEE 0 speedgoat_test_SN5659_R2021b_CM_double -1.7E+308 1.7E+308 /end CHARACTERISTIC
/begin CHARACTERISTIC speedgoat_test_SN5659__cal_impl.Encode5_P4_k "" VALUE 0x008E4470 Scalar_FLOAT64_IEEE 0 speedgoat_test_SN5659_R2021b_CM_double -1.7E+308 1.7E+308 /end CHARACTERISTIC
/begin CHARACTERISTIC speedgoat_test_SN5659__cal_impl.Encode5_P4_o "" VALUE 0x008E2AB0 Scalar_FLOAT64_IEEE 0 speedgoat_test_SN5659_R2021b_CM_double -1.7E+308 1.7E+308 /end CHARACTERISTIC
/begin CHARACTERISTIC speedgoat_test_SN5659__cal_impl.Encode5_P5_ih "" VALUE 0x008E2AC8 Scalar_FLOAT64_IEEE 0 speedgoat_test_SN5659_R2021b_CM_double -1.7E+308 1.7E+308 /end CHARACTERISTIC
/begin CHARACTERISTIC speedgoat_test_SN5659__cal_impl.Encode5_P5_o "" VALUE 0x008E4488 Scalar_FLOAT64_IEEE 0 speedgoat_test_SN5659_R2021b_CM_double -1.7E+308 1.7E+308 /end CHARACTERISTIC
/begin CHARACTERISTIC speedgoat_test_SN5659__cal_impl.Encode5_P6_j "" VALUE 0x008E44A0 Scalar_FLOAT64_IEEE 0 speedgoat_test_SN5659_R2021b_CM_double -1.7E+308 1.7E+308 /end CHARACTERISTIC
/begin CHARACTERISTIC speedgoat_test_SN5659__cal_impl.Encode5_P6_o "" VALUE 0x008E2AE0 Scalar_FLOAT64_IEEE 0 speedgoat_test_SN5659_R2021b_CM_double -1.7E+308 1.7E+308 /end CHARACTERISTIC
/begin CHARACTERISTIC speedgoat_test_SN5659__cal_impl.Encode5_P7_h "" VALUE 0x008E44B8 Scalar_FLOAT64_IEEE 0 speedgoat_test_SN5659_R2021b_CM_double -1.7E+308 1.7E+308 /end CHARACTERISTIC
/begin CHARACTERISTIC speedgoat_test_SN5659__cal_impl.Encode5_P7_l "" VALUE 0x008E2AF8 Scalar_FLOAT64_IEEE 0 speedgoat_test_SN5659_R2021b_CM_double -1.7E+308 1.7E+308 /end CHARACTERISTIC
/begin CHARACTERISTIC speedgoat_test_SN5659__cal_impl.Encode5_P8_i "" VALUE 0x008E44D0 Scalar_FLOAT64_IEEE 0 speedgoat_test_SN5659_R2021b_CM_double -1.7E+308 1.7E+308 /end CHARACTERISTIC
/begin CHARACTERISTIC speedgoat_test_SN5659__cal_impl.Encode5_P8_m "" VALUE 0x008E2B10 Scalar_FLOAT64_IEEE 0 speedgoat_test_SN5659_R2021b_CM_double -1.7E+308 1.7E+308 /end CHARACTERISTIC
/begin CHARACTERISTIC speedgoat_test_SN5659__cal_impl.Encode5_P9_g "" VALUE 0x008E44E8 Scalar_FLOAT64_IEEE 0 speedgoat_test_SN5659_R2021b_CM_double -1.7E+308 1.7E+308 /end CHARACTERISTIC
/begin CHARACTERISTIC speedgoat_test_SN5659__cal_impl.Encode5_P9_o "" VALUE 0x008E2B28 Scalar_FLOAT64_IEEE 0 speedgoat_test_SN5659_R2021b_CM_double -1.7E+308 1.7E+308 /end CHARACTERISTIC
/begin CHARACTERISTIC speedgoat_test_SN5659__cal_impl.FixPtConstant_Value_b "" VALUE 0x008E4DCA Scalar_UWORD 0 speedgoat_test_SN5659_R2021b_CM_uint16 0 65535 /end CHARACTERISTIC
/begin CHARACTERISTIC speedgoat_test_SN5659__cal_impl.FixPtConstant_Value_ie "" VALUE 0x008E4DC4 Scalar_UWORD 0 speedgoat_test_SN5659_R2021b_CM_uint16 0 65535 /end CHARACTERISTIC
/begin CHARACTERISTIC speedgoat_test_SN5659__cal_impl.FixPtConstant_Value_jp "" VALUE 0x008E4DD0 Scalar_UWORD 0 speedgoat_test_SN5659_R2021b_CM_uint16 0 65535 /end CHARACTERISTIC
/begin CHARACTERISTIC speedgoat_test_SN5659__cal_impl.FixPtConstant_Value_k "" VALUE 0x008E4DB2 Scalar_UWORD 0 speedgoat_test_SN5659_R2021b_CM_uint16 0 65535 /end CHARACTERISTIC
/begin CHARACTERISTIC speedgoat_test_SN5659__cal_impl.FixPtConstant_Value_m "" VALUE 0x008E4DB8 Scalar_UWORD 0 speedgoat_test_SN5659_R2021b_CM_uint16 0 65535 /end CHARACTERISTIC
/begin CHARACTERISTIC speedgoat_test_SN5659__cal_impl.FixPtConstant_Value_n "" VALUE 0x008E4DBE Scalar_UWORD 0 speedgoat_test_SN5659_R2021b_CM_uint16 0 65535 /end CHARACTERISTIC
/begin CHARACTERISTIC speedgoat_test_SN5659__cal_impl.Label_Value_jf "" VALUE 0x008E4D64 Scalar_ULONG 0 speedgoat_test_SN5659_R2021b_CM_uint32 0 2147483646 /end CHARACTERISTIC
/begin CHARACTERISTIC speedgoat_test_SN5659__cal_impl.Label_Value_kg "" VALUE 0x008E4D7C Scalar_ULONG 0 speedgoat_test_SN5659_R2021b_CM_uint32 0 2147483646 /end CHARACTERISTIC
/begin CHARACTERISTIC speedgoat_test_SN5659__cal_impl.Label_Value_kp "" VALUE 0x008E4D4C Scalar_ULONG 0 speedgoat_test_SN5659_R2021b_CM_uint32 0 2147483646 /end CHARACTERISTIC
/begin CHARACTERISTIC speedgoat_test_SN5659__cal_impl.Label_Value_l "" VALUE 0x008E4D40 Scalar_ULONG 0 speedgoat_test_SN5659_R2021b_CM_uint32 0 2147483646 /end CHARACTERISTIC
/begin CHARACTERISTIC speedgoat_test_SN5659__cal_impl.Label_Value_p "" VALUE 0x008E4D58 Scalar_ULONG 0 speedgoat_test_SN5659_R2021b_CM_uint32 0 2147483646 /end CHARACTERISTIC
/begin CHARACTERISTIC speedgoat_test_SN5659__cal_impl.Label_Value_pn "" VALUE 0x008E4D70 Scalar_ULONG 0 speedgoat_test_SN5659_R2021b_CM_uint32 0 2147483646 /end CHARACTERISTIC
/begin CHARACTERISTIC speedgoat_test_SN5659__cal_impl.Mask_BitMask_c "" VALUE 0x008D504C Scalar_ULONG 0 speedgoat_test_SN5659_R2021b_CM_uint32 0 2147483646 /end CHARACTERISTIC
/begin CHARACTERISTIC speedgoat_test_SN5659__cal_impl.Mask_BitMask_cx "" VALUE 0x008D505C Scalar_ULONG 0 speedgoat_test_SN5659_R2021b_CM_uint32 0 2147483646 /end CHARACTERISTIC
/begin CHARACTERISTIC speedgoat_test_SN5659__cal_impl.Mask_BitMask_er "" VALUE 0x008D5050 Scalar_ULONG 0 speedgoat_test_SN5659_R2021b_CM_uint32 0 2147483646 /end CHARACTERISTIC
/begin CHARACTERISTIC speedgoat_test_SN5659__cal_impl.Mask_BitMask_f "" VALUE 0x008D5048 Scalar_ULONG 0 speedgoat_test_SN5659_R2021b_CM_uint32 0 2147483646 /end CHARACTERISTIC
/begin CHARACTERISTIC speedgoat_test_SN5659__cal_impl.Mask_BitMask_f3 "" VALUE 0x008D5054 Scalar_ULONG 0 speedgoat_test_SN5659_R2021b_CM_uint32 0 2147483646 /end CHARACTERISTIC
/begin CHARACTERISTIC speedgoat_test_SN5659__cal_impl.Mask_BitMask_kz "" VALUE 0x008D5058 Scalar_ULONG 0 speedgoat_test_SN5659_R2021b_CM_uint32 0 2147483646 /end CHARACTERISTIC
/begin CHARACTERISTIC speedgoat_test_SN5659__cal_impl.Output_InitialCondition_a "" VALUE 0x008E4DC8 Scalar_UWORD 0 speedgoat_test_SN5659_R2021b_CM_uint16 0 65535 /end CHARACTERISTIC
/begin CHARACTERISTIC speedgoat_test_SN5659__cal_impl.Output_InitialCondition_aw "" VALUE 0x008E4DCE Scalar_UWORD 0 speedgoat_test_SN5659_R2021b_CM_uint16 0 65535 /end CHARACTERISTIC
/begin CHARACTERISTIC speedgoat_test_SN5659__cal_impl.Output_InitialCondition_d "" VALUE 0x008E4DB0 Scalar_UWORD 0 speedgoat_test_SN5659_R2021b_CM_uint16 0 65535 /end CHARACTERISTIC
/begin CHARACTERISTIC speedgoat_test_SN5659__cal_impl.Output_InitialCondition_dr "" VALUE 0x008E4DC2 Scalar_UWORD 0 speedgoat_test_SN5659_R2021b_CM_uint16 0 65535 /end CHARACTERISTIC
/begin CHARACTERISTIC speedgoat_test_SN5659__cal_impl.Output_InitialCondition_h3 "" VALUE 0x008E4DBC Scalar_UWORD 0 speedgoat_test_SN5659_R2021b_CM_uint16 0 65535 /end CHARACTERISTIC
/begin CHARACTERISTIC speedgoat_test_SN5659__cal_impl.Output_InitialCondition_nb "" VALUE 0x008E4DB6 Scalar_UWORD 0 speedgoat_test_SN5659_R2021b_CM_uint16 0 65535 /end CHARACTERISTIC
/begin CHARACTERISTIC speedgoat_test_SN5659__cal_impl.PulseGenerator_Amp_g3 "" VALUE 0x008E4900 Scalar_FLOAT64_IEEE 0 speedgoat_test_SN5659_R2021b_CM_double -1.7E+308 1.7E+308 /end CHARACTERISTIC
/begin CHARACTERISTIC speedgoat_test_SN5659__cal_impl.PulseGenerator_Duty_h "" VALUE 0x008E4910 Scalar_FLOAT64_IEEE 0 speedgoat_test_SN5659_R2021b_CM_double -1.7E+308 1.7E+308 /end CHARACTERISTIC
/begin CHARACTERISTIC speedgoat_test_SN5659__cal_impl.PulseGenerator_Period_o "" VALUE 0x008E4908 Scalar_FLOAT64_IEEE 0 speedgoat_test_SN5659_R2021b_CM_double -1.7E+308 1.7E+308 /end CHARACTERISTIC
/begin CHARACTERISTIC speedgoat_test_SN5659__cal_impl.PulseGenerator_PhaseDelay_b "" VALUE 0x008E4918 Scalar_FLOAT64_IEEE 0 speedgoat_test_SN5659_R2021b_CM_double -1.7E+308 1.7E+308 /end CHARACTERISTIC
/begin CHARACTERISTIC speedgoat_test_SN5659__cal_impl.Randomnumber_Mean_c "" VALUE 0x008E28D0 Scalar_FLOAT64_IEEE 0 speedgoat_test_SN5659_R2021b_CM_double -1.7E+308 1.7E+308 /end CHARACTERISTIC
/begin CHARACTERISTIC speedgoat_test_SN5659__cal_impl.Randomnumber_Mean_fb "" VALUE 0x008E4290 Scalar_FLOAT64_IEEE 0 speedgoat_test_SN5659_R2021b_CM_double -1.7E+308 1.7E+308 /end CHARACTERISTIC
/begin CHARACTERISTIC speedgoat_test_SN5659__cal_impl.Randomnumber_Mean_l "" VALUE 0x008E2F40 Scalar_FLOAT64_IEEE 0 speedgoat_test_SN5659_R2021b_CM_double -1.7E+308 1.7E+308 /end CHARACTERISTIC
/begin CHARACTERISTIC speedgoat_test_SN5659__cal_impl.Randomnumber_Mean_p "" VALUE 0x008E2260 Scalar_FLOAT64_IEEE 0 speedgoat_test_SN5659_R2021b_CM_double -1.7E+308 1.7E+308 /end CHARACTERISTIC
/begin CHARACTERISTIC speedgoat_test_SN5659__cal_impl.Randomnumber_Mean_pl "" VALUE 0x008E35B0 Scalar_FLOAT64_IEEE 0 speedgoat_test_SN5659_R2021b_CM_double -1.7E+308 1.7E+308 /end CHARACTERISTIC
/begin CHARACTERISTIC speedgoat_test_SN5659__cal_impl.Randomnumber_Mean_pz "" VALUE 0x008E3C20 Scalar_FLOAT64_IEEE 0 speedgoat_test_SN5659_R2021b_CM_double -1.7E+308 1.7E+308 /end CHARACTERISTIC
/begin CHARACTERISTIC speedgoat_test_SN5659__cal_impl.Randomnumber_Seed_cg "" VALUE 0x008E2F50 Scalar_FLOAT64_IEEE 0 speedgoat_test_SN5659_R2021b_CM_double -1.7E+308 1.7E+308 /end CHARACTERISTIC
/begin CHARACTERISTIC speedgoat_test_SN5659__cal_impl.Randomnumber_Seed_e "" VALUE 0x008E35C0 Scalar_FLOAT64_IEEE 0 speedgoat_test_SN5659_R2021b_CM_double -1.7E+308 1.7E+308 /end CHARACTERISTIC
/begin CHARACTERISTIC speedgoat_test_SN5659__cal_impl.Randomnumber_Seed_i "" VALUE 0x008E2270 Scalar_FLOAT64_IEEE 0 speedgoat_test_SN5659_R2021b_CM_double -1.7E+308 1.7E+308 /end CHARACTERISTIC
/begin CHARACTERISTIC speedgoat_test_SN5659__cal_impl.Randomnumber_Seed_j "" VALUE 0x008E42A0 Scalar_FLOAT64_IEEE 0 speedgoat_test_SN5659_R2021b_CM_double -1.7E+308 1.7E+308 /end CHARACTERISTIC
/begin CHARACTERISTIC speedgoat_test_SN5659__cal_impl.Randomnumber_Seed_l "" VALUE 0x008E3C30 Scalar_FLOAT64_IEEE 0 speedgoat_test_SN5659_R2021b_CM_double -1.7E+308 1.7E+308 /end CHARACTERISTIC
/begin CHARACTERISTIC speedgoat_test_SN5659__cal_impl.Randomnumber_Seed_o "" VALUE 0x008E28E0 Scalar_FLOAT64_IEEE 0 speedgoat_test_SN5659_R2021b_CM_double -1.7E+308 1.7E+308 /end CHARACTERISTIC
/begin CHARACTERISTIC speedgoat_test_SN5659__cal_impl.Randomnumber_StdDev_b "" VALUE 0x008E2268 Scalar_FLOAT64_IEEE 0 speedgoat_test_SN5659_R2021b_CM_double -1.7E+308 1.7E+308 /end CHARACTERISTIC
/begin CHARACTERISTIC speedgoat_test_SN5659__cal_impl.Randomnumber_StdDev_e "" VALUE 0x008E3C28 Scalar_FLOAT64_IEEE 0 speedgoat_test_SN5659_R2021b_CM_double -1.7E+308 1.7E+308 /end CHARACTERISTIC
/begin CHARACTERISTIC speedgoat_test_SN5659__cal_impl.Randomnumber_StdDev_fs "" VALUE 0x008E35B8 Scalar_FLOAT64_IEEE 0 speedgoat_test_SN5659_R2021b_CM_double -1.7E+308 1.7E+308 /end CHARACTERISTIC
/begin CHARACTERISTIC speedgoat_test_SN5659__cal_impl.Randomnumber_StdDev_mo "" VALUE 0x008E28D8 Scalar_FLOAT64_IEEE 0 speedgoat_test_SN5659_R2021b_CM_double -1.7E+308 1.7E+308 /end CHARACTERISTIC
/begin CHARACTERISTIC speedgoat_test_SN5659__cal_impl.Randomnumber_StdDev_o "" VALUE 0x008E2F48 Scalar_FLOAT64_IEEE 0 speedgoat_test_SN5659_R2021b_CM_double -1.7E+308 1.7E+308 /end CHARACTERISTIC
/begin CHARACTERISTIC speedgoat_test_SN5659__cal_impl.Randomnumber_StdDev_oa "" VALUE 0x008E4298 Scalar_FLOAT64_IEEE 0 speedgoat_test_SN5659_R2021b_CM_double -1.7E+308 1.7E+308 /end CHARACTERISTIC
/begin CHARACTERISTIC speedgoat_test_SN5659__cal_impl.Relays_P1 "" VALUE 0x008E4930 Scalar_FLOAT64_IEEE 0 speedgoat_test_SN5659_R2021b_CM_double -1.7E+308 1.7E+308 /end CHARACTERISTIC
/begin CHARACTERISTIC speedgoat_test_SN5659__cal_impl.Relays_P10 "" VALUE 0x008E4C10 Scalar_FLOAT64_IEEE 0 speedgoat_test_SN5659_R2021b_CM_double -1.7E+308 1.7E+308 /end CHARACTERISTIC
/begin CHARACTERISTIC speedgoat_test_SN5659__cal_impl.Relays_P11 "" VALUE 0x008E4C28 Scalar_FLOAT64_IEEE 0 speedgoat_test_SN5659_R2021b_CM_double -1.7E+308 1.7E+308 /end CHARACTERISTIC
/begin CHARACTERISTIC speedgoat_test_SN5659__cal_impl.Relays_P12 "" VALUE 0x008E4C40 Scalar_FLOAT64_IEEE 0 speedgoat_test_SN5659_R2021b_CM_double -1.7E+308 1.7E+308 /end CHARACTERISTIC
/begin CHARACTERISTIC speedgoat_test_SN5659__cal_impl.Relays_P13 "" VALUE 0x008E4C58 Scalar_FLOAT64_IEEE 0 speedgoat_test_SN5659_R2021b_CM_double -1.7E+308 1.7E+308 /end CHARACTERISTIC
/begin CHARACTERISTIC speedgoat_test_SN5659__cal_impl.Relays_P14 "" VALUE 0x008E4C70 Scalar_FLOAT64_IEEE 0 speedgoat_test_SN5659_R2021b_CM_double -1.7E+308 1.7E+308 /end CHARACTERISTIC
/begin CHARACTERISTIC speedgoat_test_SN5659__cal_impl.Relays_P15 "" VALUE 0x008E4C88 Scalar_FLOAT64_IEEE 0 speedgoat_test_SN5659_R2021b_CM_double -1.7E+308 1.7E+308 /end CHARACTERISTIC
/begin CHARACTERISTIC speedgoat_test_SN5659__cal_impl.Relays_P16 "" VALUE 0x008E4CA0 Scalar_FLOAT64_IEEE 0 speedgoat_test_SN5659_R2021b_CM_double -1.7E+308 1.7E+308 /end CHARACTERISTIC
/begin CHARACTERISTIC speedgoat_test_SN5659__cal_impl.Relays_P17 "" VALUE 0x008E4CB8 Scalar_FLOAT64_IEEE 0 speedgoat_test_SN5659_R2021b_CM_double -1.7E+308 1.7E+308 /end CHARACTERISTIC
/begin CHARACTERISTIC speedgoat_test_SN5659__cal_impl.Relays_P2 "" VAL_BLK 0x008E4948 Scalar_FLOAT64_IEEE 0 speedgoat_test_SN5659_R2021b_CM_double -1.7E+308 1.7E+308 MATRIX_DIM 45 1 /end CHARACTERISTIC
/begin CHARACTERISTIC speedgoat_test_SN5659__cal_impl.Relays_P3 "" VAL_BLK 0x008E4AC0 Scalar_FLOAT64_IEEE 0 speedgoat_test_SN5659_R2021b_CM_double -1.7E+308 1.7E+308 MATRIX_DIM 8 1 /end CHARACTERISTIC
/begin CHARACTERISTIC speedgoat_test_SN5659__cal_impl.Relays_P4 "" VAL_BLK 0x008E4B10 Scalar_FLOAT64_IEEE 0 speedgoat_test_SN5659_R2021b_CM_double -1.7E+308 1.7E+308 MATRIX_DIM 8 1 /end CHARACTERISTIC
/begin CHARACTERISTIC speedgoat_test_SN5659__cal_impl.Relays_P5 "" VAL_BLK 0x008E4B60 Scalar_FLOAT64_IEEE 0 speedgoat_test_SN5659_R2021b_CM_double -1.7E+308 1.7E+308 MATRIX_DIM 8 1 /end CHARACTERISTIC
/begin CHARACTERISTIC speedgoat_test_SN5659__cal_impl.Relays_P6 "" VALUE 0x008E4BB0 Scalar_FLOAT64_IEEE 0 speedgoat_test_SN5659_R2021b_CM_double -1.7E+308 1.7E+308 /end CHARACTERISTIC
/begin CHARACTERISTIC speedgoat_test_SN5659__cal_impl.Relays_P7 "" VALUE 0x008E4BC8 Scalar_FLOAT64_IEEE 0 speedgoat_test_SN5659_R2021b_CM_double -1.7E+308 1.7E+308 /end CHARACTERISTIC
/begin CHARACTERISTIC speedgoat_test_SN5659__cal_impl.Relays_P8 "" VALUE 0x008E4BE0 Scalar_FLOAT64_IEEE 0 speedgoat_test_SN5659_R2021b_CM_double -1.7E+308 1.7E+308 /end CHARACTERISTIC
/begin CHARACTERISTIC speedgoat_test_SN5659__cal_impl.Relays_P9 "" VALUE 0x008E4BF8 Scalar_FLOAT64_IEEE 0 speedgoat_test_SN5659_R2021b_CM_double -1.7E+308 1.7E+308 /end CHARACTERISTIC
/begin CHARACTERISTIC speedgoat_test_SN5659__cal_impl.SDI_Value_ai "" VALUE 0x008E4D48 Scalar_ULONG 0 speedgoat_test_SN5659_R2021b_CM_uint32 0 2147483646 /end CHARACTERISTIC
/begin CHARACTERISTIC speedgoat_test_SN5659__cal_impl.SDI_Value_g "" VALUE 0x008E4D3C Scalar_ULONG 0 speedgoat_test_SN5659_R2021b_CM_uint32 0 2147483646 /end CHARACTERISTIC
/begin CHARACTERISTIC speedgoat_test_SN5659__cal_impl.SDI_Value_ig "" VALUE 0x008E4D54 Scalar_ULONG 0 speedgoat_test_SN5659_R2021b_CM_uint32 0 2147483646 /end CHARACTERISTIC
/begin CHARACTERISTIC speedgoat_test_SN5659__cal_impl.SDI_Value_im "" VALUE 0x008E4D6C Scalar_ULONG 0 speedgoat_test_SN5659_R2021b_CM_uint32 0 2147483646 /end CHARACTERISTIC
/begin CHARACTERISTIC speedgoat_test_SN5659__cal_impl.SDI_Value_k "" VALUE 0x008E4D60 Scalar_ULONG 0 speedgoat_test_SN5659_R2021b_CM_uint32 0 2147483646 /end CHARACTERISTIC
/begin CHARACTERISTIC speedgoat_test_SN5659__cal_impl.SDI_Value_mq "" VALUE 0x008E4D78 Scalar_ULONG 0 speedgoat_test_SN5659_R2021b_CM_uint32 0 2147483646 /end CHARACTERISTIC
/begin CHARACTERISTIC speedgoat_test_SN5659__cal_impl.SSM_Value_a "" VALUE 0x008E4D50 Scalar_ULONG 0 speedgoat_test_SN5659_R2021b_CM_uint32 0 2147483646 /end CHARACTERISTIC
/begin CHARACTERISTIC speedgoat_test_SN5659__cal_impl.SSM_Value_f "" VALUE 0x008E4D44 Scalar_ULONG 0 speedgoat_test_SN5659_R2021b_CM_uint32 0 2147483646 /end CHARACTERISTIC
/begin CHARACTERISTIC speedgoat_test_SN5659__cal_impl.SSM_Value_g "" VALUE 0x008E4D5C Scalar_ULONG 0 speedgoat_test_SN5659_R2021b_CM_uint32 0 2147483646 /end CHARACTERISTIC
/begin CHARACTERISTIC speedgoat_test_SN5659__cal_impl.SSM_Value_jt "" VALUE 0x008E4D74 Scalar_ULONG 0 speedgoat_test_SN5659_R2021b_CM_uint32 0 2147483646 /end CHARACTERISTIC
/begin CHARACTERISTIC speedgoat_test_SN5659__cal_impl.SSM_Value_nl "" VALUE 0x008E4D38 Scalar_ULONG 0 speedgoat_test_SN5659_R2021b_CM_uint32 0 2147483646 /end CHARACTERISTIC
/begin CHARACTERISTIC speedgoat_test_SN5659__cal_impl.SSM_Value_p "" VALUE 0x008E4D68 Scalar_ULONG 0 speedgoat_test_SN5659_R2021b_CM_uint32 0 2147483646 /end CHARACTERISTIC
/begin CHARACTERISTIC speedgoat_test_SN5659__cal_impl.Scale_Value_e3 "" VALUE 0x008E3A58 Scalar_FLOAT64_IEEE 0 speedgoat_test_SN5659_R2021b_CM_double -1.7E+308 1.7E+308 /end CHARACTERISTIC
/begin CHARACTERISTIC speedgoat_test_SN5659__cal_impl.Scale_Value_g "" VALUE 0x008E2D78 Scalar_FLOAT64_IEEE 0 speedgoat_test_SN5659_R2021b_CM_double -1.7E+308 1.7E+308 /end CHARACTERISTIC
/begin CHARACTERISTIC speedgoat_test_SN5659__cal_impl.Scale_Value_h "" VALUE 0x008E33E8 Scalar_FLOAT64_IEEE 0 speedgoat_test_SN5659_R2021b_CM_double -1.7E+308 1.7E+308 /end CHARACTERISTIC
/begin CHARACTERISTIC speedgoat_test_SN5659__cal_impl.Scale_Value_kb "" VALUE 0x008E40C8 Scalar_FLOAT64_IEEE 0 speedgoat_test_SN5659_R2021b_CM_double -1.7E+308 1.7E+308 /end CHARACTERISTIC
/begin CHARACTERISTIC speedgoat_test_SN5659__cal_impl.Scale_Value_n "" VALUE 0x008E4738 Scalar_FLOAT64_IEEE 0 speedgoat_test_SN5659_R2021b_CM_double -1.7E+308 1.7E+308 /end CHARACTERISTIC
/begin CHARACTERISTIC speedgoat_test_SN5659__cal_impl.Scale_Value_o "" VALUE 0x008E2708 Scalar_FLOAT64_IEEE 0 speedgoat_test_SN5659_R2021b_CM_double -1.7E+308 1.7E+308 /end CHARACTERISTIC
/begin CHARACTERISTIC speedgoat_test_SN5659__cal_impl.Sinewave_Amp_ch "" VALUE 0x008E38A8 Scalar_FLOAT64_IEEE 0 speedgoat_test_SN5659_R2021b_CM_double -1.7E+308 1.7E+308 /end CHARACTERISTIC
/begin CHARACTERISTIC speedgoat_test_SN5659__cal_impl.Sinewave_Amp_f "" VALUE 0x008E4588 Scalar_FLOAT64_IEEE 0 speedgoat_test_SN5659_R2021b_CM_double -1.7E+308 1.7E+308 /end CHARACTERISTIC
/begin CHARACTERISTIC speedgoat_test_SN5659__cal_impl.Sinewave_Amp_h5 "" VALUE 0x008E2BC8 Scalar_FLOAT64_IEEE 0 speedgoat_test_SN5659_R2021b_CM_double -1.7E+308 1.7E+308 /end CHARACTERISTIC
/begin CHARACTERISTIC speedgoat_test_SN5659__cal_impl.Sinewave_Amp_hw "" VALUE 0x008E3F18 Scalar_FLOAT64_IEEE 0 speedgoat_test_SN5659_R2021b_CM_double -1.7E+308 1.7E+308 /end CHARACTERISTIC
/begin CHARACTERISTIC speedgoat_test_SN5659__cal_impl.Sinewave_Amp_m "" VALUE 0x008E2558 Scalar_FLOAT64_IEEE 0 speedgoat_test_SN5659_R2021b_CM_double -1.7E+308 1.7E+308 /end CHARACTERISTIC
/begin CHARACTERISTIC speedgoat_test_SN5659__cal_impl.Sinewave_Amp_m2 "" VALUE 0x008E3238 Scalar_FLOAT64_IEEE 0 speedgoat_test_SN5659_R2021b_CM_double -1.7E+308 1.7E+308 /end CHARACTERISTIC
/begin CHARACTERISTIC speedgoat_test_SN5659__cal_impl.Sinewave_Bias_a "" VALUE 0x008E2BD0 Scalar_FLOAT64_IEEE 0 speedgoat_test_SN5659_R2021b_CM_double -1.7E+308 1.7E+308 /end CHARACTERISTIC
/begin CHARACTERISTIC speedgoat_test_SN5659__cal_impl.Sinewave_Bias_ac "" VALUE 0x008E3240 Scalar_FLOAT64_IEEE 0 speedgoat_test_SN5659_R2021b_CM_double -1.7E+308 1.7E+308 /end CHARACTERISTIC
/begin CHARACTERISTIC speedgoat_test_SN5659__cal_impl.Sinewave_Bias_d "" VALUE 0x008E38B0 Scalar_FLOAT64_IEEE 0 speedgoat_test_SN5659_R2021b_CM_double -1.7E+308 1.7E+308 /end CHARACTERISTIC
/begin CHARACTERISTIC speedgoat_test_SN5659__cal_impl.Sinewave_Bias_je "" VALUE 0x008E4590 Scalar_FLOAT64_IEEE 0 speedgoat_test_SN5659_R2021b_CM_double -1.7E+308 1.7E+308 /end CHARACTERISTIC
/begin CHARACTERISTIC speedgoat_test_SN5659__cal_impl.Sinewave_Bias_o "" VALUE 0x008E2560 Scalar_FLOAT64_IEEE 0 speedgoat_test_SN5659_R2021b_CM_double -1.7E+308 1.7E+308 /end CHARACTERISTIC
/begin CHARACTERISTIC speedgoat_test_SN5659__cal_impl.Sinewave_Bias_p "" VALUE 0x008E3F20 Scalar_FLOAT64_IEEE 0 speedgoat_test_SN5659_R2021b_CM_double -1.7E+308 1.7E+308 /end CHARACTERISTIC
/begin CHARACTERISTIC speedgoat_test_SN5659__cal_impl.Sinewave_Freq_a2 "" VALUE 0x008E38B8 Scalar_FLOAT64_IEEE 0 speedgoat_test_SN5659_R2021b_CM_double -1.7E+308 1.7E+308 /end CHARACTERISTIC
/begin CHARACTERISTIC speedgoat_test_SN5659__cal_impl.Sinewave_Freq_am "" VALUE 0x008E2BD8 Scalar_FLOAT64_IEEE 0 speedgoat_test_SN5659_R2021b_CM_double -1.7E+308 1.7E+308 /end CHARACTERISTIC
/begin CHARACTERISTIC speedgoat_test_SN5659__cal_impl.Sinewave_Freq_cn "" VALUE 0x008E3248 Scalar_FLOAT64_IEEE 0 speedgoat_test_SN5659_R2021b_CM_double -1.7E+308 1.7E+308 /end CHARACTERISTIC
/begin CHARACTERISTIC speedgoat_test_SN5659__cal_impl.Sinewave_Freq_j "" VALUE 0x008E3F28 Scalar_FLOAT64_IEEE 0 speedgoat_test_SN5659_R2021b_CM_double -1.7E+308 1.7E+308 /end CHARACTERISTIC
/begin CHARACTERISTIC speedgoat_test_SN5659__cal_impl.Sinewave_Freq_k "" VALUE 0x008E4598 Scalar_FLOAT64_IEEE 0 speedgoat_test_SN5659_R2021b_CM_double -1.7E+308 1.7E+308 /end CHARACTERISTIC
/begin CHARACTERISTIC speedgoat_test_SN5659__cal_impl.Sinewave_Freq_lw "" VALUE 0x008E2568 Scalar_FLOAT64_IEEE 0 speedgoat_test_SN5659_R2021b_CM_double -1.7E+308 1.7E+308 /end CHARACTERISTIC
/begin CHARACTERISTIC speedgoat_test_SN5659__cal_impl.Sinewave_HCos_e "" VALUE 0x008E2578 Scalar_FLOAT64_IEEE 0 speedgoat_test_SN5659_R2021b_CM_double -1.7E+308 1.7E+308 /end CHARACTERISTIC
/begin CHARACTERISTIC speedgoat_test_SN5659__cal_impl.Sinewave_HCos_h "" VALUE 0x008E38C8 Scalar_FLOAT64_IEEE 0 speedgoat_test_SN5659_R2021b_CM_double -1.7E+308 1.7E+308 /end CHARACTERISTIC
/begin CHARACTERISTIC speedgoat_test_SN5659__cal_impl.Sinewave_HCos_h2 "" VALUE 0x008E3F38 Scalar_FLOAT64_IEEE 0 speedgoat_test_SN5659_R2021b_CM_double -1.7E+308 1.7E+308 /end CHARACTERISTIC
/begin CHARACTERISTIC speedgoat_test_SN5659__cal_impl.Sinewave_HCos_i "" VALUE 0x008E3258 Scalar_FLOAT64_IEEE 0 speedgoat_test_SN5659_R2021b_CM_double -1.7E+308 1.7E+308 /end CHARACTERISTIC
/begin CHARACTERISTIC speedgoat_test_SN5659__cal_impl.Sinewave_HCos_n "" VALUE 0x008E45A8 Scalar_FLOAT64_IEEE 0 speedgoat_test_SN5659_R2021b_CM_double -1.7E+308 1.7E+308 /end CHARACTERISTIC
/begin CHARACTERISTIC speedgoat_test_SN5659__cal_impl.Sinewave_HCos_p "" VALUE 0x008E2BE8 Scalar_FLOAT64_IEEE 0 speedgoat_test_SN5659_R2021b_CM_double -1.7E+308 1.7E+308 /end CHARACTERISTIC
/begin CHARACTERISTIC speedgoat_test_SN5659__cal_impl.Sinewave_Hsin_a "" VALUE 0x008E2570 Scalar_FLOAT64_IEEE 0 speedgoat_test_SN5659_R2021b_CM_double -1.7E+308 1.7E+308 /end CHARACTERISTIC
/begin CHARACTERISTIC speedgoat_test_SN5659__cal_impl.Sinewave_Hsin_c "" VALUE 0x008E3250 Scalar_FLOAT64_IEEE 0 speedgoat_test_SN5659_R2021b_CM_double -1.7E+308 1.7E+308 /end CHARACTERISTIC
/begin CHARACTERISTIC speedgoat_test_SN5659__cal_impl.Sinewave_Hsin_cy "" VALUE 0x008E38C0 Scalar_FLOAT64_IEEE 0 speedgoat_test_SN5659_R2021b_CM_double -1.7E+308 1.7E+308 /end CHARACTERISTIC
/begin CHARACTERISTIC speedgoat_test_SN5659__cal_impl.Sinewave_Hsin_jl "" VALUE 0x008E3F30 Scalar_FLOAT64_IEEE 0 speedgoat_test_SN5659_R2021b_CM_double -1.7E+308 1.7E+308 /end CHARACTERISTIC
/begin CHARACTERISTIC speedgoat_test_SN5659__cal_impl.Sinewave_Hsin_o2 "" VALUE 0x008E45A0 Scalar_FLOAT64_IEEE 0 speedgoat_test_SN5659_R2021b_CM_double -1.7E+308 1.7E+308 /end CHARACTERISTIC
/begin CHARACTERISTIC speedgoat_test_SN5659__cal_impl.Sinewave_Hsin_p "" VALUE 0x008E2BE0 Scalar_FLOAT64_IEEE 0 speedgoat_test_SN5659_R2021b_CM_double -1.7E+308 1.7E+308 /end CHARACTERISTIC
/begin CHARACTERISTIC speedgoat_test_SN5659__cal_impl.Sinewave_PCos_d "" VALUE 0x008E2BF8 Scalar_FLOAT64_IEEE 0 speedgoat_test_SN5659_R2021b_CM_double -1.7E+308 1.7E+308 /end CHARACTERISTIC
/begin CHARACTERISTIC speedgoat_test_SN5659__cal_impl.Sinewave_PCos_e "" VALUE 0x008E3268 Scalar_FLOAT64_IEEE 0 speedgoat_test_SN5659_R2021b_CM_double -1.7E+308 1.7E+308 /end CHARACTERISTIC
/begin CHARACTERISTIC speedgoat_test_SN5659__cal_impl.Sinewave_PCos_jo "" VALUE 0x008E2588 Scalar_FLOAT64_IEEE 0 speedgoat_test_SN5659_R2021b_CM_double -1.7E+308 1.7E+308 /end CHARACTERISTIC
/begin CHARACTERISTIC speedgoat_test_SN5659__cal_impl.Sinewave_PCos_l "" VALUE 0x008E3F48 Scalar_FLOAT64_IEEE 0 speedgoat_test_SN5659_R2021b_CM_double -1.7E+308 1.7E+308 /end CHARACTERISTIC
/begin CHARACTERISTIC speedgoat_test_SN5659__cal_impl.Sinewave_PCos_lt "" VALUE 0x008E45B8 Scalar_FLOAT64_IEEE 0 speedgoat_test_SN5659_R2021b_CM_double -1.7E+308 1.7E+308 /end CHARACTERISTIC
/begin CHARACTERISTIC speedgoat_test_SN5659__cal_impl.Sinewave_PCos_n "" VALUE 0x008E38D8 Scalar_FLOAT64_IEEE 0 speedgoat_test_SN5659_R2021b_CM_double -1.7E+308 1.7E+308 /end CHARACTERISTIC
/begin CHARACTERISTIC speedgoat_test_SN5659__cal_impl.Sinewave_PSin_b "" VALUE 0x008E3F40 Scalar_FLOAT64_IEEE 0 speedgoat_test_SN5659_R2021b_CM_double -1.7E+308 1.7E+308 /end CHARACTERISTIC
/begin CHARACTERISTIC speedgoat_test_SN5659__cal_impl.Sinewave_PSin_bm "" VALUE 0x008E45B0 Scalar_FLOAT64_IEEE 0 speedgoat_test_SN5659_R2021b_CM_double -1.7E+308 1.7E+308 /end CHARACTERISTIC
/begin CHARACTERISTIC speedgoat_test_SN5659__cal_impl.Sinewave_PSin_d "" VALUE 0x008E2BF0 Scalar_FLOAT64_IEEE 0 speedgoat_test_SN5659_R2021b_CM_double -1.7E+308 1.7E+308 /end CHARACTERISTIC
/begin CHARACTERISTIC speedgoat_test_SN5659__cal_impl.Sinewave_PSin_l "" VALUE 0x008E3260 Scalar_FLOAT64_IEEE 0 speedgoat_test_SN5659_R2021b_CM_double -1.7E+308 1.7E+308 /end CHARACTERISTIC
/begin CHARACTERISTIC speedgoat_test_SN5659__cal_impl.Sinewave_PSin_o "" VALUE 0x008E38D0 Scalar_FLOAT64_IEEE 0 speedgoat_test_SN5659_R2021b_CM_double -1.7E+308 1.7E+308 /end CHARACTERISTIC
/begin CHARACTERISTIC speedgoat_test_SN5659__cal_impl.Sinewave_PSin_px "" VALUE 0x008E2580 Scalar_FLOAT64_IEEE 0 speedgoat_test_SN5659_R2021b_CM_double -1.7E+308 1.7E+308 /end CHARACTERISTIC
/begin CHARACTERISTIC speedgoat_test_SN5659__cal_impl.shiftthedoublevalue27bitslef_hk "" VALUE 0x008E4740 Scalar_FLOAT64_IEEE 0 speedgoat_test_SN5659_R2021b_CM_double -1.7E+308 1.7E+308 /end CHARACTERISTIC
/begin CHARACTERISTIC speedgoat_test_SN5659__cal_impl.shiftthedoublevalue27bitslef_jj "" VALUE 0x008E3A60 Scalar_FLOAT64_IEEE 0 speedgoat_test_SN5659_R2021b_CM_double -1.7E+308 1.7E+308 /end CHARACTERISTIC
/begin CHARACTERISTIC speedgoat_test_SN5659__cal_impl.shiftthedoublevalue27bitslef_jt "" VALUE 0x008E2710 Scalar_FLOAT64_IEEE 0 speedgoat_test_SN5659_R2021b_CM_double -1.7E+308 1.7E+308 /end CHARACTERISTIC
/begin CHARACTERISTIC speedgoat_test_SN5659__cal_impl.shiftthedoublevalue27bitsleft_b "" VALUE 0x008E33F0 Scalar_FLOAT64_IEEE 0 speedgoat_test_SN5659_R2021b_CM_double -1.7E+308 1.7E+308 /end CHARACTERISTIC
/begin CHARACTERISTIC speedgoat_test_SN5659__cal_impl.shiftthedoublevalue27bitsleft_d "" VALUE 0x008E2D80 Scalar_FLOAT64_IEEE 0 speedgoat_test_SN5659_R2021b_CM_double -1.7E+308 1.7E+308 /end CHARACTERISTIC
/begin CHARACTERISTIC speedgoat_test_SN5659__cal_impl.shiftthedoublevalue27bitsleft_f "" VALUE 0x008E40D0 Scalar_FLOAT64_IEEE 0 speedgoat_test_SN5659_R2021b_CM_double -1.7E+308 1.7E+308 /end CHARACTERISTIC
/begin MEASUREMENT speedgoat_test_SN5659_R2021b_B.BitwiseOperator_b "" ULONG speedgoat_test_SN5659_R2021b_CM_uint32 0 0 0 2147483646 ECU_ADDRESS 0x0094836C /end MEASUREMENT
/begin MEASUREMENT speedgoat_test_SN5659_R2021b_B.BitwiseOperator_b5 "" ULONG speedgoat_test_SN5659_R2021b_CM_uint32 0 0 0 2147483646 ECU_ADDRESS 0x009483A8 /end MEASUREMENT
/begin MEASUREMENT speedgoat_test_SN5659_R2021b_B.BitwiseOperator_eh "" ULONG speedgoat_test_SN5659_R2021b_CM_uint32 0 0 0 2147483646 ECU_ADDRESS 0x00948380 /end MEASUREMENT
/begin MEASUREMENT speedgoat_test_SN5659_R2021b_B.BitwiseOperator_fl "" ULONG speedgoat_test_SN5659_R2021b_CM_uint32 0 0 0 2147483646 ECU_ADDRESS 0x009483BC /end MEASUREMENT
/begin MEASUREMENT speedgoat_test_SN5659_R2021b_B.BitwiseOperator_n "" ULONG speedgoat_test_SN5659_R2021b_CM_uint32 0 0 0 2147483646 ECU_ADDRESS 0x00948394 /end MEASUREMENT
/begin MEASUREMENT speedgoat_test_SN5659_R2021b_B.BitwiseOperator_pk "" ULONG speedgoat_test_SN5659_R2021b_CM_uint32 0 0 0 2147483646 ECU_ADDRESS 0x00948358 /end MEASUREMENT
/begin MEASUREMENT speedgoat_test_SN5659_R2021b_B.DataTypeConversion1_e "" FLOAT64_IEEE speedgoat_test_SN5659_R2021b_CM_double 0 0 -1.7E+308 1.7E+308 ECU_ADDRESS 0x00948238 /end MEASUREMENT
/begin MEASUREMENT speedgoat_test_SN5659_R2021b_B.DataTypeConversion1_f "" FLOAT64_IEEE speedgoat_test_SN5659_R2021b_CM_double 0 0 -1.7E+308 1.7E+308 ECU_ADDRESS 0x00948148 /end MEASUREMENT
/begin MEASUREMENT speedgoat_test_SN5659_R2021b_B.DataTypeConversion1_fw "" FLOAT64_IEEE speedgoat_test_SN5659_R2021b_CM_double 0 0 -1.7E+308 1.7E+308 ECU_ADDRESS 0x00948198 /end MEASUREMENT
/begin MEASUREMENT speedgoat_test_SN5659_R2021b_B.DataTypeConversion1_gh "" FLOAT64_IEEE speedgoat_test_SN5659_R2021b_CM_double 0 0 -1.7E+308 1.7E+308 ECU_ADDRESS 0x009480A8 /end MEASUREMENT
/begin MEASUREMENT speedgoat_test_SN5659_R2021b_B.DataTypeConversion1_j "" FLOAT64_IEEE speedgoat_test_SN5659_R2021b_CM_double 0 0 -1.7E+308 1.7E+308 ECU_ADDRESS 0x009481E8 /end MEASUREMENT
/begin MEASUREMENT speedgoat_test_SN5659_R2021b_B.DataTypeConversion1_nb "" FLOAT64_IEEE speedgoat_test_SN5659_R2021b_CM_double 0 0 -1.7E+308 1.7E+308 ECU_ADDRESS 0x009480F8 /end MEASUREMENT
/begin MEASUREMENT speedgoat_test_SN5659_R2021b_B.DataTypeConversion_cp "" ULONG speedgoat_test_SN5659_R2021b_CM_uint32 0 0 0 2147483646 ECU_ADDRESS 0x00948384 /end MEASUREMENT
/begin MEASUREMENT speedgoat_test_SN5659_R2021b_B.DataTypeConversion_dn "" ULONG speedgoat_test_SN5659_R2021b_CM_uint32 0 0 0 2147483646 ECU_ADDRESS 0x0094835C /end MEASUREMENT
/begin MEASUREMENT speedgoat_test_SN5659_R2021b_B.DataTypeConversion_dw "" FLOAT64_IEEE speedgoat_test_SN5659_R2021b_CM_double 0 0 -1.7E+308 1.7E+308 ECU_ADDRESS 0x00948208 /end MEASUREMENT
/begin MEASUREMENT speedgoat_test_SN5659_R2021b_B.DataTypeConversion_f "" FLOAT64_IEEE speedgoat_test_SN5659_R2021b_CM_double 0 0 -1.7E+308 1.7E+308 ECU_ADDRESS 0x00948078 /end MEASUREMENT
/begin MEASUREMENT speedgoat_test_SN5659_R2021b_B.DataTypeConversion_fr "" ULONG speedgoat_test_SN5659_R2021b_CM_uint32 0 0 0 2147483646 ECU_ADDRESS 0x00948348 /end MEASUREMENT
/begin MEASUREMENT speedgoat_test_SN5659_R2021b_B.DataTypeConversion_hb "" FLOAT64_IEEE speedgoat_test_SN5659_R2021b_CM_double 0 0 -1.7E+308 1.7E+308 ECU_ADDRESS 0x009480C8 /end MEASUREMENT
/begin MEASUREMENT speedgoat_test_SN5659_R2021b_B.DataTypeConversion_i "" FLOAT64_IEEE speedgoat_test_SN5659_R2021b_CM_double 0 0 -1.7E+308 1.7E+308 ECU_ADDRESS 0x00948168 /end MEASUREMENT
/begin MEASUREMENT speedgoat_test_SN5659_R2021b_B.DataTypeConversion_ib "" UBYTE speedgoat_test_SN5659_R2021b_CM_logical 0 0 0 1 ECU_ADDRESS 0x0094841A /end MEASUREMENT
/begin MEASUREMENT speedgoat_test_SN5659_R2021b_B.DataTypeConversion_is "" ULONG speedgoat_test_SN5659_R2021b_CM_uint32 0 0 0 2147483646 ECU_ADDRESS 0x00948398 /end MEASUREMENT
/begin MEASUREMENT speedgoat_test_SN5659_R2021b_B.DataTypeConversion_k "" FLOAT64_IEEE speedgoat_test_SN5659_R2021b_CM_double 0 0 -1.7E+308 1.7E+308 ECU_ADDRESS 0x009481B8 /end MEASUREMENT
/begin MEASUREMENT speedgoat_test_SN5659_R2021b_B.DataTypeConversion_ku "" ULONG speedgoat_test_SN5659_R2021b_CM_uint32 0 0 0 2147483646 ECU_ADDRESS 0x009483AC /end MEASUREMENT
/begin MEASUREMENT speedgoat_test_SN5659_R2021b_B.DataTypeConversion_m "" ULONG speedgoat_test_SN5659_R2021b_CM_uint32 0 0 0 2147483646 ECU_ADDRESS 0x00948370 /end MEASUREMENT
/begin MEASUREMENT speedgoat_test_SN5659_R2021b_B.DataTypeConversion_n "" FLOAT64_IEEE speedgoat_test_SN5659_R2021b_CM_double 0 0 -1.7E+308 1.7E+308 ECU_ADDRESS 0x00948118 /end MEASUREMENT
/begin MEASUREMENT speedgoat_test_SN5659_R2021b_B.Divide_c "" FLOAT64_IEEE speedgoat_test_SN5659_R2021b_CM_double 0 0 -1.7E+308 1.7E+308 ECU_ADDRESS 0x00948188 /end MEASUREMENT
/begin MEASUREMENT speedgoat_test_SN5659_R2021b_B.Divide_m "" FLOAT64_IEEE speedgoat_test_SN5659_R2021b_CM_double 0 0 -1.7E+308 1.7E+308 ECU_ADDRESS 0x009480E8 /end MEASUREMENT
/begin MEASUREMENT speedgoat_test_SN5659_R2021b_B.Divide_o "" FLOAT64_IEEE speedgoat_test_SN5659_R2021b_CM_double 0 0 -1.7E+308 1.7E+308 ECU_ADDRESS 0x00948098 /end MEASUREMENT
/begin MEASUREMENT speedgoat_test_SN5659_R2021b_B.Divide_oc "" FLOAT64_IEEE speedgoat_test_SN5659_R2021b_CM_double 0 0 -1.7E+308 1.7E+308 ECU_ADDRESS 0x009481D8 /end MEASUREMENT
/begin MEASUREMENT speedgoat_test_SN5659_R2021b_B.Divide_os "" FLOAT64_IEEE speedgoat_test_SN5659_R2021b_CM_double 0 0 -1.7E+308 1.7E+308 ECU_ADDRESS 0x00948228 /end MEASUREMENT
/begin MEASUREMENT speedgoat_test_SN5659_R2021b_B.Divide_pl "" FLOAT64_IEEE speedgoat_test_SN5659_R2021b_CM_double 0 0 -1.7E+308 1.7E+308 ECU_ADDRESS 0x00948138 /end MEASUREMENT
/begin MEASUREMENT speedgoat_test_SN5659_R2021b_B.Encode1_c "" FLOAT64_IEEE speedgoat_test_SN5659_R2021b_CM_double 0 0 -1.7E+308 1.7E+308 ECU_ADDRESS 0x00948070 /end MEASUREMENT
/begin MEASUREMENT speedgoat_test_SN5659_R2021b_B.Encode1_d "" FLOAT64_IEEE speedgoat_test_SN5659_R2021b_CM_double 0 0 -1.7E+308 1.7E+308 ECU_ADDRESS 0x00948110 /end MEASUREMENT
/begin MEASUREMENT speedgoat_test_SN5659_R2021b_B.Encode1_e "" FLOAT64_IEEE speedgoat_test_SN5659_R2021b_CM_double 0 0 -1.7E+308 1.7E+308 ECU_ADDRESS 0x009480C0 /end MEASUREMENT
/begin MEASUREMENT speedgoat_test_SN5659_R2021b_B.Encode1_ff "" FLOAT64_IEEE speedgoat_test_SN5659_R2021b_CM_double 0 0 -1.7E+308 1.7E+308 ECU_ADDRESS 0x009481B0 /end MEASUREMENT
/begin MEASUREMENT speedgoat_test_SN5659_R2021b_B.Encode1_i "" FLOAT64_IEEE speedgoat_test_SN5659_R2021b_CM_double 0 0 -1.7E+308 1.7E+308 ECU_ADDRESS 0x00948160 /end MEASUREMENT
/begin MEASUREMENT speedgoat_test_SN5659_R2021b_B.Encode1_kq "" FLOAT64_IEEE speedgoat_test_SN5659_R2021b_CM_double 0 0 -1.7E+308 1.7E+308 ECU_ADDRESS 0x00948200 /end MEASUREMENT
/begin MEASUREMENT speedgoat_test_SN5659_R2021b_B.Encode2_ik "" FLOAT64_IEEE speedgoat_test_SN5659_R2021b_CM_double 0 0 -1.7E+308 1.7E+308 ECU_ADDRESS 0x00948170 /end MEASUREMENT
/begin MEASUREMENT speedgoat_test_SN5659_R2021b_B.Encode2_l "" FLOAT64_IEEE speedgoat_test_SN5659_R2021b_CM_double 0 0 -1.7E+308 1.7E+308 ECU_ADDRESS 0x00948100 /end MEASUREMENT
/begin MEASUREMENT speedgoat_test_SN5659_R2021b_B.Encode2_o "" FLOAT64_IEEE speedgoat_test_SN5659_R2021b_CM_double 0 0 -1.7E+308 1.7E+308 ECU_ADDRESS 0x00948080 /end MEASUREMENT
/begin MEASUREMENT speedgoat_test_SN5659_R2021b_B.Encode2_o3 "" FLOAT64_IEEE speedgoat_test_SN5659_R2021b_CM_double 0 0 -1.7E+308 1.7E+308 ECU_ADDRESS 0x00948240 /end MEASUREMENT
/begin MEASUREMENT speedgoat_test_SN5659_R2021b_B.Encode2_o4 "" FLOAT64_IEEE speedgoat_test_SN5659_R2021b_CM_double 0 0 -1.7E+308 1.7E+308 ECU_ADDRESS 0x009481C0 /end MEASUREMENT
/begin MEASUREMENT speedgoat_test_SN5659_R2021b_B.Encode2_pt "" FLOAT64_IEEE speedgoat_test_SN5659_R2021b_CM_double 0 0 -1.7E+308 1.7E+308 ECU_ADDRESS 0x00948120 /end MEASUREMENT
/begin MEASUREMENT speedgoat_test_SN5659_R2021b_B.Encode3_bv "" FLOAT64_IEEE speedgoat_test_SN5659_R2021b_CM_double 0 0 -1.7E+308 1.7E+308 ECU_ADDRESS 0x009480E0 /end MEASUREMENT
/begin MEASUREMENT speedgoat_test_SN5659_R2021b_B.Encode3_dc "" FLOAT64_IEEE speedgoat_test_SN5659_R2021b_CM_double 0 0 -1.7E+308 1.7E+308 ECU_ADDRESS 0x00948180 /end MEASUREMENT
/begin MEASUREMENT speedgoat_test_SN5659_R2021b_B.Encode3_dp "" FLOAT64_IEEE speedgoat_test_SN5659_R2021b_CM_double 0 0 -1.7E+308 1.7E+308 ECU_ADDRESS 0x009481D0 /end MEASUREMENT
/begin MEASUREMENT speedgoat_test_SN5659_R2021b_B.Encode3_g "" FLOAT64_IEEE speedgoat_test_SN5659_R2021b_CM_double 0 0 -1.7E+308 1.7E+308 ECU_ADDRESS 0x00948090 /end MEASUREMENT
/begin MEASUREMENT speedgoat_test_SN5659_R2021b_B.Encode3_h "" FLOAT64_IEEE speedgoat_test_SN5659_R2021b_CM_double 0 0 -1.7E+308 1.7E+308 ECU_ADDRESS 0x00948220 /end MEASUREMENT
/begin MEASUREMENT speedgoat_test_SN5659_R2021b_B.Encode3_k "" FLOAT64_IEEE speedgoat_test_SN5659_R2021b_CM_double 0 0 -1.7E+308 1.7E+308 ECU_ADDRESS 0x00948130 /end MEASUREMENT
/begin MEASUREMENT speedgoat_test_SN5659_R2021b_B.Encode4_a "" FLOAT64_IEEE speedgoat_test_SN5659_R2021b_CM_double 0 0 -1.7E+308 1.7E+308 ECU_ADDRESS 0x009481F0 /end MEASUREMENT
/begin MEASUREMENT speedgoat_test_SN5659_R2021b_B.Encode4_cn "" FLOAT64_IEEE speedgoat_test_SN5659_R2021b_CM_double 0 0 -1.7E+308 1.7E+308 ECU_ADDRESS 0x009481A0 /end MEASUREMENT
/begin MEASUREMENT speedgoat_test_SN5659_R2021b_B.Encode4_cp "" FLOAT64_IEEE speedgoat_test_SN5659_R2021b_CM_double 0 0 -1.7E+308 1.7E+308 ECU_ADDRESS 0x00948150 /end MEASUREMENT
/begin MEASUREMENT speedgoat_test_SN5659_R2021b_B.Encode4_j "" FLOAT64_IEEE speedgoat_test_SN5659_R2021b_CM_double 0 0 -1.7E+308 1.7E+308 ECU_ADDRESS 0x009480B0 /end MEASUREMENT
/begin MEASUREMENT speedgoat_test_SN5659_R2021b_B.Encode5_a "" FLOAT64_IEEE speedgoat_test_SN5659_R2021b_CM_double 0 0 -1.7E+308 1.7E+308 ECU_ADDRESS 0x009480D0 /end MEASUREMENT
/begin MEASUREMENT speedgoat_test_SN5659_R2021b_B.Encode5_n "" FLOAT64_IEEE speedgoat_test_SN5659_R2021b_CM_double 0 0 -1.7E+308 1.7E+308 ECU_ADDRESS 0x00948210 /end MEASUREMENT
/begin MEASUREMENT speedgoat_test_SN5659_R2021b_B.FixPtSum1_b "" UWORD speedgoat_test_SN5659_R2021b_CM_uint16 0 0 0 65535 ECU_ADDRESS 0x00948410 /end MEASUREMENT
/begin MEASUREMENT speedgoat_test_SN5659_R2021b_B.FixPtSum1_f "" UWORD speedgoat_test_SN5659_R2021b_CM_uint16 0 0 0 65535 ECU_ADDRESS 0x009483F2 /end MEASUREMENT
/begin MEASUREMENT speedgoat_test_SN5659_R2021b_B.FixPtSum1_h2 "" UWORD speedgoat_test_SN5659_R2021b_CM_uint16 0 0 0 65535 ECU_ADDRESS 0x009483F8 /end MEASUREMENT
/begin MEASUREMENT speedgoat_test_SN5659_R2021b_B.FixPtSum1_he "" UWORD speedgoat_test_SN5659_R2021b_CM_uint16 0 0 0 65535 ECU_ADDRESS 0x00948404 /end MEASUREMENT
/begin MEASUREMENT speedgoat_test_SN5659_R2021b_B.FixPtSum1_m "" UWORD speedgoat_test_SN5659_R2021b_CM_uint16 0 0 0 65535 ECU_ADDRESS 0x009483FE /end MEASUREMENT
/begin MEASUREMENT speedgoat_test_SN5659_R2021b_B.FixPtSum1_p "" UWORD speedgoat_test_SN5659_R2021b_CM_uint16 0 0 0 65535 ECU_ADDRESS 0x0094840A /end MEASUREMENT
/begin MEASUREMENT speedgoat_test_SN5659_R2021b_B.FixPtSwitch_a "" UWORD speedgoat_test_SN5659_R2021b_CM_uint16 0 0 0 65535 ECU_ADDRESS 0x00948406 /end MEASUREMENT
/begin MEASUREMENT speedgoat_test_SN5659_R2021b_B.FixPtSwitch_hh "" UWORD speedgoat_test_SN5659_R2021b_CM_uint16 0 0 0 65535 ECU_ADDRESS 0x00948400 /end MEASUREMENT
/begin MEASUREMENT speedgoat_test_SN5659_R2021b_B.FixPtSwitch_j "" UWORD speedgoat_test_SN5659_R2021b_CM_uint16 0 0 0 65535 ECU_ADDRESS 0x009483F4 /end MEASUREMENT
/begin MEASUREMENT speedgoat_test_SN5659_R2021b_B.FixPtSwitch_k "" UWORD speedgoat_test_SN5659_R2021b_CM_uint16 0 0 0 65535 ECU_ADDRESS 0x009483FA /end MEASUREMENT
/begin MEASUREMENT speedgoat_test_SN5659_R2021b_B.FixPtSwitch_l0 "" UWORD speedgoat_test_SN5659_R2021b_CM_uint16 0 0 0 65535 ECU_ADDRESS 0x0094840C /end MEASUREMENT
/begin MEASUREMENT speedgoat_test_SN5659_R2021b_B.FixPtSwitch_m "" UWORD speedgoat_test_SN5659_R2021b_CM_uint16 0 0 0 65535 ECU_ADDRESS 0x00948412 /end MEASUREMENT
/begin MEASUREMENT speedgoat_test_SN5659_R2021b_B.IO941_CH1 "" UBYTE speedgoat_test_SN5659_R2021b_CM_logical 0 0 0 1 ECU_ADDRESS 0x0094841B /end MEASUREMENT
/begin MEASUREMENT speedgoat_test_SN5659_R2021b_B.IO941_CH2 "" UBYTE speedgoat_test_SN5659_R2021b_CM_logical 0 0 0 1 ECU_ADDRESS 0x0094841C /end MEASUREMENT
/begin MEASUREMENT speedgoat_test_SN5659_R2021b_B.IO941_CH3 "" UBYTE speedgoat_test_SN5659_R2021b_CM_logical 0 0 0 1 ECU_ADDRESS 0x0094841D /end MEASUREMENT
/begin MEASUREMENT speedgoat_test_SN5659_R2021b_B.IO941_CH4 "" UBYTE speedgoat_test_SN5659_R2021b_CM_logical 0 0 0 1 ECU_ADDRESS 0x0094841E /end MEASUREMENT
/begin MEASUREMENT speedgoat_test_SN5659_R2021b_B.IO941_CH5 "" UBYTE speedgoat_test_SN5659_R2021b_CM_logical 0 0 0 1 ECU_ADDRESS 0x0094841F /end MEASUREMENT
/begin MEASUREMENT speedgoat_test_SN5659_R2021b_B.IO941_CH6 "" UBYTE speedgoat_test_SN5659_R2021b_CM_logical 0 0 0 1 ECU_ADDRESS 0x00948420 /end MEASUREMENT
/begin MEASUREMENT speedgoat_test_SN5659_R2021b_B.IO941_CH7 "" UBYTE speedgoat_test_SN5659_R2021b_CM_logical 0 0 0 1 ECU_ADDRESS 0x00948421 /end MEASUREMENT
/begin MEASUREMENT speedgoat_test_SN5659_R2021b_B.IO941_CH8 "" UBYTE speedgoat_test_SN5659_R2021b_CM_logical 0 0 0 1 ECU_ADDRESS 0x00948422 /end MEASUREMENT
/begin MEASUREMENT speedgoat_test_SN5659_R2021b_B.Mask_aj "" ULONG speedgoat_test_SN5659_R2021b_CM_uint32 0 0 0 2147483646 ECU_ADDRESS 0x0094839C /end MEASUREMENT
/begin MEASUREMENT speedgoat_test_SN5659_R2021b_B.Mask_b "" ULONG speedgoat_test_SN5659_R2021b_CM_uint32 0 0 0 2147483646 ECU_ADDRESS 0x00948388 /end MEASUREMENT
/begin MEASUREMENT speedgoat_test_SN5659_R2021b_B.Mask_cs "" ULONG speedgoat_test_SN5659_R2021b_CM_uint32 0 0 0 2147483646 ECU_ADDRESS 0x00948360 /end MEASUREMENT
/begin MEASUREMENT speedgoat_test_SN5659_R2021b_B.Mask_cy "" ULONG speedgoat_test_SN5659_R2021b_CM_uint32 0 0 0 2147483646 ECU_ADDRESS 0x009483B0 /end MEASUREMENT
/begin MEASUREMENT speedgoat_test_SN5659_R2021b_B.Mask_my "" ULONG speedgoat_test_SN5659_R2021b_CM_uint32 0 0 0 2147483646 ECU_ADDRESS 0x00948374 /end MEASUREMENT
/begin MEASUREMENT speedgoat_test_SN5659_R2021b_B.Mask_p "" ULONG speedgoat_test_SN5659_R2021b_CM_uint32 0 0 0 2147483646 ECU_ADDRESS 0x0094834C /end MEASUREMENT
/begin MEASUREMENT speedgoat_test_SN5659_R2021b_B.Multiply_b "" FLOAT64_IEEE speedgoat_test_SN5659_R2021b_CM_double 0 0 -1.7E+308 1.7E+308 ECU_ADDRESS 0x009480A0 /end MEASUREMENT
/begin MEASUREMENT speedgoat_test_SN5659_R2021b_B.Multiply_c "" FLOAT64_IEEE speedgoat_test_SN5659_R2021b_CM_double 0 0 -1.7E+308 1.7E+308 ECU_ADDRESS 0x00948230 /end MEASUREMENT
/begin MEASUREMENT speedgoat_test_SN5659_R2021b_B.Multiply_hz "" FLOAT64_IEEE speedgoat_test_SN5659_R2021b_CM_double 0 0 -1.7E+308 1.7E+308 ECU_ADDRESS 0x00948190 /end MEASUREMENT
/begin MEASUREMENT speedgoat_test_SN5659_R2021b_B.Multiply_k "" FLOAT64_IEEE speedgoat_test_SN5659_R2021b_CM_double 0 0 -1.7E+308 1.7E+308 ECU_ADDRESS 0x00948140 /end MEASUREMENT
/begin MEASUREMENT speedgoat_test_SN5659_R2021b_B.Multiply_kl "" FLOAT64_IEEE speedgoat_test_SN5659_R2021b_CM_double 0 0 -1.7E+308 1.7E+308 ECU_ADDRESS 0x009481E0 /end MEASUREMENT
/begin MEASUREMENT speedgoat_test_SN5659_R2021b_B.Multiply_m "" FLOAT64_IEEE speedgoat_test_SN5659_R2021b_CM_double 0 0 -1.7E+308 1.7E+308 ECU_ADDRESS 0x009480F0 /end MEASUREMENT
/begin MEASUREMENT speedgoat_test_SN5659_R2021b_B.Output_bg "" UWORD speedgoat_test_SN5659_R2021b_CM_uint16 0 0 0 65535 ECU_ADDRESS 0x00948402 /end MEASUREMENT
/begin MEASUREMENT speedgoat_test_SN5659_R2021b_B.Output_d "" UWORD speedgoat_test_SN5659_R2021b_CM_uint16 0 0 0 65535 ECU_ADDRESS 0x009483F0 /end MEASUREMENT
/begin MEASUREMENT speedgoat_test_SN5659_R2021b_B.Output_i "" UWORD speedgoat_test_SN5659_R2021b_CM_uint16 0 0 0 65535 ECU_ADDRESS 0x009483FC /end MEASUREMENT
/begin MEASUREMENT speedgoat_test_SN5659_R2021b_B.Output_jl "" UWORD speedgoat_test_SN5659_R2021b_CM_uint16 0 0 0 65535 ECU_ADDRESS 0x009483F6 /end MEASUREMENT
/begin MEASUREMENT speedgoat_test_SN5659_R2021b_B.Output_mw "" UWORD speedgoat_test_SN5659_R2021b_CM_uint16 0 0 0 65535 ECU_ADDRESS 0x00948408 /end MEASUREMENT
/begin MEASUREMENT speedgoat_test_SN5659_R2021b_B.Output_pd "" UWORD speedgoat_test_SN5659_R2021b_CM_uint16 0 0 0 65535 ECU_ADDRESS 0x0094840E /end MEASUREMENT
/begin MEASUREMENT speedgoat_test_SN5659_R2021b_B.PulseGenerator_p "" FLOAT64_IEEE speedgoat_test_SN5659_R2021b_CM_double 0 0 -1.7E+308 1.7E+308 ECU_ADDRESS 0x00948248 /end MEASUREMENT
/begin MEASUREMENT speedgoat_test_SN5659_R2021b_B.Randomnumber_d "" FLOAT64_IEEE speedgoat_test_SN5659_R2021b_CM_double 0 0 -1.7E+308 1.7E+308 ECU_ADDRESS 0x00948158 /end MEASUREMENT
/begin MEASUREMENT speedgoat_test_SN5659_R2021b_B.Randomnumber_g "" FLOAT64_IEEE speedgoat_test_SN5659_R2021b_CM_double 0 0 -1.7E+308 1.7E+308 ECU_ADDRESS 0x00948068 /end MEASUREMENT
/begin MEASUREMENT speedgoat_test_SN5659_R2021b_B.Randomnumber_i "" FLOAT64_IEEE speedgoat_test_SN5659_R2021b_CM_double 0 0 -1.7E+308 1.7E+308 ECU_ADDRESS 0x009480B8 /end MEASUREMENT
/begin MEASUREMENT speedgoat_test_SN5659_R2021b_B.Randomnumber_i2 "" FLOAT64_IEEE speedgoat_test_SN5659_R2021b_CM_double 0 0 -1.7E+308 1.7E+308 ECU_ADDRESS 0x00948108 /end MEASUREMENT
/begin MEASUREMENT speedgoat_test_SN5659_R2021b_B.Randomnumber_j "" FLOAT64_IEEE speedgoat_test_SN5659_R2021b_CM_double 0 0 -1.7E+308 1.7E+308 ECU_ADDRESS 0x009481F8 /end MEASUREMENT
/begin MEASUREMENT speedgoat_test_SN5659_R2021b_B.Randomnumber_n4 "" FLOAT64_IEEE speedgoat_test_SN5659_R2021b_CM_double 0 0 -1.7E+308 1.7E+308 ECU_ADDRESS 0x009481A8 /end MEASUREMENT
/begin MEASUREMENT speedgoat_test_SN5659_R2021b_B.Read_o10 "" FLOAT64_IEEE speedgoat_test_SN5659_R2021b_CM_double 0 0 -1.7E+308 1.7E+308 ECU_ADDRESS 0x00945F10 /end MEASUREMENT
/begin MEASUREMENT speedgoat_test_SN5659_R2021b_B.Read_o12 "" FLOAT64_IEEE speedgoat_test_SN5659_R2021b_CM_double 0 0 -1.7E+308 1.7E+308 ECU_ADDRESS 0x00945F20 /end MEASUREMENT
/begin MEASUREMENT speedgoat_test_SN5659_R2021b_B.Read_o13 "" FLOAT64_IEEE speedgoat_test_SN5659_R2021b_CM_double 0 0 -1.7E+308 1.7E+308 ECU_ADDRESS 0x00945F28 /end MEASUREMENT
/begin MEASUREMENT speedgoat_test_SN5659_R2021b_B.Read_o14 "" FLOAT64_IEEE speedgoat_test_SN5659_R2021b_CM_double 0 0 -1.7E+308 1.7E+308 ECU_ADDRESS 0x00945F30 /end MEASUREMENT
/begin MEASUREMENT speedgoat_test_SN5659_R2021b_B.Read_o15 "" FLOAT64_IEEE speedgoat_test_SN5659_R2021b_CM_double 0 0 -1.7E+308 1.7E+308 ECU_ADDRESS 0x00945F38 /end MEASUREMENT
/begin MEASUREMENT speedgoat_test_SN5659_R2021b_B.Read_o2 "" FLOAT64_IEEE speedgoat_test_SN5659_R2021b_CM_double 0 0 -1.7E+308 1.7E+308 ECU_ADDRESS 0x00945ED0 /end MEASUREMENT
/begin MEASUREMENT speedgoat_test_SN5659_R2021b_B.Read_o3 "" FLOAT64_IEEE speedgoat_test_SN5659_R2021b_CM_double 0 0 -1.7E+308 1.7E+308 ECU_ADDRESS 0x00945ED8 /end MEASUREMENT
/begin MEASUREMENT speedgoat_test_SN5659_R2021b_B.Read_o4 "" FLOAT64_IEEE speedgoat_test_SN5659_R2021b_CM_double 0 0 -1.7E+308 1.7E+308 ECU_ADDRESS 0x00945EE0 /end MEASUREMENT
/begin MEASUREMENT speedgoat_test_SN5659_R2021b_B.Read_o5 "" FLOAT64_IEEE speedgoat_test_SN5659_R2021b_CM_double 0 0 -1.7E+308 1.7E+308 ECU_ADDRESS 0x00945EE8 /end MEASUREMENT
/begin MEASUREMENT speedgoat_test_SN5659_R2021b_B.Read_o7 "" FLOAT64_IEEE speedgoat_test_SN5659_R2021b_CM_double 0 0 -1.7E+308 1.7E+308 ECU_ADDRESS 0x00945EF8 /end MEASUREMENT
/begin MEASUREMENT speedgoat_test_SN5659_R2021b_B.Read_o8 "" FLOAT64_IEEE speedgoat_test_SN5659_R2021b_CM_double 0 0 -1.7E+308 1.7E+308 ECU_ADDRESS 0x00945F00 /end MEASUREMENT
/begin MEASUREMENT speedgoat_test_SN5659_R2021b_B.Read_o9 "" FLOAT64_IEEE speedgoat_test_SN5659_R2021b_CM_double 0 0 -1.7E+308 1.7E+308 ECU_ADDRESS 0x00945F08 /end MEASUREMENT
/begin MEASUREMENT speedgoat_test_SN5659_R2021b_B.ShifttoSDIslot_bb "" ULONG speedgoat_test_SN5659_R2021b_CM_uint32 0 0 0 2147483646 ECU_ADDRESS 0x00948390 /end MEASUREMENT
/begin MEASUREMENT speedgoat_test_SN5659_R2021b_B.ShifttoSDIslot_ck "" ULONG speedgoat_test_SN5659_R2021b_CM_uint32 0 0 0 2147483646 ECU_ADDRESS 0x00948354 /end MEASUREMENT
/begin MEASUREMENT speedgoat_test_SN5659_R2021b_B.ShifttoSDIslot_d "" ULONG speedgoat_test_SN5659_R2021b_CM_uint32 0 0 0 2147483646 ECU_ADDRESS 0x00948368 /end MEASUREMENT
/begin MEASUREMENT speedgoat_test_SN5659_R2021b_B.ShifttoSDIslot_f "" ULONG speedgoat_test_SN5659_R2021b_CM_uint32 0 0 0 2147483646 ECU_ADDRESS 0x009483A4 /end MEASUREMENT
/begin MEASUREMENT speedgoat_test_SN5659_R2021b_B.ShifttoSDIslot_fi "" ULONG speedgoat_test_SN5659_R2021b_CM_uint32 0 0 0 2147483646 ECU_ADDRESS 0x009483B8 /end MEASUREMENT
/begin MEASUREMENT speedgoat_test_SN5659_R2021b_B.ShifttoSDIslot_mf "" ULONG speedgoat_test_SN5659_R2021b_CM_uint32 0 0 0 2147483646 ECU_ADDRESS 0x0094837C /end MEASUREMENT
/begin MEASUREMENT speedgoat_test_SN5659_R2021b_B.ShifttoSSMslot_e "" ULONG speedgoat_test_SN5659_R2021b_CM_uint32 0 0 0 2147483646 ECU_ADDRESS 0x00948350 /end MEASUREMENT
/begin MEASUREMENT speedgoat_test_SN5659_R2021b_B.ShifttoSSMslot_ea "" ULONG speedgoat_test_SN5659_R2021b_CM_uint32 0 0 0 2147483646 ECU_ADDRESS 0x009483A0 /end MEASUREMENT
/begin MEASUREMENT speedgoat_test_SN5659_R2021b_B.ShifttoSSMslot_et "" ULONG speedgoat_test_SN5659_R2021b_CM_uint32 0 0 0 2147483646 ECU_ADDRESS 0x00948378 /end MEASUREMENT
/begin MEASUREMENT speedgoat_test_SN5659_R2021b_B.ShifttoSSMslot_hy "" ULONG speedgoat_test_SN5659_R2021b_CM_uint32 0 0 0 2147483646 ECU_ADDRESS 0x009483B4 /end MEASUREMENT
/begin MEASUREMENT speedgoat_test_SN5659_R2021b_B.ShifttoSSMslot_n "" ULONG speedgoat_test_SN5659_R2021b_CM_uint32 0 0 0 2147483646 ECU_ADDRESS 0x00948364 /end MEASUREMENT
/begin MEASUREMENT speedgoat_test_SN5659_R2021b_B.ShifttoSSMslot_o "" ULONG speedgoat_test_SN5659_R2021b_CM_uint32 0 0 0 2147483646 ECU_ADDRESS 0x0094838C /end MEASUREMENT
/begin MEASUREMENT speedgoat_test_SN5659_R2021b_B.Sinewave_ao "" FLOAT64_IEEE speedgoat_test_SN5659_R2021b_CM_double 0 0 -1.7E+308 1.7E+308 ECU_ADDRESS 0x00948218 /end MEASUREMENT
/begin MEASUREMENT speedgoat_test_SN5659_R2021b_B.Sinewave_d "" FLOAT64_IEEE speedgoat_test_SN5659_R2021b_CM_double 0 0 -1.7E+308 1.7E+308 ECU_ADDRESS 0x009480D8 /end MEASUREMENT
/begin MEASUREMENT speedgoat_test_SN5659_R2021b_B.Sinewave_fe "" FLOAT64_IEEE speedgoat_test_SN5659_R2021b_CM_double 0 0 -1.7E+308 1.7E+308 ECU_ADDRESS 0x00948128 /end MEASUREMENT
/begin MEASUREMENT speedgoat_test_SN5659_R2021b_B.Sinewave_ff "" FLOAT64_IEEE speedgoat_test_SN5659_R2021b_CM_double 0 0 -1.7E+308 1.7E+308 ECU_ADDRESS 0x00948178 /end MEASUREMENT
/begin MEASUREMENT speedgoat_test_SN5659_R2021b_B.Sinewave_m "" FLOAT64_IEEE speedgoat_test_SN5659_R2021b_CM_double 0 0 -1.7E+308 1.7E+308 ECU_ADDRESS 0x009481C8 /end MEASUREMENT
/begin MEASUREMENT speedgoat_test_SN5659_R2021b_B.Sinewave_n "" FLOAT64_IEEE speedgoat_test_SN5659_R2021b_CM_double 0 0 -1.7E+308 1.7E+308 ECU_ADDRESS 0x00948088 /end MEASUREMENT
/begin MEASUREMENT speedgoat_test_SN5659_R2021b_DW.NextOutput_b "" FLOAT64_IEEE speedgoat_test_SN5659_R2021b_CM_double 0 0 -1.7E+308 1.7E+308 ECU_ADDRESS 0x00945208 /end MEASUREMENT
/begin MEASUREMENT speedgoat_test_SN5659_R2021b_DW.NextOutput_h "" FLOAT64_IEEE speedgoat_test_SN5659_R2021b_CM_double 0 0 -1.7E+308 1.7E+308 ECU_ADDRESS 0x00945190 /end MEASUREMENT
/begin MEASUREMENT speedgoat_test_SN5659_R2021b_DW.NextOutput_hu "" FLOAT64_IEEE speedgoat_test_SN5659_R2021b_CM_double 0 0 -1.7E+308 1.7E+308 ECU_ADDRESS 0x009451C0 /end MEASUREMENT
/begin MEASUREMENT speedgoat_test_SN5659_R2021b_DW.NextOutput_ir "" FLOAT64_IEEE speedgoat_test_SN5659_R2021b_CM_double 0 0 -1.7E+308 1.7E+308 ECU_ADDRESS 0x009451A8 /end MEASUREMENT
/begin MEASUREMENT speedgoat_test_SN5659_R2021b_DW.NextOutput_jn "" FLOAT64_IEEE speedgoat_test_SN5659_R2021b_CM_double 0 0 -1.7E+308 1.7E+308 ECU_ADDRESS 0x009451F0 /end MEASUREMENT
/begin MEASUREMENT speedgoat_test_SN5659_R2021b_DW.NextOutput_p "" FLOAT64_IEEE speedgoat_test_SN5659_R2021b_CM_double 0 0 -1.7E+308 1.7E+308 ECU_ADDRESS 0x009451D8 /end MEASUREMENT
/begin MEASUREMENT speedgoat_test_SN5659_R2021b_DW.Output_DSTATE_b "" UWORD speedgoat_test_SN5659_R2021b_CM_uint16 0 0 0 65535 ECU_ADDRESS 0x00945D82 /end MEASUREMENT
/begin MEASUREMENT speedgoat_test_SN5659_R2021b_DW.Output_DSTATE_f "" UWORD speedgoat_test_SN5659_R2021b_CM_uint16 0 0 0 65535 ECU_ADDRESS 0x00945D84 /end MEASUREMENT
/begin MEASUREMENT speedgoat_test_SN5659_R2021b_DW.Output_DSTATE_fw "" UWORD speedgoat_test_SN5659_R2021b_CM_uint16 0 0 0 65535 ECU_ADDRESS 0x00945D8A /end MEASUREMENT
/begin MEASUREMENT speedgoat_test_SN5659_R2021b_DW.Output_DSTATE_h "" UWORD speedgoat_test_SN5659_R2021b_CM_uint16 0 0 0 65535 ECU_ADDRESS 0x00945D86 /end MEASUREMENT
/begin MEASUREMENT speedgoat_test_SN5659_R2021b_DW.Output_DSTATE_m4 "" UWORD speedgoat_test_SN5659_R2021b_CM_uint16 0 0 0 65535 ECU_ADDRESS 0x00945D88 /end MEASUREMENT
/begin MEASUREMENT speedgoat_test_SN5659_R2021b_DW.Output_DSTATE_p "" UWORD speedgoat_test_SN5659_R2021b_CM_uint16 0 0 0 65535 ECU_ADDRESS 0x00945D80 /end MEASUREMENT
/begin MEASUREMENT speedgoat_test_SN5659_R2021b_DW.RandSeed_bw "" ULONG speedgoat_test_SN5659_R2021b_CM_uint32 0 0 0 2147483646 ECU_ADDRESS 0x00945AC4 /end MEASUREMENT
/begin MEASUREMENT speedgoat_test_SN5659_R2021b_DW.RandSeed_fs "" ULONG speedgoat_test_SN5659_R2021b_CM_uint32 0 0 0 2147483646 ECU_ADDRESS 0x00945AD4 /end MEASUREMENT
/begin MEASUREMENT speedgoat_test_SN5659_R2021b_DW.RandSeed_hi "" ULONG speedgoat_test_SN5659_R2021b_CM_uint32 0 0 0 2147483646 ECU_ADDRESS 0x00945AC0 /end MEASUREMENT
/begin MEASUREMENT speedgoat_test_SN5659_R2021b_DW.RandSeed_j "" ULONG speedgoat_test_SN5659_R2021b_CM_uint32 0 0 0 2147483646 ECU_ADDRESS 0x00945AC8 /end MEASUREMENT
/begin MEASUREMENT speedgoat_test_SN5659_R2021b_DW.RandSeed_l "" ULONG speedgoat_test_SN5659_R2021b_CM_uint32 0 0 0 2147483646 ECU_ADDRESS 0x00945AD0 /end MEASUREMENT
/begin MEASUREMENT speedgoat_test_SN5659_R2021b_DW.RandSeed_n "" ULONG speedgoat_test_SN5659_R2021b_CM_uint32 0 0 0 2147483646 ECU_ADDRESS 0x00945ACC /end MEASUREMENT
/begin MEASUREMENT speedgoat_test_SN5659_R2021b_DW.clockTickCounter_i "" SLONG speedgoat_test_SN5659_R2021b_CM_int32 0 0 -2147483648 2147483647 ECU_ADDRESS 0x00945A94 /end MEASUREMENT
/begin MEASUREMENT speedgoat_test_SN5659_R2021b_DW.lastCos_bf "" FLOAT64_IEEE speedgoat_test_SN5659_R2021b_CM_double 0 0 -1.7E+308 1.7E+308 ECU_ADDRESS 0x00945218 /end MEASUREMENT
/begin MEASUREMENT speedgoat_test_SN5659_R2021b_DW.lastCos_ca "" FLOAT64_IEEE speedgoat_test_SN5659_R2021b_CM_double 0 0 -1.7E+308 1.7E+308 ECU_ADDRESS 0x00945200 /end MEASUREMENT
/begin MEASUREMENT speedgoat_test_SN5659_R2021b_DW.lastCos_ge "" FLOAT64_IEEE speedgoat_test_SN5659_R2021b_CM_double 0 0 -1.7E+308 1.7E+308 ECU_ADDRESS 0x009451A0 /end MEASUREMENT
/begin MEASUREMENT speedgoat_test_SN5659_R2021b_DW.lastCos_jh "" FLOAT64_IEEE speedgoat_test_SN5659_R2021b_CM_double 0 0 -1.7E+308 1.7E+308 ECU_ADDRESS 0x009451E8 /end MEASUREMENT
/begin MEASUREMENT speedgoat_test_SN5659_R2021b_DW.lastCos_oh "" FLOAT64_IEEE speedgoat_test_SN5659_R2021b_CM_double 0 0 -1.7E+308 1.7E+308 ECU_ADDRESS 0x009451B8 /end MEASUREMENT
/begin MEASUREMENT speedgoat_test_SN5659_R2021b_DW.lastCos_oy "" FLOAT64_IEEE speedgoat_test_SN5659_R2021b_CM_double 0 0 -1.7E+308 1.7E+308 ECU_ADDRESS 0x009451D0 /end MEASUREMENT
/begin MEASUREMENT speedgoat_test_SN5659_R2021b_DW.lastSin_a "" FLOAT64_IEEE speedgoat_test_SN5659_R2021b_CM_double 0 0 -1.7E+308 1.7E+308 ECU_ADDRESS 0x009451C8 /end MEASUREMENT
/begin MEASUREMENT speedgoat_test_SN5659_R2021b_DW.lastSin_fv "" FLOAT64_IEEE speedgoat_test_SN5659_R2021b_CM_double 0 0 -1.7E+308 1.7E+308 ECU_ADDRESS 0x00945210 /end MEASUREMENT
/begin MEASUREMENT speedgoat_test_SN5659_R2021b_DW.lastSin_i3 "" FLOAT64_IEEE speedgoat_test_SN5659_R2021b_CM_double 0 0 -1.7E+308 1.7E+308 ECU_ADDRESS 0x009451B0 /end MEASUREMENT
/begin MEASUREMENT speedgoat_test_SN5659_R2021b_DW.lastSin_iv "" FLOAT64_IEEE speedgoat_test_SN5659_R2021b_CM_double 0 0 -1.7E+308 1.7E+308 ECU_ADDRESS 0x009451F8 /end MEASUREMENT
/begin MEASUREMENT speedgoat_test_SN5659_R2021b_DW.lastSin_l "" FLOAT64_IEEE speedgoat_test_SN5659_R2021b_CM_double 0 0 -1.7E+308 1.7E+308 ECU_ADDRESS 0x00945198 /end MEASUREMENT
/begin MEASUREMENT speedgoat_test_SN5659_R2021b_DW.lastSin_pf "" FLOAT64_IEEE speedgoat_test_SN5659_R2021b_CM_double 0 0 -1.7E+308 1.7E+308 ECU_ADDRESS 0x009451E0 /end MEASUREMENT
/begin MEASUREMENT speedgoat_test_SN5659_R2021b_DW.systemEnable_g "" SLONG speedgoat_test_SN5659_R2021b_CM_int32 0 0 -2147483648 2147483647 ECU_ADDRESS 0x00945A7C /end MEASUREMENT
/begin MEASUREMENT speedgoat_test_SN5659_R2021b_DW.systemEnable_gv "" SLONG speedgoat_test_SN5659_R2021b_CM_int32 0 0 -2147483648 2147483647 ECU_ADDRESS 0x00945A8C /end MEASUREMENT
/begin MEASUREMENT speedgoat_test_SN5659_R2021b_DW.systemEnable_ik "" SLONG speedgoat_test_SN5659_R2021b_CM_int32 0 0 -2147483648 2147483647 ECU_ADDRESS 0x00945A84 /end MEASUREMENT
/begin MEASUREMENT speedgoat_test_SN5659_R2021b_DW.systemEnable_jy "" SLONG speedgoat_test_SN5659_R2021b_CM_int32 0 0 -2147483648 2147483647 ECU_ADDRESS 0x00945A88 /end MEASUREMENT
/begin MEASUREMENT speedgoat_test_SN5659_R2021b_DW.systemEnable_o1 "" SLONG speedgoat_test_SN5659_R2021b_CM_int32 0 0 -2147483648 2147483647 ECU_ADDRESS 0x00945A90 /end MEASUREMENT
/begin MEASUREMENT speedgoat_test_SN5659_R2021b_DW.systemEnable_pe "" SLONG speedgoat_test_SN5659_R2021b_CM_int32 0 0 -2147483648 2147483647 ECU_ADDRESS 0x00945A80 /end MEASUREMENT
/begin COMPU_METHOD speedgoat_test_SN5659_R2021b_CM_double "" IDENTICAL "%15.10" "" /end COMPU_METHOD
/begin COMPU_METHOD speedgoat_test_SN5659_R2021b_CM_int32 "" IDENTICAL "%10.0" "" /end COMPU_METHOD
/begin COMPU_METHOD speedgoat_test_SN5659_R2021b_CM_logical "" IDENTICAL "%1.0" "" /end COMPU_METHOD
/begin COMPU_METHOD speedgoat_test_SN5659_R2021b_CM_uint16 "" IDENTICAL "%5.0" "" /end COMPU_METHOD
/begin COMPU_METHOD speedgoat_test_SN5659_R2021b_CM_uint32 "" IDENTICAL "%10.0" "" /end COMPU_METHOD
/begin RECORD_LAYOUT Scalar_FLOAT64_IEEE FNC_VALUES 1 FLOAT64_IEEE COLUMN_DIR DIRECT /end RECORD_LAYOUT
/begin RECORD_LAYOUT Scalar_SLONG FNC_VALUES 1 SLONG COLUMN_DIR DIRECT /end RECORD_LAYOUT
/begin RECORD_LAYOUT Scalar_ULONG FNC_VALUES 1 ULONG COLUMN_DIR DIRECT /end RECORD_LAYOUT
/begin RECORD_LAYOUT Scalar_UWORD FNC_VALUES 1 UWORD COLUMN_DIR DIRECT /end RECORD_LAYOUT
/begin GROUP speedgoat_test_SN5659_R2021b_IO682_Encode_Channel_4 "speedgoat_test_SN5659_R2021b/IO682/Encode Channel 4"
 /begin SUB_GROUP speedgoat_test_SN5659_R2021b_IO682_Encode_Channel_4_Counter_Limited speedgoat_test_SN5659_R2021b_IO682_Encode_Channel_4_Prepare_RAW_value /end SUB_GROUP
 /begin REF_CHARACTERISTIC speedgoat_test_SN5659__cal_impl.Constant_Value_gg speedgoat_test_SN5659__cal_impl.Encode1_P10_j speedgoat_test_SN5659__cal_impl.Encode1_P11_fp speedgoat_test_SN5659__cal_impl.Encode1_P12_kd speedgoat_test_SN5659__cal_impl.Encode1_P13_h speedgoat_test_SN5659__cal_impl.Encode1_P14_ov speedgoat_test_SN5659__cal_impl.Encode1_P15_ka speedgoat_test_SN5659__cal_impl.Encode1_P1_k speedgoat_test_SN5659__cal_impl.Encode1_P2_c speedgoat_test_SN5659__cal_impl.Encode1_P3_g speedgoat_test_SN5659__cal_impl.Encode1_P4_eq speedgoat_test_SN5659__cal_impl.Encode1_P5_jf speedgoat_test_SN5659__cal_impl.Encode1_P6_k speedgoat_test_SN5659__cal_impl.Encode1_P7_p speedgoat_test_SN5659__cal_impl.Encode1_P8_o speedgoat_test_SN5659__cal_impl.Encode1_P9_h speedgoat_test_SN5659__cal_impl.Encode2_P10_ab0 speedgoat_test_SN5659__cal_impl.Encode2_P11_p speedgoat_test_SN5659__cal_impl.Encode2_P12_c speedgoat_test_SN5659__cal_impl.Encode2_P13_a speedgoat_test_SN5659__cal_impl.Encode2_P14_db speedgoat_test_SN5659__cal_impl.Encode2_P15_a speedgoat_test_SN5659__cal_impl.Encode2_P1_f speedgoat_test_SN5659__cal_impl.Encode2_P2_kra speedgoat_test_SN5659__cal_impl.Encode2_P3_d speedgoat_test_SN5659__cal_impl.Encode2_P4_lw speedgoat_test_SN5659__cal_impl.Encode2_P5_mc speedgoat_test_SN5659__cal_impl.Encode2_P6_f speedgoat_test_SN5659__cal_impl.Encode2_P7_oo speedgoat_test_SN5659__cal_impl.Encode2_P8_a speedgoat_test_SN5659__cal_impl.Encode2_P9_ni speedgoat_test_SN5659__cal_impl.Encode3_P10_od speedgoat_test_SN5659__cal_impl.Encode3_P11_o speedgoat_test_SN5659__cal_impl.Encode3_P12_f speedgoat_test_SN5659__cal_impl.Encode3_P13_a speedgoat_test_SN5659__cal_impl.Encode3_P14_g speedgoat_test_SN5659__cal_impl.Encode3_P15_a speedgoat_test_SN5659__cal_impl.Encode3_P1_ad speedgoat_test_SN5659__cal_impl.Encode3_P2_fg speedgoat_test_SN5659__cal_impl.Encode3_P3_nx speedgoat_test_SN5659__cal_impl.Encode3_P4_go speedgoat_test_SN5659__cal_impl.Encode3_P5_i0 speedgoat_test_SN5659__cal_impl.Encode3_P6_a0 speedgoat_test_SN5659__cal_impl.Encode3_P7_p speedgoat_test_SN5659__cal_impl.Encode3_P8_j speedgoat_test_SN5659__cal_impl.Encode3_P9_o speedgoat_test_SN5659__cal_impl.Encode4_P10_p speedgoat_test_SN5659__cal_impl.Encode4_P11_a speedgoat_test_SN5659__cal_impl.Encode4_P12_ld speedgoat_test_SN5659__cal_impl.Encode4_P13_g speedgoat_test_SN5659__cal_impl.Encode4_P14_o speedgoat_test_SN5659__cal_impl.Encode4_P15_j speedgoat_test_SN5659__cal_impl.Encode4_P1_h speedgoat_test_SN5659__cal_impl.Encode4_P2_e speedgoat_test_SN5659__cal_impl.Encode4_P3_j speedgoat_test_SN5659__cal_impl.Encode4_P4_o speedgoat_test_SN5659__cal_impl.Encode4_P5_pt speedgoat_test_SN5659__cal_impl.Encode4_P6_ab speedgoat_test_SN5659__cal_impl.Encode4_P7_i speedgoat_test_SN5659__cal_impl.Encode4_P8_hv speedgoat_test_SN5659__cal_impl.Encode4_P9_l speedgoat_test_SN5659__cal_impl.Randomnumber_Mean_p speedgoat_test_SN5659__cal_impl.Randomnumber_Seed_i speedgoat_test_SN5659__cal_impl.Randomnumber_StdDev_b speedgoat_test_SN5659__cal_impl.Sinewave_Amp_m speedgoat_test_SN5659__cal_impl.Sinewave_Bias_o speedgoat_test_SN5659__cal_impl.Sinewave_Freq_lw speedgoat_test_SN5659__cal_impl.Sinewave_HCos_e speedgoat_test_SN5659__cal_impl.Sinewave_Hsin_a speedgoat_test_SN5659__cal_impl.Sinewave_PCos_jo speedgoat_test_SN5659__cal_impl.Sinewave_PSin_px /end REF_CHARACTERISTIC
 /begin REF_MEASUREMENT speedgoat_test_SN5659_R2021b_B.DataTypeConversion1_gh speedgoat_test_SN5659_R2021b_B.DataTypeConversion_f speedgoat_test_SN5659_R2021b_B.Encode1_c speedgoat_test_SN5659_R2021b_B.Encode2_o speedgoat_test_SN5659_R2021b_B.Encode3_g speedgoat_test_SN5659_R2021b_B.Encode4_j speedgoat_test_SN5659_R2021b_B.Output_d speedgoat_test_SN5659_R2021b_B.Randomnumber_g speedgoat_test_SN5659_R2021b_B.Sinewave_n speedgoat_test_SN5659_R2021b_DW.NextOutput_h speedgoat_test_SN5659_R2021b_DW.RandSeed_hi speedgoat_test_SN5659_R2021b_DW.lastCos_ge speedgoat_test_SN5659_R2021b_DW.lastSin_l speedgoat_test_SN5659_R2021b_DW.systemEnable_g /end REF_MEASUREMENT
/end GROUP
/begin GROUP speedgoat_test_SN5659_R2021b_IO682_Encode_Channel_4_Counter_Limited "speedgoat_test_SN5659_R2021b/IO682/Encode Channel 4/Counter
Limited"
 /begin SUB_GROUP speedgoat_test_SN5659_R2021b_IO682_Encode_Channel_4_Counter_Limited_Increment_Real_World speedgoat_test_SN5659_R2021b_IO682_Encode_Channel_4_Counter_Limited_Wrap_To_Zero /end SUB_GROUP
 /begin REF_CHARACTERISTIC speedgoat_test_SN5659__cal_impl.Output_InitialCondition_d /end REF_CHARACTERISTIC
 /begin REF_MEASUREMENT speedgoat_test_SN5659_R2021b_B.FixPtSwitch_j speedgoat_test_SN5659_R2021b_B.Output_d speedgoat_test_SN5659_R2021b_DW.Output_DSTATE_p /end REF_MEASUREMENT
/end GROUP
/begin GROUP speedgoat_test_SN5659_R2021b_IO682_Encode_Channel_4_Counter_Limited_Increment_Real_World "speedgoat_test_SN5659_R2021b/IO682/Encode Channel 4/Counter
Limited/Increment
Real World" /begin REF_CHARACTERISTIC speedgoat_test_SN5659__cal_impl.FixPtConstant_Value_k /end REF_CHARACTERISTIC
 /begin REF_MEASUREMENT speedgoat_test_SN5659_R2021b_B.FixPtSum1_f speedgoat_test_SN5659_R2021b_B.Output_d /end REF_MEASUREMENT
/end GROUP
/begin GROUP speedgoat_test_SN5659_R2021b_IO682_Encode_Channel_4_Counter_Limited_Wrap_To_Zero "speedgoat_test_SN5659_R2021b/IO682/Encode Channel 4/Counter
Limited/Wrap To Zero"
 /begin REF_CHARACTERISTIC speedgoat_test_SN5659__cal_impl.Constant_Value_ly speedgoat_test_SN5659__cal_impl.CounterLimited_uplimit_p /end REF_CHARACTERISTIC
 /begin REF_MEASUREMENT speedgoat_test_SN5659_R2021b_B.FixPtSum1_f speedgoat_test_SN5659_R2021b_B.FixPtSwitch_j /end REF_MEASUREMENT
/end GROUP
/begin GROUP speedgoat_test_SN5659_R2021b_IO682_Encode_Channel_4_Prepare_RAW_value "speedgoat_test_SN5659_R2021b/IO682/Encode Channel 4/Prepare RAW value"
 /begin REF_CHARACTERISTIC speedgoat_test_SN5659__cal_impl.Label_Value_l speedgoat_test_SN5659__cal_impl.Mask_BitMask_f speedgoat_test_SN5659__cal_impl.SDI_Value_g speedgoat_test_SN5659__cal_impl.SSM_Value_nl speedgoat_test_SN5659__cal_impl.Scale_Value_o speedgoat_test_SN5659__cal_impl.shiftthedoublevalue27bitslef_jt /end REF_CHARACTERISTIC
 /begin REF_MEASUREMENT speedgoat_test_SN5659_R2021b_B.BitwiseOperator_pk speedgoat_test_SN5659_R2021b_B.DataTypeConversion1_gh speedgoat_test_SN5659_R2021b_B.DataTypeConversion_fr speedgoat_test_SN5659_R2021b_B.Divide_o speedgoat_test_SN5659_R2021b_B.Mask_p speedgoat_test_SN5659_R2021b_B.Multiply_b speedgoat_test_SN5659_R2021b_B.ShifttoSDIslot_ck speedgoat_test_SN5659_R2021b_B.ShifttoSSMslot_e /end REF_MEASUREMENT
/end GROUP
/begin GROUP speedgoat_test_SN5659_R2021b_IO682_Encode_Channel_5 "speedgoat_test_SN5659_R2021b/IO682/Encode Channel 5"
 /begin SUB_GROUP speedgoat_test_SN5659_R2021b_IO682_Encode_Channel_5_Counter_Limited speedgoat_test_SN5659_R2021b_IO682_Encode_Channel_5_Prepare_RAW_value /end SUB_GROUP
 /begin REF_CHARACTERISTIC speedgoat_test_SN5659__cal_impl.Constant_Value_h speedgoat_test_SN5659__cal_impl.Encode1_P10_g speedgoat_test_SN5659__cal_impl.Encode1_P11_gb speedgoat_test_SN5659__cal_impl.Encode1_P12_i speedgoat_test_SN5659__cal_impl.Encode1_P13_hz speedgoat_test_SN5659__cal_impl.Encode1_P14_f speedgoat_test_SN5659__cal_impl.Encode1_P15_n speedgoat_test_SN5659__cal_impl.Encode1_P1_n speedgoat_test_SN5659__cal_impl.Encode1_P2_d speedgoat_test_SN5659__cal_impl.Encode1_P3_n speedgoat_test_SN5659__cal_impl.Encode1_P4_b speedgoat_test_SN5659__cal_impl.Encode1_P5_gx speedgoat_test_SN5659__cal_impl.Encode1_P6_mt speedgoat_test_SN5659__cal_impl.Encode1_P7_k speedgoat_test_SN5659__cal_impl.Encode1_P8_bu speedgoat_test_SN5659__cal_impl.Encode1_P9_ju speedgoat_test_SN5659__cal_impl.Encode2_P10_im speedgoat_test_SN5659__cal_impl.Encode2_P11_o speedgoat_test_SN5659__cal_impl.Encode2_P12_k3 speedgoat_test_SN5659__cal_impl.Encode2_P13_m speedgoat_test_SN5659__cal_impl.Encode2_P14_k speedgoat_test_SN5659__cal_impl.Encode2_P15_e1 speedgoat_test_SN5659__cal_impl.Encode2_P1_b speedgoat_test_SN5659__cal_impl.Encode2_P2_di speedgoat_test_SN5659__cal_impl.Encode2_P3_ln speedgoat_test_SN5659__cal_impl.Encode2_P4_n speedgoat_test_SN5659__cal_impl.Encode2_P5_a speedgoat_test_SN5659__cal_impl.Encode2_P6_c speedgoat_test_SN5659__cal_impl.Encode2_P7_iq speedgoat_test_SN5659__cal_impl.Encode2_P8_b speedgoat_test_SN5659__cal_impl.Encode2_P9_l speedgoat_test_SN5659__cal_impl.Encode3_P10_f speedgoat_test_SN5659__cal_impl.Encode3_P11_ic speedgoat_test_SN5659__cal_impl.Encode3_P12_m speedgoat_test_SN5659__cal_impl.Encode3_P13_hi speedgoat_test_SN5659__cal_impl.Encode3_P14_op speedgoat_test_SN5659__cal_impl.Encode3_P15_f speedgoat_test_SN5659__cal_impl.Encode3_P1_o speedgoat_test_SN5659__cal_impl.Encode3_P2_b0 speedgoat_test_SN5659__cal_impl.Encode3_P3_p speedgoat_test_SN5659__cal_impl.Encode3_P4_hs speedgoat_test_SN5659__cal_impl.Encode3_P5_g speedgoat_test_SN5659__cal_impl.Encode3_P6_hi speedgoat_test_SN5659__cal_impl.Encode3_P7_c speedgoat_test_SN5659__cal_impl.Encode3_P8_fe speedgoat_test_SN5659__cal_impl.Encode3_P9_l speedgoat_test_SN5659__cal_impl.Encode5_P10_j speedgoat_test_SN5659__cal_impl.Encode5_P11_h speedgoat_test_SN5659__cal_impl.Encode5_P12_c speedgoat_test_SN5659__cal_impl.Encode5_P13_c speedgoat_test_SN5659__cal_impl.Encode5_P14_e speedgoat_test_SN5659__cal_impl.Encode5_P15_m speedgoat_test_SN5659__cal_impl.Encode5_P1_a speedgoat_test_SN5659__cal_impl.Encode5_P2_l speedgoat_test_SN5659__cal_impl.Encode5_P3_c speedgoat_test_SN5659__cal_impl.Encode5_P4_o speedgoat_test_SN5659__cal_impl.Encode5_P5_ih speedgoat_test_SN5659__cal_impl.Encode5_P6_o speedgoat_test_SN5659__cal_impl.Encode5_P7_l speedgoat_test_SN5659__cal_impl.Encode5_P8_m speedgoat_test_SN5659__cal_impl.Encode5_P9_o speedgoat_test_SN5659__cal_impl.Randomnumber_Mean_c speedgoat_test_SN5659__cal_impl.Randomnumber_Seed_o speedgoat_test_SN5659__cal_impl.Randomnumber_StdDev_mo speedgoat_test_SN5659__cal_impl.Sinewave_Amp_h5 speedgoat_test_SN5659__cal_impl.Sinewave_Bias_a speedgoat_test_SN5659__cal_impl.Sinewave_Freq_am speedgoat_test_SN5659__cal_impl.Sinewave_HCos_p speedgoat_test_SN5659__cal_impl.Sinewave_Hsin_p speedgoat_test_SN5659__cal_impl.Sinewave_PCos_d speedgoat_test_SN5659__cal_impl.Sinewave_PSin_d /end REF_CHARACTERISTIC
 /begin REF_MEASUREMENT speedgoat_test_SN5659_R2021b_B.DataTypeConversion1_nb speedgoat_test_SN5659_R2021b_B.DataTypeConversion_hb speedgoat_test_SN5659_R2021b_B.Encode1_e speedgoat_test_SN5659_R2021b_B.Encode2_l speedgoat_test_SN5659_R2021b_B.Encode3_bv speedgoat_test_SN5659_R2021b_B.Encode5_a speedgoat_test_SN5659_R2021b_B.Output_jl speedgoat_test_SN5659_R2021b_B.Randomnumber_i speedgoat_test_SN5659_R2021b_B.Sinewave_d speedgoat_test_SN5659_R2021b_DW.NextOutput_ir speedgoat_test_SN5659_R2021b_DW.RandSeed_bw speedgoat_test_SN5659_R2021b_DW.lastCos_oh speedgoat_test_SN5659_R2021b_DW.lastSin_i3 speedgoat_test_SN5659_R2021b_DW.systemEnable_pe /end REF_MEASUREMENT
/end GROUP
/begin GROUP speedgoat_test_SN5659_R2021b_IO682_Encode_Channel_5_Counter_Limited "speedgoat_test_SN5659_R2021b/IO682/Encode Channel 5/Counter
Limited"
 /begin SUB_GROUP speedgoat_test_SN5659_R2021b_IO682_Encode_Channel_5_Counter_Limited_Increment_Real_World speedgoat_test_SN5659_R2021b_IO682_Encode_Channel_5_Counter_Limited_Wrap_To_Zero /end SUB_GROUP
 /begin REF_CHARACTERISTIC speedgoat_test_SN5659__cal_impl.Output_InitialCondition_nb /end REF_CHARACTERISTIC
 /begin REF_MEASUREMENT speedgoat_test_SN5659_R2021b_B.FixPtSwitch_k speedgoat_test_SN5659_R2021b_B.Output_jl speedgoat_test_SN5659_R2021b_DW.Output_DSTATE_b /end REF_MEASUREMENT
/end GROUP
/begin GROUP speedgoat_test_SN5659_R2021b_IO682_Encode_Channel_5_Counter_Limited_Increment_Real_World "speedgoat_test_SN5659_R2021b/IO682/Encode Channel 5/Counter
Limited/Increment
Real World" /begin REF_CHARACTERISTIC speedgoat_test_SN5659__cal_impl.FixPtConstant_Value_m /end REF_CHARACTERISTIC
 /begin REF_MEASUREMENT speedgoat_test_SN5659_R2021b_B.FixPtSum1_h2 speedgoat_test_SN5659_R2021b_B.Output_jl /end REF_MEASUREMENT
/end GROUP
/begin GROUP speedgoat_test_SN5659_R2021b_IO682_Encode_Channel_5_Counter_Limited_Wrap_To_Zero "speedgoat_test_SN5659_R2021b/IO682/Encode Channel 5/Counter
Limited/Wrap To Zero"
 /begin REF_CHARACTERISTIC speedgoat_test_SN5659__cal_impl.Constant_Value_ng speedgoat_test_SN5659__cal_impl.CounterLimited_uplimit_ck /end REF_CHARACTERISTIC
 /begin REF_MEASUREMENT speedgoat_test_SN5659_R2021b_B.FixPtSum1_h2 speedgoat_test_SN5659_R2021b_B.FixPtSwitch_k /end REF_MEASUREMENT
/end GROUP
/begin GROUP speedgoat_test_SN5659_R2021b_IO682_Encode_Channel_5_Prepare_RAW_value "speedgoat_test_SN5659_R2021b/IO682/Encode Channel 5/Prepare RAW value"
 /begin REF_CHARACTERISTIC speedgoat_test_SN5659__cal_impl.Label_Value_kp speedgoat_test_SN5659__cal_impl.Mask_BitMask_c speedgoat_test_SN5659__cal_impl.SDI_Value_ai speedgoat_test_SN5659__cal_impl.SSM_Value_f speedgoat_test_SN5659__cal_impl.Scale_Value_g speedgoat_test_SN5659__cal_impl.shiftthedoublevalue27bitsleft_d /end REF_CHARACTERISTIC
 /begin REF_MEASUREMENT speedgoat_test_SN5659_R2021b_B.BitwiseOperator_b speedgoat_test_SN5659_R2021b_B.DataTypeConversion1_nb speedgoat_test_SN5659_R2021b_B.DataTypeConversion_dn speedgoat_test_SN5659_R2021b_B.Divide_m speedgoat_test_SN5659_R2021b_B.Mask_cs speedgoat_test_SN5659_R2021b_B.Multiply_m speedgoat_test_SN5659_R2021b_B.ShifttoSDIslot_d speedgoat_test_SN5659_R2021b_B.ShifttoSSMslot_n /end REF_MEASUREMENT
/end GROUP
/begin GROUP speedgoat_test_SN5659_R2021b_IO682_Encode_Channel_6 "speedgoat_test_SN5659_R2021b/IO682/Encode Channel 6"
 /begin SUB_GROUP speedgoat_test_SN5659_R2021b_IO682_Encode_Channel_6_Counter_Limited speedgoat_test_SN5659_R2021b_IO682_Encode_Channel_6_Prepare_RAW_value /end SUB_GROUP
 /begin REF_CHARACTERISTIC speedgoat_test_SN5659__cal_impl.Constant_Value_f speedgoat_test_SN5659__cal_impl.Encode1_P10_i0 speedgoat_test_SN5659__cal_impl.Encode1_P11_c speedgoat_test_SN5659__cal_impl.Encode1_P12_as speedgoat_test_SN5659__cal_impl.Encode1_P13_b speedgoat_test_SN5659__cal_impl.Encode1_P14_fh speedgoat_test_SN5659__cal_impl.Encode1_P15_h1 speedgoat_test_SN5659__cal_impl.Encode1_P1_gb speedgoat_test_SN5659__cal_impl.Encode1_P2_es speedgoat_test_SN5659__cal_impl.Encode1_P3_eh speedgoat_test_SN5659__cal_impl.Encode1_P4_h speedgoat_test_SN5659__cal_impl.Encode1_P5_d speedgoat_test_SN5659__cal_impl.Encode1_P6_g speedgoat_test_SN5659__cal_impl.Encode1_P7_n speedgoat_test_SN5659__cal_impl.Encode1_P8_cc speedgoat_test_SN5659__cal_impl.Encode1_P9_f speedgoat_test_SN5659__cal_impl.Encode2_P10_d speedgoat_test_SN5659__cal_impl.Encode2_P11_b speedgoat_test_SN5659__cal_impl.Encode2_P12_mp speedgoat_test_SN5659__cal_impl.Encode2_P13_b speedgoat_test_SN5659__cal_impl.Encode2_P14_h speedgoat_test_SN5659__cal_impl.Encode2_P15_d speedgoat_test_SN5659__cal_impl.Encode2_P1_ga speedgoat_test_SN5659__cal_impl.Encode2_P2_ka speedgoat_test_SN5659__cal_impl.Encode2_P3_fe speedgoat_test_SN5659__cal_impl.Encode2_P4_lk speedgoat_test_SN5659__cal_impl.Encode2_P5_n speedgoat_test_SN5659__cal_impl.Encode2_P6_fn speedgoat_test_SN5659__cal_impl.Encode2_P7_jb speedgoat_test_SN5659__cal_impl.Encode2_P8_hl speedgoat_test_SN5659__cal_impl.Encode2_P9_dn speedgoat_test_SN5659__cal_impl.Encode3_P10_g speedgoat_test_SN5659__cal_impl.Encode3_P11_ox speedgoat_test_SN5659__cal_impl.Encode3_P12_d3 speedgoat_test_SN5659__cal_impl.Encode3_P13_n speedgoat_test_SN5659__cal_impl.Encode3_P14_bl speedgoat_test_SN5659__cal_impl.Encode3_P15_gy speedgoat_test_SN5659__cal_impl.Encode3_P1_j speedgoat_test_SN5659__cal_impl.Encode3_P2_p speedgoat_test_SN5659__cal_impl.Encode3_P3_pb speedgoat_test_SN5659__cal_impl.Encode3_P4_hu speedgoat_test_SN5659__cal_impl.Encode3_P5_kk speedgoat_test_SN5659__cal_impl.Encode3_P6_iy speedgoat_test_SN5659__cal_impl.Encode3_P7_g speedgoat_test_SN5659__cal_impl.Encode3_P8_c speedgoat_test_SN5659__cal_impl.Encode3_P9_a speedgoat_test_SN5659__cal_impl.Encode4_P10_h3 speedgoat_test_SN5659__cal_impl.Encode4_P11_l speedgoat_test_SN5659__cal_impl.Encode4_P12_c speedgoat_test_SN5659__cal_impl.Encode4_P13_ml speedgoat_test_SN5659__cal_impl.Encode4_P14_k speedgoat_test_SN5659__cal_impl.Encode4_P15_o speedgoat_test_SN5659__cal_impl.Encode4_P1_af speedgoat_test_SN5659__cal_impl.Encode4_P2_j speedgoat_test_SN5659__cal_impl.Encode4_P3_n5 speedgoat_test_SN5659__cal_impl.Encode4_P4_kc speedgoat_test_SN5659__cal_impl.Encode4_P5_d speedgoat_test_SN5659__cal_impl.Encode4_P6_abh speedgoat_test_SN5659__cal_impl.Encode4_P7_di speedgoat_test_SN5659__cal_impl.Encode4_P8_e speedgoat_test_SN5659__cal_impl.Encode4_P9_d speedgoat_test_SN5659__cal_impl.Randomnumber_Mean_l speedgoat_test_SN5659__cal_impl.Randomnumber_Seed_cg speedgoat_test_SN5659__cal_impl.Randomnumber_StdDev_o speedgoat_test_SN5659__cal_impl.Sinewave_Amp_m2 speedgoat_test_SN5659__cal_impl.Sinewave_Bias_ac speedgoat_test_SN5659__cal_impl.Sinewave_Freq_cn speedgoat_test_SN5659__cal_impl.Sinewave_HCos_i speedgoat_test_SN5659__cal_impl.Sinewave_Hsin_c speedgoat_test_SN5659__cal_impl.Sinewave_PCos_e speedgoat_test_SN5659__cal_impl.Sinewave_PSin_l /end REF_CHARACTERISTIC
 /begin REF_MEASUREMENT speedgoat_test_SN5659_R2021b_B.DataTypeConversion1_f speedgoat_test_SN5659_R2021b_B.DataTypeConversion_n speedgoat_test_SN5659_R2021b_B.Encode1_d speedgoat_test_SN5659_R2021b_B.Encode2_pt speedgoat_test_SN5659_R2021b_B.Encode3_k speedgoat_test_SN5659_R2021b_B.Encode4_cp speedgoat_test_SN5659_R2021b_B.Output_i speedgoat_test_SN5659_R2021b_B.Randomnumber_i2 speedgoat_test_SN5659_R2021b_B.Sinewave_fe speedgoat_test_SN5659_R2021b_DW.NextOutput_hu speedgoat_test_SN5659_R2021b_DW.RandSeed_j speedgoat_test_SN5659_R2021b_DW.lastCos_oy speedgoat_test_SN5659_R2021b_DW.lastSin_a speedgoat_test_SN5659_R2021b_DW.systemEnable_ik /end REF_MEASUREMENT
/end GROUP
/begin GROUP speedgoat_test_SN5659_R2021b_IO682_Encode_Channel_6_Counter_Limited "speedgoat_test_SN5659_R2021b/IO682/Encode Channel 6/Counter
Limited"
 /begin SUB_GROUP speedgoat_test_SN5659_R2021b_IO682_Encode_Channel_6_Counter_Limited_Increment_Real_World speedgoat_test_SN5659_R2021b_IO682_Encode_Channel_6_Counter_Limited_Wrap_To_Zero /end SUB_GROUP
 /begin REF_CHARACTERISTIC speedgoat_test_SN5659__cal_impl.Output_InitialCondition_h3 /end REF_CHARACTERISTIC
 /begin REF_MEASUREMENT speedgoat_test_SN5659_R2021b_B.FixPtSwitch_hh speedgoat_test_SN5659_R2021b_B.Output_i speedgoat_test_SN5659_R2021b_DW.Output_DSTATE_f /end REF_MEASUREMENT
/end GROUP
/begin GROUP speedgoat_test_SN5659_R2021b_IO682_Encode_Channel_6_Counter_Limited_Increment_Real_World "speedgoat_test_SN5659_R2021b/IO682/Encode Channel 6/Counter
Limited/Increment
Real World" /begin REF_CHARACTERISTIC speedgoat_test_SN5659__cal_impl.FixPtConstant_Value_n /end REF_CHARACTERISTIC
 /begin REF_MEASUREMENT speedgoat_test_SN5659_R2021b_B.FixPtSum1_m speedgoat_test_SN5659_R2021b_B.Output_i /end REF_MEASUREMENT
/end GROUP
/begin GROUP speedgoat_test_SN5659_R2021b_IO682_Encode_Channel_6_Counter_Limited_Wrap_To_Zero "speedgoat_test_SN5659_R2021b/IO682/Encode Channel 6/Counter
Limited/Wrap To Zero"
 /begin REF_CHARACTERISTIC speedgoat_test_SN5659__cal_impl.Constant_Value_oy speedgoat_test_SN5659__cal_impl.CounterLimited_uplimit_l /end REF_CHARACTERISTIC
 /begin REF_MEASUREMENT speedgoat_test_SN5659_R2021b_B.FixPtSum1_m speedgoat_test_SN5659_R2021b_B.FixPtSwitch_hh /end REF_MEASUREMENT
/end GROUP
/begin GROUP speedgoat_test_SN5659_R2021b_IO682_Encode_Channel_6_Prepare_RAW_value "speedgoat_test_SN5659_R2021b/IO682/Encode Channel 6/Prepare RAW value"
 /begin REF_CHARACTERISTIC speedgoat_test_SN5659__cal_impl.Label_Value_p speedgoat_test_SN5659__cal_impl.Mask_BitMask_er speedgoat_test_SN5659__cal_impl.SDI_Value_ig speedgoat_test_SN5659__cal_impl.SSM_Value_a speedgoat_test_SN5659__cal_impl.Scale_Value_h speedgoat_test_SN5659__cal_impl.shiftthedoublevalue27bitsleft_b /end REF_CHARACTERISTIC
 /begin REF_MEASUREMENT speedgoat_test_SN5659_R2021b_B.BitwiseOperator_eh speedgoat_test_SN5659_R2021b_B.DataTypeConversion1_f speedgoat_test_SN5659_R2021b_B.DataTypeConversion_m speedgoat_test_SN5659_R2021b_B.Divide_pl speedgoat_test_SN5659_R2021b_B.Mask_my speedgoat_test_SN5659_R2021b_B.Multiply_k speedgoat_test_SN5659_R2021b_B.ShifttoSDIslot_mf speedgoat_test_SN5659_R2021b_B.ShifttoSSMslot_et /end REF_MEASUREMENT
/end GROUP
/begin GROUP speedgoat_test_SN5659_R2021b_IO682_Encode_Channel_7 "speedgoat_test_SN5659_R2021b/IO682/Encode Channel 7"
 /begin SUB_GROUP speedgoat_test_SN5659_R2021b_IO682_Encode_Channel_7_Counter_Limited speedgoat_test_SN5659_R2021b_IO682_Encode_Channel_7_Prepare_RAW_value /end SUB_GROUP
 /begin REF_CHARACTERISTIC speedgoat_test_SN5659__cal_impl.Constant_Value_bz speedgoat_test_SN5659__cal_impl.Encode1_P10_i5 speedgoat_test_SN5659__cal_impl.Encode1_P11_am speedgoat_test_SN5659__cal_impl.Encode1_P12_mt speedgoat_test_SN5659__cal_impl.Encode1_P13_is speedgoat_test_SN5659__cal_impl.Encode1_P14_cd speedgoat_test_SN5659__cal_impl.Encode1_P15_kak speedgoat_test_SN5659__cal_impl.Encode1_P1_cy speedgoat_test_SN5659__cal_impl.Encode1_P2_a speedgoat_test_SN5659__cal_impl.Encode1_P3_em speedgoat_test_SN5659__cal_impl.Encode1_P4_m speedgoat_test_SN5659__cal_impl.Encode1_P5_dq speedgoat_test_SN5659__cal_impl.Encode1_P6_ad speedgoat_test_SN5659__cal_impl.Encode1_P7_eo speedgoat_test_SN5659__cal_impl.Encode1_P8_n speedgoat_test_SN5659__cal_impl.Encode1_P9_a2 speedgoat_test_SN5659__cal_impl.Encode2_P10_dc speedgoat_test_SN5659__cal_impl.Encode2_P11_hq speedgoat_test_SN5659__cal_impl.Encode2_P12_ek speedgoat_test_SN5659__cal_impl.Encode2_P13_oo speedgoat_test_SN5659__cal_impl.Encode2_P14_j speedgoat_test_SN5659__cal_impl.Encode2_P15_n speedgoat_test_SN5659__cal_impl.Encode2_P1_o speedgoat_test_SN5659__cal_impl.Encode2_P2_g speedgoat_test_SN5659__cal_impl.Encode2_P3_kx speedgoat_test_SN5659__cal_impl.Encode2_P4_a speedgoat_test_SN5659__cal_impl.Encode2_P5_pz speedgoat_test_SN5659__cal_impl.Encode2_P6_k speedgoat_test_SN5659__cal_impl.Encode2_P7_p speedgoat_test_SN5659__cal_impl.Encode2_P8_ip speedgoat_test_SN5659__cal_impl.Encode2_P9_hv speedgoat_test_SN5659__cal_impl.Encode3_P10_oe speedgoat_test_SN5659__cal_impl.Encode3_P11_a speedgoat_test_SN5659__cal_impl.Encode3_P12_et speedgoat_test_SN5659__cal_impl.Encode3_P13_d speedgoat_test_SN5659__cal_impl.Encode3_P14_p speedgoat_test_SN5659__cal_impl.Encode3_P15_l speedgoat_test_SN5659__cal_impl.Encode3_P1_jy speedgoat_test_SN5659__cal_impl.Encode3_P2_d speedgoat_test_SN5659__cal_impl.Encode3_P3_f speedgoat_test_SN5659__cal_impl.Encode3_P4_mc speedgoat_test_SN5659__cal_impl.Encode3_P5_d0 speedgoat_test_SN5659__cal_impl.Encode3_P6_hf speedgoat_test_SN5659__cal_impl.Encode3_P7_k speedgoat_test_SN5659__cal_impl.Encode3_P8_o speedgoat_test_SN5659__cal_impl.Encode3_P9_cw speedgoat_test_SN5659__cal_impl.Encode4_P10_l speedgoat_test_SN5659__cal_impl.Encode4_P11_pl speedgoat_test_SN5659__cal_impl.Encode4_P12_k speedgoat_test_SN5659__cal_impl.Encode4_P13_hn speedgoat_test_SN5659__cal_impl.Encode4_P14_ma speedgoat_test_SN5659__cal_impl.Encode4_P15_iu speedgoat_test_SN5659__cal_impl.Encode4_P1_o speedgoat_test_SN5659__cal_impl.Encode4_P2_pk speedgoat_test_SN5659__cal_impl.Encode4_P3_h5 speedgoat_test_SN5659__cal_impl.Encode4_P4_my speedgoat_test_SN5659__cal_impl.Encode4_P5_pv speedgoat_test_SN5659__cal_impl.Encode4_P6_ed speedgoat_test_SN5659__cal_impl.Encode4_P7_by speedgoat_test_SN5659__cal_impl.Encode4_P8_a speedgoat_test_SN5659__cal_impl.Encode4_P9_a speedgoat_test_SN5659__cal_impl.Randomnumber_Mean_pl speedgoat_test_SN5659__cal_impl.Randomnumber_Seed_e speedgoat_test_SN5659__cal_impl.Randomnumber_StdDev_fs speedgoat_test_SN5659__cal_impl.Sinewave_Amp_ch speedgoat_test_SN5659__cal_impl.Sinewave_Bias_d speedgoat_test_SN5659__cal_impl.Sinewave_Freq_a2 speedgoat_test_SN5659__cal_impl.Sinewave_HCos_h speedgoat_test_SN5659__cal_impl.Sinewave_Hsin_cy speedgoat_test_SN5659__cal_impl.Sinewave_PCos_n speedgoat_test_SN5659__cal_impl.Sinewave_PSin_o /end REF_CHARACTERISTIC
 /begin REF_MEASUREMENT speedgoat_test_SN5659_R2021b_B.DataTypeConversion1_fw speedgoat_test_SN5659_R2021b_B.DataTypeConversion_i speedgoat_test_SN5659_R2021b_B.Encode1_i speedgoat_test_SN5659_R2021b_B.Encode2_ik speedgoat_test_SN5659_R2021b_B.Encode3_dc speedgoat_test_SN5659_R2021b_B.Encode4_cn speedgoat_test_SN5659_R2021b_B.Output_bg speedgoat_test_SN5659_R2021b_B.Randomnumber_d speedgoat_test_SN5659_R2021b_B.Sinewave_ff speedgoat_test_SN5659_R2021b_DW.NextOutput_p speedgoat_test_SN5659_R2021b_DW.RandSeed_n speedgoat_test_SN5659_R2021b_DW.lastCos_jh speedgoat_test_SN5659_R2021b_DW.lastSin_pf speedgoat_test_SN5659_R2021b_DW.systemEnable_jy /end REF_MEASUREMENT
/end GROUP
/begin GROUP speedgoat_test_SN5659_R2021b_IO682_Encode_Channel_7_Counter_Limited "speedgoat_test_SN5659_R2021b/IO682/Encode Channel 7/Counter
Limited"
 /begin SUB_GROUP speedgoat_test_SN5659_R2021b_IO682_Encode_Channel_7_Counter_Limited_Increment_Real_World speedgoat_test_SN5659_R2021b_IO682_Encode_Channel_7_Counter_Limited_Wrap_To_Zero /end SUB_GROUP
 /begin REF_CHARACTERISTIC speedgoat_test_SN5659__cal_impl.Output_InitialCondition_dr /end REF_CHARACTERISTIC
 /begin REF_MEASUREMENT speedgoat_test_SN5659_R2021b_B.FixPtSwitch_a speedgoat_test_SN5659_R2021b_B.Output_bg speedgoat_test_SN5659_R2021b_DW.Output_DSTATE_h /end REF_MEASUREMENT
/end GROUP
/begin GROUP speedgoat_test_SN5659_R2021b_IO682_Encode_Channel_7_Counter_Limited_Increment_Real_World "speedgoat_test_SN5659_R2021b/IO682/Encode Channel 7/Counter
Limited/Increment
Real World" /begin REF_CHARACTERISTIC speedgoat_test_SN5659__cal_impl.FixPtConstant_Value_ie /end REF_CHARACTERISTIC
 /begin REF_MEASUREMENT speedgoat_test_SN5659_R2021b_B.FixPtSum1_he speedgoat_test_SN5659_R2021b_B.Output_bg /end REF_MEASUREMENT
/end GROUP
/begin GROUP speedgoat_test_SN5659_R2021b_IO682_Encode_Channel_7_Counter_Limited_Wrap_To_Zero "speedgoat_test_SN5659_R2021b/IO682/Encode Channel 7/Counter
Limited/Wrap To Zero"
 /begin REF_CHARACTERISTIC speedgoat_test_SN5659__cal_impl.Constant_Value_pl speedgoat_test_SN5659__cal_impl.CounterLimited_uplimit_du /end REF_CHARACTERISTIC
 /begin REF_MEASUREMENT speedgoat_test_SN5659_R2021b_B.FixPtSum1_he speedgoat_test_SN5659_R2021b_B.FixPtSwitch_a /end REF_MEASUREMENT
/end GROUP
/begin GROUP speedgoat_test_SN5659_R2021b_IO682_Encode_Channel_7_Prepare_RAW_value "speedgoat_test_SN5659_R2021b/IO682/Encode Channel 7/Prepare RAW value"
 /begin REF_CHARACTERISTIC speedgoat_test_SN5659__cal_impl.Label_Value_jf speedgoat_test_SN5659__cal_impl.Mask_BitMask_f3 speedgoat_test_SN5659__cal_impl.SDI_Value_k speedgoat_test_SN5659__cal_impl.SSM_Value_g speedgoat_test_SN5659__cal_impl.Scale_Value_e3 speedgoat_test_SN5659__cal_impl.shiftthedoublevalue27bitslef_jj /end REF_CHARACTERISTIC
 /begin REF_MEASUREMENT speedgoat_test_SN5659_R2021b_B.BitwiseOperator_n speedgoat_test_SN5659_R2021b_B.DataTypeConversion1_fw speedgoat_test_SN5659_R2021b_B.DataTypeConversion_cp speedgoat_test_SN5659_R2021b_B.Divide_c speedgoat_test_SN5659_R2021b_B.Mask_b speedgoat_test_SN5659_R2021b_B.Multiply_hz speedgoat_test_SN5659_R2021b_B.ShifttoSDIslot_bb speedgoat_test_SN5659_R2021b_B.ShifttoSSMslot_o /end REF_MEASUREMENT
/end GROUP
/begin GROUP speedgoat_test_SN5659_R2021b_IO682_Encode_Channel_8 "speedgoat_test_SN5659_R2021b/IO682/Encode Channel 8"
 /begin SUB_GROUP speedgoat_test_SN5659_R2021b_IO682_Encode_Channel_8_Counter_Limited speedgoat_test_SN5659_R2021b_IO682_Encode_Channel_8_Prepare_RAW_value /end SUB_GROUP
 /begin REF_CHARACTERISTIC speedgoat_test_SN5659__cal_impl.Constant_Value_b5 speedgoat_test_SN5659__cal_impl.Encode1_P10_pr speedgoat_test_SN5659__cal_impl.Encode1_P11_d speedgoat_test_SN5659__cal_impl.Encode1_P12_a2 speedgoat_test_SN5659__cal_impl.Encode1_P13_g speedgoat_test_SN5659__cal_impl.Encode1_P14_av speedgoat_test_SN5659__cal_impl.Encode1_P15_c speedgoat_test_SN5659__cal_impl.Encode1_P1_d speedgoat_test_SN5659__cal_impl.Encode1_P2_cw speedgoat_test_SN5659__cal_impl.Encode1_P3_hc speedgoat_test_SN5659__cal_impl.Encode1_P4_f speedgoat_test_SN5659__cal_impl.Encode1_P5_p speedgoat_test_SN5659__cal_impl.Encode1_P6_gn speedgoat_test_SN5659__cal_impl.Encode1_P7_h speedgoat_test_SN5659__cal_impl.Encode1_P8_bi speedgoat_test_SN5659__cal_impl.Encode1_P9_i speedgoat_test_SN5659__cal_impl.Encode2_P10_og speedgoat_test_SN5659__cal_impl.Encode2_P11_df speedgoat_test_SN5659__cal_impl.Encode2_P12_l speedgoat_test_SN5659__cal_impl.Encode2_P13_ol speedgoat_test_SN5659__cal_impl.Encode2_P14_dr speedgoat_test_SN5659__cal_impl.Encode2_P15_f speedgoat_test_SN5659__cal_impl.Encode2_P1_i speedgoat_test_SN5659__cal_impl.Encode2_P2_gi speedgoat_test_SN5659__cal_impl.Encode2_P3_oj speedgoat_test_SN5659__cal_impl.Encode2_P4_nt speedgoat_test_SN5659__cal_impl.Encode2_P5_af speedgoat_test_SN5659__cal_impl.Encode2_P6_ny speedgoat_test_SN5659__cal_impl.Encode2_P7_g speedgoat_test_SN5659__cal_impl.Encode2_P8_m speedgoat_test_SN5659__cal_impl.Encode2_P9_f speedgoat_test_SN5659__cal_impl.Encode3_P10_k speedgoat_test_SN5659__cal_impl.Encode3_P11_lg speedgoat_test_SN5659__cal_impl.Encode3_P12_a speedgoat_test_SN5659__cal_impl.Encode3_P13_ov speedgoat_test_SN5659__cal_impl.Encode3_P14_m5 speedgoat_test_SN5659__cal_impl.Encode3_P15_pd speedgoat_test_SN5659__cal_impl.Encode3_P1_d speedgoat_test_SN5659__cal_impl.Encode3_P2_ni speedgoat_test_SN5659__cal_impl.Encode3_P3_e speedgoat_test_SN5659__cal_impl.Encode3_P4_he speedgoat_test_SN5659__cal_impl.Encode3_P5_l speedgoat_test_SN5659__cal_impl.Encode3_P6_o speedgoat_test_SN5659__cal_impl.Encode3_P7_bt speedgoat_test_SN5659__cal_impl.Encode3_P8_n speedgoat_test_SN5659__cal_impl.Encode3_P9_e speedgoat_test_SN5659__cal_impl.Encode4_P10_jg speedgoat_test_SN5659__cal_impl.Encode4_P11_js speedgoat_test_SN5659__cal_impl.Encode4_P12_n speedgoat_test_SN5659__cal_impl.Encode4_P13_k speedgoat_test_SN5659__cal_impl.Encode4_P14_f speedgoat_test_SN5659__cal_impl.Encode4_P15_c speedgoat_test_SN5659__cal_impl.Encode4_P1_hi speedgoat_test_SN5659__cal_impl.Encode4_P2_k speedgoat_test_SN5659__cal_impl.Encode4_P3_k speedgoat_test_SN5659__cal_impl.Encode4_P4_j speedgoat_test_SN5659__cal_impl.Encode4_P5_g speedgoat_test_SN5659__cal_impl.Encode4_P6_g speedgoat_test_SN5659__cal_impl.Encode4_P7_c3 speedgoat_test_SN5659__cal_impl.Encode4_P8_c speedgoat_test_SN5659__cal_impl.Encode4_P9_m speedgoat_test_SN5659__cal_impl.Randomnumber_Mean_pz speedgoat_test_SN5659__cal_impl.Randomnumber_Seed_l speedgoat_test_SN5659__cal_impl.Randomnumber_StdDev_e speedgoat_test_SN5659__cal_impl.Sinewave_Amp_hw speedgoat_test_SN5659__cal_impl.Sinewave_Bias_p speedgoat_test_SN5659__cal_impl.Sinewave_Freq_j speedgoat_test_SN5659__cal_impl.Sinewave_HCos_h2 speedgoat_test_SN5659__cal_impl.Sinewave_Hsin_jl speedgoat_test_SN5659__cal_impl.Sinewave_PCos_l speedgoat_test_SN5659__cal_impl.Sinewave_PSin_b /end REF_CHARACTERISTIC
 /begin REF_MEASUREMENT speedgoat_test_SN5659_R2021b_B.DataTypeConversion1_j speedgoat_test_SN5659_R2021b_B.DataTypeConversion_k speedgoat_test_SN5659_R2021b_B.Encode1_ff speedgoat_test_SN5659_R2021b_B.Encode2_o4 speedgoat_test_SN5659_R2021b_B.Encode3_dp speedgoat_test_SN5659_R2021b_B.Encode4_a speedgoat_test_SN5659_R2021b_B.Output_mw speedgoat_test_SN5659_R2021b_B.Randomnumber_n4 speedgoat_test_SN5659_R2021b_B.Sinewave_m speedgoat_test_SN5659_R2021b_DW.NextOutput_jn speedgoat_test_SN5659_R2021b_DW.RandSeed_l speedgoat_test_SN5659_R2021b_DW.lastCos_ca speedgoat_test_SN5659_R2021b_DW.lastSin_iv speedgoat_test_SN5659_R2021b_DW.systemEnable_gv /end REF_MEASUREMENT
/end GROUP
/begin GROUP speedgoat_test_SN5659_R2021b_IO682_Encode_Channel_8_Counter_Limited "speedgoat_test_SN5659_R2021b/IO682/Encode Channel 8/Counter
Limited"
 /begin SUB_GROUP speedgoat_test_SN5659_R2021b_IO682_Encode_Channel_8_Counter_Limited_Increment_Real_World speedgoat_test_SN5659_R2021b_IO682_Encode_Channel_8_Counter_Limited_Wrap_To_Zero /end SUB_GROUP
 /begin REF_CHARACTERISTIC speedgoat_test_SN5659__cal_impl.Output_InitialCondition_a /end REF_CHARACTERISTIC
 /begin REF_MEASUREMENT speedgoat_test_SN5659_R2021b_B.FixPtSwitch_l0 speedgoat_test_SN5659_R2021b_B.Output_mw speedgoat_test_SN5659_R2021b_DW.Output_DSTATE_m4 /end REF_MEASUREMENT
/end GROUP
/begin GROUP speedgoat_test_SN5659_R2021b_IO682_Encode_Channel_8_Counter_Limited_Increment_Real_World "speedgoat_test_SN5659_R2021b/IO682/Encode Channel 8/Counter
Limited/Increment
Real World" /begin REF_CHARACTERISTIC speedgoat_test_SN5659__cal_impl.FixPtConstant_Value_b /end REF_CHARACTERISTIC
 /begin REF_MEASUREMENT speedgoat_test_SN5659_R2021b_B.FixPtSum1_p speedgoat_test_SN5659_R2021b_B.Output_mw /end REF_MEASUREMENT
/end GROUP
/begin GROUP speedgoat_test_SN5659_R2021b_IO682_Encode_Channel_8_Counter_Limited_Wrap_To_Zero "speedgoat_test_SN5659_R2021b/IO682/Encode Channel 8/Counter
Limited/Wrap To Zero"
 /begin REF_CHARACTERISTIC speedgoat_test_SN5659__cal_impl.Constant_Value_pv speedgoat_test_SN5659__cal_impl.CounterLimited_uplimit_b /end REF_CHARACTERISTIC
 /begin REF_MEASUREMENT speedgoat_test_SN5659_R2021b_B.FixPtSum1_p speedgoat_test_SN5659_R2021b_B.FixPtSwitch_l0 /end REF_MEASUREMENT
/end GROUP
/begin GROUP speedgoat_test_SN5659_R2021b_IO682_Encode_Channel_8_Prepare_RAW_value "speedgoat_test_SN5659_R2021b/IO682/Encode Channel 8/Prepare RAW value"
 /begin REF_CHARACTERISTIC speedgoat_test_SN5659__cal_impl.Label_Value_pn speedgoat_test_SN5659__cal_impl.Mask_BitMask_kz speedgoat_test_SN5659__cal_impl.SDI_Value_im speedgoat_test_SN5659__cal_impl.SSM_Value_p speedgoat_test_SN5659__cal_impl.Scale_Value_kb speedgoat_test_SN5659__cal_impl.shiftthedoublevalue27bitsleft_f /end REF_CHARACTERISTIC
 /begin REF_MEASUREMENT speedgoat_test_SN5659_R2021b_B.BitwiseOperator_b5 speedgoat_test_SN5659_R2021b_B.DataTypeConversion1_j speedgoat_test_SN5659_R2021b_B.DataTypeConversion_is speedgoat_test_SN5659_R2021b_B.Divide_oc speedgoat_test_SN5659_R2021b_B.Mask_aj speedgoat_test_SN5659_R2021b_B.Multiply_kl speedgoat_test_SN5659_R2021b_B.ShifttoSDIslot_f speedgoat_test_SN5659_R2021b_B.ShifttoSSMslot_ea /end REF_MEASUREMENT
/end GROUP
/begin GROUP speedgoat_test_SN5659_R2021b_IO682_Encode_Channel_9 "speedgoat_test_SN5659_R2021b/IO682/Encode Channel 9"
 /begin SUB_GROUP speedgoat_test_SN5659_R2021b_IO682_Encode_Channel_9_Counter_Limited speedgoat_test_SN5659_R2021b_IO682_Encode_Channel_9_Prepare_RAW_value /end SUB_GROUP
 /begin REF_CHARACTERISTIC speedgoat_test_SN5659__cal_impl.Constant_Value_le speedgoat_test_SN5659__cal_impl.Encode1_P10_d speedgoat_test_SN5659__cal_impl.Encode1_P11_i speedgoat_test_SN5659__cal_impl.Encode1_P12_jx speedgoat_test_SN5659__cal_impl.Encode1_P13_gu speedgoat_test_SN5659__cal_impl.Encode1_P14_fz speedgoat_test_SN5659__cal_impl.Encode1_P15_d speedgoat_test_SN5659__cal_impl.Encode1_P1_kw speedgoat_test_SN5659__cal_impl.Encode1_P2_ho speedgoat_test_SN5659__cal_impl.Encode1_P3_lm speedgoat_test_SN5659__cal_impl.Encode1_P4_cs speedgoat_test_SN5659__cal_impl.Encode1_P5_m speedgoat_test_SN5659__cal_impl.Encode1_P6_am speedgoat_test_SN5659__cal_impl.Encode1_P7_b3 speedgoat_test_SN5659__cal_impl.Encode1_P8_j speedgoat_test_SN5659__cal_impl.Encode1_P9_oc speedgoat_test_SN5659__cal_impl.Encode2_P10_dz speedgoat_test_SN5659__cal_impl.Encode2_P11_dm speedgoat_test_SN5659__cal_impl.Encode2_P12_j speedgoat_test_SN5659__cal_impl.Encode2_P13_g speedgoat_test_SN5659__cal_impl.Encode2_P14_hh speedgoat_test_SN5659__cal_impl.Encode2_P15_km speedgoat_test_SN5659__cal_impl.Encode2_P1_bc speedgoat_test_SN5659__cal_impl.Encode2_P2_hl speedgoat_test_SN5659__cal_impl.Encode2_P3_dm speedgoat_test_SN5659__cal_impl.Encode2_P4_ny speedgoat_test_SN5659__cal_impl.Encode2_P5_im speedgoat_test_SN5659__cal_impl.Encode2_P6_g speedgoat_test_SN5659__cal_impl.Encode2_P7_k5 speedgoat_test_SN5659__cal_impl.Encode2_P8_ig speedgoat_test_SN5659__cal_impl.Encode2_P9_g speedgoat_test_SN5659__cal_impl.Encode3_P10_l15 speedgoat_test_SN5659__cal_impl.Encode3_P11_jg speedgoat_test_SN5659__cal_impl.Encode3_P12_n speedgoat_test_SN5659__cal_impl.Encode3_P13_f speedgoat_test_SN5659__cal_impl.Encode3_P14_nc speedgoat_test_SN5659__cal_impl.Encode3_P15_o speedgoat_test_SN5659__cal_impl.Encode3_P1_lu speedgoat_test_SN5659__cal_impl.Encode3_P2_dl speedgoat_test_SN5659__cal_impl.Encode3_P3_k speedgoat_test_SN5659__cal_impl.Encode3_P4_ga speedgoat_test_SN5659__cal_impl.Encode3_P5_j speedgoat_test_SN5659__cal_impl.Encode3_P6_gz speedgoat_test_SN5659__cal_impl.Encode3_P7_dw speedgoat_test_SN5659__cal_impl.Encode3_P8_a speedgoat_test_SN5659__cal_impl.Encode3_P9_lj speedgoat_test_SN5659__cal_impl.Encode5_P10_o speedgoat_test_SN5659__cal_impl.Encode5_P11_g speedgoat_test_SN5659__cal_impl.Encode5_P12_p speedgoat_test_SN5659__cal_impl.Encode5_P13_m speedgoat_test_SN5659__cal_impl.Encode5_P14_k speedgoat_test_SN5659__cal_impl.Encode5_P15_a speedgoat_test_SN5659__cal_impl.Encode5_P1_i speedgoat_test_SN5659__cal_impl.Encode5_P2_b speedgoat_test_SN5659__cal_impl.Encode5_P3_i speedgoat_test_SN5659__cal_impl.Encode5_P4_k speedgoat_test_SN5659__cal_impl.Encode5_P5_o speedgoat_test_SN5659__cal_impl.Encode5_P6_j speedgoat_test_SN5659__cal_impl.Encode5_P7_h speedgoat_test_SN5659__cal_impl.Encode5_P8_i speedgoat_test_SN5659__cal_impl.Encode5_P9_g speedgoat_test_SN5659__cal_impl.Randomnumber_Mean_fb speedgoat_test_SN5659__cal_impl.Randomnumber_Seed_j speedgoat_test_SN5659__cal_impl.Randomnumber_StdDev_oa speedgoat_test_SN5659__cal_impl.Sinewave_Amp_f speedgoat_test_SN5659__cal_impl.Sinewave_Bias_je speedgoat_test_SN5659__cal_impl.Sinewave_Freq_k speedgoat_test_SN5659__cal_impl.Sinewave_HCos_n speedgoat_test_SN5659__cal_impl.Sinewave_Hsin_o2 speedgoat_test_SN5659__cal_impl.Sinewave_PCos_lt speedgoat_test_SN5659__cal_impl.Sinewave_PSin_bm /end REF_CHARACTERISTIC
 /begin REF_MEASUREMENT speedgoat_test_SN5659_R2021b_B.DataTypeConversion1_e speedgoat_test_SN5659_R2021b_B.DataTypeConversion_dw speedgoat_test_SN5659_R2021b_B.Encode1_kq speedgoat_test_SN5659_R2021b_B.Encode2_o3 speedgoat_test_SN5659_R2021b_B.Encode3_h speedgoat_test_SN5659_R2021b_B.Encode5_n speedgoat_test_SN5659_R2021b_B.Output_pd speedgoat_test_SN5659_R2021b_B.Randomnumber_j speedgoat_test_SN5659_R2021b_B.Sinewave_ao speedgoat_test_SN5659_R2021b_DW.NextOutput_b speedgoat_test_SN5659_R2021b_DW.RandSeed_fs speedgoat_test_SN5659_R2021b_DW.lastCos_bf speedgoat_test_SN5659_R2021b_DW.lastSin_fv speedgoat_test_SN5659_R2021b_DW.systemEnable_o1 /end REF_MEASUREMENT
/end GROUP
/begin GROUP speedgoat_test_SN5659_R2021b_IO682_Encode_Channel_9_Counter_Limited "speedgoat_test_SN5659_R2021b/IO682/Encode Channel 9/Counter
Limited"
 /begin SUB_GROUP speedgoat_test_SN5659_R2021b_IO682_Encode_Channel_9_Counter_Limited_Increment_Real_World speedgoat_test_SN5659_R2021b_IO682_Encode_Channel_9_Counter_Limited_Wrap_To_Zero /end SUB_GROUP
 /begin REF_CHARACTERISTIC speedgoat_test_SN5659__cal_impl.Output_InitialCondition_aw /end REF_CHARACTERISTIC
 /begin REF_MEASUREMENT speedgoat_test_SN5659_R2021b_B.FixPtSwitch_m speedgoat_test_SN5659_R2021b_B.Output_pd speedgoat_test_SN5659_R2021b_DW.Output_DSTATE_fw /end REF_MEASUREMENT
/end GROUP
/begin GROUP speedgoat_test_SN5659_R2021b_IO682_Encode_Channel_9_Counter_Limited_Increment_Real_World "speedgoat_test_SN5659_R2021b/IO682/Encode Channel 9/Counter
Limited/Increment
Real World" /begin REF_CHARACTERISTIC speedgoat_test_SN5659__cal_impl.FixPtConstant_Value_jp /end REF_CHARACTERISTIC
 /begin REF_MEASUREMENT speedgoat_test_SN5659_R2021b_B.FixPtSum1_b speedgoat_test_SN5659_R2021b_B.Output_pd /end REF_MEASUREMENT
/end GROUP
/begin GROUP speedgoat_test_SN5659_R2021b_IO682_Encode_Channel_9_Counter_Limited_Wrap_To_Zero "speedgoat_test_SN5659_R2021b/IO682/Encode Channel 9/Counter
Limited/Wrap To Zero"
 /begin REF_CHARACTERISTIC speedgoat_test_SN5659__cal_impl.Constant_Value_b2 speedgoat_test_SN5659__cal_impl.CounterLimited_uplimit_a /end REF_CHARACTERISTIC
 /begin REF_MEASUREMENT speedgoat_test_SN5659_R2021b_B.FixPtSum1_b speedgoat_test_SN5659_R2021b_B.FixPtSwitch_m /end REF_MEASUREMENT
/end GROUP
/begin GROUP speedgoat_test_SN5659_R2021b_IO682_Encode_Channel_9_Prepare_RAW_value "speedgoat_test_SN5659_R2021b/IO682/Encode Channel 9/Prepare RAW value"
 /begin REF_CHARACTERISTIC speedgoat_test_SN5659__cal_impl.Label_Value_kg speedgoat_test_SN5659__cal_impl.Mask_BitMask_cx speedgoat_test_SN5659__cal_impl.SDI_Value_mq speedgoat_test_SN5659__cal_impl.SSM_Value_jt speedgoat_test_SN5659__cal_impl.Scale_Value_n speedgoat_test_SN5659__cal_impl.shiftthedoublevalue27bitslef_hk /end REF_CHARACTERISTIC
 /begin REF_MEASUREMENT speedgoat_test_SN5659_R2021b_B.BitwiseOperator_fl speedgoat_test_SN5659_R2021b_B.DataTypeConversion1_e speedgoat_test_SN5659_R2021b_B.DataTypeConversion_ku speedgoat_test_SN5659_R2021b_B.Divide_os speedgoat_test_SN5659_R2021b_B.Mask_cy speedgoat_test_SN5659_R2021b_B.Multiply_c speedgoat_test_SN5659_R2021b_B.ShifttoSDIslot_fi speedgoat_test_SN5659_R2021b_B.ShifttoSSMslot_hy /end REF_MEASUREMENT
/end GROUP
/begin GROUP speedgoat_test_SN5659_R2021b_IO941_SPDT_64 "speedgoat_test_SN5659_R2021b/IO941-SPDT-64"
 /begin REF_CHARACTERISTIC speedgoat_test_SN5659__cal_impl.PulseGenerator_Amp_g3 speedgoat_test_SN5659__cal_impl.PulseGenerator_Duty_h speedgoat_test_SN5659__cal_impl.PulseGenerator_Period_o speedgoat_test_SN5659__cal_impl.PulseGenerator_PhaseDelay_b speedgoat_test_SN5659__cal_impl.Relays_P1 speedgoat_test_SN5659__cal_impl.Relays_P10 speedgoat_test_SN5659__cal_impl.Relays_P11 speedgoat_test_SN5659__cal_impl.Relays_P12 speedgoat_test_SN5659__cal_impl.Relays_P13 speedgoat_test_SN5659__cal_impl.Relays_P14 speedgoat_test_SN5659__cal_impl.Relays_P15 speedgoat_test_SN5659__cal_impl.Relays_P16 speedgoat_test_SN5659__cal_impl.Relays_P17 speedgoat_test_SN5659__cal_impl.Relays_P2 speedgoat_test_SN5659__cal_impl.Relays_P3 speedgoat_test_SN5659__cal_impl.Relays_P4 speedgoat_test_SN5659__cal_impl.Relays_P5 speedgoat_test_SN5659__cal_impl.Relays_P6 speedgoat_test_SN5659__cal_impl.Relays_P7 speedgoat_test_SN5659__cal_impl.Relays_P8 speedgoat_test_SN5659__cal_impl.Relays_P9 /end REF_CHARACTERISTIC
 /begin REF_MEASUREMENT speedgoat_test_SN5659_R2021b_B.DataTypeConversion_ib speedgoat_test_SN5659_R2021b_B.IO941_CH1 speedgoat_test_SN5659_R2021b_B.IO941_CH2 speedgoat_test_SN5659_R2021b_B.IO941_CH3 speedgoat_test_SN5659_R2021b_B.IO941_CH4 speedgoat_test_SN5659_R2021b_B.IO941_CH5 speedgoat_test_SN5659_R2021b_B.IO941_CH6 speedgoat_test_SN5659_R2021b_B.IO941_CH7 speedgoat_test_SN5659_R2021b_B.IO941_CH8 speedgoat_test_SN5659_R2021b_B.PulseGenerator_p speedgoat_test_SN5659_R2021b_DW.Scope_PWORK_n speedgoat_test_SN5659_R2021b_DW.clockTickCounter_i /end REF_MEASUREMENT
/end GROUP
/end MODULE
/end PROJECT
