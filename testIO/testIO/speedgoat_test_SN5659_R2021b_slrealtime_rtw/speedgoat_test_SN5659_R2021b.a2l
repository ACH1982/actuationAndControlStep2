ASAP2_VERSION 1 71
/begin PROJECT ProjectName "Project Comment Goes Here"
/begin HEADER "Header Comments go here" /end HEADER
/begin MODULE ModuleName "Module Comment Goes Here"
/begin MOD_COMMON "Mod Common Comment Here" BYTE_ORDER MSB_LAST ALIGNMENT_BYTE 1 ALIGNMENT_WORD 2 ALIGNMENT_LONG 4 ALIGNMENT_FLOAT32_IEEE 4 ALIGNMENT_FLOAT64_IEEE 8 ALIGNMENT_INT64 8 /end MOD_COMMON
/begin CHARACTERISTIC speedgoat_test_SN5659__cal_impl.Constant_Value_a "" VALUE 0x008E4D96 Scalar_UWORD 0 speedgoat_test_SN5659_R2021b_CM_uint16 0 65535 /end CHARACTERISTIC
/begin CHARACTERISTIC speedgoat_test_SN5659__cal_impl.Constant_Value_aq "" VALUE 0x008E4DA2 Scalar_UWORD 0 speedgoat_test_SN5659_R2021b_CM_uint16 0 65535 /end CHARACTERISTIC
/begin CHARACTERISTIC speedgoat_test_SN5659__cal_impl.Constant_Value_av "" VALUE 0x008E4DD6 Scalar_UBYTE 0 speedgoat_test_SN5659_R2021b_CM_uint8 0 255 /end CHARACTERISTIC
/begin CHARACTERISTIC speedgoat_test_SN5659__cal_impl.Constant_Value_b "" VALUE 0x008E1A20 Scalar_FLOAT64_IEEE 0 speedgoat_test_SN5659_R2021b_CM_double -1.7E+308 1.7E+308 /end CHARACTERISTIC
/begin CHARACTERISTIC speedgoat_test_SN5659__cal_impl.Constant_Value_d "" VALUE 0x008E0060 Scalar_FLOAT64_IEEE 0 speedgoat_test_SN5659_R2021b_CM_double -1.7E+308 1.7E+308 /end CHARACTERISTIC
/begin CHARACTERISTIC speedgoat_test_SN5659__cal_impl.Constant_Value_ee "" VALUE 0x008E4DD9 Scalar_UBYTE 0 speedgoat_test_SN5659_R2021b_CM_uint8 0 255 /end CHARACTERISTIC
/begin CHARACTERISTIC speedgoat_test_SN5659__cal_impl.Constant_Value_ek "" VALUE 0x008E2090 Scalar_FLOAT64_IEEE 0 speedgoat_test_SN5659_R2021b_CM_double -1.7E+308 1.7E+308 /end CHARACTERISTIC
/begin CHARACTERISTIC speedgoat_test_SN5659__cal_impl.Constant_Value_g "" VALUE 0x008E06D0 Scalar_FLOAT64_IEEE 0 speedgoat_test_SN5659_R2021b_CM_double -1.7E+308 1.7E+308 /end CHARACTERISTIC
/begin CHARACTERISTIC speedgoat_test_SN5659__cal_impl.Constant_Value_j5 "" VALUE 0x008E4DAE Scalar_UWORD 0 speedgoat_test_SN5659_R2021b_CM_uint16 0 65535 /end CHARACTERISTIC
/begin CHARACTERISTIC speedgoat_test_SN5659__cal_impl.Constant_Value_k "" VALUE 0x008E4D9C Scalar_UWORD 0 speedgoat_test_SN5659_R2021b_CM_uint16 0 65535 /end CHARACTERISTIC
/begin CHARACTERISTIC speedgoat_test_SN5659__cal_impl.Constant_Value_l "" VALUE 0x008E0D40 Scalar_FLOAT64_IEEE 0 speedgoat_test_SN5659_R2021b_CM_double -1.7E+308 1.7E+308 /end CHARACTERISTIC
/begin CHARACTERISTIC speedgoat_test_SN5659__cal_impl.Constant_Value_o "" VALUE 0x008E13B0 Scalar_FLOAT64_IEEE 0 speedgoat_test_SN5659_R2021b_CM_double -1.7E+308 1.7E+308 /end CHARACTERISTIC
/begin CHARACTERISTIC speedgoat_test_SN5659__cal_impl.Constant_Value_p "" VALUE 0x008E4DA8 Scalar_UWORD 0 speedgoat_test_SN5659_R2021b_CM_uint16 0 65535 /end CHARACTERISTIC
/begin CHARACTERISTIC speedgoat_test_SN5659__cal_impl.CounterLimited_uplimit_be "" VALUE 0x008D507D Scalar_UBYTE 0 speedgoat_test_SN5659_R2021b_CM_uint8 0 255 /end CHARACTERISTIC
/begin CHARACTERISTIC speedgoat_test_SN5659__cal_impl.CounterLimited_uplimit_c "" VALUE 0x008D5066 Scalar_UWORD 0 speedgoat_test_SN5659_R2021b_CM_uint16 0 65535 /end CHARACTERISTIC
/begin CHARACTERISTIC speedgoat_test_SN5659__cal_impl.CounterLimited_uplimit_cp "" VALUE 0x008D506A Scalar_UWORD 0 speedgoat_test_SN5659_R2021b_CM_uint16 0 65535 /end CHARACTERISTIC
/begin CHARACTERISTIC speedgoat_test_SN5659__cal_impl.CounterLimited_uplimit_e "" VALUE 0x008D506E Scalar_UWORD 0 speedgoat_test_SN5659_R2021b_CM_uint16 0 65535 /end CHARACTERISTIC
/begin CHARACTERISTIC speedgoat_test_SN5659__cal_impl.CounterLimited_uplimit_g "" VALUE 0x008D506C Scalar_UWORD 0 speedgoat_test_SN5659_R2021b_CM_uint16 0 65535 /end CHARACTERISTIC
/begin CHARACTERISTIC speedgoat_test_SN5659__cal_impl.CounterLimited_uplimit_i "" VALUE 0x008D507C Scalar_UBYTE 0 speedgoat_test_SN5659_R2021b_CM_uint8 0 255 /end CHARACTERISTIC
/begin CHARACTERISTIC speedgoat_test_SN5659__cal_impl.CounterLimited_uplimit_n "" VALUE 0x008D5068 Scalar_UWORD 0 speedgoat_test_SN5659_R2021b_CM_uint16 0 65535 /end CHARACTERISTIC
/begin CHARACTERISTIC speedgoat_test_SN5659__cal_impl.Encode1_P10_e "" VALUE 0x008E1010 Scalar_FLOAT64_IEEE 0 speedgoat_test_SN5659_R2021b_CM_double -1.7E+308 1.7E+308 /end CHARACTERISTIC
/begin CHARACTERISTIC speedgoat_test_SN5659__cal_impl.Encode1_P10_f "" VALUE 0x008E1680 Scalar_FLOAT64_IEEE 0 speedgoat_test_SN5659_R2021b_CM_double -1.7E+308 1.7E+308 /end CHARACTERISTIC
/begin CHARACTERISTIC speedgoat_test_SN5659__cal_impl.Encode1_P10_k "" VALUE 0x008E09A0 Scalar_FLOAT64_IEEE 0 speedgoat_test_SN5659_R2021b_CM_double -1.7E+308 1.7E+308 /end CHARACTERISTIC
/begin CHARACTERISTIC speedgoat_test_SN5659__cal_impl.Encode1_P10_l "" VALUE 0x008DFCC0 Scalar_FLOAT64_IEEE 0 speedgoat_test_SN5659_R2021b_CM_double -1.7E+308 1.7E+308 /end CHARACTERISTIC
/begin CHARACTERISTIC speedgoat_test_SN5659__cal_impl.Encode1_P10_l0 "" VALUE 0x008E1CF0 Scalar_FLOAT64_IEEE 0 speedgoat_test_SN5659_R2021b_CM_double -1.7E+308 1.7E+308 /end CHARACTERISTIC
/begin CHARACTERISTIC speedgoat_test_SN5659__cal_impl.Encode1_P10_pc "" VALUE 0x008E0330 Scalar_FLOAT64_IEEE 0 speedgoat_test_SN5659_R2021b_CM_double -1.7E+308 1.7E+308 /end CHARACTERISTIC
/begin CHARACTERISTIC speedgoat_test_SN5659__cal_impl.Encode1_P11_a "" VAL_BLK 0x008E0348 Scalar_FLOAT64_IEEE 0 speedgoat_test_SN5659_R2021b_CM_double -1.7E+308 1.7E+308 MATRIX_DIM 2 1 /end CHARACTERISTIC
/begin CHARACTERISTIC speedgoat_test_SN5659__cal_impl.Encode1_P11_bk "" VAL_BLK 0x008DFCD8 Scalar_FLOAT64_IEEE 0 speedgoat_test_SN5659_R2021b_CM_double -1.7E+308 1.7E+308 MATRIX_DIM 2 1 /end CHARACTERISTIC
/begin CHARACTERISTIC speedgoat_test_SN5659__cal_impl.Encode1_P11_e "" VAL_BLK 0x008E1698 Scalar_FLOAT64_IEEE 0 speedgoat_test_SN5659_R2021b_CM_double -1.7E+308 1.7E+308 MATRIX_DIM 2 1 /end CHARACTERISTIC
/begin CHARACTERISTIC speedgoat_test_SN5659__cal_impl.Encode1_P11_f "" VAL_BLK 0x008E1D08 Scalar_FLOAT64_IEEE 0 speedgoat_test_SN5659_R2021b_CM_double -1.7E+308 1.7E+308 MATRIX_DIM 2 1 /end CHARACTERISTIC
/begin CHARACTERISTIC speedgoat_test_SN5659__cal_impl.Encode1_P11_n "" VAL_BLK 0x008E09B8 Scalar_FLOAT64_IEEE 0 speedgoat_test_SN5659_R2021b_CM_double -1.7E+308 1.7E+308 MATRIX_DIM 2 1 /end CHARACTERISTIC
/begin CHARACTERISTIC speedgoat_test_SN5659__cal_impl.Encode1_P11_o "" VAL_BLK 0x008E1028 Scalar_FLOAT64_IEEE 0 speedgoat_test_SN5659_R2021b_CM_double -1.7E+308 1.7E+308 MATRIX_DIM 2 1 /end CHARACTERISTIC
/begin CHARACTERISTIC speedgoat_test_SN5659__cal_impl.Encode1_P12_a "" VALUE 0x008E1D28 Scalar_FLOAT64_IEEE 0 speedgoat_test_SN5659_R2021b_CM_double -1.7E+308 1.7E+308 /end CHARACTERISTIC
/begin CHARACTERISTIC speedgoat_test_SN5659__cal_impl.Encode1_P12_g "" VALUE 0x008E16B8 Scalar_FLOAT64_IEEE 0 speedgoat_test_SN5659_R2021b_CM_double -1.7E+308 1.7E+308 /end CHARACTERISTIC
/begin CHARACTERISTIC speedgoat_test_SN5659__cal_impl.Encode1_P12_h "" VALUE 0x008E0368 Scalar_FLOAT64_IEEE 0 speedgoat_test_SN5659_R2021b_CM_double -1.7E+308 1.7E+308 /end CHARACTERISTIC
/begin CHARACTERISTIC speedgoat_test_SN5659__cal_impl.Encode1_P12_j "" VALUE 0x008E09D8 Scalar_FLOAT64_IEEE 0 speedgoat_test_SN5659_R2021b_CM_double -1.7E+308 1.7E+308 /end CHARACTERISTIC
/begin CHARACTERISTIC speedgoat_test_SN5659__cal_impl.Encode1_P12_m "" VALUE 0x008E1048 Scalar_FLOAT64_IEEE 0 speedgoat_test_SN5659_R2021b_CM_double -1.7E+308 1.7E+308 /end CHARACTERISTIC
/begin CHARACTERISTIC speedgoat_test_SN5659__cal_impl.Encode1_P12_o "" VALUE 0x008DFCF8 Scalar_FLOAT64_IEEE 0 speedgoat_test_SN5659_R2021b_CM_double -1.7E+308 1.7E+308 /end CHARACTERISTIC
/begin CHARACTERISTIC speedgoat_test_SN5659__cal_impl.Encode1_P13_f "" VALUE 0x008E09F0 Scalar_FLOAT64_IEEE 0 speedgoat_test_SN5659_R2021b_CM_double -1.7E+308 1.7E+308 /end CHARACTERISTIC
/begin CHARACTERISTIC speedgoat_test_SN5659__cal_impl.Encode1_P13_fj "" VALUE 0x008E1060 Scalar_FLOAT64_IEEE 0 speedgoat_test_SN5659_R2021b_CM_double -1.7E+308 1.7E+308 /end CHARACTERISTIC
/begin CHARACTERISTIC speedgoat_test_SN5659__cal_impl.Encode1_P13_k "" VALUE 0x008E16D0 Scalar_FLOAT64_IEEE 0 speedgoat_test_SN5659_R2021b_CM_double -1.7E+308 1.7E+308 /end CHARACTERISTIC
/begin CHARACTERISTIC speedgoat_test_SN5659__cal_impl.Encode1_P13_l "" VALUE 0x008E0380 Scalar_FLOAT64_IEEE 0 speedgoat_test_SN5659_R2021b_CM_double -1.7E+308 1.7E+308 /end CHARACTERISTIC
/begin CHARACTERISTIC speedgoat_test_SN5659__cal_impl.Encode1_P13_n "" VALUE 0x008E1D40 Scalar_FLOAT64_IEEE 0 speedgoat_test_SN5659_R2021b_CM_double -1.7E+308 1.7E+308 /end CHARACTERISTIC
/begin CHARACTERISTIC speedgoat_test_SN5659__cal_impl.Encode1_P13_o "" VALUE 0x008DFD10 Scalar_FLOAT64_IEEE 0 speedgoat_test_SN5659_R2021b_CM_double -1.7E+308 1.7E+308 /end CHARACTERISTIC
/begin CHARACTERISTIC speedgoat_test_SN5659__cal_impl.Encode1_P14_a "" VALUE 0x008E16E8 Scalar_FLOAT64_IEEE 0 speedgoat_test_SN5659_R2021b_CM_double -1.7E+308 1.7E+308 /end CHARACTERISTIC
/begin CHARACTERISTIC speedgoat_test_SN5659__cal_impl.Encode1_P14_c "" VALUE 0x008E0A08 Scalar_FLOAT64_IEEE 0 speedgoat_test_SN5659_R2021b_CM_double -1.7E+308 1.7E+308 /end CHARACTERISTIC
/begin CHARACTERISTIC speedgoat_test_SN5659__cal_impl.Encode1_P14_d "" VALUE 0x008E1078 Scalar_FLOAT64_IEEE 0 speedgoat_test_SN5659_R2021b_CM_double -1.7E+308 1.7E+308 /end CHARACTERISTIC
/begin CHARACTERISTIC speedgoat_test_SN5659__cal_impl.Encode1_P14_e "" VALUE 0x008E0398 Scalar_FLOAT64_IEEE 0 speedgoat_test_SN5659_R2021b_CM_double -1.7E+308 1.7E+308 /end CHARACTERISTIC
/begin CHARACTERISTIC speedgoat_test_SN5659__cal_impl.Encode1_P14_g "" VALUE 0x008DFD28 Scalar_FLOAT64_IEEE 0 speedgoat_test_SN5659_R2021b_CM_double -1.7E+308 1.7E+308 /end CHARACTERISTIC
/begin CHARACTERISTIC speedgoat_test_SN5659__cal_impl.Encode1_P14_on "" VALUE 0x008E1D58 Scalar_FLOAT64_IEEE 0 speedgoat_test_SN5659_R2021b_CM_double -1.7E+308 1.7E+308 /end CHARACTERISTIC
/begin CHARACTERISTIC speedgoat_test_SN5659__cal_impl.Encode1_P15_a "" VALUE 0x008E0A20 Scalar_FLOAT64_IEEE 0 speedgoat_test_SN5659_R2021b_CM_double -1.7E+308 1.7E+308 /end CHARACTERISTIC
/begin CHARACTERISTIC speedgoat_test_SN5659__cal_impl.Encode1_P15_i "" VALUE 0x008E1090 Scalar_FLOAT64_IEEE 0 speedgoat_test_SN5659_R2021b_CM_double -1.7E+308 1.7E+308 /end CHARACTERISTIC
/begin CHARACTERISTIC speedgoat_test_SN5659__cal_impl.Encode1_P15_j "" VALUE 0x008DFD40 Scalar_FLOAT64_IEEE 0 speedgoat_test_SN5659_R2021b_CM_double -1.7E+308 1.7E+308 /end CHARACTERISTIC
/begin CHARACTERISTIC speedgoat_test_SN5659__cal_impl.Encode1_P15_m "" VALUE 0x008E03B0 Scalar_FLOAT64_IEEE 0 speedgoat_test_SN5659_R2021b_CM_double -1.7E+308 1.7E+308 /end CHARACTERISTIC
/begin CHARACTERISTIC speedgoat_test_SN5659__cal_impl.Encode1_P15_p "" VALUE 0x008E1700 Scalar_FLOAT64_IEEE 0 speedgoat_test_SN5659_R2021b_CM_double -1.7E+308 1.7E+308 /end CHARACTERISTIC
/begin CHARACTERISTIC speedgoat_test_SN5659__cal_impl.Encode1_P15_pw "" VALUE 0x008E1D70 Scalar_FLOAT64_IEEE 0 speedgoat_test_SN5659_R2021b_CM_double -1.7E+308 1.7E+308 /end CHARACTERISTIC
/begin CHARACTERISTIC speedgoat_test_SN5659__cal_impl.Encode1_P1_f "" VALUE 0x008E0258 Scalar_FLOAT64_IEEE 0 speedgoat_test_SN5659_R2021b_CM_double -1.7E+308 1.7E+308 /end CHARACTERISTIC
/begin CHARACTERISTIC speedgoat_test_SN5659__cal_impl.Encode1_P1_ft "" VALUE 0x008E15A8 Scalar_FLOAT64_IEEE 0 speedgoat_test_SN5659_R2021b_CM_double -1.7E+308 1.7E+308 /end CHARACTERISTIC
/begin CHARACTERISTIC speedgoat_test_SN5659__cal_impl.Encode1_P1_g "" VALUE 0x008DFBE8 Scalar_FLOAT64_IEEE 0 speedgoat_test_SN5659_R2021b_CM_double -1.7E+308 1.7E+308 /end CHARACTERISTIC
/begin CHARACTERISTIC speedgoat_test_SN5659__cal_impl.Encode1_P1_h "" VALUE 0x008E08C8 Scalar_FLOAT64_IEEE 0 speedgoat_test_SN5659_R2021b_CM_double -1.7E+308 1.7E+308 /end CHARACTERISTIC
/begin CHARACTERISTIC speedgoat_test_SN5659__cal_impl.Encode1_P1_j "" VALUE 0x008E0F38 Scalar_FLOAT64_IEEE 0 speedgoat_test_SN5659_R2021b_CM_double -1.7E+308 1.7E+308 /end CHARACTERISTIC
/begin CHARACTERISTIC speedgoat_test_SN5659__cal_impl.Encode1_P1_m "" VALUE 0x008E1C18 Scalar_FLOAT64_IEEE 0 speedgoat_test_SN5659_R2021b_CM_double -1.7E+308 1.7E+308 /end CHARACTERISTIC
/begin CHARACTERISTIC speedgoat_test_SN5659__cal_impl.Encode1_P2_e "" VALUE 0x008E08E0 Scalar_FLOAT64_IEEE 0 speedgoat_test_SN5659_R2021b_CM_double -1.7E+308 1.7E+308 /end CHARACTERISTIC
/begin CHARACTERISTIC speedgoat_test_SN5659__cal_impl.Encode1_P2_hw "" VALUE 0x008E15C0 Scalar_FLOAT64_IEEE 0 speedgoat_test_SN5659_R2021b_CM_double -1.7E+308 1.7E+308 /end CHARACTERISTIC
/begin CHARACTERISTIC speedgoat_test_SN5659__cal_impl.Encode1_P2_i "" VALUE 0x008E1C30 Scalar_FLOAT64_IEEE 0 speedgoat_test_SN5659_R2021b_CM_double -1.7E+308 1.7E+308 /end CHARACTERISTIC
/begin CHARACTERISTIC speedgoat_test_SN5659__cal_impl.Encode1_P2_n "" VALUE 0x008E0F50 Scalar_FLOAT64_IEEE 0 speedgoat_test_SN5659_R2021b_CM_double -1.7E+308 1.7E+308 /end CHARACTERISTIC
/begin CHARACTERISTIC speedgoat_test_SN5659__cal_impl.Encode1_P2_p "" VALUE 0x008DFC00 Scalar_FLOAT64_IEEE 0 speedgoat_test_SN5659_R2021b_CM_double -1.7E+308 1.7E+308 /end CHARACTERISTIC
/begin CHARACTERISTIC speedgoat_test_SN5659__cal_impl.Encode1_P2_pf "" VALUE 0x008E0270 Scalar_FLOAT64_IEEE 0 speedgoat_test_SN5659_R2021b_CM_double -1.7E+308 1.7E+308 /end CHARACTERISTIC
/begin CHARACTERISTIC speedgoat_test_SN5659__cal_impl.Encode1_P3_e "" VALUE 0x008E1C48 Scalar_FLOAT64_IEEE 0 speedgoat_test_SN5659_R2021b_CM_double -1.7E+308 1.7E+308 /end CHARACTERISTIC
/begin CHARACTERISTIC speedgoat_test_SN5659__cal_impl.Encode1_P3_h "" VALUE 0x008E0288 Scalar_FLOAT64_IEEE 0 speedgoat_test_SN5659_R2021b_CM_double -1.7E+308 1.7E+308 /end CHARACTERISTIC
/begin CHARACTERISTIC speedgoat_test_SN5659__cal_impl.Encode1_P3_hu "" VALUE 0x008E0F68 Scalar_FLOAT64_IEEE 0 speedgoat_test_SN5659_R2021b_CM_double -1.7E+308 1.7E+308 /end CHARACTERISTIC
/begin CHARACTERISTIC speedgoat_test_SN5659__cal_impl.Encode1_P3_i "" VALUE 0x008E08F8 Scalar_FLOAT64_IEEE 0 speedgoat_test_SN5659_R2021b_CM_double -1.7E+308 1.7E+308 /end CHARACTERISTIC
/begin CHARACTERISTIC speedgoat_test_SN5659__cal_impl.Encode1_P3_j "" VALUE 0x008E15D8 Scalar_FLOAT64_IEEE 0 speedgoat_test_SN5659_R2021b_CM_double -1.7E+308 1.7E+308 /end CHARACTERISTIC
/begin CHARACTERISTIC speedgoat_test_SN5659__cal_impl.Encode1_P3_o0 "" VALUE 0x008DFC18 Scalar_FLOAT64_IEEE 0 speedgoat_test_SN5659_R2021b_CM_double -1.7E+308 1.7E+308 /end CHARACTERISTIC
/begin CHARACTERISTIC speedgoat_test_SN5659__cal_impl.Encode1_P4_c "" VALUE 0x008DFC30 Scalar_FLOAT64_IEEE 0 speedgoat_test_SN5659_R2021b_CM_double -1.7E+308 1.7E+308 /end CHARACTERISTIC
/begin CHARACTERISTIC speedgoat_test_SN5659__cal_impl.Encode1_P4_d2 "" VALUE 0x008E1C60 Scalar_FLOAT64_IEEE 0 speedgoat_test_SN5659_R2021b_CM_double -1.7E+308 1.7E+308 /end CHARACTERISTIC
/begin CHARACTERISTIC speedgoat_test_SN5659__cal_impl.Encode1_P4_el "" VALUE 0x008E0910 Scalar_FLOAT64_IEEE 0 speedgoat_test_SN5659_R2021b_CM_double -1.7E+308 1.7E+308 /end CHARACTERISTIC
/begin CHARACTERISTIC speedgoat_test_SN5659__cal_impl.Encode1_P4_g "" VALUE 0x008E15F0 Scalar_FLOAT64_IEEE 0 speedgoat_test_SN5659_R2021b_CM_double -1.7E+308 1.7E+308 /end CHARACTERISTIC
/begin CHARACTERISTIC speedgoat_test_SN5659__cal_impl.Encode1_P4_o "" VALUE 0x008E02A0 Scalar_FLOAT64_IEEE 0 speedgoat_test_SN5659_R2021b_CM_double -1.7E+308 1.7E+308 /end CHARACTERISTIC
/begin CHARACTERISTIC speedgoat_test_SN5659__cal_impl.Encode1_P4_p "" VALUE 0x008E0F80 Scalar_FLOAT64_IEEE 0 speedgoat_test_SN5659_R2021b_CM_double -1.7E+308 1.7E+308 /end CHARACTERISTIC
/begin CHARACTERISTIC speedgoat_test_SN5659__cal_impl.Encode1_P5_e "" VALUE 0x008E0F98 Scalar_FLOAT64_IEEE 0 speedgoat_test_SN5659_R2021b_CM_double -1.7E+308 1.7E+308 /end CHARACTERISTIC
/begin CHARACTERISTIC speedgoat_test_SN5659__cal_impl.Encode1_P5_g "" VALUE 0x008E0928 Scalar_FLOAT64_IEEE 0 speedgoat_test_SN5659_R2021b_CM_double -1.7E+308 1.7E+308 /end CHARACTERISTIC
/begin CHARACTERISTIC speedgoat_test_SN5659__cal_impl.Encode1_P5_h "" VALUE 0x008E1C78 Scalar_FLOAT64_IEEE 0 speedgoat_test_SN5659_R2021b_CM_double -1.7E+308 1.7E+308 /end CHARACTERISTIC
/begin CHARACTERISTIC speedgoat_test_SN5659__cal_impl.Encode1_P5_l "" VALUE 0x008E02B8 Scalar_FLOAT64_IEEE 0 speedgoat_test_SN5659_R2021b_CM_double -1.7E+308 1.7E+308 /end CHARACTERISTIC
/begin CHARACTERISTIC speedgoat_test_SN5659__cal_impl.Encode1_P5_ov "" VALUE 0x008E1608 Scalar_FLOAT64_IEEE 0 speedgoat_test_SN5659_R2021b_CM_double -1.7E+308 1.7E+308 /end CHARACTERISTIC
/begin CHARACTERISTIC speedgoat_test_SN5659__cal_impl.Encode1_P5_oz "" VALUE 0x008DFC48 Scalar_FLOAT64_IEEE 0 speedgoat_test_SN5659_R2021b_CM_double -1.7E+308 1.7E+308 /end CHARACTERISTIC
/begin CHARACTERISTIC speedgoat_test_SN5659__cal_impl.Encode1_P6_a "" VALUE 0x008E0940 Scalar_FLOAT64_IEEE 0 speedgoat_test_SN5659_R2021b_CM_double -1.7E+308 1.7E+308 /end CHARACTERISTIC
/begin CHARACTERISTIC speedgoat_test_SN5659__cal_impl.Encode1_P6_d "" VALUE 0x008E02D0 Scalar_FLOAT64_IEEE 0 speedgoat_test_SN5659_R2021b_CM_double -1.7E+308 1.7E+308 /end CHARACTERISTIC
/begin CHARACTERISTIC speedgoat_test_SN5659__cal_impl.Encode1_P6_i "" VALUE 0x008E1C90 Scalar_FLOAT64_IEEE 0 speedgoat_test_SN5659_R2021b_CM_double -1.7E+308 1.7E+308 /end CHARACTERISTIC
/begin CHARACTERISTIC speedgoat_test_SN5659__cal_impl.Encode1_P6_m "" VALUE 0x008E0FB0 Scalar_FLOAT64_IEEE 0 speedgoat_test_SN5659_R2021b_CM_double -1.7E+308 1.7E+308 /end CHARACTERISTIC
/begin CHARACTERISTIC speedgoat_test_SN5659__cal_impl.Encode1_P6_n5 "" VALUE 0x008DFC60 Scalar_FLOAT64_IEEE 0 speedgoat_test_SN5659_R2021b_CM_double -1.7E+308 1.7E+308 /end CHARACTERISTIC
/begin CHARACTERISTIC speedgoat_test_SN5659__cal_impl.Encode1_P6_pe "" VALUE 0x008E1620 Scalar_FLOAT64_IEEE 0 speedgoat_test_SN5659_R2021b_CM_double -1.7E+308 1.7E+308 /end CHARACTERISTIC
/begin CHARACTERISTIC speedgoat_test_SN5659__cal_impl.Encode1_P7_a "" VALUE 0x008E0958 Scalar_FLOAT64_IEEE 0 speedgoat_test_SN5659_R2021b_CM_double -1.7E+308 1.7E+308 /end CHARACTERISTIC
/begin CHARACTERISTIC speedgoat_test_SN5659__cal_impl.Encode1_P7_b "" VALUE 0x008E02E8 Scalar_FLOAT64_IEEE 0 speedgoat_test_SN5659_R2021b_CM_double -1.7E+308 1.7E+308 /end CHARACTERISTIC
/begin CHARACTERISTIC speedgoat_test_SN5659__cal_impl.Encode1_P7_dz "" VALUE 0x008DFC78 Scalar_FLOAT64_IEEE 0 speedgoat_test_SN5659_R2021b_CM_double -1.7E+308 1.7E+308 /end CHARACTERISTIC
/begin CHARACTERISTIC speedgoat_test_SN5659__cal_impl.Encode1_P7_e "" VALUE 0x008E0FC8 Scalar_FLOAT64_IEEE 0 speedgoat_test_SN5659_R2021b_CM_double -1.7E+308 1.7E+308 /end CHARACTERISTIC
/begin CHARACTERISTIC speedgoat_test_SN5659__cal_impl.Encode1_P7_gj "" VALUE 0x008E1CA8 Scalar_FLOAT64_IEEE 0 speedgoat_test_SN5659_R2021b_CM_double -1.7E+308 1.7E+308 /end CHARACTERISTIC
/begin CHARACTERISTIC speedgoat_test_SN5659__cal_impl.Encode1_P7_m "" VALUE 0x008E1638 Scalar_FLOAT64_IEEE 0 speedgoat_test_SN5659_R2021b_CM_double -1.7E+308 1.7E+308 /end CHARACTERISTIC
/begin CHARACTERISTIC speedgoat_test_SN5659__cal_impl.Encode1_P8_ck "" VALUE 0x008E1650 Scalar_FLOAT64_IEEE 0 speedgoat_test_SN5659_R2021b_CM_double -1.7E+308 1.7E+308 /end CHARACTERISTIC
/begin CHARACTERISTIC speedgoat_test_SN5659__cal_impl.Encode1_P8_ct "" VALUE 0x008E1CC0 Scalar_FLOAT64_IEEE 0 speedgoat_test_SN5659_R2021b_CM_double -1.7E+308 1.7E+308 /end CHARACTERISTIC
/begin CHARACTERISTIC speedgoat_test_SN5659__cal_impl.Encode1_P8_d "" VALUE 0x008DFC90 Scalar_FLOAT64_IEEE 0 speedgoat_test_SN5659_R2021b_CM_double -1.7E+308 1.7E+308 /end CHARACTERISTIC
/begin CHARACTERISTIC speedgoat_test_SN5659__cal_impl.Encode1_P8_dh "" VALUE 0x008E0970 Scalar_FLOAT64_IEEE 0 speedgoat_test_SN5659_R2021b_CM_double -1.7E+308 1.7E+308 /end CHARACTERISTIC
/begin CHARACTERISTIC speedgoat_test_SN5659__cal_impl.Encode1_P8_f "" VALUE 0x008E0300 Scalar_FLOAT64_IEEE 0 speedgoat_test_SN5659_R2021b_CM_double -1.7E+308 1.7E+308 /end CHARACTERISTIC
/begin CHARACTERISTIC speedgoat_test_SN5659__cal_impl.Encode1_P8_fq "" VALUE 0x008E0FE0 Scalar_FLOAT64_IEEE 0 speedgoat_test_SN5659_R2021b_CM_double -1.7E+308 1.7E+308 /end CHARACTERISTIC
/begin CHARACTERISTIC speedgoat_test_SN5659__cal_impl.Encode1_P9_a "" VALUE 0x008DFCA8 Scalar_FLOAT64_IEEE 0 speedgoat_test_SN5659_R2021b_CM_double -1.7E+308 1.7E+308 /end CHARACTERISTIC
/begin CHARACTERISTIC speedgoat_test_SN5659__cal_impl.Encode1_P9_j "" VALUE 0x008E1CD8 Scalar_FLOAT64_IEEE 0 speedgoat_test_SN5659_R2021b_CM_double -1.7E+308 1.7E+308 /end CHARACTERISTIC
/begin CHARACTERISTIC speedgoat_test_SN5659__cal_impl.Encode1_P9_k "" VALUE 0x008E0988 Scalar_FLOAT64_IEEE 0 speedgoat_test_SN5659_R2021b_CM_double -1.7E+308 1.7E+308 /end CHARACTERISTIC
/begin CHARACTERISTIC speedgoat_test_SN5659__cal_impl.Encode1_P9_ng "" VALUE 0x008E0318 Scalar_FLOAT64_IEEE 0 speedgoat_test_SN5659_R2021b_CM_double -1.7E+308 1.7E+308 /end CHARACTERISTIC
/begin CHARACTERISTIC speedgoat_test_SN5659__cal_impl.Encode1_P9_o "" VALUE 0x008E0FF8 Scalar_FLOAT64_IEEE 0 speedgoat_test_SN5659_R2021b_CM_double -1.7E+308 1.7E+308 /end CHARACTERISTIC
/begin CHARACTERISTIC speedgoat_test_SN5659__cal_impl.Encode1_P9_ol "" VALUE 0x008E1668 Scalar_FLOAT64_IEEE 0 speedgoat_test_SN5659_R2021b_CM_double -1.7E+308 1.7E+308 /end CHARACTERISTIC
/begin CHARACTERISTIC speedgoat_test_SN5659__cal_impl.Encode2_P10_a "" VALUE 0x008E04A0 Scalar_FLOAT64_IEEE 0 speedgoat_test_SN5659_R2021b_CM_double -1.7E+308 1.7E+308 /end CHARACTERISTIC
/begin CHARACTERISTIC speedgoat_test_SN5659__cal_impl.Encode2_P10_ab "" VALUE 0x008E0B10 Scalar_FLOAT64_IEEE 0 speedgoat_test_SN5659_R2021b_CM_double -1.7E+308 1.7E+308 /end CHARACTERISTIC
/begin CHARACTERISTIC speedgoat_test_SN5659__cal_impl.Encode2_P10_f "" VALUE 0x008E1E60 Scalar_FLOAT64_IEEE 0 speedgoat_test_SN5659_R2021b_CM_double -1.7E+308 1.7E+308 /end CHARACTERISTIC
/begin CHARACTERISTIC speedgoat_test_SN5659__cal_impl.Encode2_P10_g "" VALUE 0x008E0160 Scalar_FLOAT64_IEEE 0 speedgoat_test_SN5659_R2021b_CM_double -1.7E+308 1.7E+308 /end CHARACTERISTIC
/begin CHARACTERISTIC speedgoat_test_SN5659__cal_impl.Encode2_P10_gm "" VALUE 0x008E17F0 Scalar_FLOAT64_IEEE 0 speedgoat_test_SN5659_R2021b_CM_double -1.7E+308 1.7E+308 /end CHARACTERISTIC
/begin CHARACTERISTIC speedgoat_test_SN5659__cal_impl.Encode2_P10_o "" VALUE 0x008E1180 Scalar_FLOAT64_IEEE 0 speedgoat_test_SN5659_R2021b_CM_double -1.7E+308 1.7E+308 /end CHARACTERISTIC
/begin CHARACTERISTIC speedgoat_test_SN5659__cal_impl.Encode2_P11_d "" VAL_BLK 0x008E1808 Scalar_FLOAT64_IEEE 0 speedgoat_test_SN5659_R2021b_CM_double -1.7E+308 1.7E+308 MATRIX_DIM 2 1 /end CHARACTERISTIC
/begin CHARACTERISTIC speedgoat_test_SN5659__cal_impl.Encode2_P11_e "" VAL_BLK 0x008E1198 Scalar_FLOAT64_IEEE 0 speedgoat_test_SN5659_R2021b_CM_double -1.7E+308 1.7E+308 MATRIX_DIM 2 1 /end CHARACTERISTIC
/begin CHARACTERISTIC speedgoat_test_SN5659__cal_impl.Encode2_P11_ga "" VAL_BLK 0x008E04B8 Scalar_FLOAT64_IEEE 0 speedgoat_test_SN5659_R2021b_CM_double -1.7E+308 1.7E+308 MATRIX_DIM 2 1 /end CHARACTERISTIC
/begin CHARACTERISTIC speedgoat_test_SN5659__cal_impl.Encode2_P11_gc "" VAL_BLK 0x008E0178 Scalar_FLOAT64_IEEE 0 speedgoat_test_SN5659_R2021b_CM_double -1.7E+308 1.7E+308 MATRIX_DIM 2 1 /end CHARACTERISTIC
/begin CHARACTERISTIC speedgoat_test_SN5659__cal_impl.Encode2_P11_k "" VAL_BLK 0x008E0B28 Scalar_FLOAT64_IEEE 0 speedgoat_test_SN5659_R2021b_CM_double -1.7E+308 1.7E+308 MATRIX_DIM 2 1 /end CHARACTERISTIC
/begin CHARACTERISTIC speedgoat_test_SN5659__cal_impl.Encode2_P11_m "" VAL_BLK 0x008E1E78 Scalar_FLOAT64_IEEE 0 speedgoat_test_SN5659_R2021b_CM_double -1.7E+308 1.7E+308 MATRIX_DIM 2 1 /end CHARACTERISTIC
/begin CHARACTERISTIC speedgoat_test_SN5659__cal_impl.Encode2_P12_a "" VALUE 0x008E1828 Scalar_FLOAT64_IEEE 0 speedgoat_test_SN5659_R2021b_CM_double -1.7E+308 1.7E+308 /end CHARACTERISTIC
/begin CHARACTERISTIC speedgoat_test_SN5659__cal_impl.Encode2_P12_d "" VALUE 0x008E0B48 Scalar_FLOAT64_IEEE 0 speedgoat_test_SN5659_R2021b_CM_double -1.7E+308 1.7E+308 /end CHARACTERISTIC
/begin CHARACTERISTIC speedgoat_test_SN5659__cal_impl.Encode2_P12_e "" VALUE 0x008E1E98 Scalar_FLOAT64_IEEE 0 speedgoat_test_SN5659_R2021b_CM_double -1.7E+308 1.7E+308 /end CHARACTERISTIC
/begin CHARACTERISTIC speedgoat_test_SN5659__cal_impl.Encode2_P12_f "" VALUE 0x008E04D8 Scalar_FLOAT64_IEEE 0 speedgoat_test_SN5659_R2021b_CM_double -1.7E+308 1.7E+308 /end CHARACTERISTIC
/begin CHARACTERISTIC speedgoat_test_SN5659__cal_impl.Encode2_P12_fa "" VALUE 0x008E11B8 Scalar_FLOAT64_IEEE 0 speedgoat_test_SN5659_R2021b_CM_double -1.7E+308 1.7E+308 /end CHARACTERISTIC
/begin CHARACTERISTIC speedgoat_test_SN5659__cal_impl.Encode2_P12_me "" VALUE 0x008E0198 Scalar_FLOAT64_IEEE 0 speedgoat_test_SN5659_R2021b_CM_double -1.7E+308 1.7E+308 /end CHARACTERISTIC
/begin CHARACTERISTIC speedgoat_test_SN5659__cal_impl.Encode2_P13_d "" VALUE 0x008E11D0 Scalar_FLOAT64_IEEE 0 speedgoat_test_SN5659_R2021b_CM_double -1.7E+308 1.7E+308 /end CHARACTERISTIC
/begin CHARACTERISTIC speedgoat_test_SN5659__cal_impl.Encode2_P13_e "" VALUE 0x008E01B0 Scalar_FLOAT64_IEEE 0 speedgoat_test_SN5659_R2021b_CM_double -1.7E+308 1.7E+308 /end CHARACTERISTIC
/begin CHARACTERISTIC speedgoat_test_SN5659__cal_impl.Encode2_P13_fx "" VALUE 0x008E1EB0 Scalar_FLOAT64_IEEE 0 speedgoat_test_SN5659_R2021b_CM_double -1.7E+308 1.7E+308 /end CHARACTERISTIC
/begin CHARACTERISTIC speedgoat_test_SN5659__cal_impl.Encode2_P13_fz "" VALUE 0x008E1840 Scalar_FLOAT64_IEEE 0 speedgoat_test_SN5659_R2021b_CM_double -1.7E+308 1.7E+308 /end CHARACTERISTIC
/begin CHARACTERISTIC speedgoat_test_SN5659__cal_impl.Encode2_P13_n "" VALUE 0x008E0B60 Scalar_FLOAT64_IEEE 0 speedgoat_test_SN5659_R2021b_CM_double -1.7E+308 1.7E+308 /end CHARACTERISTIC
/begin CHARACTERISTIC speedgoat_test_SN5659__cal_impl.Encode2_P13_o "" VALUE 0x008E04F0 Scalar_FLOAT64_IEEE 0 speedgoat_test_SN5659_R2021b_CM_double -1.7E+308 1.7E+308 /end CHARACTERISTIC
/begin CHARACTERISTIC speedgoat_test_SN5659__cal_impl.Encode2_P14_b "" VALUE 0x008E01C8 Scalar_FLOAT64_IEEE 0 speedgoat_test_SN5659_R2021b_CM_double -1.7E+308 1.7E+308 /end CHARACTERISTIC
/begin CHARACTERISTIC speedgoat_test_SN5659__cal_impl.Encode2_P14_ck "" VALUE 0x008E11E8 Scalar_FLOAT64_IEEE 0 speedgoat_test_SN5659_R2021b_CM_double -1.7E+308 1.7E+308 /end CHARACTERISTIC
/begin CHARACTERISTIC speedgoat_test_SN5659__cal_impl.Encode2_P14_d "" VALUE 0x008E1EC8 Scalar_FLOAT64_IEEE 0 speedgoat_test_SN5659_R2021b_CM_double -1.7E+308 1.7E+308 /end CHARACTERISTIC
/begin CHARACTERISTIC speedgoat_test_SN5659__cal_impl.Encode2_P14_i "" VALUE 0x008E1858 Scalar_FLOAT64_IEEE 0 speedgoat_test_SN5659_R2021b_CM_double -1.7E+308 1.7E+308 /end CHARACTERISTIC
/begin CHARACTERISTIC speedgoat_test_SN5659__cal_impl.Encode2_P14_n "" VALUE 0x008E0B78 Scalar_FLOAT64_IEEE 0 speedgoat_test_SN5659_R2021b_CM_double -1.7E+308 1.7E+308 /end CHARACTERISTIC
/begin CHARACTERISTIC speedgoat_test_SN5659__cal_impl.Encode2_P14_po "" VALUE 0x008E0508 Scalar_FLOAT64_IEEE 0 speedgoat_test_SN5659_R2021b_CM_double -1.7E+308 1.7E+308 /end CHARACTERISTIC
/begin CHARACTERISTIC speedgoat_test_SN5659__cal_impl.Encode2_P15_ck "" VALUE 0x008E1EE0 Scalar_FLOAT64_IEEE 0 speedgoat_test_SN5659_R2021b_CM_double -1.7E+308 1.7E+308 /end CHARACTERISTIC
/begin CHARACTERISTIC speedgoat_test_SN5659__cal_impl.Encode2_P15_e "" VALUE 0x008E1200 Scalar_FLOAT64_IEEE 0 speedgoat_test_SN5659_R2021b_CM_double -1.7E+308 1.7E+308 /end CHARACTERISTIC
/begin CHARACTERISTIC speedgoat_test_SN5659__cal_impl.Encode2_P15_h "" VALUE 0x008E0520 Scalar_FLOAT64_IEEE 0 speedgoat_test_SN5659_R2021b_CM_double -1.7E+308 1.7E+308 /end CHARACTERISTIC
/begin CHARACTERISTIC speedgoat_test_SN5659__cal_impl.Encode2_P15_js "" VALUE 0x008E0B90 Scalar_FLOAT64_IEEE 0 speedgoat_test_SN5659_R2021b_CM_double -1.7E+308 1.7E+308 /end CHARACTERISTIC
/begin CHARACTERISTIC speedgoat_test_SN5659__cal_impl.Encode2_P15_k "" VALUE 0x008E01E0 Scalar_FLOAT64_IEEE 0 speedgoat_test_SN5659_R2021b_CM_double -1.7E+308 1.7E+308 /end CHARACTERISTIC
/begin CHARACTERISTIC speedgoat_test_SN5659__cal_impl.Encode2_P15_m "" VALUE 0x008E1870 Scalar_FLOAT64_IEEE 0 speedgoat_test_SN5659_R2021b_CM_double -1.7E+308 1.7E+308 /end CHARACTERISTIC
/begin CHARACTERISTIC speedgoat_test_SN5659__cal_impl.Encode2_P1_az "" VALUE 0x008E1D88 Scalar_FLOAT64_IEEE 0 speedgoat_test_SN5659_R2021b_CM_double -1.7E+308 1.7E+308 /end CHARACTERISTIC
/begin CHARACTERISTIC speedgoat_test_SN5659__cal_impl.Encode2_P1_e "" VALUE 0x008E03C8 Scalar_FLOAT64_IEEE 0 speedgoat_test_SN5659_R2021b_CM_double -1.7E+308 1.7E+308 /end CHARACTERISTIC
/begin CHARACTERISTIC speedgoat_test_SN5659__cal_impl.Encode2_P1_g "" VALUE 0x008E10A8 Scalar_FLOAT64_IEEE 0 speedgoat_test_SN5659_R2021b_CM_double -1.7E+308 1.7E+308 /end CHARACTERISTIC
/begin CHARACTERISTIC speedgoat_test_SN5659__cal_impl.Encode2_P1_hz "" VALUE 0x008E1718 Scalar_FLOAT64_IEEE 0 speedgoat_test_SN5659_R2021b_CM_double -1.7E+308 1.7E+308 /end CHARACTERISTIC
/begin CHARACTERISTIC speedgoat_test_SN5659__cal_impl.Encode2_P1_m "" VALUE 0x008E0088 Scalar_FLOAT64_IEEE 0 speedgoat_test_SN5659_R2021b_CM_double -1.7E+308 1.7E+308 /end CHARACTERISTIC
/begin CHARACTERISTIC speedgoat_test_SN5659__cal_impl.Encode2_P1_n "" VALUE 0x008E0A38 Scalar_FLOAT64_IEEE 0 speedgoat_test_SN5659_R2021b_CM_double -1.7E+308 1.7E+308 /end CHARACTERISTIC
/begin CHARACTERISTIC speedgoat_test_SN5659__cal_impl.Encode2_P2_d "" VALUE 0x008E10C0 Scalar_FLOAT64_IEEE 0 speedgoat_test_SN5659_R2021b_CM_double -1.7E+308 1.7E+308 /end CHARACTERISTIC
/begin CHARACTERISTIC speedgoat_test_SN5659__cal_impl.Encode2_P2_f "" VALUE 0x008E00A0 Scalar_FLOAT64_IEEE 0 speedgoat_test_SN5659_R2021b_CM_double -1.7E+308 1.7E+308 /end CHARACTERISTIC
/begin CHARACTERISTIC speedgoat_test_SN5659__cal_impl.Encode2_P2_f0 "" VALUE 0x008E1DA0 Scalar_FLOAT64_IEEE 0 speedgoat_test_SN5659_R2021b_CM_double -1.7E+308 1.7E+308 /end CHARACTERISTIC
/begin CHARACTERISTIC speedgoat_test_SN5659__cal_impl.Encode2_P2_h "" VALUE 0x008E03E0 Scalar_FLOAT64_IEEE 0 speedgoat_test_SN5659_R2021b_CM_double -1.7E+308 1.7E+308 /end CHARACTERISTIC
/begin CHARACTERISTIC speedgoat_test_SN5659__cal_impl.Encode2_P2_kr "" VALUE 0x008E0A50 Scalar_FLOAT64_IEEE 0 speedgoat_test_SN5659_R2021b_CM_double -1.7E+308 1.7E+308 /end CHARACTERISTIC
/begin CHARACTERISTIC speedgoat_test_SN5659__cal_impl.Encode2_P2_mu "" VALUE 0x008E1730 Scalar_FLOAT64_IEEE 0 speedgoat_test_SN5659_R2021b_CM_double -1.7E+308 1.7E+308 /end CHARACTERISTIC
/begin CHARACTERISTIC speedgoat_test_SN5659__cal_impl.Encode2_P3_f "" VALUE 0x008E03F8 Scalar_FLOAT64_IEEE 0 speedgoat_test_SN5659_R2021b_CM_double -1.7E+308 1.7E+308 /end CHARACTERISTIC
/begin CHARACTERISTIC speedgoat_test_SN5659__cal_impl.Encode2_P3_g "" VALUE 0x008E00B8 Scalar_FLOAT64_IEEE 0 speedgoat_test_SN5659_R2021b_CM_double -1.7E+308 1.7E+308 /end CHARACTERISTIC
/begin CHARACTERISTIC speedgoat_test_SN5659__cal_impl.Encode2_P3_i "" VALUE 0x008E10D8 Scalar_FLOAT64_IEEE 0 speedgoat_test_SN5659_R2021b_CM_double -1.7E+308 1.7E+308 /end CHARACTERISTIC
/begin CHARACTERISTIC speedgoat_test_SN5659__cal_impl.Encode2_P3_j "" VALUE 0x008E0A68 Scalar_FLOAT64_IEEE 0 speedgoat_test_SN5659_R2021b_CM_double -1.7E+308 1.7E+308 /end CHARACTERISTIC
/begin CHARACTERISTIC speedgoat_test_SN5659__cal_impl.Encode2_P3_jd "" VALUE 0x008E1748 Scalar_FLOAT64_IEEE 0 speedgoat_test_SN5659_R2021b_CM_double -1.7E+308 1.7E+308 /end CHARACTERISTIC
/begin CHARACTERISTIC speedgoat_test_SN5659__cal_impl.Encode2_P3_o2 "" VALUE 0x008E1DB8 Scalar_FLOAT64_IEEE 0 speedgoat_test_SN5659_R2021b_CM_double -1.7E+308 1.7E+308 /end CHARACTERISTIC
/begin CHARACTERISTIC speedgoat_test_SN5659__cal_impl.Encode2_P4_b "" VALUE 0x008E0410 Scalar_FLOAT64_IEEE 0 speedgoat_test_SN5659_R2021b_CM_double -1.7E+308 1.7E+308 /end CHARACTERISTIC
/begin CHARACTERISTIC speedgoat_test_SN5659__cal_impl.Encode2_P4_g0 "" VALUE 0x008E1760 Scalar_FLOAT64_IEEE 0 speedgoat_test_SN5659_R2021b_CM_double -1.7E+308 1.7E+308 /end CHARACTERISTIC
/begin CHARACTERISTIC speedgoat_test_SN5659__cal_impl.Encode2_P4_h "" VALUE 0x008E1DD0 Scalar_FLOAT64_IEEE 0 speedgoat_test_SN5659_R2021b_CM_double -1.7E+308 1.7E+308 /end CHARACTERISTIC
/begin CHARACTERISTIC speedgoat_test_SN5659__cal_impl.Encode2_P4_l "" VALUE 0x008E10F0 Scalar_FLOAT64_IEEE 0 speedgoat_test_SN5659_R2021b_CM_double -1.7E+308 1.7E+308 /end CHARACTERISTIC
/begin CHARACTERISTIC speedgoat_test_SN5659__cal_impl.Encode2_P4_m "" VALUE 0x008E00D0 Scalar_FLOAT64_IEEE 0 speedgoat_test_SN5659_R2021b_CM_double -1.7E+308 1.7E+308 /end CHARACTERISTIC
/begin CHARACTERISTIC speedgoat_test_SN5659__cal_impl.Encode2_P4_o0 "" VALUE 0x008E0A80 Scalar_FLOAT64_IEEE 0 speedgoat_test_SN5659_R2021b_CM_double -1.7E+308 1.7E+308 /end CHARACTERISTIC
/begin CHARACTERISTIC speedgoat_test_SN5659__cal_impl.Encode2_P5_h "" VALUE 0x008E1778 Scalar_FLOAT64_IEEE 0 speedgoat_test_SN5659_R2021b_CM_double -1.7E+308 1.7E+308 /end CHARACTERISTIC
/begin CHARACTERISTIC speedgoat_test_SN5659__cal_impl.Encode2_P5_i "" VALUE 0x008E1DE8 Scalar_FLOAT64_IEEE 0 speedgoat_test_SN5659_R2021b_CM_double -1.7E+308 1.7E+308 /end CHARACTERISTIC
/begin CHARACTERISTIC speedgoat_test_SN5659__cal_impl.Encode2_P5_j "" VALUE 0x008E00E8 Scalar_FLOAT64_IEEE 0 speedgoat_test_SN5659_R2021b_CM_double -1.7E+308 1.7E+308 /end CHARACTERISTIC
/begin CHARACTERISTIC speedgoat_test_SN5659__cal_impl.Encode2_P5_m "" VALUE 0x008E0A98 Scalar_FLOAT64_IEEE 0 speedgoat_test_SN5659_R2021b_CM_double -1.7E+308 1.7E+308 /end CHARACTERISTIC
/begin CHARACTERISTIC speedgoat_test_SN5659__cal_impl.Encode2_P5_p "" VALUE 0x008E0428 Scalar_FLOAT64_IEEE 0 speedgoat_test_SN5659_R2021b_CM_double -1.7E+308 1.7E+308 /end CHARACTERISTIC
/begin CHARACTERISTIC speedgoat_test_SN5659__cal_impl.Encode2_P5_p4 "" VALUE 0x008E1108 Scalar_FLOAT64_IEEE 0 speedgoat_test_SN5659_R2021b_CM_double -1.7E+308 1.7E+308 /end CHARACTERISTIC
/begin CHARACTERISTIC speedgoat_test_SN5659__cal_impl.Encode2_P6_d "" VALUE 0x008E1120 Scalar_FLOAT64_IEEE 0 speedgoat_test_SN5659_R2021b_CM_double -1.7E+308 1.7E+308 /end CHARACTERISTIC
/begin CHARACTERISTIC speedgoat_test_SN5659__cal_impl.Encode2_P6_d2 "" VALUE 0x008E1790 Scalar_FLOAT64_IEEE 0 speedgoat_test_SN5659_R2021b_CM_double -1.7E+308 1.7E+308 /end CHARACTERISTIC
/begin CHARACTERISTIC speedgoat_test_SN5659__cal_impl.Encode2_P6_i "" VALUE 0x008E0AB0 Scalar_FLOAT64_IEEE 0 speedgoat_test_SN5659_R2021b_CM_double -1.7E+308 1.7E+308 /end CHARACTERISTIC
/begin CHARACTERISTIC speedgoat_test_SN5659__cal_impl.Encode2_P6_l "" VALUE 0x008E0440 Scalar_FLOAT64_IEEE 0 speedgoat_test_SN5659_R2021b_CM_double -1.7E+308 1.7E+308 /end CHARACTERISTIC
/begin CHARACTERISTIC speedgoat_test_SN5659__cal_impl.Encode2_P6_m "" VALUE 0x008E0100 Scalar_FLOAT64_IEEE 0 speedgoat_test_SN5659_R2021b_CM_double -1.7E+308 1.7E+308 /end CHARACTERISTIC
/begin CHARACTERISTIC speedgoat_test_SN5659__cal_impl.Encode2_P6_o "" VALUE 0x008E1E00 Scalar_FLOAT64_IEEE 0 speedgoat_test_SN5659_R2021b_CM_double -1.7E+308 1.7E+308 /end CHARACTERISTIC
/begin CHARACTERISTIC speedgoat_test_SN5659__cal_impl.Encode2_P7_bh "" VALUE 0x008E1138 Scalar_FLOAT64_IEEE 0 speedgoat_test_SN5659_R2021b_CM_double -1.7E+308 1.7E+308 /end CHARACTERISTIC
/begin CHARACTERISTIC speedgoat_test_SN5659__cal_impl.Encode2_P7_i "" VALUE 0x008E17A8 Scalar_FLOAT64_IEEE 0 speedgoat_test_SN5659_R2021b_CM_double -1.7E+308 1.7E+308 /end CHARACTERISTIC
/begin CHARACTERISTIC speedgoat_test_SN5659__cal_impl.Encode2_P7_j "" VALUE 0x008E0118 Scalar_FLOAT64_IEEE 0 speedgoat_test_SN5659_R2021b_CM_double -1.7E+308 1.7E+308 /end CHARACTERISTIC
/begin CHARACTERISTIC speedgoat_test_SN5659__cal_impl.Encode2_P7_jh "" VALUE 0x008E0458 Scalar_FLOAT64_IEEE 0 speedgoat_test_SN5659_R2021b_CM_double -1.7E+308 1.7E+308 /end CHARACTERISTIC
/begin CHARACTERISTIC speedgoat_test_SN5659__cal_impl.Encode2_P7_k "" VALUE 0x008E0AC8 Scalar_FLOAT64_IEEE 0 speedgoat_test_SN5659_R2021b_CM_double -1.7E+308 1.7E+308 /end CHARACTERISTIC
/begin CHARACTERISTIC speedgoat_test_SN5659__cal_impl.Encode2_P7_o "" VALUE 0x008E1E18 Scalar_FLOAT64_IEEE 0 speedgoat_test_SN5659_R2021b_CM_double -1.7E+308 1.7E+308 /end CHARACTERISTIC
/begin CHARACTERISTIC speedgoat_test_SN5659__cal_impl.Encode2_P8_d "" VALUE 0x008E1150 Scalar_FLOAT64_IEEE 0 speedgoat_test_SN5659_R2021b_CM_double -1.7E+308 1.7E+308 /end CHARACTERISTIC
/begin CHARACTERISTIC speedgoat_test_SN5659__cal_impl.Encode2_P8_fs "" VALUE 0x008E1E30 Scalar_FLOAT64_IEEE 0 speedgoat_test_SN5659_R2021b_CM_double -1.7E+308 1.7E+308 /end CHARACTERISTIC
/begin CHARACTERISTIC speedgoat_test_SN5659__cal_impl.Encode2_P8_h3 "" VALUE 0x008E0AE0 Scalar_FLOAT64_IEEE 0 speedgoat_test_SN5659_R2021b_CM_double -1.7E+308 1.7E+308 /end CHARACTERISTIC
/begin CHARACTERISTIC speedgoat_test_SN5659__cal_impl.Encode2_P8_iw "" VALUE 0x008E0130 Scalar_FLOAT64_IEEE 0 speedgoat_test_SN5659_R2021b_CM_double -1.7E+308 1.7E+308 /end CHARACTERISTIC
/begin CHARACTERISTIC speedgoat_test_SN5659__cal_impl.Encode2_P8_j "" VALUE 0x008E17C0 Scalar_FLOAT64_IEEE 0 speedgoat_test_SN5659_R2021b_CM_double -1.7E+308 1.7E+308 /end CHARACTERISTIC
/begin CHARACTERISTIC speedgoat_test_SN5659__cal_impl.Encode2_P8_n "" VALUE 0x008E0470 Scalar_FLOAT64_IEEE 0 speedgoat_test_SN5659_R2021b_CM_double -1.7E+308 1.7E+308 /end CHARACTERISTIC
/begin CHARACTERISTIC speedgoat_test_SN5659__cal_impl.Encode2_P9_a "" VALUE 0x008E0AF8 Scalar_FLOAT64_IEEE 0 speedgoat_test_SN5659_R2021b_CM_double -1.7E+308 1.7E+308 /end CHARACTERISTIC
/begin CHARACTERISTIC speedgoat_test_SN5659__cal_impl.Encode2_P9_c "" VALUE 0x008E1E48 Scalar_FLOAT64_IEEE 0 speedgoat_test_SN5659_R2021b_CM_double -1.7E+308 1.7E+308 /end CHARACTERISTIC
/begin CHARACTERISTIC speedgoat_test_SN5659__cal_impl.Encode2_P9_d "" VALUE 0x008E1168 Scalar_FLOAT64_IEEE 0 speedgoat_test_SN5659_R2021b_CM_double -1.7E+308 1.7E+308 /end CHARACTERISTIC
/begin CHARACTERISTIC speedgoat_test_SN5659__cal_impl.Encode2_P9_h "" VALUE 0x008E0488 Scalar_FLOAT64_IEEE 0 speedgoat_test_SN5659_R2021b_CM_double -1.7E+308 1.7E+308 /end CHARACTERISTIC
/begin CHARACTERISTIC speedgoat_test_SN5659__cal_impl.Encode2_P9_n "" VALUE 0x008E17D8 Scalar_FLOAT64_IEEE 0 speedgoat_test_SN5659_R2021b_CM_double -1.7E+308 1.7E+308 /end CHARACTERISTIC
/begin CHARACTERISTIC speedgoat_test_SN5659__cal_impl.Encode2_P9_pd "" VALUE 0x008E0148 Scalar_FLOAT64_IEEE 0 speedgoat_test_SN5659_R2021b_CM_double -1.7E+308 1.7E+308 /end CHARACTERISTIC
/begin CHARACTERISTIC speedgoat_test_SN5659__cal_impl.Encode3_P10_a "" VALUE 0x008E2008 Scalar_FLOAT64_IEEE 0 speedgoat_test_SN5659_R2021b_CM_double -1.7E+308 1.7E+308 /end CHARACTERISTIC
/begin CHARACTERISTIC speedgoat_test_SN5659__cal_impl.Encode3_P10_l "" VALUE 0x008DFFD8 Scalar_FLOAT64_IEEE 0 speedgoat_test_SN5659_R2021b_CM_double -1.7E+308 1.7E+308 /end CHARACTERISTIC
/begin CHARACTERISTIC speedgoat_test_SN5659__cal_impl.Encode3_P10_l1 "" VALUE 0x008E0648 Scalar_FLOAT64_IEEE 0 speedgoat_test_SN5659_R2021b_CM_double -1.7E+308 1.7E+308 /end CHARACTERISTIC
/begin CHARACTERISTIC speedgoat_test_SN5659__cal_impl.Encode3_P10_lx "" VALUE 0x008E0CB8 Scalar_FLOAT64_IEEE 0 speedgoat_test_SN5659_R2021b_CM_double -1.7E+308 1.7E+308 /end CHARACTERISTIC
/begin CHARACTERISTIC speedgoat_test_SN5659__cal_impl.Encode3_P10_o "" VALUE 0x008E1328 Scalar_FLOAT64_IEEE 0 speedgoat_test_SN5659_R2021b_CM_double -1.7E+308 1.7E+308 /end CHARACTERISTIC
/begin CHARACTERISTIC speedgoat_test_SN5659__cal_impl.Encode3_P10_p "" VALUE 0x008E1998 Scalar_FLOAT64_IEEE 0 speedgoat_test_SN5659_R2021b_CM_double -1.7E+308 1.7E+308 /end CHARACTERISTIC
/begin CHARACTERISTIC speedgoat_test_SN5659__cal_impl.Encode3_P11_c "" VAL_BLK 0x008E0660 Scalar_FLOAT64_IEEE 0 speedgoat_test_SN5659_R2021b_CM_double -1.7E+308 1.7E+308 MATRIX_DIM 2 1 /end CHARACTERISTIC
/begin CHARACTERISTIC speedgoat_test_SN5659__cal_impl.Encode3_P11_f "" VAL_BLK 0x008E2020 Scalar_FLOAT64_IEEE 0 speedgoat_test_SN5659_R2021b_CM_double -1.7E+308 1.7E+308 MATRIX_DIM 2 1 /end CHARACTERISTIC
/begin CHARACTERISTIC speedgoat_test_SN5659__cal_impl.Encode3_P11_h "" VAL_BLK 0x008DFFF0 Scalar_FLOAT64_IEEE 0 speedgoat_test_SN5659_R2021b_CM_double -1.7E+308 1.7E+308 MATRIX_DIM 2 1 /end CHARACTERISTIC
/begin CHARACTERISTIC speedgoat_test_SN5659__cal_impl.Encode3_P11_h0 "" VAL_BLK 0x008E1340 Scalar_FLOAT64_IEEE 0 speedgoat_test_SN5659_R2021b_CM_double -1.7E+308 1.7E+308 MATRIX_DIM 2 1 /end CHARACTERISTIC
/begin CHARACTERISTIC speedgoat_test_SN5659__cal_impl.Encode3_P11_jq "" VAL_BLK 0x008E19B0 Scalar_FLOAT64_IEEE 0 speedgoat_test_SN5659_R2021b_CM_double -1.7E+308 1.7E+308 MATRIX_DIM 2 1 /end CHARACTERISTIC
/begin CHARACTERISTIC speedgoat_test_SN5659__cal_impl.Encode3_P11_m "" VAL_BLK 0x008E0CD0 Scalar_FLOAT64_IEEE 0 speedgoat_test_SN5659_R2021b_CM_double -1.7E+308 1.7E+308 MATRIX_DIM 2 1 /end CHARACTERISTIC
/begin CHARACTERISTIC speedgoat_test_SN5659__cal_impl.Encode3_P12_b3 "" VALUE 0x008E2040 Scalar_FLOAT64_IEEE 0 speedgoat_test_SN5659_R2021b_CM_double -1.7E+308 1.7E+308 /end CHARACTERISTIC
/begin CHARACTERISTIC speedgoat_test_SN5659__cal_impl.Encode3_P12_c "" VALUE 0x008E0010 Scalar_FLOAT64_IEEE 0 speedgoat_test_SN5659_R2021b_CM_double -1.7E+308 1.7E+308 /end CHARACTERISTIC
/begin CHARACTERISTIC speedgoat_test_SN5659__cal_impl.Encode3_P12_d "" VALUE 0x008E19D0 Scalar_FLOAT64_IEEE 0 speedgoat_test_SN5659_R2021b_CM_double -1.7E+308 1.7E+308 /end CHARACTERISTIC
/begin CHARACTERISTIC speedgoat_test_SN5659__cal_impl.Encode3_P12_i "" VALUE 0x008E0CF0 Scalar_FLOAT64_IEEE 0 speedgoat_test_SN5659_R2021b_CM_double -1.7E+308 1.7E+308 /end CHARACTERISTIC
/begin CHARACTERISTIC speedgoat_test_SN5659__cal_impl.Encode3_P12_k "" VALUE 0x008E1360 Scalar_FLOAT64_IEEE 0 speedgoat_test_SN5659_R2021b_CM_double -1.7E+308 1.7E+308 /end CHARACTERISTIC
/begin CHARACTERISTIC speedgoat_test_SN5659__cal_impl.Encode3_P12_p "" VALUE 0x008E0680 Scalar_FLOAT64_IEEE 0 speedgoat_test_SN5659_R2021b_CM_double -1.7E+308 1.7E+308 /end CHARACTERISTIC
/begin CHARACTERISTIC speedgoat_test_SN5659__cal_impl.Encode3_P13_c "" VALUE 0x008E2058 Scalar_FLOAT64_IEEE 0 speedgoat_test_SN5659_R2021b_CM_double -1.7E+308 1.7E+308 /end CHARACTERISTIC
/begin CHARACTERISTIC speedgoat_test_SN5659__cal_impl.Encode3_P13_e "" VALUE 0x008E0028 Scalar_FLOAT64_IEEE 0 speedgoat_test_SN5659_R2021b_CM_double -1.7E+308 1.7E+308 /end CHARACTERISTIC
/begin CHARACTERISTIC speedgoat_test_SN5659__cal_impl.Encode3_P13_h "" VALUE 0x008E19E8 Scalar_FLOAT64_IEEE 0 speedgoat_test_SN5659_R2021b_CM_double -1.7E+308 1.7E+308 /end CHARACTERISTIC
/begin CHARACTERISTIC speedgoat_test_SN5659__cal_impl.Encode3_P13_k "" VALUE 0x008E0D08 Scalar_FLOAT64_IEEE 0 speedgoat_test_SN5659_R2021b_CM_double -1.7E+308 1.7E+308 /end CHARACTERISTIC
/begin CHARACTERISTIC speedgoat_test_SN5659__cal_impl.Encode3_P13_ka "" VALUE 0x008E1378 Scalar_FLOAT64_IEEE 0 speedgoat_test_SN5659_R2021b_CM_double -1.7E+308 1.7E+308 /end CHARACTERISTIC
/begin CHARACTERISTIC speedgoat_test_SN5659__cal_impl.Encode3_P13_p "" VALUE 0x008E0698 Scalar_FLOAT64_IEEE 0 speedgoat_test_SN5659_R2021b_CM_double -1.7E+308 1.7E+308 /end CHARACTERISTIC
/begin CHARACTERISTIC speedgoat_test_SN5659__cal_impl.Encode3_P14_b "" VALUE 0x008E0040 Scalar_FLOAT64_IEEE 0 speedgoat_test_SN5659_R2021b_CM_double -1.7E+308 1.7E+308 /end CHARACTERISTIC
/begin CHARACTERISTIC speedgoat_test_SN5659__cal_impl.Encode3_P14_do "" VALUE 0x008E2070 Scalar_FLOAT64_IEEE 0 speedgoat_test_SN5659_R2021b_CM_double -1.7E+308 1.7E+308 /end CHARACTERISTIC
/begin CHARACTERISTIC speedgoat_test_SN5659__cal_impl.Encode3_P14_f "" VALUE 0x008E06B0 Scalar_FLOAT64_IEEE 0 speedgoat_test_SN5659_R2021b_CM_double -1.7E+308 1.7E+308 /end CHARACTERISTIC
/begin CHARACTERISTIC speedgoat_test_SN5659__cal_impl.Encode3_P14_m "" VALUE 0x008E0D20 Scalar_FLOAT64_IEEE 0 speedgoat_test_SN5659_R2021b_CM_double -1.7E+308 1.7E+308 /end CHARACTERISTIC
/begin CHARACTERISTIC speedgoat_test_SN5659__cal_impl.Encode3_P14_n "" VALUE 0x008E1390 Scalar_FLOAT64_IEEE 0 speedgoat_test_SN5659_R2021b_CM_double -1.7E+308 1.7E+308 /end CHARACTERISTIC
/begin CHARACTERISTIC speedgoat_test_SN5659__cal_impl.Encode3_P14_ny "" VALUE 0x008E1A00 Scalar_FLOAT64_IEEE 0 speedgoat_test_SN5659_R2021b_CM_double -1.7E+308 1.7E+308 /end CHARACTERISTIC
/begin CHARACTERISTIC speedgoat_test_SN5659__cal_impl.Encode3_P15_b "" VALUE 0x008E0D38 Scalar_FLOAT64_IEEE 0 speedgoat_test_SN5659_R2021b_CM_double -1.7E+308 1.7E+308 /end CHARACTERISTIC
/begin CHARACTERISTIC speedgoat_test_SN5659__cal_impl.Encode3_P15_c "" VALUE 0x008E13A8 Scalar_FLOAT64_IEEE 0 speedgoat_test_SN5659_R2021b_CM_double -1.7E+308 1.7E+308 /end CHARACTERISTIC
/begin CHARACTERISTIC speedgoat_test_SN5659__cal_impl.Encode3_P15_g "" VALUE 0x008E1A18 Scalar_FLOAT64_IEEE 0 speedgoat_test_SN5659_R2021b_CM_double -1.7E+308 1.7E+308 /end CHARACTERISTIC
/begin CHARACTERISTIC speedgoat_test_SN5659__cal_impl.Encode3_P15_hl "" VALUE 0x008E06C8 Scalar_FLOAT64_IEEE 0 speedgoat_test_SN5659_R2021b_CM_double -1.7E+308 1.7E+308 /end CHARACTERISTIC
/begin CHARACTERISTIC speedgoat_test_SN5659__cal_impl.Encode3_P15_i "" VALUE 0x008E0058 Scalar_FLOAT64_IEEE 0 speedgoat_test_SN5659_R2021b_CM_double -1.7E+308 1.7E+308 /end CHARACTERISTIC
/begin CHARACTERISTIC speedgoat_test_SN5659__cal_impl.Encode3_P15_pu "" VALUE 0x008E2088 Scalar_FLOAT64_IEEE 0 speedgoat_test_SN5659_R2021b_CM_double -1.7E+308 1.7E+308 /end CHARACTERISTIC
/begin CHARACTERISTIC speedgoat_test_SN5659__cal_impl.Encode3_P1_a "" VALUE 0x008E0570 Scalar_FLOAT64_IEEE 0 speedgoat_test_SN5659_R2021b_CM_double -1.7E+308 1.7E+308 /end CHARACTERISTIC
/begin CHARACTERISTIC speedgoat_test_SN5659__cal_impl.Encode3_P1_i "" VALUE 0x008DFF00 Scalar_FLOAT64_IEEE 0 speedgoat_test_SN5659_R2021b_CM_double -1.7E+308 1.7E+308 /end CHARACTERISTIC
/begin CHARACTERISTIC speedgoat_test_SN5659__cal_impl.Encode3_P1_m "" VALUE 0x008E18C0 Scalar_FLOAT64_IEEE 0 speedgoat_test_SN5659_R2021b_CM_double -1.7E+308 1.7E+308 /end CHARACTERISTIC
/begin CHARACTERISTIC speedgoat_test_SN5659__cal_impl.Encode3_P1_mk "" VALUE 0x008E1F30 Scalar_FLOAT64_IEEE 0 speedgoat_test_SN5659_R2021b_CM_double -1.7E+308 1.7E+308 /end CHARACTERISTIC
/begin CHARACTERISTIC speedgoat_test_SN5659__cal_impl.Encode3_P1_nj "" VALUE 0x008E0BE0 Scalar_FLOAT64_IEEE 0 speedgoat_test_SN5659_R2021b_CM_double -1.7E+308 1.7E+308 /end CHARACTERISTIC
/begin CHARACTERISTIC speedgoat_test_SN5659__cal_impl.Encode3_P1_nj3 "" VALUE 0x008E1250 Scalar_FLOAT64_IEEE 0 speedgoat_test_SN5659_R2021b_CM_double -1.7E+308 1.7E+308 /end CHARACTERISTIC
/begin CHARACTERISTIC speedgoat_test_SN5659__cal_impl.Encode3_P2_a "" VALUE 0x008DFF18 Scalar_FLOAT64_IEEE 0 speedgoat_test_SN5659_R2021b_CM_double -1.7E+308 1.7E+308 /end CHARACTERISTIC
/begin CHARACTERISTIC speedgoat_test_SN5659__cal_impl.Encode3_P2_b "" VALUE 0x008E0588 Scalar_FLOAT64_IEEE 0 speedgoat_test_SN5659_R2021b_CM_double -1.7E+308 1.7E+308 /end CHARACTERISTIC
/begin CHARACTERISTIC speedgoat_test_SN5659__cal_impl.Encode3_P2_h "" VALUE 0x008E1268 Scalar_FLOAT64_IEEE 0 speedgoat_test_SN5659_R2021b_CM_double -1.7E+308 1.7E+308 /end CHARACTERISTIC
/begin CHARACTERISTIC speedgoat_test_SN5659__cal_impl.Encode3_P2_m "" VALUE 0x008E18D8 Scalar_FLOAT64_IEEE 0 speedgoat_test_SN5659_R2021b_CM_double -1.7E+308 1.7E+308 /end CHARACTERISTIC
/begin CHARACTERISTIC speedgoat_test_SN5659__cal_impl.Encode3_P2_n "" VALUE 0x008E0BF8 Scalar_FLOAT64_IEEE 0 speedgoat_test_SN5659_R2021b_CM_double -1.7E+308 1.7E+308 /end CHARACTERISTIC
/begin CHARACTERISTIC speedgoat_test_SN5659__cal_impl.Encode3_P2_o "" VALUE 0x008E1F48 Scalar_FLOAT64_IEEE 0 speedgoat_test_SN5659_R2021b_CM_double -1.7E+308 1.7E+308 /end CHARACTERISTIC
/begin CHARACTERISTIC speedgoat_test_SN5659__cal_impl.Encode3_P3_c "" VALUE 0x008DFF30 Scalar_FLOAT64_IEEE 0 speedgoat_test_SN5659_R2021b_CM_double -1.7E+308 1.7E+308 /end CHARACTERISTIC
/begin CHARACTERISTIC speedgoat_test_SN5659__cal_impl.Encode3_P3_cs "" VALUE 0x008E1F60 Scalar_FLOAT64_IEEE 0 speedgoat_test_SN5659_R2021b_CM_double -1.7E+308 1.7E+308 /end CHARACTERISTIC
/begin CHARACTERISTIC speedgoat_test_SN5659__cal_impl.Encode3_P3_d "" VALUE 0x008E1280 Scalar_FLOAT64_IEEE 0 speedgoat_test_SN5659_R2021b_CM_double -1.7E+308 1.7E+308 /end CHARACTERISTIC
/begin CHARACTERISTIC speedgoat_test_SN5659__cal_impl.Encode3_P3_g "" VALUE 0x008E05A0 Scalar_FLOAT64_IEEE 0 speedgoat_test_SN5659_R2021b_CM_double -1.7E+308 1.7E+308 /end CHARACTERISTIC
/begin CHARACTERISTIC speedgoat_test_SN5659__cal_impl.Encode3_P3_gs "" VALUE 0x008E18F0 Scalar_FLOAT64_IEEE 0 speedgoat_test_SN5659_R2021b_CM_double -1.7E+308 1.7E+308 /end CHARACTERISTIC
/begin CHARACTERISTIC speedgoat_test_SN5659__cal_impl.Encode3_P3_nc "" VALUE 0x008E0C10 Scalar_FLOAT64_IEEE 0 speedgoat_test_SN5659_R2021b_CM_double -1.7E+308 1.7E+308 /end CHARACTERISTIC
/begin CHARACTERISTIC speedgoat_test_SN5659__cal_impl.Encode3_P4_b "" VALUE 0x008E05B8 Scalar_FLOAT64_IEEE 0 speedgoat_test_SN5659_R2021b_CM_double -1.7E+308 1.7E+308 /end CHARACTERISTIC
/begin CHARACTERISTIC speedgoat_test_SN5659__cal_impl.Encode3_P4_dq "" VALUE 0x008E1F78 Scalar_FLOAT64_IEEE 0 speedgoat_test_SN5659_R2021b_CM_double -1.7E+308 1.7E+308 /end CHARACTERISTIC
/begin CHARACTERISTIC speedgoat_test_SN5659__cal_impl.Encode3_P4_dt "" VALUE 0x008E1908 Scalar_FLOAT64_IEEE 0 speedgoat_test_SN5659_R2021b_CM_double -1.7E+308 1.7E+308 /end CHARACTERISTIC
/begin CHARACTERISTIC speedgoat_test_SN5659__cal_impl.Encode3_P4_h "" VALUE 0x008E1298 Scalar_FLOAT64_IEEE 0 speedgoat_test_SN5659_R2021b_CM_double -1.7E+308 1.7E+308 /end CHARACTERISTIC
/begin CHARACTERISTIC speedgoat_test_SN5659__cal_impl.Encode3_P4_ls "" VALUE 0x008DFF48 Scalar_FLOAT64_IEEE 0 speedgoat_test_SN5659_R2021b_CM_double -1.7E+308 1.7E+308 /end CHARACTERISTIC
/begin CHARACTERISTIC speedgoat_test_SN5659__cal_impl.Encode3_P4_m "" VALUE 0x008E0C28 Scalar_FLOAT64_IEEE 0 speedgoat_test_SN5659_R2021b_CM_double -1.7E+308 1.7E+308 /end CHARACTERISTIC
/begin CHARACTERISTIC speedgoat_test_SN5659__cal_impl.Encode3_P5_bo "" VALUE 0x008DFF60 Scalar_FLOAT64_IEEE 0 speedgoat_test_SN5659_R2021b_CM_double -1.7E+308 1.7E+308 /end CHARACTERISTIC
/begin CHARACTERISTIC speedgoat_test_SN5659__cal_impl.Encode3_P5_d "" VALUE 0x008E1920 Scalar_FLOAT64_IEEE 0 speedgoat_test_SN5659_R2021b_CM_double -1.7E+308 1.7E+308 /end CHARACTERISTIC
/begin CHARACTERISTIC speedgoat_test_SN5659__cal_impl.Encode3_P5_f "" VALUE 0x008E12B0 Scalar_FLOAT64_IEEE 0 speedgoat_test_SN5659_R2021b_CM_double -1.7E+308 1.7E+308 /end CHARACTERISTIC
/begin CHARACTERISTIC speedgoat_test_SN5659__cal_impl.Encode3_P5_h "" VALUE 0x008E0C40 Scalar_FLOAT64_IEEE 0 speedgoat_test_SN5659_R2021b_CM_double -1.7E+308 1.7E+308 /end CHARACTERISTIC
/begin CHARACTERISTIC speedgoat_test_SN5659__cal_impl.Encode3_P5_ij "" VALUE 0x008E05D0 Scalar_FLOAT64_IEEE 0 speedgoat_test_SN5659_R2021b_CM_double -1.7E+308 1.7E+308 /end CHARACTERISTIC
/begin CHARACTERISTIC speedgoat_test_SN5659__cal_impl.Encode3_P5_im "" VALUE 0x008E1F90 Scalar_FLOAT64_IEEE 0 speedgoat_test_SN5659_R2021b_CM_double -1.7E+308 1.7E+308 /end CHARACTERISTIC
/begin CHARACTERISTIC speedgoat_test_SN5659__cal_impl.Encode3_P6_a "" VALUE 0x008DFF78 Scalar_FLOAT64_IEEE 0 speedgoat_test_SN5659_R2021b_CM_double -1.7E+308 1.7E+308 /end CHARACTERISTIC
/begin CHARACTERISTIC speedgoat_test_SN5659__cal_impl.Encode3_P6_d "" VALUE 0x008E1FA8 Scalar_FLOAT64_IEEE 0 speedgoat_test_SN5659_R2021b_CM_double -1.7E+308 1.7E+308 /end CHARACTERISTIC
/begin CHARACTERISTIC speedgoat_test_SN5659__cal_impl.Encode3_P6_g "" VALUE 0x008E1938 Scalar_FLOAT64_IEEE 0 speedgoat_test_SN5659_R2021b_CM_double -1.7E+308 1.7E+308 /end CHARACTERISTIC
/begin CHARACTERISTIC speedgoat_test_SN5659__cal_impl.Encode3_P6_i "" VALUE 0x008E0C58 Scalar_FLOAT64_IEEE 0 speedgoat_test_SN5659_R2021b_CM_double -1.7E+308 1.7E+308 /end CHARACTERISTIC
/begin CHARACTERISTIC speedgoat_test_SN5659__cal_impl.Encode3_P6_jb "" VALUE 0x008E05E8 Scalar_FLOAT64_IEEE 0 speedgoat_test_SN5659_R2021b_CM_double -1.7E+308 1.7E+308 /end CHARACTERISTIC
/begin CHARACTERISTIC speedgoat_test_SN5659__cal_impl.Encode3_P6_k "" VALUE 0x008E12C8 Scalar_FLOAT64_IEEE 0 speedgoat_test_SN5659_R2021b_CM_double -1.7E+308 1.7E+308 /end CHARACTERISTIC
/begin CHARACTERISTIC speedgoat_test_SN5659__cal_impl.Encode3_P7_d "" VALUE 0x008DFF90 Scalar_FLOAT64_IEEE 0 speedgoat_test_SN5659_R2021b_CM_double -1.7E+308 1.7E+308 /end CHARACTERISTIC
/begin CHARACTERISTIC speedgoat_test_SN5659__cal_impl.Encode3_P7_f "" VALUE 0x008E0600 Scalar_FLOAT64_IEEE 0 speedgoat_test_SN5659_R2021b_CM_double -1.7E+308 1.7E+308 /end CHARACTERISTIC
/begin CHARACTERISTIC speedgoat_test_SN5659__cal_impl.Encode3_P7_fm "" VALUE 0x008E1950 Scalar_FLOAT64_IEEE 0 speedgoat_test_SN5659_R2021b_CM_double -1.7E+308 1.7E+308 /end CHARACTERISTIC
/begin CHARACTERISTIC speedgoat_test_SN5659__cal_impl.Encode3_P7_fx "" VALUE 0x008E12E0 Scalar_FLOAT64_IEEE 0 speedgoat_test_SN5659_R2021b_CM_double -1.7E+308 1.7E+308 /end CHARACTERISTIC
/begin CHARACTERISTIC speedgoat_test_SN5659__cal_impl.Encode3_P7_i "" VALUE 0x008E0C70 Scalar_FLOAT64_IEEE 0 speedgoat_test_SN5659_R2021b_CM_double -1.7E+308 1.7E+308 /end CHARACTERISTIC
/begin CHARACTERISTIC speedgoat_test_SN5659__cal_impl.Encode3_P7_o "" VALUE 0x008E1FC0 Scalar_FLOAT64_IEEE 0 speedgoat_test_SN5659_R2021b_CM_double -1.7E+308 1.7E+308 /end CHARACTERISTIC
/begin CHARACTERISTIC speedgoat_test_SN5659__cal_impl.Encode3_P8_b "" VALUE 0x008E12F8 Scalar_FLOAT64_IEEE 0 speedgoat_test_SN5659_R2021b_CM_double -1.7E+308 1.7E+308 /end CHARACTERISTIC
/begin CHARACTERISTIC speedgoat_test_SN5659__cal_impl.Encode3_P8_en "" VALUE 0x008E1FD8 Scalar_FLOAT64_IEEE 0 speedgoat_test_SN5659_R2021b_CM_double -1.7E+308 1.7E+308 /end CHARACTERISTIC
/begin CHARACTERISTIC speedgoat_test_SN5659__cal_impl.Encode3_P8_fh "" VALUE 0x008E1968 Scalar_FLOAT64_IEEE 0 speedgoat_test_SN5659_R2021b_CM_double -1.7E+308 1.7E+308 /end CHARACTERISTIC
/begin CHARACTERISTIC speedgoat_test_SN5659__cal_impl.Encode3_P8_k "" VALUE 0x008DFFA8 Scalar_FLOAT64_IEEE 0 speedgoat_test_SN5659_R2021b_CM_double -1.7E+308 1.7E+308 /end CHARACTERISTIC
/begin CHARACTERISTIC speedgoat_test_SN5659__cal_impl.Encode3_P8_l "" VALUE 0x008E0618 Scalar_FLOAT64_IEEE 0 speedgoat_test_SN5659_R2021b_CM_double -1.7E+308 1.7E+308 /end CHARACTERISTIC
/begin CHARACTERISTIC speedgoat_test_SN5659__cal_impl.Encode3_P8_p "" VALUE 0x008E0C88 Scalar_FLOAT64_IEEE 0 speedgoat_test_SN5659_R2021b_CM_double -1.7E+308 1.7E+308 /end CHARACTERISTIC
/begin CHARACTERISTIC speedgoat_test_SN5659__cal_impl.Encode3_P9_b5 "" VALUE 0x008DFFC0 Scalar_FLOAT64_IEEE 0 speedgoat_test_SN5659_R2021b_CM_double -1.7E+308 1.7E+308 /end CHARACTERISTIC
/begin CHARACTERISTIC speedgoat_test_SN5659__cal_impl.Encode3_P9_bx "" VALUE 0x008E1310 Scalar_FLOAT64_IEEE 0 speedgoat_test_SN5659_R2021b_CM_double -1.7E+308 1.7E+308 /end CHARACTERISTIC
/begin CHARACTERISTIC speedgoat_test_SN5659__cal_impl.Encode3_P9_c "" VALUE 0x008E0630 Scalar_FLOAT64_IEEE 0 speedgoat_test_SN5659_R2021b_CM_double -1.7E+308 1.7E+308 /end CHARACTERISTIC
/begin CHARACTERISTIC speedgoat_test_SN5659__cal_impl.Encode3_P9_m "" VALUE 0x008E1FF0 Scalar_FLOAT64_IEEE 0 speedgoat_test_SN5659_R2021b_CM_double -1.7E+308 1.7E+308 /end CHARACTERISTIC
/begin CHARACTERISTIC speedgoat_test_SN5659__cal_impl.Encode3_P9_n "" VALUE 0x008E1980 Scalar_FLOAT64_IEEE 0 speedgoat_test_SN5659_R2021b_CM_double -1.7E+308 1.7E+308 /end CHARACTERISTIC
/begin CHARACTERISTIC speedgoat_test_SN5659__cal_impl.Encode3_P9_p "" VALUE 0x008E0CA0 Scalar_FLOAT64_IEEE 0 speedgoat_test_SN5659_R2021b_CM_double -1.7E+308 1.7E+308 /end CHARACTERISTIC
/begin CHARACTERISTIC speedgoat_test_SN5659__cal_impl.Encode4_P10_b "" VALUE 0x008E2190 Scalar_FLOAT64_IEEE 0 speedgoat_test_SN5659_R2021b_CM_double -1.7E+308 1.7E+308 /end CHARACTERISTIC
/begin CHARACTERISTIC speedgoat_test_SN5659__cal_impl.Encode4_P10_j "" VALUE 0x008E14B0 Scalar_FLOAT64_IEEE 0 speedgoat_test_SN5659_R2021b_CM_double -1.7E+308 1.7E+308 /end CHARACTERISTIC
/begin CHARACTERISTIC speedgoat_test_SN5659__cal_impl.Encode4_P10_k "" VALUE 0x008E0E40 Scalar_FLOAT64_IEEE 0 speedgoat_test_SN5659_R2021b_CM_double -1.7E+308 1.7E+308 /end CHARACTERISTIC
/begin CHARACTERISTIC speedgoat_test_SN5659__cal_impl.Encode4_P10_o2 "" VALUE 0x008E07D0 Scalar_FLOAT64_IEEE 0 speedgoat_test_SN5659_R2021b_CM_double -1.7E+308 1.7E+308 /end CHARACTERISTIC
/begin CHARACTERISTIC speedgoat_test_SN5659__cal_impl.Encode4_P10_o4 "" VALUE 0x008E1B20 Scalar_FLOAT64_IEEE 0 speedgoat_test_SN5659_R2021b_CM_double -1.7E+308 1.7E+308 /end CHARACTERISTIC
/begin CHARACTERISTIC speedgoat_test_SN5659__cal_impl.Encode4_P11_c "" VAL_BLK 0x008E1B38 Scalar_FLOAT64_IEEE 0 speedgoat_test_SN5659_R2021b_CM_double -1.7E+308 1.7E+308 MATRIX_DIM 2 1 /end CHARACTERISTIC
/begin CHARACTERISTIC speedgoat_test_SN5659__cal_impl.Encode4_P11_e "" VAL_BLK 0x008E14C8 Scalar_FLOAT64_IEEE 0 speedgoat_test_SN5659_R2021b_CM_double -1.7E+308 1.7E+308 MATRIX_DIM 2 1 /end CHARACTERISTIC
/begin CHARACTERISTIC speedgoat_test_SN5659__cal_impl.Encode4_P11_jr "" VAL_BLK 0x008E21A8 Scalar_FLOAT64_IEEE 0 speedgoat_test_SN5659_R2021b_CM_double -1.7E+308 1.7E+308 MATRIX_DIM 2 1 /end CHARACTERISTIC
/begin CHARACTERISTIC speedgoat_test_SN5659__cal_impl.Encode4_P11_p "" VAL_BLK 0x008E07E8 Scalar_FLOAT64_IEEE 0 speedgoat_test_SN5659_R2021b_CM_double -1.7E+308 1.7E+308 MATRIX_DIM 2 1 /end CHARACTERISTIC
/begin CHARACTERISTIC speedgoat_test_SN5659__cal_impl.Encode4_P11_pb "" VAL_BLK 0x008E0E58 Scalar_FLOAT64_IEEE 0 speedgoat_test_SN5659_R2021b_CM_double -1.7E+308 1.7E+308 MATRIX_DIM 2 1 /end CHARACTERISTIC
/begin CHARACTERISTIC speedgoat_test_SN5659__cal_impl.Encode4_P12_e "" VALUE 0x008E0E78 Scalar_FLOAT64_IEEE 0 speedgoat_test_SN5659_R2021b_CM_double -1.7E+308 1.7E+308 /end CHARACTERISTIC
/begin CHARACTERISTIC speedgoat_test_SN5659__cal_impl.Encode4_P12_g "" VALUE 0x008E21C8 Scalar_FLOAT64_IEEE 0 speedgoat_test_SN5659_R2021b_CM_double -1.7E+308 1.7E+308 /end CHARACTERISTIC
/begin CHARACTERISTIC speedgoat_test_SN5659__cal_impl.Encode4_P12_h "" VALUE 0x008E0808 Scalar_FLOAT64_IEEE 0 speedgoat_test_SN5659_R2021b_CM_double -1.7E+308 1.7E+308 /end CHARACTERISTIC
/begin CHARACTERISTIC speedgoat_test_SN5659__cal_impl.Encode4_P12_lr "" VALUE 0x008E1B58 Scalar_FLOAT64_IEEE 0 speedgoat_test_SN5659_R2021b_CM_double -1.7E+308 1.7E+308 /end CHARACTERISTIC
/begin CHARACTERISTIC speedgoat_test_SN5659__cal_impl.Encode4_P12_o "" VALUE 0x008E14E8 Scalar_FLOAT64_IEEE 0 speedgoat_test_SN5659_R2021b_CM_double -1.7E+308 1.7E+308 /end CHARACTERISTIC
/begin CHARACTERISTIC speedgoat_test_SN5659__cal_impl.Encode4_P13_d "" VALUE 0x008E21E0 Scalar_FLOAT64_IEEE 0 speedgoat_test_SN5659_R2021b_CM_double -1.7E+308 1.7E+308 /end CHARACTERISTIC
/begin CHARACTERISTIC speedgoat_test_SN5659__cal_impl.Encode4_P13_h "" VALUE 0x008E1500 Scalar_FLOAT64_IEEE 0 speedgoat_test_SN5659_R2021b_CM_double -1.7E+308 1.7E+308 /end CHARACTERISTIC
/begin CHARACTERISTIC speedgoat_test_SN5659__cal_impl.Encode4_P13_m "" VALUE 0x008E1B70 Scalar_FLOAT64_IEEE 0 speedgoat_test_SN5659_R2021b_CM_double -1.7E+308 1.7E+308 /end CHARACTERISTIC
/begin CHARACTERISTIC speedgoat_test_SN5659__cal_impl.Encode4_P13_o "" VALUE 0x008E0820 Scalar_FLOAT64_IEEE 0 speedgoat_test_SN5659_R2021b_CM_double -1.7E+308 1.7E+308 /end CHARACTERISTIC
/begin CHARACTERISTIC speedgoat_test_SN5659__cal_impl.Encode4_P13_p "" VALUE 0x008E0E90 Scalar_FLOAT64_IEEE 0 speedgoat_test_SN5659_R2021b_CM_double -1.7E+308 1.7E+308 /end CHARACTERISTIC
/begin CHARACTERISTIC speedgoat_test_SN5659__cal_impl.Encode4_P14_b "" VALUE 0x008E0EA8 Scalar_FLOAT64_IEEE 0 speedgoat_test_SN5659_R2021b_CM_double -1.7E+308 1.7E+308 /end CHARACTERISTIC
/begin CHARACTERISTIC speedgoat_test_SN5659__cal_impl.Encode4_P14_g "" VALUE 0x008E21F8 Scalar_FLOAT64_IEEE 0 speedgoat_test_SN5659_R2021b_CM_double -1.7E+308 1.7E+308 /end CHARACTERISTIC
/begin CHARACTERISTIC speedgoat_test_SN5659__cal_impl.Encode4_P14_lr "" VALUE 0x008E0838 Scalar_FLOAT64_IEEE 0 speedgoat_test_SN5659_R2021b_CM_double -1.7E+308 1.7E+308 /end CHARACTERISTIC
/begin CHARACTERISTIC speedgoat_test_SN5659__cal_impl.Encode4_P14_m "" VALUE 0x008E1518 Scalar_FLOAT64_IEEE 0 speedgoat_test_SN5659_R2021b_CM_double -1.7E+308 1.7E+308 /end CHARACTERISTIC
/begin CHARACTERISTIC speedgoat_test_SN5659__cal_impl.Encode4_P14_mx "" VALUE 0x008E1B88 Scalar_FLOAT64_IEEE 0 speedgoat_test_SN5659_R2021b_CM_double -1.7E+308 1.7E+308 /end CHARACTERISTIC
/begin CHARACTERISTIC speedgoat_test_SN5659__cal_impl.Encode4_P15_a "" VALUE 0x008E0850 Scalar_FLOAT64_IEEE 0 speedgoat_test_SN5659_R2021b_CM_double -1.7E+308 1.7E+308 /end CHARACTERISTIC
/begin CHARACTERISTIC speedgoat_test_SN5659__cal_impl.Encode4_P15_f "" VALUE 0x008E1530 Scalar_FLOAT64_IEEE 0 speedgoat_test_SN5659_R2021b_CM_double -1.7E+308 1.7E+308 /end CHARACTERISTIC
/begin CHARACTERISTIC speedgoat_test_SN5659__cal_impl.Encode4_P15_h "" VALUE 0x008E2210 Scalar_FLOAT64_IEEE 0 speedgoat_test_SN5659_R2021b_CM_double -1.7E+308 1.7E+308 /end CHARACTERISTIC
/begin CHARACTERISTIC speedgoat_test_SN5659__cal_impl.Encode4_P15_k "" VALUE 0x008E1BA0 Scalar_FLOAT64_IEEE 0 speedgoat_test_SN5659_R2021b_CM_double -1.7E+308 1.7E+308 /end CHARACTERISTIC
/begin CHARACTERISTIC speedgoat_test_SN5659__cal_impl.Encode4_P15_l "" VALUE 0x008E0EC0 Scalar_FLOAT64_IEEE 0 speedgoat_test_SN5659_R2021b_CM_double -1.7E+308 1.7E+308 /end CHARACTERISTIC
/begin CHARACTERISTIC speedgoat_test_SN5659__cal_impl.Encode4_P1_a "" VALUE 0x008E13D8 Scalar_FLOAT64_IEEE 0 speedgoat_test_SN5659_R2021b_CM_double -1.7E+308 1.7E+308 /end CHARACTERISTIC
/begin CHARACTERISTIC speedgoat_test_SN5659__cal_impl.Encode4_P1_fl "" VALUE 0x008E06F8 Scalar_FLOAT64_IEEE 0 speedgoat_test_SN5659_R2021b_CM_double -1.7E+308 1.7E+308 /end CHARACTERISTIC
/begin CHARACTERISTIC speedgoat_test_SN5659__cal_impl.Encode4_P1_g "" VALUE 0x008E1A48 Scalar_FLOAT64_IEEE 0 speedgoat_test_SN5659_R2021b_CM_double -1.7E+308 1.7E+308 /end CHARACTERISTIC
/begin CHARACTERISTIC speedgoat_test_SN5659__cal_impl.Encode4_P1_n "" VALUE 0x008E0D68 Scalar_FLOAT64_IEEE 0 speedgoat_test_SN5659_R2021b_CM_double -1.7E+308 1.7E+308 /end CHARACTERISTIC
/begin CHARACTERISTIC speedgoat_test_SN5659__cal_impl.Encode4_P1_ns "" VALUE 0x008E20B8 Scalar_FLOAT64_IEEE 0 speedgoat_test_SN5659_R2021b_CM_double -1.7E+308 1.7E+308 /end CHARACTERISTIC
/begin CHARACTERISTIC speedgoat_test_SN5659__cal_impl.Encode4_P2_dd "" VALUE 0x008E0D80 Scalar_FLOAT64_IEEE 0 speedgoat_test_SN5659_R2021b_CM_double -1.7E+308 1.7E+308 /end CHARACTERISTIC
/begin CHARACTERISTIC speedgoat_test_SN5659__cal_impl.Encode4_P2_f "" VALUE 0x008E0710 Scalar_FLOAT64_IEEE 0 speedgoat_test_SN5659_R2021b_CM_double -1.7E+308 1.7E+308 /end CHARACTERISTIC
/begin CHARACTERISTIC speedgoat_test_SN5659__cal_impl.Encode4_P2_g "" VALUE 0x008E20D0 Scalar_FLOAT64_IEEE 0 speedgoat_test_SN5659_R2021b_CM_double -1.7E+308 1.7E+308 /end CHARACTERISTIC
/begin CHARACTERISTIC speedgoat_test_SN5659__cal_impl.Encode4_P2_h "" VALUE 0x008E1A60 Scalar_FLOAT64_IEEE 0 speedgoat_test_SN5659_R2021b_CM_double -1.7E+308 1.7E+308 /end CHARACTERISTIC
/begin CHARACTERISTIC speedgoat_test_SN5659__cal_impl.Encode4_P2_p "" VALUE 0x008E13F0 Scalar_FLOAT64_IEEE 0 speedgoat_test_SN5659_R2021b_CM_double -1.7E+308 1.7E+308 /end CHARACTERISTIC
/begin CHARACTERISTIC speedgoat_test_SN5659__cal_impl.Encode4_P3_a "" VALUE 0x008E1408 Scalar_FLOAT64_IEEE 0 speedgoat_test_SN5659_R2021b_CM_double -1.7E+308 1.7E+308 /end CHARACTERISTIC
/begin CHARACTERISTIC speedgoat_test_SN5659__cal_impl.Encode4_P3_b "" VALUE 0x008E0D98 Scalar_FLOAT64_IEEE 0 speedgoat_test_SN5659_R2021b_CM_double -1.7E+308 1.7E+308 /end CHARACTERISTIC
/begin CHARACTERISTIC speedgoat_test_SN5659__cal_impl.Encode4_P3_h "" VALUE 0x008E0728 Scalar_FLOAT64_IEEE 0 speedgoat_test_SN5659_R2021b_CM_double -1.7E+308 1.7E+308 /end CHARACTERISTIC
/begin CHARACTERISTIC speedgoat_test_SN5659__cal_impl.Encode4_P3_m "" VALUE 0x008E1A78 Scalar_FLOAT64_IEEE 0 speedgoat_test_SN5659_R2021b_CM_double -1.7E+308 1.7E+308 /end CHARACTERISTIC
/begin CHARACTERISTIC speedgoat_test_SN5659__cal_impl.Encode4_P3_n "" VALUE 0x008E20E8 Scalar_FLOAT64_IEEE 0 speedgoat_test_SN5659_R2021b_CM_double -1.7E+308 1.7E+308 /end CHARACTERISTIC
/begin CHARACTERISTIC speedgoat_test_SN5659__cal_impl.Encode4_P4_b "" VALUE 0x008E0740 Scalar_FLOAT64_IEEE 0 speedgoat_test_SN5659_R2021b_CM_double -1.7E+308 1.7E+308 /end CHARACTERISTIC
/begin CHARACTERISTIC speedgoat_test_SN5659__cal_impl.Encode4_P4_h "" VALUE 0x008E0DB0 Scalar_FLOAT64_IEEE 0 speedgoat_test_SN5659_R2021b_CM_double -1.7E+308 1.7E+308 /end CHARACTERISTIC
/begin CHARACTERISTIC speedgoat_test_SN5659__cal_impl.Encode4_P4_i "" VALUE 0x008E1A90 Scalar_FLOAT64_IEEE 0 speedgoat_test_SN5659_R2021b_CM_double -1.7E+308 1.7E+308 /end CHARACTERISTIC
/begin CHARACTERISTIC speedgoat_test_SN5659__cal_impl.Encode4_P4_l "" VALUE 0x008E1420 Scalar_FLOAT64_IEEE 0 speedgoat_test_SN5659_R2021b_CM_double -1.7E+308 1.7E+308 /end CHARACTERISTIC
/begin CHARACTERISTIC speedgoat_test_SN5659__cal_impl.Encode4_P4_m "" VALUE 0x008E2100 Scalar_FLOAT64_IEEE 0 speedgoat_test_SN5659_R2021b_CM_double -1.7E+308 1.7E+308 /end CHARACTERISTIC
/begin CHARACTERISTIC speedgoat_test_SN5659__cal_impl.Encode4_P5_i "" VALUE 0x008E1438 Scalar_FLOAT64_IEEE 0 speedgoat_test_SN5659_R2021b_CM_double -1.7E+308 1.7E+308 /end CHARACTERISTIC
/begin CHARACTERISTIC speedgoat_test_SN5659__cal_impl.Encode4_P5_j "" VALUE 0x008E1AA8 Scalar_FLOAT64_IEEE 0 speedgoat_test_SN5659_R2021b_CM_double -1.7E+308 1.7E+308 /end CHARACTERISTIC
/begin CHARACTERISTIC speedgoat_test_SN5659__cal_impl.Encode4_P5_k "" VALUE 0x008E2118 Scalar_FLOAT64_IEEE 0 speedgoat_test_SN5659_R2021b_CM_double -1.7E+308 1.7E+308 /end CHARACTERISTIC
/begin CHARACTERISTIC speedgoat_test_SN5659__cal_impl.Encode4_P5_l "" VALUE 0x008E0DC8 Scalar_FLOAT64_IEEE 0 speedgoat_test_SN5659_R2021b_CM_double -1.7E+308 1.7E+308 /end CHARACTERISTIC
/begin CHARACTERISTIC speedgoat_test_SN5659__cal_impl.Encode4_P5_o "" VALUE 0x008E0758 Scalar_FLOAT64_IEEE 0 speedgoat_test_SN5659_R2021b_CM_double -1.7E+308 1.7E+308 /end CHARACTERISTIC
/begin CHARACTERISTIC speedgoat_test_SN5659__cal_impl.Encode4_P6_d "" VALUE 0x008E1450 Scalar_FLOAT64_IEEE 0 speedgoat_test_SN5659_R2021b_CM_double -1.7E+308 1.7E+308 /end CHARACTERISTIC
/begin CHARACTERISTIC speedgoat_test_SN5659__cal_impl.Encode4_P6_e "" VALUE 0x008E2130 Scalar_FLOAT64_IEEE 0 speedgoat_test_SN5659_R2021b_CM_double -1.7E+308 1.7E+308 /end CHARACTERISTIC
/begin CHARACTERISTIC speedgoat_test_SN5659__cal_impl.Encode4_P6_kc "" VALUE 0x008E0770 Scalar_FLOAT64_IEEE 0 speedgoat_test_SN5659_R2021b_CM_double -1.7E+308 1.7E+308 /end CHARACTERISTIC
/begin CHARACTERISTIC speedgoat_test_SN5659__cal_impl.Encode4_P6_l "" VALUE 0x008E0DE0 Scalar_FLOAT64_IEEE 0 speedgoat_test_SN5659_R2021b_CM_double -1.7E+308 1.7E+308 /end CHARACTERISTIC
/begin CHARACTERISTIC speedgoat_test_SN5659__cal_impl.Encode4_P6_n "" VALUE 0x008E1AC0 Scalar_FLOAT64_IEEE 0 speedgoat_test_SN5659_R2021b_CM_double -1.7E+308 1.7E+308 /end CHARACTERISTIC
/begin CHARACTERISTIC speedgoat_test_SN5659__cal_impl.Encode4_P7_b "" VALUE 0x008E1468 Scalar_FLOAT64_IEEE 0 speedgoat_test_SN5659_R2021b_CM_double -1.7E+308 1.7E+308 /end CHARACTERISTIC
/begin CHARACTERISTIC speedgoat_test_SN5659__cal_impl.Encode4_P7_d "" VALUE 0x008E0788 Scalar_FLOAT64_IEEE 0 speedgoat_test_SN5659_R2021b_CM_double -1.7E+308 1.7E+308 /end CHARACTERISTIC
/begin CHARACTERISTIC speedgoat_test_SN5659__cal_impl.Encode4_P7_l "" VALUE 0x008E0DF8 Scalar_FLOAT64_IEEE 0 speedgoat_test_SN5659_R2021b_CM_double -1.7E+308 1.7E+308 /end CHARACTERISTIC
/begin CHARACTERISTIC speedgoat_test_SN5659__cal_impl.Encode4_P7_pf "" VALUE 0x008E1AD8 Scalar_FLOAT64_IEEE 0 speedgoat_test_SN5659_R2021b_CM_double -1.7E+308 1.7E+308 /end CHARACTERISTIC
/begin CHARACTERISTIC speedgoat_test_SN5659__cal_impl.Encode4_P7_pm "" VALUE 0x008E2148 Scalar_FLOAT64_IEEE 0 speedgoat_test_SN5659_R2021b_CM_double -1.7E+308 1.7E+308 /end CHARACTERISTIC
/begin CHARACTERISTIC speedgoat_test_SN5659__cal_impl.Encode4_P8_f "" VALUE 0x008E2160 Scalar_FLOAT64_IEEE 0 speedgoat_test_SN5659_R2021b_CM_double -1.7E+308 1.7E+308 /end CHARACTERISTIC
/begin CHARACTERISTIC speedgoat_test_SN5659__cal_impl.Encode4_P8_h "" VALUE 0x008E0E10 Scalar_FLOAT64_IEEE 0 speedgoat_test_SN5659_R2021b_CM_double -1.7E+308 1.7E+308 /end CHARACTERISTIC
/begin CHARACTERISTIC speedgoat_test_SN5659__cal_impl.Encode4_P8_k "" VALUE 0x008E1480 Scalar_FLOAT64_IEEE 0 speedgoat_test_SN5659_R2021b_CM_double -1.7E+308 1.7E+308 /end CHARACTERISTIC
/begin CHARACTERISTIC speedgoat_test_SN5659__cal_impl.Encode4_P8_l "" VALUE 0x008E1AF0 Scalar_FLOAT64_IEEE 0 speedgoat_test_SN5659_R2021b_CM_double -1.7E+308 1.7E+308 /end CHARACTERISTIC
/begin CHARACTERISTIC speedgoat_test_SN5659__cal_impl.Encode4_P8_oo "" VALUE 0x008E07A0 Scalar_FLOAT64_IEEE 0 speedgoat_test_SN5659_R2021b_CM_double -1.7E+308 1.7E+308 /end CHARACTERISTIC
/begin CHARACTERISTIC speedgoat_test_SN5659__cal_impl.Encode4_P9_e "" VALUE 0x008E0E28 Scalar_FLOAT64_IEEE 0 speedgoat_test_SN5659_R2021b_CM_double -1.7E+308 1.7E+308 /end CHARACTERISTIC
/begin CHARACTERISTIC speedgoat_test_SN5659__cal_impl.Encode4_P9_f "" VALUE 0x008E2178 Scalar_FLOAT64_IEEE 0 speedgoat_test_SN5659_R2021b_CM_double -1.7E+308 1.7E+308 /end CHARACTERISTIC
/begin CHARACTERISTIC speedgoat_test_SN5659__cal_impl.Encode4_P9_n "" VALUE 0x008E07B8 Scalar_FLOAT64_IEEE 0 speedgoat_test_SN5659_R2021b_CM_double -1.7E+308 1.7E+308 /end CHARACTERISTIC
/begin CHARACTERISTIC speedgoat_test_SN5659__cal_impl.Encode4_P9_ns "" VALUE 0x008E1B08 Scalar_FLOAT64_IEEE 0 speedgoat_test_SN5659_R2021b_CM_double -1.7E+308 1.7E+308 /end CHARACTERISTIC
/begin CHARACTERISTIC speedgoat_test_SN5659__cal_impl.Encode4_P9_p "" VALUE 0x008E1498 Scalar_FLOAT64_IEEE 0 speedgoat_test_SN5659_R2021b_CM_double -1.7E+308 1.7E+308 /end CHARACTERISTIC
/begin CHARACTERISTIC speedgoat_test_SN5659__cal_impl.Encode5_P10_a "" VALUE 0x008DFE30 Scalar_FLOAT64_IEEE 0 speedgoat_test_SN5659_R2021b_CM_double -1.7E+308 1.7E+308 /end CHARACTERISTIC
/begin CHARACTERISTIC speedgoat_test_SN5659__cal_impl.Encode5_P11_n "" VAL_BLK 0x008DFE48 Scalar_FLOAT64_IEEE 0 speedgoat_test_SN5659_R2021b_CM_double -1.7E+308 1.7E+308 MATRIX_DIM 2 1 /end CHARACTERISTIC
/begin CHARACTERISTIC speedgoat_test_SN5659__cal_impl.Encode5_P12_m "" VALUE 0x008DFE68 Scalar_FLOAT64_IEEE 0 speedgoat_test_SN5659_R2021b_CM_double -1.7E+308 1.7E+308 /end CHARACTERISTIC
/begin CHARACTERISTIC speedgoat_test_SN5659__cal_impl.Encode5_P13_g "" VALUE 0x008DFE80 Scalar_FLOAT64_IEEE 0 speedgoat_test_SN5659_R2021b_CM_double -1.7E+308 1.7E+308 /end CHARACTERISTIC
/begin CHARACTERISTIC speedgoat_test_SN5659__cal_impl.Encode5_P14_l "" VALUE 0x008DFE98 Scalar_FLOAT64_IEEE 0 speedgoat_test_SN5659_R2021b_CM_double -1.7E+308 1.7E+308 /end CHARACTERISTIC
/begin CHARACTERISTIC speedgoat_test_SN5659__cal_impl.Encode5_P15_c "" VALUE 0x008DFEB0 Scalar_FLOAT64_IEEE 0 speedgoat_test_SN5659_R2021b_CM_double -1.7E+308 1.7E+308 /end CHARACTERISTIC
/begin CHARACTERISTIC speedgoat_test_SN5659__cal_impl.Encode5_P1_f "" VALUE 0x008DFD58 Scalar_FLOAT64_IEEE 0 speedgoat_test_SN5659_R2021b_CM_double -1.7E+308 1.7E+308 /end CHARACTERISTIC
/begin CHARACTERISTIC speedgoat_test_SN5659__cal_impl.Encode5_P2_e "" VALUE 0x008DFD70 Scalar_FLOAT64_IEEE 0 speedgoat_test_SN5659_R2021b_CM_double -1.7E+308 1.7E+308 /end CHARACTERISTIC
/begin CHARACTERISTIC speedgoat_test_SN5659__cal_impl.Encode5_P3_m "" VALUE 0x008DFD88 Scalar_FLOAT64_IEEE 0 speedgoat_test_SN5659_R2021b_CM_double -1.7E+308 1.7E+308 /end CHARACTERISTIC
/begin CHARACTERISTIC speedgoat_test_SN5659__cal_impl.Encode5_P4_a "" VALUE 0x008DFDA0 Scalar_FLOAT64_IEEE 0 speedgoat_test_SN5659_R2021b_CM_double -1.7E+308 1.7E+308 /end CHARACTERISTIC
/begin CHARACTERISTIC speedgoat_test_SN5659__cal_impl.Encode5_P5_i "" VALUE 0x008DFDB8 Scalar_FLOAT64_IEEE 0 speedgoat_test_SN5659_R2021b_CM_double -1.7E+308 1.7E+308 /end CHARACTERISTIC
/begin CHARACTERISTIC speedgoat_test_SN5659__cal_impl.Encode5_P6_d "" VALUE 0x008DFDD0 Scalar_FLOAT64_IEEE 0 speedgoat_test_SN5659_R2021b_CM_double -1.7E+308 1.7E+308 /end CHARACTERISTIC
/begin CHARACTERISTIC speedgoat_test_SN5659__cal_impl.Encode5_P7_f "" VALUE 0x008DFDE8 Scalar_FLOAT64_IEEE 0 speedgoat_test_SN5659_R2021b_CM_double -1.7E+308 1.7E+308 /end CHARACTERISTIC
/begin CHARACTERISTIC speedgoat_test_SN5659__cal_impl.Encode5_P8_k "" VALUE 0x008DFE00 Scalar_FLOAT64_IEEE 0 speedgoat_test_SN5659_R2021b_CM_double -1.7E+308 1.7E+308 /end CHARACTERISTIC
/begin CHARACTERISTIC speedgoat_test_SN5659__cal_impl.Encode5_P9_l "" VALUE 0x008DFE18 Scalar_FLOAT64_IEEE 0 speedgoat_test_SN5659_R2021b_CM_double -1.7E+308 1.7E+308 /end CHARACTERISTIC
/begin CHARACTERISTIC speedgoat_test_SN5659__cal_impl.FixPtConstant_Value_h "" VALUE 0x008E4DD5 Scalar_UBYTE 0 speedgoat_test_SN5659_R2021b_CM_uint8 0 255 /end CHARACTERISTIC
/begin CHARACTERISTIC speedgoat_test_SN5659__cal_impl.FixPtConstant_Value_i "" VALUE 0x008E4DA6 Scalar_UWORD 0 speedgoat_test_SN5659_R2021b_CM_uint16 0 65535 /end CHARACTERISTIC
/begin CHARACTERISTIC speedgoat_test_SN5659__cal_impl.FixPtConstant_Value_j "" VALUE 0x008E4D9A Scalar_UWORD 0 speedgoat_test_SN5659_R2021b_CM_uint16 0 65535 /end CHARACTERISTIC
/begin CHARACTERISTIC speedgoat_test_SN5659__cal_impl.FixPtConstant_Value_k0 "" VALUE 0x008E4DD8 Scalar_UBYTE 0 speedgoat_test_SN5659_R2021b_CM_uint8 0 255 /end CHARACTERISTIC
/begin CHARACTERISTIC speedgoat_test_SN5659__cal_impl.FixPtConstant_Value_l "" VALUE 0x008E4DA0 Scalar_UWORD 0 speedgoat_test_SN5659_R2021b_CM_uint16 0 65535 /end CHARACTERISTIC
/begin CHARACTERISTIC speedgoat_test_SN5659__cal_impl.FixPtConstant_Value_oq "" VALUE 0x008E4DAC Scalar_UWORD 0 speedgoat_test_SN5659_R2021b_CM_uint16 0 65535 /end CHARACTERISTIC
/begin CHARACTERISTIC speedgoat_test_SN5659__cal_impl.FixPtConstant_Value_oz "" VALUE 0x008E4D94 Scalar_UWORD 0 speedgoat_test_SN5659_R2021b_CM_uint16 0 65535 /end CHARACTERISTIC
/begin CHARACTERISTIC speedgoat_test_SN5659__cal_impl.Label_Value "" VALUE 0x008E4CC8 Scalar_ULONG 0 speedgoat_test_SN5659_R2021b_CM_uint32 0 2147483646 /end CHARACTERISTIC
/begin CHARACTERISTIC speedgoat_test_SN5659__cal_impl.Label_Value_b "" VALUE 0x008E4D10 Scalar_ULONG 0 speedgoat_test_SN5659_R2021b_CM_uint32 0 2147483646 /end CHARACTERISTIC
/begin CHARACTERISTIC speedgoat_test_SN5659__cal_impl.Label_Value_ex "" VALUE 0x008E4CF8 Scalar_ULONG 0 speedgoat_test_SN5659_R2021b_CM_uint32 0 2147483646 /end CHARACTERISTIC
/begin CHARACTERISTIC speedgoat_test_SN5659__cal_impl.Label_Value_f "" VALUE 0x008E4D04 Scalar_ULONG 0 speedgoat_test_SN5659_R2021b_CM_uint32 0 2147483646 /end CHARACTERISTIC
/begin CHARACTERISTIC speedgoat_test_SN5659__cal_impl.Label_Value_fv "" VALUE 0x008E4D34 Scalar_ULONG 0 speedgoat_test_SN5659_R2021b_CM_uint32 0 2147483646 /end CHARACTERISTIC
/begin CHARACTERISTIC speedgoat_test_SN5659__cal_impl.Label_Value_k "" VALUE 0x008E4D1C Scalar_ULONG 0 speedgoat_test_SN5659_R2021b_CM_uint32 0 2147483646 /end CHARACTERISTIC
/begin CHARACTERISTIC speedgoat_test_SN5659__cal_impl.Label_Value_n "" VALUE 0x008E4D28 Scalar_ULONG 0 speedgoat_test_SN5659_R2021b_CM_uint32 0 2147483646 /end CHARACTERISTIC
/begin CHARACTERISTIC speedgoat_test_SN5659__cal_impl.Mask_BitMask "" VALUE 0x008D5020 Scalar_ULONG 0 speedgoat_test_SN5659_R2021b_CM_uint32 0 2147483646 /end CHARACTERISTIC
/begin CHARACTERISTIC speedgoat_test_SN5659__cal_impl.Mask_BitMask_a "" VALUE 0x008D503C Scalar_ULONG 0 speedgoat_test_SN5659_R2021b_CM_uint32 0 2147483646 /end CHARACTERISTIC
/begin CHARACTERISTIC speedgoat_test_SN5659__cal_impl.Mask_BitMask_e "" VALUE 0x008D5030 Scalar_ULONG 0 speedgoat_test_SN5659_R2021b_CM_uint32 0 2147483646 /end CHARACTERISTIC
/begin CHARACTERISTIC speedgoat_test_SN5659__cal_impl.Mask_BitMask_e3 "" VALUE 0x008D5044 Scalar_ULONG 0 speedgoat_test_SN5659_R2021b_CM_uint32 0 2147483646 /end CHARACTERISTIC
/begin CHARACTERISTIC speedgoat_test_SN5659__cal_impl.Mask_BitMask_l "" VALUE 0x008D5040 Scalar_ULONG 0 speedgoat_test_SN5659_R2021b_CM_uint32 0 2147483646 /end CHARACTERISTIC
/begin CHARACTERISTIC speedgoat_test_SN5659__cal_impl.Mask_BitMask_p "" VALUE 0x008D5034 Scalar_ULONG 0 speedgoat_test_SN5659_R2021b_CM_uint32 0 2147483646 /end CHARACTERISTIC
/begin CHARACTERISTIC speedgoat_test_SN5659__cal_impl.Mask_BitMask_pd "" VALUE 0x008D5038 Scalar_ULONG 0 speedgoat_test_SN5659_R2021b_CM_uint32 0 2147483646 /end CHARACTERISTIC
/begin CHARACTERISTIC speedgoat_test_SN5659__cal_impl.Output_InitialCondition_b "" VALUE 0x008E4DD4 Scalar_UBYTE 0 speedgoat_test_SN5659_R2021b_CM_uint8 0 255 /end CHARACTERISTIC
/begin CHARACTERISTIC speedgoat_test_SN5659__cal_impl.Output_InitialCondition_e "" VALUE 0x008E4D98 Scalar_UWORD 0 speedgoat_test_SN5659_R2021b_CM_uint16 0 65535 /end CHARACTERISTIC
/begin CHARACTERISTIC speedgoat_test_SN5659__cal_impl.Output_InitialCondition_h "" VALUE 0x008E4DAA Scalar_UWORD 0 speedgoat_test_SN5659_R2021b_CM_uint16 0 65535 /end CHARACTERISTIC
/begin CHARACTERISTIC speedgoat_test_SN5659__cal_impl.Output_InitialCondition_j "" VALUE 0x008E4DD7 Scalar_UBYTE 0 speedgoat_test_SN5659_R2021b_CM_uint8 0 255 /end CHARACTERISTIC
/begin CHARACTERISTIC speedgoat_test_SN5659__cal_impl.Output_InitialCondition_k "" VALUE 0x008E4D92 Scalar_UWORD 0 speedgoat_test_SN5659_R2021b_CM_uint16 0 65535 /end CHARACTERISTIC
/begin CHARACTERISTIC speedgoat_test_SN5659__cal_impl.Output_InitialCondition_l "" VALUE 0x008E4D9E Scalar_UWORD 0 speedgoat_test_SN5659_R2021b_CM_uint16 0 65535 /end CHARACTERISTIC
/begin CHARACTERISTIC speedgoat_test_SN5659__cal_impl.Output_InitialCondition_nl "" VALUE 0x008E4DA4 Scalar_UWORD 0 speedgoat_test_SN5659_R2021b_CM_uint16 0 65535 /end CHARACTERISTIC
/begin CHARACTERISTIC speedgoat_test_SN5659__cal_impl.Randomnumber_Mean_a "" VALUE 0x008DFBC0 Scalar_FLOAT64_IEEE 0 speedgoat_test_SN5659_R2021b_CM_double -1.7E+308 1.7E+308 /end CHARACTERISTIC
/begin CHARACTERISTIC speedgoat_test_SN5659__cal_impl.Randomnumber_Mean_b "" VALUE 0x008E08A0 Scalar_FLOAT64_IEEE 0 speedgoat_test_SN5659_R2021b_CM_double -1.7E+308 1.7E+308 /end CHARACTERISTIC
/begin CHARACTERISTIC speedgoat_test_SN5659__cal_impl.Randomnumber_Mean_d "" VALUE 0x008E1BF0 Scalar_FLOAT64_IEEE 0 speedgoat_test_SN5659_R2021b_CM_double -1.7E+308 1.7E+308 /end CHARACTERISTIC
/begin CHARACTERISTIC speedgoat_test_SN5659__cal_impl.Randomnumber_Mean_f3 "" VALUE 0x008E1580 Scalar_FLOAT64_IEEE 0 speedgoat_test_SN5659_R2021b_CM_double -1.7E+308 1.7E+308 /end CHARACTERISTIC
/begin CHARACTERISTIC speedgoat_test_SN5659__cal_impl.Randomnumber_Mean_fh "" VALUE 0x008E0F10 Scalar_FLOAT64_IEEE 0 speedgoat_test_SN5659_R2021b_CM_double -1.7E+308 1.7E+308 /end CHARACTERISTIC
/begin CHARACTERISTIC speedgoat_test_SN5659__cal_impl.Randomnumber_Mean_h "" VALUE 0x008E0230 Scalar_FLOAT64_IEEE 0 speedgoat_test_SN5659_R2021b_CM_double -1.7E+308 1.7E+308 /end CHARACTERISTIC
/begin CHARACTERISTIC speedgoat_test_SN5659__cal_impl.Randomnumber_Seed_c "" VALUE 0x008DFBD0 Scalar_FLOAT64_IEEE 0 speedgoat_test_SN5659_R2021b_CM_double -1.7E+308 1.7E+308 /end CHARACTERISTIC
/begin CHARACTERISTIC speedgoat_test_SN5659__cal_impl.Randomnumber_Seed_cd "" VALUE 0x008E0F20 Scalar_FLOAT64_IEEE 0 speedgoat_test_SN5659_R2021b_CM_double -1.7E+308 1.7E+308 /end CHARACTERISTIC
/begin CHARACTERISTIC speedgoat_test_SN5659__cal_impl.Randomnumber_Seed_fj "" VALUE 0x008E08B0 Scalar_FLOAT64_IEEE 0 speedgoat_test_SN5659_R2021b_CM_double -1.7E+308 1.7E+308 /end CHARACTERISTIC
/begin CHARACTERISTIC speedgoat_test_SN5659__cal_impl.Randomnumber_Seed_fq "" VALUE 0x008E1C00 Scalar_FLOAT64_IEEE 0 speedgoat_test_SN5659_R2021b_CM_double -1.7E+308 1.7E+308 /end CHARACTERISTIC
/begin CHARACTERISTIC speedgoat_test_SN5659__cal_impl.Randomnumber_Seed_nh "" VALUE 0x008E1590 Scalar_FLOAT64_IEEE 0 speedgoat_test_SN5659_R2021b_CM_double -1.7E+308 1.7E+308 /end CHARACTERISTIC
/begin CHARACTERISTIC speedgoat_test_SN5659__cal_impl.Randomnumber_Seed_p "" VALUE 0x008E0240 Scalar_FLOAT64_IEEE 0 speedgoat_test_SN5659_R2021b_CM_double -1.7E+308 1.7E+308 /end CHARACTERISTIC
/begin CHARACTERISTIC speedgoat_test_SN5659__cal_impl.Randomnumber_StdDev_f "" VALUE 0x008E1BF8 Scalar_FLOAT64_IEEE 0 speedgoat_test_SN5659_R2021b_CM_double -1.7E+308 1.7E+308 /end CHARACTERISTIC
/begin CHARACTERISTIC speedgoat_test_SN5659__cal_impl.Randomnumber_StdDev_g "" VALUE 0x008E0238 Scalar_FLOAT64_IEEE 0 speedgoat_test_SN5659_R2021b_CM_double -1.7E+308 1.7E+308 /end CHARACTERISTIC
/begin CHARACTERISTIC speedgoat_test_SN5659__cal_impl.Randomnumber_StdDev_k "" VALUE 0x008DFBC8 Scalar_FLOAT64_IEEE 0 speedgoat_test_SN5659_R2021b_CM_double -1.7E+308 1.7E+308 /end CHARACTERISTIC
/begin CHARACTERISTIC speedgoat_test_SN5659__cal_impl.Randomnumber_StdDev_l4 "" VALUE 0x008E08A8 Scalar_FLOAT64_IEEE 0 speedgoat_test_SN5659_R2021b_CM_double -1.7E+308 1.7E+308 /end CHARACTERISTIC
/begin CHARACTERISTIC speedgoat_test_SN5659__cal_impl.Randomnumber_StdDev_m "" VALUE 0x008E1588 Scalar_FLOAT64_IEEE 0 speedgoat_test_SN5659_R2021b_CM_double -1.7E+308 1.7E+308 /end CHARACTERISTIC
/begin CHARACTERISTIC speedgoat_test_SN5659__cal_impl.Randomnumber_StdDev_n "" VALUE 0x008E0F18 Scalar_FLOAT64_IEEE 0 speedgoat_test_SN5659_R2021b_CM_double -1.7E+308 1.7E+308 /end CHARACTERISTIC
/begin CHARACTERISTIC speedgoat_test_SN5659__cal_impl.SDI_Value "" VALUE 0x008E4CC4 Scalar_ULONG 0 speedgoat_test_SN5659_R2021b_CM_uint32 0 2147483646 /end CHARACTERISTIC
/begin CHARACTERISTIC speedgoat_test_SN5659__cal_impl.SDI_Value_a "" VALUE 0x008E4CF4 Scalar_ULONG 0 speedgoat_test_SN5659_R2021b_CM_uint32 0 2147483646 /end CHARACTERISTIC
/begin CHARACTERISTIC speedgoat_test_SN5659__cal_impl.SDI_Value_h "" VALUE 0x008E4D00 Scalar_ULONG 0 speedgoat_test_SN5659_R2021b_CM_uint32 0 2147483646 /end CHARACTERISTIC
/begin CHARACTERISTIC speedgoat_test_SN5659__cal_impl.SDI_Value_i "" VALUE 0x008E4D0C Scalar_ULONG 0 speedgoat_test_SN5659_R2021b_CM_uint32 0 2147483646 /end CHARACTERISTIC
/begin CHARACTERISTIC speedgoat_test_SN5659__cal_impl.SDI_Value_l4 "" VALUE 0x008E4D24 Scalar_ULONG 0 speedgoat_test_SN5659_R2021b_CM_uint32 0 2147483646 /end CHARACTERISTIC
/begin CHARACTERISTIC speedgoat_test_SN5659__cal_impl.SDI_Value_m3 "" VALUE 0x008E4D18 Scalar_ULONG 0 speedgoat_test_SN5659_R2021b_CM_uint32 0 2147483646 /end CHARACTERISTIC
/begin CHARACTERISTIC speedgoat_test_SN5659__cal_impl.SDI_Value_p "" VALUE 0x008E4D30 Scalar_ULONG 0 speedgoat_test_SN5659_R2021b_CM_uint32 0 2147483646 /end CHARACTERISTIC
/begin CHARACTERISTIC speedgoat_test_SN5659__cal_impl.SSM_Value "" VALUE 0x008E4CC0 Scalar_ULONG 0 speedgoat_test_SN5659_R2021b_CM_uint32 0 2147483646 /end CHARACTERISTIC
/begin CHARACTERISTIC speedgoat_test_SN5659__cal_impl.SSM_Value_i "" VALUE 0x008E4D14 Scalar_ULONG 0 speedgoat_test_SN5659_R2021b_CM_uint32 0 2147483646 /end CHARACTERISTIC
/begin CHARACTERISTIC speedgoat_test_SN5659__cal_impl.SSM_Value_j "" VALUE 0x008E4CFC Scalar_ULONG 0 speedgoat_test_SN5659_R2021b_CM_uint32 0 2147483646 /end CHARACTERISTIC
/begin CHARACTERISTIC speedgoat_test_SN5659__cal_impl.SSM_Value_ji "" VALUE 0x008E4D08 Scalar_ULONG 0 speedgoat_test_SN5659_R2021b_CM_uint32 0 2147483646 /end CHARACTERISTIC
/begin CHARACTERISTIC speedgoat_test_SN5659__cal_impl.SSM_Value_m "" VALUE 0x008E4CF0 Scalar_ULONG 0 speedgoat_test_SN5659_R2021b_CM_uint32 0 2147483646 /end CHARACTERISTIC
/begin CHARACTERISTIC speedgoat_test_SN5659__cal_impl.SSM_Value_na "" VALUE 0x008E4D20 Scalar_ULONG 0 speedgoat_test_SN5659_R2021b_CM_uint32 0 2147483646 /end CHARACTERISTIC
/begin CHARACTERISTIC speedgoat_test_SN5659__cal_impl.SSM_Value_os "" VALUE 0x008E4D2C Scalar_ULONG 0 speedgoat_test_SN5659_R2021b_CM_uint32 0 2147483646 /end CHARACTERISTIC
/begin CHARACTERISTIC speedgoat_test_SN5659__cal_impl.Scale_Value "" VALUE 0x008DE6A8 Scalar_FLOAT64_IEEE 0 speedgoat_test_SN5659_R2021b_CM_double -1.7E+308 1.7E+308 /end CHARACTERISTIC
/begin CHARACTERISTIC speedgoat_test_SN5659__cal_impl.Scale_Value_c "" VALUE 0x008E0D48 Scalar_FLOAT64_IEEE 0 speedgoat_test_SN5659_R2021b_CM_double -1.7E+308 1.7E+308 /end CHARACTERISTIC
/begin CHARACTERISTIC speedgoat_test_SN5659__cal_impl.Scale_Value_d "" VALUE 0x008E06D8 Scalar_FLOAT64_IEEE 0 speedgoat_test_SN5659_R2021b_CM_double -1.7E+308 1.7E+308 /end CHARACTERISTIC
/begin CHARACTERISTIC speedgoat_test_SN5659__cal_impl.Scale_Value_e "" VALUE 0x008E2098 Scalar_FLOAT64_IEEE 0 speedgoat_test_SN5659_R2021b_CM_double -1.7E+308 1.7E+308 /end CHARACTERISTIC
/begin CHARACTERISTIC speedgoat_test_SN5659__cal_impl.Scale_Value_f "" VALUE 0x008E0068 Scalar_FLOAT64_IEEE 0 speedgoat_test_SN5659_R2021b_CM_double -1.7E+308 1.7E+308 /end CHARACTERISTIC
/begin CHARACTERISTIC speedgoat_test_SN5659__cal_impl.Scale_Value_i "" VALUE 0x008E13B8 Scalar_FLOAT64_IEEE 0 speedgoat_test_SN5659_R2021b_CM_double -1.7E+308 1.7E+308 /end CHARACTERISTIC
/begin CHARACTERISTIC speedgoat_test_SN5659__cal_impl.Scale_Value_k "" VALUE 0x008E1A28 Scalar_FLOAT64_IEEE 0 speedgoat_test_SN5659_R2021b_CM_double -1.7E+308 1.7E+308 /end CHARACTERISTIC
/begin CHARACTERISTIC speedgoat_test_SN5659__cal_impl.Sinewave_Amp_a "" VALUE 0x008E1EE8 Scalar_FLOAT64_IEEE 0 speedgoat_test_SN5659_R2021b_CM_double -1.7E+308 1.7E+308 /end CHARACTERISTIC
/begin CHARACTERISTIC speedgoat_test_SN5659__cal_impl.Sinewave_Amp_c "" VALUE 0x008E1208 Scalar_FLOAT64_IEEE 0 speedgoat_test_SN5659_R2021b_CM_double -1.7E+308 1.7E+308 /end CHARACTERISTIC
/begin CHARACTERISTIC speedgoat_test_SN5659__cal_impl.Sinewave_Amp_h "" VALUE 0x008DFEB8 Scalar_FLOAT64_IEEE 0 speedgoat_test_SN5659_R2021b_CM_double -1.7E+308 1.7E+308 /end CHARACTERISTIC
/begin CHARACTERISTIC speedgoat_test_SN5659__cal_impl.Sinewave_Amp_hh "" VALUE 0x008E0B98 Scalar_FLOAT64_IEEE 0 speedgoat_test_SN5659_R2021b_CM_double -1.7E+308 1.7E+308 /end CHARACTERISTIC
/begin CHARACTERISTIC speedgoat_test_SN5659__cal_impl.Sinewave_Amp_n "" VALUE 0x008E0528 Scalar_FLOAT64_IEEE 0 speedgoat_test_SN5659_R2021b_CM_double -1.7E+308 1.7E+308 /end CHARACTERISTIC
/begin CHARACTERISTIC speedgoat_test_SN5659__cal_impl.Sinewave_Amp_nm "" VALUE 0x008E1878 Scalar_FLOAT64_IEEE 0 speedgoat_test_SN5659_R2021b_CM_double -1.7E+308 1.7E+308 /end CHARACTERISTIC
/begin CHARACTERISTIC speedgoat_test_SN5659__cal_impl.Sinewave_Bias_g "" VALUE 0x008E0BA0 Scalar_FLOAT64_IEEE 0 speedgoat_test_SN5659_R2021b_CM_double -1.7E+308 1.7E+308 /end CHARACTERISTIC
/begin CHARACTERISTIC speedgoat_test_SN5659__cal_impl.Sinewave_Bias_j "" VALUE 0x008E0530 Scalar_FLOAT64_IEEE 0 speedgoat_test_SN5659_R2021b_CM_double -1.7E+308 1.7E+308 /end CHARACTERISTIC
/begin CHARACTERISTIC speedgoat_test_SN5659__cal_impl.Sinewave_Bias_jq "" VALUE 0x008E1880 Scalar_FLOAT64_IEEE 0 speedgoat_test_SN5659_R2021b_CM_double -1.7E+308 1.7E+308 /end CHARACTERISTIC
/begin CHARACTERISTIC speedgoat_test_SN5659__cal_impl.Sinewave_Bias_kg "" VALUE 0x008E1210 Scalar_FLOAT64_IEEE 0 speedgoat_test_SN5659_R2021b_CM_double -1.7E+308 1.7E+308 /end CHARACTERISTIC
/begin CHARACTERISTIC speedgoat_test_SN5659__cal_impl.Sinewave_Bias_m "" VALUE 0x008DFEC0 Scalar_FLOAT64_IEEE 0 speedgoat_test_SN5659_R2021b_CM_double -1.7E+308 1.7E+308 /end CHARACTERISTIC
/begin CHARACTERISTIC speedgoat_test_SN5659__cal_impl.Sinewave_Bias_mn "" VALUE 0x008E1EF0 Scalar_FLOAT64_IEEE 0 speedgoat_test_SN5659_R2021b_CM_double -1.7E+308 1.7E+308 /end CHARACTERISTIC
/begin CHARACTERISTIC speedgoat_test_SN5659__cal_impl.Sinewave_Freq_ah "" VALUE 0x008E0538 Scalar_FLOAT64_IEEE 0 speedgoat_test_SN5659_R2021b_CM_double -1.7E+308 1.7E+308 /end CHARACTERISTIC
/begin CHARACTERISTIC speedgoat_test_SN5659__cal_impl.Sinewave_Freq_b "" VALUE 0x008E1EF8 Scalar_FLOAT64_IEEE 0 speedgoat_test_SN5659_R2021b_CM_double -1.7E+308 1.7E+308 /end CHARACTERISTIC
/begin CHARACTERISTIC speedgoat_test_SN5659__cal_impl.Sinewave_Freq_c "" VALUE 0x008E0BA8 Scalar_FLOAT64_IEEE 0 speedgoat_test_SN5659_R2021b_CM_double -1.7E+308 1.7E+308 /end CHARACTERISTIC
/begin CHARACTERISTIC speedgoat_test_SN5659__cal_impl.Sinewave_Freq_l "" VALUE 0x008E1888 Scalar_FLOAT64_IEEE 0 speedgoat_test_SN5659_R2021b_CM_double -1.7E+308 1.7E+308 /end CHARACTERISTIC
/begin CHARACTERISTIC speedgoat_test_SN5659__cal_impl.Sinewave_Freq_m "" VALUE 0x008DFEC8 Scalar_FLOAT64_IEEE 0 speedgoat_test_SN5659_R2021b_CM_double -1.7E+308 1.7E+308 /end CHARACTERISTIC
/begin CHARACTERISTIC speedgoat_test_SN5659__cal_impl.Sinewave_Freq_mo "" VALUE 0x008E1218 Scalar_FLOAT64_IEEE 0 speedgoat_test_SN5659_R2021b_CM_double -1.7E+308 1.7E+308 /end CHARACTERISTIC
/begin CHARACTERISTIC speedgoat_test_SN5659__cal_impl.Sinewave_HCos_b "" VALUE 0x008E1898 Scalar_FLOAT64_IEEE 0 speedgoat_test_SN5659_R2021b_CM_double -1.7E+308 1.7E+308 /end CHARACTERISTIC
/begin CHARACTERISTIC speedgoat_test_SN5659__cal_impl.Sinewave_HCos_bz "" VALUE 0x008E1F08 Scalar_FLOAT64_IEEE 0 speedgoat_test_SN5659_R2021b_CM_double -1.7E+308 1.7E+308 /end CHARACTERISTIC
/begin CHARACTERISTIC speedgoat_test_SN5659__cal_impl.Sinewave_HCos_f "" VALUE 0x008E1228 Scalar_FLOAT64_IEEE 0 speedgoat_test_SN5659_R2021b_CM_double -1.7E+308 1.7E+308 /end CHARACTERISTIC
/begin CHARACTERISTIC speedgoat_test_SN5659__cal_impl.Sinewave_HCos_jg "" VALUE 0x008E0BB8 Scalar_FLOAT64_IEEE 0 speedgoat_test_SN5659_R2021b_CM_double -1.7E+308 1.7E+308 /end CHARACTERISTIC
/begin CHARACTERISTIC speedgoat_test_SN5659__cal_impl.Sinewave_HCos_jn "" VALUE 0x008E0548 Scalar_FLOAT64_IEEE 0 speedgoat_test_SN5659_R2021b_CM_double -1.7E+308 1.7E+308 /end CHARACTERISTIC
/begin CHARACTERISTIC speedgoat_test_SN5659__cal_impl.Sinewave_HCos_o "" VALUE 0x008DFED8 Scalar_FLOAT64_IEEE 0 speedgoat_test_SN5659_R2021b_CM_double -1.7E+308 1.7E+308 /end CHARACTERISTIC
/begin CHARACTERISTIC speedgoat_test_SN5659__cal_impl.Sinewave_Hsin_e "" VALUE 0x008E1890 Scalar_FLOAT64_IEEE 0 speedgoat_test_SN5659_R2021b_CM_double -1.7E+308 1.7E+308 /end CHARACTERISTIC
/begin CHARACTERISTIC speedgoat_test_SN5659__cal_impl.Sinewave_Hsin_h "" VALUE 0x008E1220 Scalar_FLOAT64_IEEE 0 speedgoat_test_SN5659_R2021b_CM_double -1.7E+308 1.7E+308 /end CHARACTERISTIC
/begin CHARACTERISTIC speedgoat_test_SN5659__cal_impl.Sinewave_Hsin_h4 "" VALUE 0x008E1F00 Scalar_FLOAT64_IEEE 0 speedgoat_test_SN5659_R2021b_CM_double -1.7E+308 1.7E+308 /end CHARACTERISTIC
/begin CHARACTERISTIC speedgoat_test_SN5659__cal_impl.Sinewave_Hsin_i "" VALUE 0x008E0540 Scalar_FLOAT64_IEEE 0 speedgoat_test_SN5659_R2021b_CM_double -1.7E+308 1.7E+308 /end CHARACTERISTIC
/begin CHARACTERISTIC speedgoat_test_SN5659__cal_impl.Sinewave_Hsin_o "" VALUE 0x008DFED0 Scalar_FLOAT64_IEEE 0 speedgoat_test_SN5659_R2021b_CM_double -1.7E+308 1.7E+308 /end CHARACTERISTIC
/begin CHARACTERISTIC speedgoat_test_SN5659__cal_impl.Sinewave_Hsin_o1 "" VALUE 0x008E0BB0 Scalar_FLOAT64_IEEE 0 speedgoat_test_SN5659_R2021b_CM_double -1.7E+308 1.7E+308 /end CHARACTERISTIC
/begin CHARACTERISTIC speedgoat_test_SN5659__cal_impl.Sinewave_PCos_a "" VALUE 0x008E0BC8 Scalar_FLOAT64_IEEE 0 speedgoat_test_SN5659_R2021b_CM_double -1.7E+308 1.7E+308 /end CHARACTERISTIC
/begin CHARACTERISTIC speedgoat_test_SN5659__cal_impl.Sinewave_PCos_f "" VALUE 0x008E0558 Scalar_FLOAT64_IEEE 0 speedgoat_test_SN5659_R2021b_CM_double -1.7E+308 1.7E+308 /end CHARACTERISTIC
/begin CHARACTERISTIC speedgoat_test_SN5659__cal_impl.Sinewave_PCos_h "" VALUE 0x008DFEE8 Scalar_FLOAT64_IEEE 0 speedgoat_test_SN5659_R2021b_CM_double -1.7E+308 1.7E+308 /end CHARACTERISTIC
/begin CHARACTERISTIC speedgoat_test_SN5659__cal_impl.Sinewave_PCos_k "" VALUE 0x008E18A8 Scalar_FLOAT64_IEEE 0 speedgoat_test_SN5659_R2021b_CM_double -1.7E+308 1.7E+308 /end CHARACTERISTIC
/begin CHARACTERISTIC speedgoat_test_SN5659__cal_impl.Sinewave_PCos_m "" VALUE 0x008E1238 Scalar_FLOAT64_IEEE 0 speedgoat_test_SN5659_R2021b_CM_double -1.7E+308 1.7E+308 /end CHARACTERISTIC
/begin CHARACTERISTIC speedgoat_test_SN5659__cal_impl.Sinewave_PCos_ma "" VALUE 0x008E1F18 Scalar_FLOAT64_IEEE 0 speedgoat_test_SN5659_R2021b_CM_double -1.7E+308 1.7E+308 /end CHARACTERISTIC
/begin CHARACTERISTIC speedgoat_test_SN5659__cal_impl.Sinewave_PSin_e "" VALUE 0x008DFEE0 Scalar_FLOAT64_IEEE 0 speedgoat_test_SN5659_R2021b_CM_double -1.7E+308 1.7E+308 /end CHARACTERISTIC
/begin CHARACTERISTIC speedgoat_test_SN5659__cal_impl.Sinewave_PSin_f "" VALUE 0x008E0550 Scalar_FLOAT64_IEEE 0 speedgoat_test_SN5659_R2021b_CM_double -1.7E+308 1.7E+308 /end CHARACTERISTIC
/begin CHARACTERISTIC speedgoat_test_SN5659__cal_impl.Sinewave_PSin_fk "" VALUE 0x008E0BC0 Scalar_FLOAT64_IEEE 0 speedgoat_test_SN5659_R2021b_CM_double -1.7E+308 1.7E+308 /end CHARACTERISTIC
/begin CHARACTERISTIC speedgoat_test_SN5659__cal_impl.Sinewave_PSin_g "" VALUE 0x008E18A0 Scalar_FLOAT64_IEEE 0 speedgoat_test_SN5659_R2021b_CM_double -1.7E+308 1.7E+308 /end CHARACTERISTIC
/begin CHARACTERISTIC speedgoat_test_SN5659__cal_impl.Sinewave_PSin_gt "" VALUE 0x008E1F10 Scalar_FLOAT64_IEEE 0 speedgoat_test_SN5659_R2021b_CM_double -1.7E+308 1.7E+308 /end CHARACTERISTIC
/begin CHARACTERISTIC speedgoat_test_SN5659__cal_impl.Sinewave_PSin_m "" VALUE 0x008E1230 Scalar_FLOAT64_IEEE 0 speedgoat_test_SN5659_R2021b_CM_double -1.7E+308 1.7E+308 /end CHARACTERISTIC
/begin CHARACTERISTIC speedgoat_test_SN5659__cal_impl.shiftthedoublevalue27bitslef_oj "" VALUE 0x008E0D50 Scalar_FLOAT64_IEEE 0 speedgoat_test_SN5659_R2021b_CM_double -1.7E+308 1.7E+308 /end CHARACTERISTIC
/begin CHARACTERISTIC speedgoat_test_SN5659__cal_impl.shiftthedoublevalue27bitslef_pp "" VALUE 0x008E06E0 Scalar_FLOAT64_IEEE 0 speedgoat_test_SN5659_R2021b_CM_double -1.7E+308 1.7E+308 /end CHARACTERISTIC
/begin CHARACTERISTIC speedgoat_test_SN5659__cal_impl.shiftthedoublevalue27bitsleft_V "" VALUE 0x008DE6B0 Scalar_FLOAT64_IEEE 0 speedgoat_test_SN5659_R2021b_CM_double -1.7E+308 1.7E+308 /end CHARACTERISTIC
/begin CHARACTERISTIC speedgoat_test_SN5659__cal_impl.shiftthedoublevalue27bitsleft_h "" VALUE 0x008E13C0 Scalar_FLOAT64_IEEE 0 speedgoat_test_SN5659_R2021b_CM_double -1.7E+308 1.7E+308 /end CHARACTERISTIC
/begin CHARACTERISTIC speedgoat_test_SN5659__cal_impl.shiftthedoublevalue27bitsleft_i "" VALUE 0x008E0070 Scalar_FLOAT64_IEEE 0 speedgoat_test_SN5659_R2021b_CM_double -1.7E+308 1.7E+308 /end CHARACTERISTIC
/begin CHARACTERISTIC speedgoat_test_SN5659__cal_impl.shiftthedoublevalue27bitsleft_j "" VALUE 0x008E1A30 Scalar_FLOAT64_IEEE 0 speedgoat_test_SN5659_R2021b_CM_double -1.7E+308 1.7E+308 /end CHARACTERISTIC
/begin CHARACTERISTIC speedgoat_test_SN5659__cal_impl.shiftthedoublevalue27bitsleft_n "" VALUE 0x008E20A0 Scalar_FLOAT64_IEEE 0 speedgoat_test_SN5659_R2021b_CM_double -1.7E+308 1.7E+308 /end CHARACTERISTIC
/begin MEASUREMENT speedgoat_test_SN5659_R2021b_B.BitwiseOperator "" ULONG speedgoat_test_SN5659_R2021b_CM_uint32 0 0 0 2147483646 ECU_ADDRESS 0x00948290 /end MEASUREMENT
/begin MEASUREMENT speedgoat_test_SN5659_R2021b_B.BitwiseOperator_a4 "" ULONG speedgoat_test_SN5659_R2021b_CM_uint32 0 0 0 2147483646 ECU_ADDRESS 0x00948344 /end MEASUREMENT
/begin MEASUREMENT speedgoat_test_SN5659_R2021b_B.BitwiseOperator_c "" ULONG speedgoat_test_SN5659_R2021b_CM_uint32 0 0 0 2147483646 ECU_ADDRESS 0x009482F4 /end MEASUREMENT
/begin MEASUREMENT speedgoat_test_SN5659_R2021b_B.BitwiseOperator_e "" ULONG speedgoat_test_SN5659_R2021b_CM_uint32 0 0 0 2147483646 ECU_ADDRESS 0x0094831C /end MEASUREMENT
/begin MEASUREMENT speedgoat_test_SN5659_R2021b_B.BitwiseOperator_f "" ULONG speedgoat_test_SN5659_R2021b_CM_uint32 0 0 0 2147483646 ECU_ADDRESS 0x00948308 /end MEASUREMENT
/begin MEASUREMENT speedgoat_test_SN5659_R2021b_B.BitwiseOperator_j "" ULONG speedgoat_test_SN5659_R2021b_CM_uint32 0 0 0 2147483646 ECU_ADDRESS 0x00948330 /end MEASUREMENT
/begin MEASUREMENT speedgoat_test_SN5659_R2021b_B.BitwiseOperator_k "" ULONG speedgoat_test_SN5659_R2021b_CM_uint32 0 0 0 2147483646 ECU_ADDRESS 0x009482E0 /end MEASUREMENT
/begin MEASUREMENT speedgoat_test_SN5659_R2021b_B.DataTypeConversion1_a "" FLOAT64_IEEE speedgoat_test_SN5659_R2021b_CM_double 0 0 -1.7E+308 1.7E+308 ECU_ADDRESS 0x00948058 /end MEASUREMENT
/begin MEASUREMENT speedgoat_test_SN5659_R2021b_B.DataTypeConversion1_d "" FLOAT64_IEEE speedgoat_test_SN5659_R2021b_CM_double 0 0 -1.7E+308 1.7E+308 ECU_ADDRESS 0x00947FB8 /end MEASUREMENT
/begin MEASUREMENT speedgoat_test_SN5659_R2021b_B.DataTypeConversion1_ga "" FLOAT64_IEEE speedgoat_test_SN5659_R2021b_CM_double 0 0 -1.7E+308 1.7E+308 ECU_ADDRESS 0x00947F68 /end MEASUREMENT
/begin MEASUREMENT speedgoat_test_SN5659_R2021b_B.DataTypeConversion1_gm "" FLOAT64_IEEE speedgoat_test_SN5659_R2021b_CM_double 0 0 -1.7E+308 1.7E+308 ECU_ADDRESS 0x00947F18 /end MEASUREMENT
/begin MEASUREMENT speedgoat_test_SN5659_R2021b_B.DataTypeConversion1_l "" FLOAT64_IEEE speedgoat_test_SN5659_R2021b_CM_double 0 0 -1.7E+308 1.7E+308 ECU_ADDRESS 0x00948008 /end MEASUREMENT
/begin MEASUREMENT speedgoat_test_SN5659_R2021b_B.DataTypeConversion1_n "" FLOAT64_IEEE speedgoat_test_SN5659_R2021b_CM_double 0 0 -1.7E+308 1.7E+308 ECU_ADDRESS 0x00947EC8 /end MEASUREMENT
/begin MEASUREMENT speedgoat_test_SN5659_R2021b_B.DataTypeConversion_b "" ULONG speedgoat_test_SN5659_R2021b_CM_uint32 0 0 0 2147483646 ECU_ADDRESS 0x009482D0 /end MEASUREMENT
/begin MEASUREMENT speedgoat_test_SN5659_R2021b_B.DataTypeConversion_bh "" ULONG speedgoat_test_SN5659_R2021b_CM_uint32 0 0 0 2147483646 ECU_ADDRESS 0x00948320 /end MEASUREMENT
/begin MEASUREMENT speedgoat_test_SN5659_R2021b_B.DataTypeConversion_d "" FLOAT64_IEEE speedgoat_test_SN5659_R2021b_CM_double 0 0 -1.7E+308 1.7E+308 ECU_ADDRESS 0x00947F38 /end MEASUREMENT
/begin MEASUREMENT speedgoat_test_SN5659_R2021b_B.DataTypeConversion_dd "" FLOAT64_IEEE speedgoat_test_SN5659_R2021b_CM_double 0 0 -1.7E+308 1.7E+308 ECU_ADDRESS 0x00948028 /end MEASUREMENT
/begin MEASUREMENT speedgoat_test_SN5659_R2021b_B.DataTypeConversion_er "" ULONG speedgoat_test_SN5659_R2021b_CM_uint32 0 0 0 2147483646 ECU_ADDRESS 0x009482E4 /end MEASUREMENT
/begin MEASUREMENT speedgoat_test_SN5659_R2021b_B.DataTypeConversion_f5 "" ULONG speedgoat_test_SN5659_R2021b_CM_uint32 0 0 0 2147483646 ECU_ADDRESS 0x0094830C /end MEASUREMENT
/begin MEASUREMENT speedgoat_test_SN5659_R2021b_B.DataTypeConversion_fb "" ULONG speedgoat_test_SN5659_R2021b_CM_uint32 0 0 0 2147483646 ECU_ADDRESS 0x009482F8 /end MEASUREMENT
/begin MEASUREMENT speedgoat_test_SN5659_R2021b_B.DataTypeConversion_hu "" FLOAT64_IEEE speedgoat_test_SN5659_R2021b_CM_double 0 0 -1.7E+308 1.7E+308 ECU_ADDRESS 0x00947FD8 /end MEASUREMENT
/begin MEASUREMENT speedgoat_test_SN5659_R2021b_B.DataTypeConversion_jr "" FLOAT64_IEEE speedgoat_test_SN5659_R2021b_CM_double 0 0 -1.7E+308 1.7E+308 ECU_ADDRESS 0x00947F88 /end MEASUREMENT
/begin MEASUREMENT speedgoat_test_SN5659_R2021b_B.DataTypeConversion_k5 "" ULONG speedgoat_test_SN5659_R2021b_CM_uint32 0 0 0 2147483646 ECU_ADDRESS 0x00948280 /end MEASUREMENT
/begin MEASUREMENT speedgoat_test_SN5659_R2021b_B.DataTypeConversion_l "" ULONG speedgoat_test_SN5659_R2021b_CM_uint32 0 0 0 2147483646 ECU_ADDRESS 0x00948334 /end MEASUREMENT
/begin MEASUREMENT speedgoat_test_SN5659_R2021b_B.DataTypeConversion_o "" FLOAT64_IEEE speedgoat_test_SN5659_R2021b_CM_double 0 0 -1.7E+308 1.7E+308 ECU_ADDRESS 0x00947EE8 /end MEASUREMENT
/begin MEASUREMENT speedgoat_test_SN5659_R2021b_B.DataTypeConversion_p "" FLOAT64_IEEE speedgoat_test_SN5659_R2021b_CM_double 0 0 -1.7E+308 1.7E+308 ECU_ADDRESS 0x00947E98 /end MEASUREMENT
/begin MEASUREMENT speedgoat_test_SN5659_R2021b_B.Divide "" FLOAT64_IEEE speedgoat_test_SN5659_R2021b_CM_double 0 0 -1.7E+308 1.7E+308 ECU_ADDRESS 0x00947D78 /end MEASUREMENT
/begin MEASUREMENT speedgoat_test_SN5659_R2021b_B.Divide_g "" FLOAT64_IEEE speedgoat_test_SN5659_R2021b_CM_double 0 0 -1.7E+308 1.7E+308 ECU_ADDRESS 0x00947F58 /end MEASUREMENT
/begin MEASUREMENT speedgoat_test_SN5659_R2021b_B.Divide_g4 "" FLOAT64_IEEE speedgoat_test_SN5659_R2021b_CM_double 0 0 -1.7E+308 1.7E+308 ECU_ADDRESS 0x00947FF8 /end MEASUREMENT
/begin MEASUREMENT speedgoat_test_SN5659_R2021b_B.Divide_i "" FLOAT64_IEEE speedgoat_test_SN5659_R2021b_CM_double 0 0 -1.7E+308 1.7E+308 ECU_ADDRESS 0x00947EB8 /end MEASUREMENT
/begin MEASUREMENT speedgoat_test_SN5659_R2021b_B.Divide_j "" FLOAT64_IEEE speedgoat_test_SN5659_R2021b_CM_double 0 0 -1.7E+308 1.7E+308 ECU_ADDRESS 0x00947F08 /end MEASUREMENT
/begin MEASUREMENT speedgoat_test_SN5659_R2021b_B.Divide_k3 "" FLOAT64_IEEE speedgoat_test_SN5659_R2021b_CM_double 0 0 -1.7E+308 1.7E+308 ECU_ADDRESS 0x00947FA8 /end MEASUREMENT
/begin MEASUREMENT speedgoat_test_SN5659_R2021b_B.Divide_n "" FLOAT64_IEEE speedgoat_test_SN5659_R2021b_CM_double 0 0 -1.7E+308 1.7E+308 ECU_ADDRESS 0x00948048 /end MEASUREMENT
/begin MEASUREMENT speedgoat_test_SN5659_R2021b_B.Encode1_f0 "" FLOAT64_IEEE speedgoat_test_SN5659_R2021b_CM_double 0 0 -1.7E+308 1.7E+308 ECU_ADDRESS 0x00948020 /end MEASUREMENT
/begin MEASUREMENT speedgoat_test_SN5659_R2021b_B.Encode1_h "" FLOAT64_IEEE speedgoat_test_SN5659_R2021b_CM_double 0 0 -1.7E+308 1.7E+308 ECU_ADDRESS 0x00947FD0 /end MEASUREMENT
/begin MEASUREMENT speedgoat_test_SN5659_R2021b_B.Encode1_l "" FLOAT64_IEEE speedgoat_test_SN5659_R2021b_CM_double 0 0 -1.7E+308 1.7E+308 ECU_ADDRESS 0x00947E90 /end MEASUREMENT
/begin MEASUREMENT speedgoat_test_SN5659_R2021b_B.Encode1_p "" FLOAT64_IEEE speedgoat_test_SN5659_R2021b_CM_double 0 0 -1.7E+308 1.7E+308 ECU_ADDRESS 0x00947EE0 /end MEASUREMENT
/begin MEASUREMENT speedgoat_test_SN5659_R2021b_B.Encode1_pb "" FLOAT64_IEEE speedgoat_test_SN5659_R2021b_CM_double 0 0 -1.7E+308 1.7E+308 ECU_ADDRESS 0x00947F30 /end MEASUREMENT
/begin MEASUREMENT speedgoat_test_SN5659_R2021b_B.Encode1_pbz "" FLOAT64_IEEE speedgoat_test_SN5659_R2021b_CM_double 0 0 -1.7E+308 1.7E+308 ECU_ADDRESS 0x00947F80 /end MEASUREMENT
/begin MEASUREMENT speedgoat_test_SN5659_R2021b_B.Encode2_fb "" FLOAT64_IEEE speedgoat_test_SN5659_R2021b_CM_double 0 0 -1.7E+308 1.7E+308 ECU_ADDRESS 0x00947FE0 /end MEASUREMENT
/begin MEASUREMENT speedgoat_test_SN5659_R2021b_B.Encode2_fi "" FLOAT64_IEEE speedgoat_test_SN5659_R2021b_CM_double 0 0 -1.7E+308 1.7E+308 ECU_ADDRESS 0x00947EF0 /end MEASUREMENT
/begin MEASUREMENT speedgoat_test_SN5659_R2021b_B.Encode2_h "" FLOAT64_IEEE speedgoat_test_SN5659_R2021b_CM_double 0 0 -1.7E+308 1.7E+308 ECU_ADDRESS 0x00947F40 /end MEASUREMENT
/begin MEASUREMENT speedgoat_test_SN5659_R2021b_B.Encode2_hc "" FLOAT64_IEEE speedgoat_test_SN5659_R2021b_CM_double 0 0 -1.7E+308 1.7E+308 ECU_ADDRESS 0x00947F90 /end MEASUREMENT
/begin MEASUREMENT speedgoat_test_SN5659_R2021b_B.Encode2_iu "" FLOAT64_IEEE speedgoat_test_SN5659_R2021b_CM_double 0 0 -1.7E+308 1.7E+308 ECU_ADDRESS 0x00948030 /end MEASUREMENT
/begin MEASUREMENT speedgoat_test_SN5659_R2021b_B.Encode2_j "" FLOAT64_IEEE speedgoat_test_SN5659_R2021b_CM_double 0 0 -1.7E+308 1.7E+308 ECU_ADDRESS 0x00947ED0 /end MEASUREMENT
/begin MEASUREMENT speedgoat_test_SN5659_R2021b_B.Encode3_d "" FLOAT64_IEEE speedgoat_test_SN5659_R2021b_CM_double 0 0 -1.7E+308 1.7E+308 ECU_ADDRESS 0x00947FF0 /end MEASUREMENT
/begin MEASUREMENT speedgoat_test_SN5659_R2021b_B.Encode3_f "" FLOAT64_IEEE speedgoat_test_SN5659_R2021b_CM_double 0 0 -1.7E+308 1.7E+308 ECU_ADDRESS 0x00947F00 /end MEASUREMENT
/begin MEASUREMENT speedgoat_test_SN5659_R2021b_B.Encode3_ik "" FLOAT64_IEEE speedgoat_test_SN5659_R2021b_CM_double 0 0 -1.7E+308 1.7E+308 ECU_ADDRESS 0x00948040 /end MEASUREMENT
/begin MEASUREMENT speedgoat_test_SN5659_R2021b_B.Encode3_l "" FLOAT64_IEEE speedgoat_test_SN5659_R2021b_CM_double 0 0 -1.7E+308 1.7E+308 ECU_ADDRESS 0x00947F50 /end MEASUREMENT
/begin MEASUREMENT speedgoat_test_SN5659_R2021b_B.Encode3_ou "" FLOAT64_IEEE speedgoat_test_SN5659_R2021b_CM_double 0 0 -1.7E+308 1.7E+308 ECU_ADDRESS 0x00947FA0 /end MEASUREMENT
/begin MEASUREMENT speedgoat_test_SN5659_R2021b_B.Encode3_p "" FLOAT64_IEEE speedgoat_test_SN5659_R2021b_CM_double 0 0 -1.7E+308 1.7E+308 ECU_ADDRESS 0x00947EB0 /end MEASUREMENT
/begin MEASUREMENT speedgoat_test_SN5659_R2021b_B.Encode4_g "" FLOAT64_IEEE speedgoat_test_SN5659_R2021b_CM_double 0 0 -1.7E+308 1.7E+308 ECU_ADDRESS 0x00947F20 /end MEASUREMENT
/begin MEASUREMENT speedgoat_test_SN5659_R2021b_B.Encode4_ix "" FLOAT64_IEEE speedgoat_test_SN5659_R2021b_CM_double 0 0 -1.7E+308 1.7E+308 ECU_ADDRESS 0x00948060 /end MEASUREMENT
/begin MEASUREMENT speedgoat_test_SN5659_R2021b_B.Encode4_l "" FLOAT64_IEEE speedgoat_test_SN5659_R2021b_CM_double 0 0 -1.7E+308 1.7E+308 ECU_ADDRESS 0x00947F70 /end MEASUREMENT
/begin MEASUREMENT speedgoat_test_SN5659_R2021b_B.Encode4_n "" FLOAT64_IEEE speedgoat_test_SN5659_R2021b_CM_double 0 0 -1.7E+308 1.7E+308 ECU_ADDRESS 0x00948010 /end MEASUREMENT
/begin MEASUREMENT speedgoat_test_SN5659_R2021b_B.Encode4_p "" FLOAT64_IEEE speedgoat_test_SN5659_R2021b_CM_double 0 0 -1.7E+308 1.7E+308 ECU_ADDRESS 0x00947FC0 /end MEASUREMENT
/begin MEASUREMENT speedgoat_test_SN5659_R2021b_B.Encode5_d "" FLOAT64_IEEE speedgoat_test_SN5659_R2021b_CM_double 0 0 -1.7E+308 1.7E+308 ECU_ADDRESS 0x00947EA0 /end MEASUREMENT
/begin MEASUREMENT speedgoat_test_SN5659_R2021b_B.FixPtSum1_d "" UWORD speedgoat_test_SN5659_R2021b_CM_uint16 0 0 0 65535 ECU_ADDRESS 0x009483E6 /end MEASUREMENT
/begin MEASUREMENT speedgoat_test_SN5659_R2021b_B.FixPtSum1_e "" UWORD speedgoat_test_SN5659_R2021b_CM_uint16 0 0 0 65535 ECU_ADDRESS 0x009483DA /end MEASUREMENT
/begin MEASUREMENT speedgoat_test_SN5659_R2021b_B.FixPtSum1_fe "" UBYTE speedgoat_test_SN5659_R2021b_CM_uint8 0 0 0 255 ECU_ADDRESS 0x00948418 /end MEASUREMENT
/begin MEASUREMENT speedgoat_test_SN5659_R2021b_B.FixPtSum1_g "" UWORD speedgoat_test_SN5659_R2021b_CM_uint16 0 0 0 65535 ECU_ADDRESS 0x009483D4 /end MEASUREMENT
/begin MEASUREMENT speedgoat_test_SN5659_R2021b_B.FixPtSum1_h "" UWORD speedgoat_test_SN5659_R2021b_CM_uint16 0 0 0 65535 ECU_ADDRESS 0x009483EC /end MEASUREMENT
/begin MEASUREMENT speedgoat_test_SN5659_R2021b_B.FixPtSum1_i "" UBYTE speedgoat_test_SN5659_R2021b_CM_uint8 0 0 0 255 ECU_ADDRESS 0x00948415 /end MEASUREMENT
/begin MEASUREMENT speedgoat_test_SN5659_R2021b_B.FixPtSum1_o "" UWORD speedgoat_test_SN5659_R2021b_CM_uint16 0 0 0 65535 ECU_ADDRESS 0x009483E0 /end MEASUREMENT
/begin MEASUREMENT speedgoat_test_SN5659_R2021b_B.FixPtSwitch_bx "" UWORD speedgoat_test_SN5659_R2021b_CM_uint16 0 0 0 65535 ECU_ADDRESS 0x009483DC /end MEASUREMENT
/begin MEASUREMENT speedgoat_test_SN5659_R2021b_B.FixPtSwitch_d "" UWORD speedgoat_test_SN5659_R2021b_CM_uint16 0 0 0 65535 ECU_ADDRESS 0x009483EE /end MEASUREMENT
/begin MEASUREMENT speedgoat_test_SN5659_R2021b_B.FixPtSwitch_ha "" UBYTE speedgoat_test_SN5659_R2021b_CM_uint8 0 0 0 255 ECU_ADDRESS 0x00948416 /end MEASUREMENT
/begin MEASUREMENT speedgoat_test_SN5659_R2021b_B.FixPtSwitch_jo "" UBYTE speedgoat_test_SN5659_R2021b_CM_uint8 0 0 0 255 ECU_ADDRESS 0x00948419 /end MEASUREMENT
/begin MEASUREMENT speedgoat_test_SN5659_R2021b_B.FixPtSwitch_l "" UWORD speedgoat_test_SN5659_R2021b_CM_uint16 0 0 0 65535 ECU_ADDRESS 0x009483D6 /end MEASUREMENT
/begin MEASUREMENT speedgoat_test_SN5659_R2021b_B.FixPtSwitch_l2 "" UWORD speedgoat_test_SN5659_R2021b_CM_uint16 0 0 0 65535 ECU_ADDRESS 0x009483E8 /end MEASUREMENT
/begin MEASUREMENT speedgoat_test_SN5659_R2021b_B.FixPtSwitch_lo "" UWORD speedgoat_test_SN5659_R2021b_CM_uint16 0 0 0 65535 ECU_ADDRESS 0x009483E2 /end MEASUREMENT
/begin MEASUREMENT speedgoat_test_SN5659_R2021b_B.Mask "" ULONG speedgoat_test_SN5659_R2021b_CM_uint32 0 0 0 2147483646 ECU_ADDRESS 0x00948284 /end MEASUREMENT
/begin MEASUREMENT speedgoat_test_SN5659_R2021b_B.Mask_c "" ULONG speedgoat_test_SN5659_R2021b_CM_uint32 0 0 0 2147483646 ECU_ADDRESS 0x009482D4 /end MEASUREMENT
/begin MEASUREMENT speedgoat_test_SN5659_R2021b_B.Mask_d "" ULONG speedgoat_test_SN5659_R2021b_CM_uint32 0 0 0 2147483646 ECU_ADDRESS 0x00948324 /end MEASUREMENT
/begin MEASUREMENT speedgoat_test_SN5659_R2021b_B.Mask_h "" ULONG speedgoat_test_SN5659_R2021b_CM_uint32 0 0 0 2147483646 ECU_ADDRESS 0x009482FC /end MEASUREMENT
/begin MEASUREMENT speedgoat_test_SN5659_R2021b_B.Mask_h0 "" ULONG speedgoat_test_SN5659_R2021b_CM_uint32 0 0 0 2147483646 ECU_ADDRESS 0x00948310 /end MEASUREMENT
/begin MEASUREMENT speedgoat_test_SN5659_R2021b_B.Mask_k "" ULONG speedgoat_test_SN5659_R2021b_CM_uint32 0 0 0 2147483646 ECU_ADDRESS 0x00948338 /end MEASUREMENT
/begin MEASUREMENT speedgoat_test_SN5659_R2021b_B.Mask_m "" ULONG speedgoat_test_SN5659_R2021b_CM_uint32 0 0 0 2147483646 ECU_ADDRESS 0x009482E8 /end MEASUREMENT
/begin MEASUREMENT speedgoat_test_SN5659_R2021b_B.Multiply "" FLOAT64_IEEE speedgoat_test_SN5659_R2021b_CM_double 0 0 -1.7E+308 1.7E+308 ECU_ADDRESS 0x00947D80 /end MEASUREMENT
/begin MEASUREMENT speedgoat_test_SN5659_R2021b_B.Multiply_e "" FLOAT64_IEEE speedgoat_test_SN5659_R2021b_CM_double 0 0 -1.7E+308 1.7E+308 ECU_ADDRESS 0x00948050 /end MEASUREMENT
/begin MEASUREMENT speedgoat_test_SN5659_R2021b_B.Multiply_hd "" FLOAT64_IEEE speedgoat_test_SN5659_R2021b_CM_double 0 0 -1.7E+308 1.7E+308 ECU_ADDRESS 0x00947FB0 /end MEASUREMENT
/begin MEASUREMENT speedgoat_test_SN5659_R2021b_B.Multiply_he "" FLOAT64_IEEE speedgoat_test_SN5659_R2021b_CM_double 0 0 -1.7E+308 1.7E+308 ECU_ADDRESS 0x00947EC0 /end MEASUREMENT
/begin MEASUREMENT speedgoat_test_SN5659_R2021b_B.Multiply_i "" FLOAT64_IEEE speedgoat_test_SN5659_R2021b_CM_double 0 0 -1.7E+308 1.7E+308 ECU_ADDRESS 0x00947F10 /end MEASUREMENT
/begin MEASUREMENT speedgoat_test_SN5659_R2021b_B.Multiply_il "" FLOAT64_IEEE speedgoat_test_SN5659_R2021b_CM_double 0 0 -1.7E+308 1.7E+308 ECU_ADDRESS 0x00948000 /end MEASUREMENT
/begin MEASUREMENT speedgoat_test_SN5659_R2021b_B.Multiply_n "" FLOAT64_IEEE speedgoat_test_SN5659_R2021b_CM_double 0 0 -1.7E+308 1.7E+308 ECU_ADDRESS 0x00947F60 /end MEASUREMENT
/begin MEASUREMENT speedgoat_test_SN5659_R2021b_B.Output_b2 "" UWORD speedgoat_test_SN5659_R2021b_CM_uint16 0 0 0 65535 ECU_ADDRESS 0x009483EA /end MEASUREMENT
/begin MEASUREMENT speedgoat_test_SN5659_R2021b_B.Output_e "" UWORD speedgoat_test_SN5659_R2021b_CM_uint16 0 0 0 65535 ECU_ADDRESS 0x009483DE /end MEASUREMENT
/begin MEASUREMENT speedgoat_test_SN5659_R2021b_B.Output_g "" UBYTE speedgoat_test_SN5659_R2021b_CM_uint8 0 0 0 255 ECU_ADDRESS 0x00948417 /end MEASUREMENT
/begin MEASUREMENT speedgoat_test_SN5659_R2021b_B.Output_j "" UWORD speedgoat_test_SN5659_R2021b_CM_uint16 0 0 0 65535 ECU_ADDRESS 0x009483D2 /end MEASUREMENT
/begin MEASUREMENT speedgoat_test_SN5659_R2021b_B.Output_k "" UWORD speedgoat_test_SN5659_R2021b_CM_uint16 0 0 0 65535 ECU_ADDRESS 0x009483E4 /end MEASUREMENT
/begin MEASUREMENT speedgoat_test_SN5659_R2021b_B.Output_m "" UWORD speedgoat_test_SN5659_R2021b_CM_uint16 0 0 0 65535 ECU_ADDRESS 0x009483D8 /end MEASUREMENT
/begin MEASUREMENT speedgoat_test_SN5659_R2021b_B.Randomnumber_br "" FLOAT64_IEEE speedgoat_test_SN5659_R2021b_CM_double 0 0 -1.7E+308 1.7E+308 ECU_ADDRESS 0x00947F78 /end MEASUREMENT
/begin MEASUREMENT speedgoat_test_SN5659_R2021b_B.Randomnumber_e "" FLOAT64_IEEE speedgoat_test_SN5659_R2021b_CM_double 0 0 -1.7E+308 1.7E+308 ECU_ADDRESS 0x00947FC8 /end MEASUREMENT
/begin MEASUREMENT speedgoat_test_SN5659_R2021b_B.Randomnumber_f "" FLOAT64_IEEE speedgoat_test_SN5659_R2021b_CM_double 0 0 -1.7E+308 1.7E+308 ECU_ADDRESS 0x00948018 /end MEASUREMENT
/begin MEASUREMENT speedgoat_test_SN5659_R2021b_B.Randomnumber_m "" FLOAT64_IEEE speedgoat_test_SN5659_R2021b_CM_double 0 0 -1.7E+308 1.7E+308 ECU_ADDRESS 0x00947F28 /end MEASUREMENT
/begin MEASUREMENT speedgoat_test_SN5659_R2021b_B.Randomnumber_n "" FLOAT64_IEEE speedgoat_test_SN5659_R2021b_CM_double 0 0 -1.7E+308 1.7E+308 ECU_ADDRESS 0x00947ED8 /end MEASUREMENT
/begin MEASUREMENT speedgoat_test_SN5659_R2021b_B.Randomnumber_pz "" FLOAT64_IEEE speedgoat_test_SN5659_R2021b_CM_double 0 0 -1.7E+308 1.7E+308 ECU_ADDRESS 0x00947E88 /end MEASUREMENT
/begin MEASUREMENT speedgoat_test_SN5659_R2021b_B.ShifttoSDIslot "" ULONG speedgoat_test_SN5659_R2021b_CM_uint32 0 0 0 2147483646 ECU_ADDRESS 0x0094828C /end MEASUREMENT
/begin MEASUREMENT speedgoat_test_SN5659_R2021b_B.ShifttoSDIslot_b "" ULONG speedgoat_test_SN5659_R2021b_CM_uint32 0 0 0 2147483646 ECU_ADDRESS 0x009482DC /end MEASUREMENT
/begin MEASUREMENT speedgoat_test_SN5659_R2021b_B.ShifttoSDIslot_c "" ULONG speedgoat_test_SN5659_R2021b_CM_uint32 0 0 0 2147483646 ECU_ADDRESS 0x00948304 /end MEASUREMENT
/begin MEASUREMENT speedgoat_test_SN5659_R2021b_B.ShifttoSDIslot_g "" ULONG speedgoat_test_SN5659_R2021b_CM_uint32 0 0 0 2147483646 ECU_ADDRESS 0x0094832C /end MEASUREMENT
/begin MEASUREMENT speedgoat_test_SN5659_R2021b_B.ShifttoSDIslot_km "" ULONG speedgoat_test_SN5659_R2021b_CM_uint32 0 0 0 2147483646 ECU_ADDRESS 0x009482F0 /end MEASUREMENT
/begin MEASUREMENT speedgoat_test_SN5659_R2021b_B.ShifttoSDIslot_m "" ULONG speedgoat_test_SN5659_R2021b_CM_uint32 0 0 0 2147483646 ECU_ADDRESS 0x00948318 /end MEASUREMENT
/begin MEASUREMENT speedgoat_test_SN5659_R2021b_B.ShifttoSDIslot_n "" ULONG speedgoat_test_SN5659_R2021b_CM_uint32 0 0 0 2147483646 ECU_ADDRESS 0x00948340 /end MEASUREMENT
/begin MEASUREMENT speedgoat_test_SN5659_R2021b_B.ShifttoSSMslot "" ULONG speedgoat_test_SN5659_R2021b_CM_uint32 0 0 0 2147483646 ECU_ADDRESS 0x00948288 /end MEASUREMENT
/begin MEASUREMENT speedgoat_test_SN5659_R2021b_B.ShifttoSSMslot_f "" ULONG speedgoat_test_SN5659_R2021b_CM_uint32 0 0 0 2147483646 ECU_ADDRESS 0x00948300 /end MEASUREMENT
/begin MEASUREMENT speedgoat_test_SN5659_R2021b_B.ShifttoSSMslot_g "" ULONG speedgoat_test_SN5659_R2021b_CM_uint32 0 0 0 2147483646 ECU_ADDRESS 0x00948328 /end MEASUREMENT
/begin MEASUREMENT speedgoat_test_SN5659_R2021b_B.ShifttoSSMslot_k "" ULONG speedgoat_test_SN5659_R2021b_CM_uint32 0 0 0 2147483646 ECU_ADDRESS 0x009482D8 /end MEASUREMENT
/begin MEASUREMENT speedgoat_test_SN5659_R2021b_B.ShifttoSSMslot_kz "" ULONG speedgoat_test_SN5659_R2021b_CM_uint32 0 0 0 2147483646 ECU_ADDRESS 0x0094833C /end MEASUREMENT
/begin MEASUREMENT speedgoat_test_SN5659_R2021b_B.ShifttoSSMslot_m3 "" ULONG speedgoat_test_SN5659_R2021b_CM_uint32 0 0 0 2147483646 ECU_ADDRESS 0x00948314 /end MEASUREMENT
/begin MEASUREMENT speedgoat_test_SN5659_R2021b_B.ShifttoSSMslot_mi "" ULONG speedgoat_test_SN5659_R2021b_CM_uint32 0 0 0 2147483646 ECU_ADDRESS 0x009482EC /end MEASUREMENT
/begin MEASUREMENT speedgoat_test_SN5659_R2021b_B.Sinewave_a "" FLOAT64_IEEE speedgoat_test_SN5659_R2021b_CM_double 0 0 -1.7E+308 1.7E+308 ECU_ADDRESS 0x00947F98 /end MEASUREMENT
/begin MEASUREMENT speedgoat_test_SN5659_R2021b_B.Sinewave_g "" FLOAT64_IEEE speedgoat_test_SN5659_R2021b_CM_double 0 0 -1.7E+308 1.7E+308 ECU_ADDRESS 0x00947EF8 /end MEASUREMENT
/begin MEASUREMENT speedgoat_test_SN5659_R2021b_B.Sinewave_kh "" FLOAT64_IEEE speedgoat_test_SN5659_R2021b_CM_double 0 0 -1.7E+308 1.7E+308 ECU_ADDRESS 0x00947F48 /end MEASUREMENT
/begin MEASUREMENT speedgoat_test_SN5659_R2021b_B.Sinewave_o5 "" FLOAT64_IEEE speedgoat_test_SN5659_R2021b_CM_double 0 0 -1.7E+308 1.7E+308 ECU_ADDRESS 0x00947FE8 /end MEASUREMENT
/begin MEASUREMENT speedgoat_test_SN5659_R2021b_B.Sinewave_oh "" FLOAT64_IEEE speedgoat_test_SN5659_R2021b_CM_double 0 0 -1.7E+308 1.7E+308 ECU_ADDRESS 0x00948038 /end MEASUREMENT
/begin MEASUREMENT speedgoat_test_SN5659_R2021b_B.Sinewave_p "" FLOAT64_IEEE speedgoat_test_SN5659_R2021b_CM_double 0 0 -1.7E+308 1.7E+308 ECU_ADDRESS 0x00947EA8 /end MEASUREMENT
/begin MEASUREMENT speedgoat_test_SN5659_R2021b_DW.NextOutput_ft "" FLOAT64_IEEE speedgoat_test_SN5659_R2021b_CM_double 0 0 -1.7E+308 1.7E+308 ECU_ADDRESS 0x00945130 /end MEASUREMENT
/begin MEASUREMENT speedgoat_test_SN5659_R2021b_DW.NextOutput_i "" FLOAT64_IEEE speedgoat_test_SN5659_R2021b_CM_double 0 0 -1.7E+308 1.7E+308 ECU_ADDRESS 0x00945148 /end MEASUREMENT
/begin MEASUREMENT speedgoat_test_SN5659_R2021b_DW.NextOutput_j "" FLOAT64_IEEE speedgoat_test_SN5659_R2021b_CM_double 0 0 -1.7E+308 1.7E+308 ECU_ADDRESS 0x00945160 /end MEASUREMENT
/begin MEASUREMENT speedgoat_test_SN5659_R2021b_DW.NextOutput_m "" FLOAT64_IEEE speedgoat_test_SN5659_R2021b_CM_double 0 0 -1.7E+308 1.7E+308 ECU_ADDRESS 0x00945178 /end MEASUREMENT
/begin MEASUREMENT speedgoat_test_SN5659_R2021b_DW.NextOutput_ni "" FLOAT64_IEEE speedgoat_test_SN5659_R2021b_CM_double 0 0 -1.7E+308 1.7E+308 ECU_ADDRESS 0x00945118 /end MEASUREMENT
/begin MEASUREMENT speedgoat_test_SN5659_R2021b_DW.NextOutput_nj "" FLOAT64_IEEE speedgoat_test_SN5659_R2021b_CM_double 0 0 -1.7E+308 1.7E+308 ECU_ADDRESS 0x00945100 /end MEASUREMENT
/begin MEASUREMENT speedgoat_test_SN5659_R2021b_DW.Output_DSTATE_c "" UBYTE speedgoat_test_SN5659_R2021b_CM_uint8 0 0 0 255 ECU_ADDRESS 0x00945D8C /end MEASUREMENT
/begin MEASUREMENT speedgoat_test_SN5659_R2021b_DW.Output_DSTATE_e "" UWORD speedgoat_test_SN5659_R2021b_CM_uint16 0 0 0 65535 ECU_ADDRESS 0x00945D7A /end MEASUREMENT
/begin MEASUREMENT speedgoat_test_SN5659_R2021b_DW.Output_DSTATE_e0 "" UBYTE speedgoat_test_SN5659_R2021b_CM_uint8 0 0 0 255 ECU_ADDRESS 0x00945D8D /end MEASUREMENT
/begin MEASUREMENT speedgoat_test_SN5659_R2021b_DW.Output_DSTATE_g "" UWORD speedgoat_test_SN5659_R2021b_CM_uint16 0 0 0 65535 ECU_ADDRESS 0x00945D7E /end MEASUREMENT
/begin MEASUREMENT speedgoat_test_SN5659_R2021b_DW.Output_DSTATE_k "" UWORD speedgoat_test_SN5659_R2021b_CM_uint16 0 0 0 65535 ECU_ADDRESS 0x00945D7C /end MEASUREMENT
/begin MEASUREMENT speedgoat_test_SN5659_R2021b_DW.Output_DSTATE_m "" UWORD speedgoat_test_SN5659_R2021b_CM_uint16 0 0 0 65535 ECU_ADDRESS 0x00945D76 /end MEASUREMENT
/begin MEASUREMENT speedgoat_test_SN5659_R2021b_DW.Output_DSTATE_oy "" UWORD speedgoat_test_SN5659_R2021b_CM_uint16 0 0 0 65535 ECU_ADDRESS 0x00945D78 /end MEASUREMENT
/begin MEASUREMENT speedgoat_test_SN5659_R2021b_DW.RandSeed_b "" ULONG speedgoat_test_SN5659_R2021b_CM_uint32 0 0 0 2147483646 ECU_ADDRESS 0x00945ABC /end MEASUREMENT
/begin MEASUREMENT speedgoat_test_SN5659_R2021b_DW.RandSeed_d "" ULONG speedgoat_test_SN5659_R2021b_CM_uint32 0 0 0 2147483646 ECU_ADDRESS 0x00945AB8 /end MEASUREMENT
/begin MEASUREMENT speedgoat_test_SN5659_R2021b_DW.RandSeed_f "" ULONG speedgoat_test_SN5659_R2021b_CM_uint32 0 0 0 2147483646 ECU_ADDRESS 0x00945AAC /end MEASUREMENT
/begin MEASUREMENT speedgoat_test_SN5659_R2021b_DW.RandSeed_f4 "" ULONG speedgoat_test_SN5659_R2021b_CM_uint32 0 0 0 2147483646 ECU_ADDRESS 0x00945AB0 /end MEASUREMENT
/begin MEASUREMENT speedgoat_test_SN5659_R2021b_DW.RandSeed_g "" ULONG speedgoat_test_SN5659_R2021b_CM_uint32 0 0 0 2147483646 ECU_ADDRESS 0x00945AA8 /end MEASUREMENT
/begin MEASUREMENT speedgoat_test_SN5659_R2021b_DW.RandSeed_i "" ULONG speedgoat_test_SN5659_R2021b_CM_uint32 0 0 0 2147483646 ECU_ADDRESS 0x00945AB4 /end MEASUREMENT
/begin MEASUREMENT speedgoat_test_SN5659_R2021b_DW.lastCos_af "" FLOAT64_IEEE speedgoat_test_SN5659_R2021b_CM_double 0 0 -1.7E+308 1.7E+308 ECU_ADDRESS 0x00945110 /end MEASUREMENT
/begin MEASUREMENT speedgoat_test_SN5659_R2021b_DW.lastCos_gg "" FLOAT64_IEEE speedgoat_test_SN5659_R2021b_CM_double 0 0 -1.7E+308 1.7E+308 ECU_ADDRESS 0x00945188 /end MEASUREMENT
/begin MEASUREMENT speedgoat_test_SN5659_R2021b_DW.lastCos_ht "" FLOAT64_IEEE speedgoat_test_SN5659_R2021b_CM_double 0 0 -1.7E+308 1.7E+308 ECU_ADDRESS 0x00945128 /end MEASUREMENT
/begin MEASUREMENT speedgoat_test_SN5659_R2021b_DW.lastCos_l "" FLOAT64_IEEE speedgoat_test_SN5659_R2021b_CM_double 0 0 -1.7E+308 1.7E+308 ECU_ADDRESS 0x00945140 /end MEASUREMENT
/begin MEASUREMENT speedgoat_test_SN5659_R2021b_DW.lastCos_ld "" FLOAT64_IEEE speedgoat_test_SN5659_R2021b_CM_double 0 0 -1.7E+308 1.7E+308 ECU_ADDRESS 0x00945158 /end MEASUREMENT
/begin MEASUREMENT speedgoat_test_SN5659_R2021b_DW.lastCos_lh "" FLOAT64_IEEE speedgoat_test_SN5659_R2021b_CM_double 0 0 -1.7E+308 1.7E+308 ECU_ADDRESS 0x00945170 /end MEASUREMENT
/begin MEASUREMENT speedgoat_test_SN5659_R2021b_DW.lastSin_dj "" FLOAT64_IEEE speedgoat_test_SN5659_R2021b_CM_double 0 0 -1.7E+308 1.7E+308 ECU_ADDRESS 0x00945120 /end MEASUREMENT
/begin MEASUREMENT speedgoat_test_SN5659_R2021b_DW.lastSin_du "" FLOAT64_IEEE speedgoat_test_SN5659_R2021b_CM_double 0 0 -1.7E+308 1.7E+308 ECU_ADDRESS 0x00945138 /end MEASUREMENT
/begin MEASUREMENT speedgoat_test_SN5659_R2021b_DW.lastSin_e "" FLOAT64_IEEE speedgoat_test_SN5659_R2021b_CM_double 0 0 -1.7E+308 1.7E+308 ECU_ADDRESS 0x00945168 /end MEASUREMENT
/begin MEASUREMENT speedgoat_test_SN5659_R2021b_DW.lastSin_f "" FLOAT64_IEEE speedgoat_test_SN5659_R2021b_CM_double 0 0 -1.7E+308 1.7E+308 ECU_ADDRESS 0x00945150 /end MEASUREMENT
/begin MEASUREMENT speedgoat_test_SN5659_R2021b_DW.lastSin_p "" FLOAT64_IEEE speedgoat_test_SN5659_R2021b_CM_double 0 0 -1.7E+308 1.7E+308 ECU_ADDRESS 0x00945108 /end MEASUREMENT
/begin MEASUREMENT speedgoat_test_SN5659_R2021b_DW.lastSin_pg "" FLOAT64_IEEE speedgoat_test_SN5659_R2021b_CM_double 0 0 -1.7E+308 1.7E+308 ECU_ADDRESS 0x00945180 /end MEASUREMENT
/begin MEASUREMENT speedgoat_test_SN5659_R2021b_DW.systemEnable_a "" SLONG speedgoat_test_SN5659_R2021b_CM_int32 0 0 -2147483648 2147483647 ECU_ADDRESS 0x00945A6C /end MEASUREMENT
/begin MEASUREMENT speedgoat_test_SN5659_R2021b_DW.systemEnable_bx "" SLONG speedgoat_test_SN5659_R2021b_CM_int32 0 0 -2147483648 2147483647 ECU_ADDRESS 0x00945A78 /end MEASUREMENT
/begin MEASUREMENT speedgoat_test_SN5659_R2021b_DW.systemEnable_j "" SLONG speedgoat_test_SN5659_R2021b_CM_int32 0 0 -2147483648 2147483647 ECU_ADDRESS 0x00945A68 /end MEASUREMENT
/begin MEASUREMENT speedgoat_test_SN5659_R2021b_DW.systemEnable_m "" SLONG speedgoat_test_SN5659_R2021b_CM_int32 0 0 -2147483648 2147483647 ECU_ADDRESS 0x00945A64 /end MEASUREMENT
/begin MEASUREMENT speedgoat_test_SN5659_R2021b_DW.systemEnable_ml "" SLONG speedgoat_test_SN5659_R2021b_CM_int32 0 0 -2147483648 2147483647 ECU_ADDRESS 0x00945A74 /end MEASUREMENT
/begin MEASUREMENT speedgoat_test_SN5659_R2021b_DW.systemEnable_p0 "" SLONG speedgoat_test_SN5659_R2021b_CM_int32 0 0 -2147483648 2147483647 ECU_ADDRESS 0x00945A70 /end MEASUREMENT
/begin COMPU_METHOD speedgoat_test_SN5659_R2021b_CM_double "" IDENTICAL "%15.10" "" /end COMPU_METHOD
/begin COMPU_METHOD speedgoat_test_SN5659_R2021b_CM_int32 "" IDENTICAL "%10.0" "" /end COMPU_METHOD
/begin COMPU_METHOD speedgoat_test_SN5659_R2021b_CM_uint16 "" IDENTICAL "%5.0" "" /end COMPU_METHOD
/begin COMPU_METHOD speedgoat_test_SN5659_R2021b_CM_uint32 "" IDENTICAL "%10.0" "" /end COMPU_METHOD
/begin COMPU_METHOD speedgoat_test_SN5659_R2021b_CM_uint8 "" IDENTICAL "%3.0" "" /end COMPU_METHOD
/begin RECORD_LAYOUT Scalar_BOOLEAN FNC_VALUES 1 UBYTE COLUMN_DIR DIRECT /end RECORD_LAYOUT
/begin RECORD_LAYOUT Scalar_FLOAT64_IEEE FNC_VALUES 1 FLOAT64_IEEE COLUMN_DIR DIRECT /end RECORD_LAYOUT
/begin RECORD_LAYOUT Scalar_UBYTE FNC_VALUES 1 UBYTE COLUMN_DIR DIRECT /end RECORD_LAYOUT
/begin RECORD_LAYOUT Scalar_ULONG FNC_VALUES 1 ULONG COLUMN_DIR DIRECT /end RECORD_LAYOUT
/begin RECORD_LAYOUT Scalar_UWORD FNC_VALUES 1 UWORD COLUMN_DIR DIRECT /end RECORD_LAYOUT
/begin GROUP speedgoat_test_SN5659_R2021b_IO682_Encode_Channel_13 "speedgoat_test_SN5659_R2021b/IO682/Encode Channel 13"
 /begin SUB_GROUP speedgoat_test_SN5659_R2021b_IO682_Encode_Channel_13_Counter_Limited speedgoat_test_SN5659_R2021b_IO682_Encode_Channel_13_Prepare_RAW_value /end SUB_GROUP
 /begin REF_CHARACTERISTIC speedgoat_test_SN5659__cal_impl.Constant_Value_d speedgoat_test_SN5659__cal_impl.Encode1_P10_l speedgoat_test_SN5659__cal_impl.Encode1_P11_bk speedgoat_test_SN5659__cal_impl.Encode1_P12_o speedgoat_test_SN5659__cal_impl.Encode1_P13_o speedgoat_test_SN5659__cal_impl.Encode1_P14_g speedgoat_test_SN5659__cal_impl.Encode1_P15_j speedgoat_test_SN5659__cal_impl.Encode1_P1_g speedgoat_test_SN5659__cal_impl.Encode1_P2_p speedgoat_test_SN5659__cal_impl.Encode1_P3_o0 speedgoat_test_SN5659__cal_impl.Encode1_P4_c speedgoat_test_SN5659__cal_impl.Encode1_P5_oz speedgoat_test_SN5659__cal_impl.Encode1_P6_n5 speedgoat_test_SN5659__cal_impl.Encode1_P7_dz speedgoat_test_SN5659__cal_impl.Encode1_P8_d speedgoat_test_SN5659__cal_impl.Encode1_P9_a speedgoat_test_SN5659__cal_impl.Encode2_P10_g speedgoat_test_SN5659__cal_impl.Encode2_P11_gc speedgoat_test_SN5659__cal_impl.Encode2_P12_me speedgoat_test_SN5659__cal_impl.Encode2_P13_e speedgoat_test_SN5659__cal_impl.Encode2_P14_b speedgoat_test_SN5659__cal_impl.Encode2_P15_k speedgoat_test_SN5659__cal_impl.Encode2_P1_m speedgoat_test_SN5659__cal_impl.Encode2_P2_f speedgoat_test_SN5659__cal_impl.Encode2_P3_g speedgoat_test_SN5659__cal_impl.Encode2_P4_m speedgoat_test_SN5659__cal_impl.Encode2_P5_j speedgoat_test_SN5659__cal_impl.Encode2_P6_m speedgoat_test_SN5659__cal_impl.Encode2_P7_j speedgoat_test_SN5659__cal_impl.Encode2_P8_iw speedgoat_test_SN5659__cal_impl.Encode2_P9_pd speedgoat_test_SN5659__cal_impl.Encode3_P10_l speedgoat_test_SN5659__cal_impl.Encode3_P11_h speedgoat_test_SN5659__cal_impl.Encode3_P12_c speedgoat_test_SN5659__cal_impl.Encode3_P13_e speedgoat_test_SN5659__cal_impl.Encode3_P14_b speedgoat_test_SN5659__cal_impl.Encode3_P15_i speedgoat_test_SN5659__cal_impl.Encode3_P1_i speedgoat_test_SN5659__cal_impl.Encode3_P2_a speedgoat_test_SN5659__cal_impl.Encode3_P3_c speedgoat_test_SN5659__cal_impl.Encode3_P4_ls speedgoat_test_SN5659__cal_impl.Encode3_P5_bo speedgoat_test_SN5659__cal_impl.Encode3_P6_a speedgoat_test_SN5659__cal_impl.Encode3_P7_d speedgoat_test_SN5659__cal_impl.Encode3_P8_k speedgoat_test_SN5659__cal_impl.Encode3_P9_b5 speedgoat_test_SN5659__cal_impl.Encode5_P10_a speedgoat_test_SN5659__cal_impl.Encode5_P11_n speedgoat_test_SN5659__cal_impl.Encode5_P12_m speedgoat_test_SN5659__cal_impl.Encode5_P13_g speedgoat_test_SN5659__cal_impl.Encode5_P14_l speedgoat_test_SN5659__cal_impl.Encode5_P15_c speedgoat_test_SN5659__cal_impl.Encode5_P1_f speedgoat_test_SN5659__cal_impl.Encode5_P2_e speedgoat_test_SN5659__cal_impl.Encode5_P3_m speedgoat_test_SN5659__cal_impl.Encode5_P4_a speedgoat_test_SN5659__cal_impl.Encode5_P5_i speedgoat_test_SN5659__cal_impl.Encode5_P6_d speedgoat_test_SN5659__cal_impl.Encode5_P7_f speedgoat_test_SN5659__cal_impl.Encode5_P8_k speedgoat_test_SN5659__cal_impl.Encode5_P9_l speedgoat_test_SN5659__cal_impl.Randomnumber_Mean_a speedgoat_test_SN5659__cal_impl.Randomnumber_Seed_c speedgoat_test_SN5659__cal_impl.Randomnumber_StdDev_k speedgoat_test_SN5659__cal_impl.Sinewave_Amp_h speedgoat_test_SN5659__cal_impl.Sinewave_Bias_m speedgoat_test_SN5659__cal_impl.Sinewave_Freq_m speedgoat_test_SN5659__cal_impl.Sinewave_HCos_o speedgoat_test_SN5659__cal_impl.Sinewave_Hsin_o speedgoat_test_SN5659__cal_impl.Sinewave_PCos_h speedgoat_test_SN5659__cal_impl.Sinewave_PSin_e /end REF_CHARACTERISTIC
 /begin REF_MEASUREMENT speedgoat_test_SN5659_R2021b_B.DataTypeConversion1_n speedgoat_test_SN5659_R2021b_B.DataTypeConversion_p speedgoat_test_SN5659_R2021b_B.Encode1_l speedgoat_test_SN5659_R2021b_B.Encode2_j speedgoat_test_SN5659_R2021b_B.Encode3_p speedgoat_test_SN5659_R2021b_B.Encode5_d speedgoat_test_SN5659_R2021b_B.Output_j speedgoat_test_SN5659_R2021b_B.Randomnumber_pz speedgoat_test_SN5659_R2021b_B.Sinewave_p speedgoat_test_SN5659_R2021b_DW.NextOutput_nj speedgoat_test_SN5659_R2021b_DW.RandSeed_g speedgoat_test_SN5659_R2021b_DW.lastCos_af speedgoat_test_SN5659_R2021b_DW.lastSin_p speedgoat_test_SN5659_R2021b_DW.systemEnable_m /end REF_MEASUREMENT
/end GROUP
/begin GROUP speedgoat_test_SN5659_R2021b_IO682_Encode_Channel_13_Counter_Limited "speedgoat_test_SN5659_R2021b/IO682/Encode Channel 13/Counter
Limited"
 /begin SUB_GROUP speedgoat_test_SN5659_R2021b_IO682_Encode_Channel_13_Counter_Limited_Increment_Real_World speedgoat_test_SN5659_R2021b_IO682_Encode_Channel_13_Counter_Limited_Wrap_To_Zero /end SUB_GROUP
 /begin REF_CHARACTERISTIC speedgoat_test_SN5659__cal_impl.Output_InitialCondition_k /end REF_CHARACTERISTIC
 /begin REF_MEASUREMENT speedgoat_test_SN5659_R2021b_B.FixPtSwitch_l speedgoat_test_SN5659_R2021b_B.Output_j speedgoat_test_SN5659_R2021b_DW.Output_DSTATE_m /end REF_MEASUREMENT
/end GROUP
/begin GROUP speedgoat_test_SN5659_R2021b_IO682_Encode_Channel_13_Counter_Limited_Increment_Real_World "speedgoat_test_SN5659_R2021b/IO682/Encode Channel 13/Counter
Limited/Increment
Real World" /begin REF_CHARACTERISTIC speedgoat_test_SN5659__cal_impl.FixPtConstant_Value_oz /end REF_CHARACTERISTIC
 /begin REF_MEASUREMENT speedgoat_test_SN5659_R2021b_B.FixPtSum1_g speedgoat_test_SN5659_R2021b_B.Output_j /end REF_MEASUREMENT
/end GROUP
/begin GROUP speedgoat_test_SN5659_R2021b_IO682_Encode_Channel_13_Counter_Limited_Wrap_To_Zero "speedgoat_test_SN5659_R2021b/IO682/Encode Channel 13/Counter
Limited/Wrap To Zero"
 /begin REF_CHARACTERISTIC speedgoat_test_SN5659__cal_impl.Constant_Value_a speedgoat_test_SN5659__cal_impl.CounterLimited_uplimit_c /end REF_CHARACTERISTIC
 /begin REF_MEASUREMENT speedgoat_test_SN5659_R2021b_B.FixPtSum1_g speedgoat_test_SN5659_R2021b_B.FixPtSwitch_l /end REF_MEASUREMENT
/end GROUP
/begin GROUP speedgoat_test_SN5659_R2021b_IO682_Encode_Channel_13_Prepare_RAW_value "speedgoat_test_SN5659_R2021b/IO682/Encode Channel 13/Prepare RAW value"
 /begin REF_CHARACTERISTIC speedgoat_test_SN5659__cal_impl.Label_Value_ex speedgoat_test_SN5659__cal_impl.Mask_BitMask_e speedgoat_test_SN5659__cal_impl.SDI_Value_a speedgoat_test_SN5659__cal_impl.SSM_Value_m speedgoat_test_SN5659__cal_impl.Scale_Value_f speedgoat_test_SN5659__cal_impl.shiftthedoublevalue27bitsleft_i /end REF_CHARACTERISTIC
 /begin REF_MEASUREMENT speedgoat_test_SN5659_R2021b_B.BitwiseOperator_k speedgoat_test_SN5659_R2021b_B.DataTypeConversion1_n speedgoat_test_SN5659_R2021b_B.DataTypeConversion_b speedgoat_test_SN5659_R2021b_B.Divide_i speedgoat_test_SN5659_R2021b_B.Mask_c speedgoat_test_SN5659_R2021b_B.Multiply_he speedgoat_test_SN5659_R2021b_B.ShifttoSDIslot_b speedgoat_test_SN5659_R2021b_B.ShifttoSSMslot_k /end REF_MEASUREMENT
/end GROUP
/begin GROUP speedgoat_test_SN5659_R2021b_IO682_Encode_Channel_14 "speedgoat_test_SN5659_R2021b/IO682/Encode Channel 14"
 /begin SUB_GROUP speedgoat_test_SN5659_R2021b_IO682_Encode_Channel_14_Counter_Limited speedgoat_test_SN5659_R2021b_IO682_Encode_Channel_14_Prepare_RAW_value /end SUB_GROUP
 /begin REF_CHARACTERISTIC speedgoat_test_SN5659__cal_impl.Constant_Value_g speedgoat_test_SN5659__cal_impl.Encode1_P10_pc speedgoat_test_SN5659__cal_impl.Encode1_P11_a speedgoat_test_SN5659__cal_impl.Encode1_P12_h speedgoat_test_SN5659__cal_impl.Encode1_P13_l speedgoat_test_SN5659__cal_impl.Encode1_P14_e speedgoat_test_SN5659__cal_impl.Encode1_P15_m speedgoat_test_SN5659__cal_impl.Encode1_P1_f speedgoat_test_SN5659__cal_impl.Encode1_P2_pf speedgoat_test_SN5659__cal_impl.Encode1_P3_h speedgoat_test_SN5659__cal_impl.Encode1_P4_o speedgoat_test_SN5659__cal_impl.Encode1_P5_l speedgoat_test_SN5659__cal_impl.Encode1_P6_d speedgoat_test_SN5659__cal_impl.Encode1_P7_b speedgoat_test_SN5659__cal_impl.Encode1_P8_f speedgoat_test_SN5659__cal_impl.Encode1_P9_ng speedgoat_test_SN5659__cal_impl.Encode2_P10_a speedgoat_test_SN5659__cal_impl.Encode2_P11_ga speedgoat_test_SN5659__cal_impl.Encode2_P12_f speedgoat_test_SN5659__cal_impl.Encode2_P13_o speedgoat_test_SN5659__cal_impl.Encode2_P14_po speedgoat_test_SN5659__cal_impl.Encode2_P15_h speedgoat_test_SN5659__cal_impl.Encode2_P1_e speedgoat_test_SN5659__cal_impl.Encode2_P2_h speedgoat_test_SN5659__cal_impl.Encode2_P3_f speedgoat_test_SN5659__cal_impl.Encode2_P4_b speedgoat_test_SN5659__cal_impl.Encode2_P5_p speedgoat_test_SN5659__cal_impl.Encode2_P6_l speedgoat_test_SN5659__cal_impl.Encode2_P7_jh speedgoat_test_SN5659__cal_impl.Encode2_P8_n speedgoat_test_SN5659__cal_impl.Encode2_P9_h speedgoat_test_SN5659__cal_impl.Encode3_P10_l1 speedgoat_test_SN5659__cal_impl.Encode3_P11_c speedgoat_test_SN5659__cal_impl.Encode3_P12_p speedgoat_test_SN5659__cal_impl.Encode3_P13_p speedgoat_test_SN5659__cal_impl.Encode3_P14_f speedgoat_test_SN5659__cal_impl.Encode3_P15_hl speedgoat_test_SN5659__cal_impl.Encode3_P1_a speedgoat_test_SN5659__cal_impl.Encode3_P2_b speedgoat_test_SN5659__cal_impl.Encode3_P3_g speedgoat_test_SN5659__cal_impl.Encode3_P4_b speedgoat_test_SN5659__cal_impl.Encode3_P5_ij speedgoat_test_SN5659__cal_impl.Encode3_P6_jb speedgoat_test_SN5659__cal_impl.Encode3_P7_f speedgoat_test_SN5659__cal_impl.Encode3_P8_l speedgoat_test_SN5659__cal_impl.Encode3_P9_c speedgoat_test_SN5659__cal_impl.Encode4_P10_o2 speedgoat_test_SN5659__cal_impl.Encode4_P11_p speedgoat_test_SN5659__cal_impl.Encode4_P12_h speedgoat_test_SN5659__cal_impl.Encode4_P13_o speedgoat_test_SN5659__cal_impl.Encode4_P14_lr speedgoat_test_SN5659__cal_impl.Encode4_P15_a speedgoat_test_SN5659__cal_impl.Encode4_P1_fl speedgoat_test_SN5659__cal_impl.Encode4_P2_f speedgoat_test_SN5659__cal_impl.Encode4_P3_h speedgoat_test_SN5659__cal_impl.Encode4_P4_b speedgoat_test_SN5659__cal_impl.Encode4_P5_o speedgoat_test_SN5659__cal_impl.Encode4_P6_kc speedgoat_test_SN5659__cal_impl.Encode4_P7_d speedgoat_test_SN5659__cal_impl.Encode4_P8_oo speedgoat_test_SN5659__cal_impl.Encode4_P9_n speedgoat_test_SN5659__cal_impl.Randomnumber_Mean_h speedgoat_test_SN5659__cal_impl.Randomnumber_Seed_p speedgoat_test_SN5659__cal_impl.Randomnumber_StdDev_g speedgoat_test_SN5659__cal_impl.Sinewave_Amp_n speedgoat_test_SN5659__cal_impl.Sinewave_Bias_j speedgoat_test_SN5659__cal_impl.Sinewave_Freq_ah speedgoat_test_SN5659__cal_impl.Sinewave_HCos_jn speedgoat_test_SN5659__cal_impl.Sinewave_Hsin_i speedgoat_test_SN5659__cal_impl.Sinewave_PCos_f speedgoat_test_SN5659__cal_impl.Sinewave_PSin_f /end REF_CHARACTERISTIC
 /begin REF_MEASUREMENT speedgoat_test_SN5659_R2021b_B.DataTypeConversion1_gm speedgoat_test_SN5659_R2021b_B.DataTypeConversion_o speedgoat_test_SN5659_R2021b_B.Encode1_p speedgoat_test_SN5659_R2021b_B.Encode2_fi speedgoat_test_SN5659_R2021b_B.Encode3_f speedgoat_test_SN5659_R2021b_B.Encode4_g speedgoat_test_SN5659_R2021b_B.Output_m speedgoat_test_SN5659_R2021b_B.Randomnumber_n speedgoat_test_SN5659_R2021b_B.Sinewave_g speedgoat_test_SN5659_R2021b_DW.NextOutput_ni speedgoat_test_SN5659_R2021b_DW.RandSeed_f speedgoat_test_SN5659_R2021b_DW.lastCos_ht speedgoat_test_SN5659_R2021b_DW.lastSin_dj speedgoat_test_SN5659_R2021b_DW.systemEnable_j /end REF_MEASUREMENT
/end GROUP
/begin GROUP speedgoat_test_SN5659_R2021b_IO682_Encode_Channel_14_Counter_Limited "speedgoat_test_SN5659_R2021b/IO682/Encode Channel 14/Counter
Limited"
 /begin SUB_GROUP speedgoat_test_SN5659_R2021b_IO682_Encode_Channel_14_Counter_Limited_Increment_Real_World speedgoat_test_SN5659_R2021b_IO682_Encode_Channel_14_Counter_Limited_Wrap_To_Zero /end SUB_GROUP
 /begin REF_CHARACTERISTIC speedgoat_test_SN5659__cal_impl.Output_InitialCondition_e /end REF_CHARACTERISTIC
 /begin REF_MEASUREMENT speedgoat_test_SN5659_R2021b_B.FixPtSwitch_bx speedgoat_test_SN5659_R2021b_B.Output_m speedgoat_test_SN5659_R2021b_DW.Output_DSTATE_oy /end REF_MEASUREMENT
/end GROUP
/begin GROUP speedgoat_test_SN5659_R2021b_IO682_Encode_Channel_14_Counter_Limited_Increment_Real_World "speedgoat_test_SN5659_R2021b/IO682/Encode Channel 14/Counter
Limited/Increment
Real World" /begin REF_CHARACTERISTIC speedgoat_test_SN5659__cal_impl.FixPtConstant_Value_j /end REF_CHARACTERISTIC
 /begin REF_MEASUREMENT speedgoat_test_SN5659_R2021b_B.FixPtSum1_e speedgoat_test_SN5659_R2021b_B.Output_m /end REF_MEASUREMENT
/end GROUP
/begin GROUP speedgoat_test_SN5659_R2021b_IO682_Encode_Channel_14_Counter_Limited_Wrap_To_Zero "speedgoat_test_SN5659_R2021b/IO682/Encode Channel 14/Counter
Limited/Wrap To Zero"
 /begin REF_CHARACTERISTIC speedgoat_test_SN5659__cal_impl.Constant_Value_k speedgoat_test_SN5659__cal_impl.CounterLimited_uplimit_n /end REF_CHARACTERISTIC
 /begin REF_MEASUREMENT speedgoat_test_SN5659_R2021b_B.FixPtSum1_e speedgoat_test_SN5659_R2021b_B.FixPtSwitch_bx /end REF_MEASUREMENT
/end GROUP
/begin GROUP speedgoat_test_SN5659_R2021b_IO682_Encode_Channel_14_Prepare_RAW_value "speedgoat_test_SN5659_R2021b/IO682/Encode Channel 14/Prepare RAW value"
 /begin REF_CHARACTERISTIC speedgoat_test_SN5659__cal_impl.Label_Value_f speedgoat_test_SN5659__cal_impl.Mask_BitMask_p speedgoat_test_SN5659__cal_impl.SDI_Value_h speedgoat_test_SN5659__cal_impl.SSM_Value_j speedgoat_test_SN5659__cal_impl.Scale_Value_d speedgoat_test_SN5659__cal_impl.shiftthedoublevalue27bitslef_pp /end REF_CHARACTERISTIC
 /begin REF_MEASUREMENT speedgoat_test_SN5659_R2021b_B.BitwiseOperator_c speedgoat_test_SN5659_R2021b_B.DataTypeConversion1_gm speedgoat_test_SN5659_R2021b_B.DataTypeConversion_er speedgoat_test_SN5659_R2021b_B.Divide_j speedgoat_test_SN5659_R2021b_B.Mask_m speedgoat_test_SN5659_R2021b_B.Multiply_i speedgoat_test_SN5659_R2021b_B.ShifttoSDIslot_km speedgoat_test_SN5659_R2021b_B.ShifttoSSMslot_mi /end REF_MEASUREMENT
/end GROUP
/begin GROUP speedgoat_test_SN5659_R2021b_IO682_Encode_Channel_15 "speedgoat_test_SN5659_R2021b/IO682/Encode Channel 15"
 /begin SUB_GROUP speedgoat_test_SN5659_R2021b_IO682_Encode_Channel_15_Counter_Limited speedgoat_test_SN5659_R2021b_IO682_Encode_Channel_15_Prepare_RAW_value /end SUB_GROUP
 /begin REF_CHARACTERISTIC speedgoat_test_SN5659__cal_impl.Constant_Value_l speedgoat_test_SN5659__cal_impl.Encode1_P10_k speedgoat_test_SN5659__cal_impl.Encode1_P11_n speedgoat_test_SN5659__cal_impl.Encode1_P12_j speedgoat_test_SN5659__cal_impl.Encode1_P13_f speedgoat_test_SN5659__cal_impl.Encode1_P14_c speedgoat_test_SN5659__cal_impl.Encode1_P15_a speedgoat_test_SN5659__cal_impl.Encode1_P1_h speedgoat_test_SN5659__cal_impl.Encode1_P2_e speedgoat_test_SN5659__cal_impl.Encode1_P3_i speedgoat_test_SN5659__cal_impl.Encode1_P4_el speedgoat_test_SN5659__cal_impl.Encode1_P5_g speedgoat_test_SN5659__cal_impl.Encode1_P6_a speedgoat_test_SN5659__cal_impl.Encode1_P7_a speedgoat_test_SN5659__cal_impl.Encode1_P8_dh speedgoat_test_SN5659__cal_impl.Encode1_P9_k speedgoat_test_SN5659__cal_impl.Encode2_P10_ab speedgoat_test_SN5659__cal_impl.Encode2_P11_k speedgoat_test_SN5659__cal_impl.Encode2_P12_d speedgoat_test_SN5659__cal_impl.Encode2_P13_n speedgoat_test_SN5659__cal_impl.Encode2_P14_n speedgoat_test_SN5659__cal_impl.Encode2_P15_js speedgoat_test_SN5659__cal_impl.Encode2_P1_n speedgoat_test_SN5659__cal_impl.Encode2_P2_kr speedgoat_test_SN5659__cal_impl.Encode2_P3_j speedgoat_test_SN5659__cal_impl.Encode2_P4_o0 speedgoat_test_SN5659__cal_impl.Encode2_P5_m speedgoat_test_SN5659__cal_impl.Encode2_P6_i speedgoat_test_SN5659__cal_impl.Encode2_P7_k speedgoat_test_SN5659__cal_impl.Encode2_P8_h3 speedgoat_test_SN5659__cal_impl.Encode2_P9_a speedgoat_test_SN5659__cal_impl.Encode3_P10_lx speedgoat_test_SN5659__cal_impl.Encode3_P11_m speedgoat_test_SN5659__cal_impl.Encode3_P12_i speedgoat_test_SN5659__cal_impl.Encode3_P13_k speedgoat_test_SN5659__cal_impl.Encode3_P14_m speedgoat_test_SN5659__cal_impl.Encode3_P15_b speedgoat_test_SN5659__cal_impl.Encode3_P1_nj speedgoat_test_SN5659__cal_impl.Encode3_P2_n speedgoat_test_SN5659__cal_impl.Encode3_P3_nc speedgoat_test_SN5659__cal_impl.Encode3_P4_m speedgoat_test_SN5659__cal_impl.Encode3_P5_h speedgoat_test_SN5659__cal_impl.Encode3_P6_i speedgoat_test_SN5659__cal_impl.Encode3_P7_i speedgoat_test_SN5659__cal_impl.Encode3_P8_p speedgoat_test_SN5659__cal_impl.Encode3_P9_p speedgoat_test_SN5659__cal_impl.Encode4_P10_k speedgoat_test_SN5659__cal_impl.Encode4_P11_pb speedgoat_test_SN5659__cal_impl.Encode4_P12_e speedgoat_test_SN5659__cal_impl.Encode4_P13_p speedgoat_test_SN5659__cal_impl.Encode4_P14_b speedgoat_test_SN5659__cal_impl.Encode4_P15_l speedgoat_test_SN5659__cal_impl.Encode4_P1_n speedgoat_test_SN5659__cal_impl.Encode4_P2_dd speedgoat_test_SN5659__cal_impl.Encode4_P3_b speedgoat_test_SN5659__cal_impl.Encode4_P4_h speedgoat_test_SN5659__cal_impl.Encode4_P5_l speedgoat_test_SN5659__cal_impl.Encode4_P6_l speedgoat_test_SN5659__cal_impl.Encode4_P7_l speedgoat_test_SN5659__cal_impl.Encode4_P8_h speedgoat_test_SN5659__cal_impl.Encode4_P9_e speedgoat_test_SN5659__cal_impl.Randomnumber_Mean_b speedgoat_test_SN5659__cal_impl.Randomnumber_Seed_fj speedgoat_test_SN5659__cal_impl.Randomnumber_StdDev_l4 speedgoat_test_SN5659__cal_impl.Sinewave_Amp_hh speedgoat_test_SN5659__cal_impl.Sinewave_Bias_g speedgoat_test_SN5659__cal_impl.Sinewave_Freq_c speedgoat_test_SN5659__cal_impl.Sinewave_HCos_jg speedgoat_test_SN5659__cal_impl.Sinewave_Hsin_o1 speedgoat_test_SN5659__cal_impl.Sinewave_PCos_a speedgoat_test_SN5659__cal_impl.Sinewave_PSin_fk /end REF_CHARACTERISTIC
 /begin REF_MEASUREMENT speedgoat_test_SN5659_R2021b_B.DataTypeConversion1_ga speedgoat_test_SN5659_R2021b_B.DataTypeConversion_d speedgoat_test_SN5659_R2021b_B.Encode1_pb speedgoat_test_SN5659_R2021b_B.Encode2_h speedgoat_test_SN5659_R2021b_B.Encode3_l speedgoat_test_SN5659_R2021b_B.Encode4_l speedgoat_test_SN5659_R2021b_B.Output_e speedgoat_test_SN5659_R2021b_B.Randomnumber_m speedgoat_test_SN5659_R2021b_B.Sinewave_kh speedgoat_test_SN5659_R2021b_DW.NextOutput_ft speedgoat_test_SN5659_R2021b_DW.RandSeed_f4 speedgoat_test_SN5659_R2021b_DW.lastCos_l speedgoat_test_SN5659_R2021b_DW.lastSin_du speedgoat_test_SN5659_R2021b_DW.systemEnable_a /end REF_MEASUREMENT
/end GROUP
/begin GROUP speedgoat_test_SN5659_R2021b_IO682_Encode_Channel_15_Counter_Limited "speedgoat_test_SN5659_R2021b/IO682/Encode Channel 15/Counter
Limited"
 /begin SUB_GROUP speedgoat_test_SN5659_R2021b_IO682_Encode_Channel_15_Counter_Limited_Increment_Real_World speedgoat_test_SN5659_R2021b_IO682_Encode_Channel_15_Counter_Limited_Wrap_To_Zero /end SUB_GROUP
 /begin REF_CHARACTERISTIC speedgoat_test_SN5659__cal_impl.Output_InitialCondition_l /end REF_CHARACTERISTIC
 /begin REF_MEASUREMENT speedgoat_test_SN5659_R2021b_B.FixPtSwitch_lo speedgoat_test_SN5659_R2021b_B.Output_e speedgoat_test_SN5659_R2021b_DW.Output_DSTATE_e /end REF_MEASUREMENT
/end GROUP
/begin GROUP speedgoat_test_SN5659_R2021b_IO682_Encode_Channel_15_Counter_Limited_Increment_Real_World "speedgoat_test_SN5659_R2021b/IO682/Encode Channel 15/Counter
Limited/Increment
Real World" /begin REF_CHARACTERISTIC speedgoat_test_SN5659__cal_impl.FixPtConstant_Value_l /end REF_CHARACTERISTIC
 /begin REF_MEASUREMENT speedgoat_test_SN5659_R2021b_B.FixPtSum1_o speedgoat_test_SN5659_R2021b_B.Output_e /end REF_MEASUREMENT
/end GROUP
/begin GROUP speedgoat_test_SN5659_R2021b_IO682_Encode_Channel_15_Counter_Limited_Wrap_To_Zero "speedgoat_test_SN5659_R2021b/IO682/Encode Channel 15/Counter
Limited/Wrap To Zero"
 /begin REF_CHARACTERISTIC speedgoat_test_SN5659__cal_impl.Constant_Value_aq speedgoat_test_SN5659__cal_impl.CounterLimited_uplimit_cp /end REF_CHARACTERISTIC
 /begin REF_MEASUREMENT speedgoat_test_SN5659_R2021b_B.FixPtSum1_o speedgoat_test_SN5659_R2021b_B.FixPtSwitch_lo /end REF_MEASUREMENT
/end GROUP
/begin GROUP speedgoat_test_SN5659_R2021b_IO682_Encode_Channel_15_Prepare_RAW_value "speedgoat_test_SN5659_R2021b/IO682/Encode Channel 15/Prepare RAW value"
 /begin REF_CHARACTERISTIC speedgoat_test_SN5659__cal_impl.Label_Value_b speedgoat_test_SN5659__cal_impl.Mask_BitMask_pd speedgoat_test_SN5659__cal_impl.SDI_Value_i speedgoat_test_SN5659__cal_impl.SSM_Value_ji speedgoat_test_SN5659__cal_impl.Scale_Value_c speedgoat_test_SN5659__cal_impl.shiftthedoublevalue27bitslef_oj /end REF_CHARACTERISTIC
 /begin REF_MEASUREMENT speedgoat_test_SN5659_R2021b_B.BitwiseOperator_f speedgoat_test_SN5659_R2021b_B.DataTypeConversion1_ga speedgoat_test_SN5659_R2021b_B.DataTypeConversion_fb speedgoat_test_SN5659_R2021b_B.Divide_g speedgoat_test_SN5659_R2021b_B.Mask_h speedgoat_test_SN5659_R2021b_B.Multiply_n speedgoat_test_SN5659_R2021b_B.ShifttoSDIslot_c speedgoat_test_SN5659_R2021b_B.ShifttoSSMslot_f /end REF_MEASUREMENT
/end GROUP
/begin GROUP speedgoat_test_SN5659_R2021b_IO682_Encode_Channel_16 "speedgoat_test_SN5659_R2021b/IO682/Encode Channel 16"
 /begin SUB_GROUP speedgoat_test_SN5659_R2021b_IO682_Encode_Channel_16_Counter_Limited speedgoat_test_SN5659_R2021b_IO682_Encode_Channel_16_Prepare_RAW_value /end SUB_GROUP
 /begin REF_CHARACTERISTIC speedgoat_test_SN5659__cal_impl.Constant_Value_o speedgoat_test_SN5659__cal_impl.Encode1_P10_e speedgoat_test_SN5659__cal_impl.Encode1_P11_o speedgoat_test_SN5659__cal_impl.Encode1_P12_m speedgoat_test_SN5659__cal_impl.Encode1_P13_fj speedgoat_test_SN5659__cal_impl.Encode1_P14_d speedgoat_test_SN5659__cal_impl.Encode1_P15_i speedgoat_test_SN5659__cal_impl.Encode1_P1_j speedgoat_test_SN5659__cal_impl.Encode1_P2_n speedgoat_test_SN5659__cal_impl.Encode1_P3_hu speedgoat_test_SN5659__cal_impl.Encode1_P4_p speedgoat_test_SN5659__cal_impl.Encode1_P5_e speedgoat_test_SN5659__cal_impl.Encode1_P6_m speedgoat_test_SN5659__cal_impl.Encode1_P7_e speedgoat_test_SN5659__cal_impl.Encode1_P8_fq speedgoat_test_SN5659__cal_impl.Encode1_P9_o speedgoat_test_SN5659__cal_impl.Encode2_P10_o speedgoat_test_SN5659__cal_impl.Encode2_P11_e speedgoat_test_SN5659__cal_impl.Encode2_P12_fa speedgoat_test_SN5659__cal_impl.Encode2_P13_d speedgoat_test_SN5659__cal_impl.Encode2_P14_ck speedgoat_test_SN5659__cal_impl.Encode2_P15_e speedgoat_test_SN5659__cal_impl.Encode2_P1_g speedgoat_test_SN5659__cal_impl.Encode2_P2_d speedgoat_test_SN5659__cal_impl.Encode2_P3_i speedgoat_test_SN5659__cal_impl.Encode2_P4_l speedgoat_test_SN5659__cal_impl.Encode2_P5_p4 speedgoat_test_SN5659__cal_impl.Encode2_P6_d speedgoat_test_SN5659__cal_impl.Encode2_P7_bh speedgoat_test_SN5659__cal_impl.Encode2_P8_d speedgoat_test_SN5659__cal_impl.Encode2_P9_d speedgoat_test_SN5659__cal_impl.Encode3_P10_o speedgoat_test_SN5659__cal_impl.Encode3_P11_h0 speedgoat_test_SN5659__cal_impl.Encode3_P12_k speedgoat_test_SN5659__cal_impl.Encode3_P13_ka speedgoat_test_SN5659__cal_impl.Encode3_P14_n speedgoat_test_SN5659__cal_impl.Encode3_P15_c speedgoat_test_SN5659__cal_impl.Encode3_P1_nj3 speedgoat_test_SN5659__cal_impl.Encode3_P2_h speedgoat_test_SN5659__cal_impl.Encode3_P3_d speedgoat_test_SN5659__cal_impl.Encode3_P4_h speedgoat_test_SN5659__cal_impl.Encode3_P5_f speedgoat_test_SN5659__cal_impl.Encode3_P6_k speedgoat_test_SN5659__cal_impl.Encode3_P7_fx speedgoat_test_SN5659__cal_impl.Encode3_P8_b speedgoat_test_SN5659__cal_impl.Encode3_P9_bx speedgoat_test_SN5659__cal_impl.Encode4_P10_j speedgoat_test_SN5659__cal_impl.Encode4_P11_e speedgoat_test_SN5659__cal_impl.Encode4_P12_o speedgoat_test_SN5659__cal_impl.Encode4_P13_h speedgoat_test_SN5659__cal_impl.Encode4_P14_m speedgoat_test_SN5659__cal_impl.Encode4_P15_f speedgoat_test_SN5659__cal_impl.Encode4_P1_a speedgoat_test_SN5659__cal_impl.Encode4_P2_p speedgoat_test_SN5659__cal_impl.Encode4_P3_a speedgoat_test_SN5659__cal_impl.Encode4_P4_l speedgoat_test_SN5659__cal_impl.Encode4_P5_i speedgoat_test_SN5659__cal_impl.Encode4_P6_d speedgoat_test_SN5659__cal_impl.Encode4_P7_b speedgoat_test_SN5659__cal_impl.Encode4_P8_k speedgoat_test_SN5659__cal_impl.Encode4_P9_p speedgoat_test_SN5659__cal_impl.Randomnumber_Mean_fh speedgoat_test_SN5659__cal_impl.Randomnumber_Seed_cd speedgoat_test_SN5659__cal_impl.Randomnumber_StdDev_n speedgoat_test_SN5659__cal_impl.Sinewave_Amp_c speedgoat_test_SN5659__cal_impl.Sinewave_Bias_kg speedgoat_test_SN5659__cal_impl.Sinewave_Freq_mo speedgoat_test_SN5659__cal_impl.Sinewave_HCos_f speedgoat_test_SN5659__cal_impl.Sinewave_Hsin_h speedgoat_test_SN5659__cal_impl.Sinewave_PCos_m speedgoat_test_SN5659__cal_impl.Sinewave_PSin_m /end REF_CHARACTERISTIC
 /begin REF_MEASUREMENT speedgoat_test_SN5659_R2021b_B.DataTypeConversion1_d speedgoat_test_SN5659_R2021b_B.DataTypeConversion_jr speedgoat_test_SN5659_R2021b_B.Encode1_pbz speedgoat_test_SN5659_R2021b_B.Encode2_hc speedgoat_test_SN5659_R2021b_B.Encode3_ou speedgoat_test_SN5659_R2021b_B.Encode4_p speedgoat_test_SN5659_R2021b_B.Output_k speedgoat_test_SN5659_R2021b_B.Randomnumber_br speedgoat_test_SN5659_R2021b_B.Sinewave_a speedgoat_test_SN5659_R2021b_DW.NextOutput_i speedgoat_test_SN5659_R2021b_DW.RandSeed_i speedgoat_test_SN5659_R2021b_DW.lastCos_ld speedgoat_test_SN5659_R2021b_DW.lastSin_f speedgoat_test_SN5659_R2021b_DW.systemEnable_p0 /end REF_MEASUREMENT
/end GROUP
/begin GROUP speedgoat_test_SN5659_R2021b_IO682_Encode_Channel_16_Counter_Limited "speedgoat_test_SN5659_R2021b/IO682/Encode Channel 16/Counter
Limited"
 /begin SUB_GROUP speedgoat_test_SN5659_R2021b_IO682_Encode_Channel_16_Counter_Limited_Increment_Real_World speedgoat_test_SN5659_R2021b_IO682_Encode_Channel_16_Counter_Limited_Wrap_To_Zero /end SUB_GROUP
 /begin REF_CHARACTERISTIC speedgoat_test_SN5659__cal_impl.Output_InitialCondition_nl /end REF_CHARACTERISTIC
 /begin REF_MEASUREMENT speedgoat_test_SN5659_R2021b_B.FixPtSwitch_l2 speedgoat_test_SN5659_R2021b_B.Output_k speedgoat_test_SN5659_R2021b_DW.Output_DSTATE_k /end REF_MEASUREMENT
/end GROUP
/begin GROUP speedgoat_test_SN5659_R2021b_IO682_Encode_Channel_16_Counter_Limited_Increment_Real_World "speedgoat_test_SN5659_R2021b/IO682/Encode Channel 16/Counter
Limited/Increment
Real World" /begin REF_CHARACTERISTIC speedgoat_test_SN5659__cal_impl.FixPtConstant_Value_i /end REF_CHARACTERISTIC
 /begin REF_MEASUREMENT speedgoat_test_SN5659_R2021b_B.FixPtSum1_d speedgoat_test_SN5659_R2021b_B.Output_k /end REF_MEASUREMENT
/end GROUP
/begin GROUP speedgoat_test_SN5659_R2021b_IO682_Encode_Channel_16_Counter_Limited_Wrap_To_Zero "speedgoat_test_SN5659_R2021b/IO682/Encode Channel 16/Counter
Limited/Wrap To Zero"
 /begin REF_CHARACTERISTIC speedgoat_test_SN5659__cal_impl.Constant_Value_p speedgoat_test_SN5659__cal_impl.CounterLimited_uplimit_g /end REF_CHARACTERISTIC
 /begin REF_MEASUREMENT speedgoat_test_SN5659_R2021b_B.FixPtSum1_d speedgoat_test_SN5659_R2021b_B.FixPtSwitch_l2 /end REF_MEASUREMENT
/end GROUP
/begin GROUP speedgoat_test_SN5659_R2021b_IO682_Encode_Channel_16_Prepare_RAW_value "speedgoat_test_SN5659_R2021b/IO682/Encode Channel 16/Prepare RAW value"
 /begin REF_CHARACTERISTIC speedgoat_test_SN5659__cal_impl.Label_Value_k speedgoat_test_SN5659__cal_impl.Mask_BitMask_a speedgoat_test_SN5659__cal_impl.SDI_Value_m3 speedgoat_test_SN5659__cal_impl.SSM_Value_i speedgoat_test_SN5659__cal_impl.Scale_Value_i speedgoat_test_SN5659__cal_impl.shiftthedoublevalue27bitsleft_h /end REF_CHARACTERISTIC
 /begin REF_MEASUREMENT speedgoat_test_SN5659_R2021b_B.BitwiseOperator_e speedgoat_test_SN5659_R2021b_B.DataTypeConversion1_d speedgoat_test_SN5659_R2021b_B.DataTypeConversion_f5 speedgoat_test_SN5659_R2021b_B.Divide_k3 speedgoat_test_SN5659_R2021b_B.Mask_h0 speedgoat_test_SN5659_R2021b_B.Multiply_hd speedgoat_test_SN5659_R2021b_B.ShifttoSDIslot_m speedgoat_test_SN5659_R2021b_B.ShifttoSSMslot_m3 /end REF_MEASUREMENT
/end GROUP
/begin GROUP speedgoat_test_SN5659_R2021b_IO682_Encode_Channel_1_Counter_Limited "speedgoat_test_SN5659_R2021b/IO682/Encode Channel 1/Counter
Limited"
 /begin SUB_GROUP speedgoat_test_SN5659_R2021b_IO682_Encode_Channel_1_Counter_Limited_Increment_Real_World speedgoat_test_SN5659_R2021b_IO682_Encode_Channel_1_Counter_Limited_Wrap_To_Zero /end SUB_GROUP
 /begin REF_CHARACTERISTIC speedgoat_test_SN5659__cal_impl.Output_InitialCondition_b /end REF_CHARACTERISTIC
 /begin REF_MEASUREMENT speedgoat_test_SN5659_R2021b_B.FixPtSwitch_ha speedgoat_test_SN5659_R2021b_DW.Output_DSTATE_c /end REF_MEASUREMENT
/end GROUP
/begin GROUP speedgoat_test_SN5659_R2021b_IO682_Encode_Channel_1_Counter_Limited_Increment_Real_World "speedgoat_test_SN5659_R2021b/IO682/Encode Channel 1/Counter
Limited/Increment
Real World" /begin REF_CHARACTERISTIC speedgoat_test_SN5659__cal_impl.FixPtConstant_Value_h /end REF_CHARACTERISTIC /begin REF_MEASUREMENT speedgoat_test_SN5659_R2021b_B.FixPtSum1_i /end REF_MEASUREMENT /end GROUP
/begin GROUP speedgoat_test_SN5659_R2021b_IO682_Encode_Channel_1_Counter_Limited_Wrap_To_Zero "speedgoat_test_SN5659_R2021b/IO682/Encode Channel 1/Counter
Limited/Wrap To Zero"
 /begin REF_CHARACTERISTIC speedgoat_test_SN5659__cal_impl.Constant_Value_av speedgoat_test_SN5659__cal_impl.CounterLimited_uplimit_i /end REF_CHARACTERISTIC
 /begin REF_MEASUREMENT speedgoat_test_SN5659_R2021b_B.FixPtSum1_i speedgoat_test_SN5659_R2021b_B.FixPtSwitch_ha /end REF_MEASUREMENT
/end GROUP
/begin GROUP speedgoat_test_SN5659_R2021b_IO682_Encode_Channel_1_Prepare_RAW_value "speedgoat_test_SN5659_R2021b/IO682/Encode Channel 1/Prepare RAW value"
 /begin REF_CHARACTERISTIC speedgoat_test_SN5659__cal_impl.Label_Value speedgoat_test_SN5659__cal_impl.Mask_BitMask speedgoat_test_SN5659__cal_impl.SDI_Value speedgoat_test_SN5659__cal_impl.SSM_Value speedgoat_test_SN5659__cal_impl.Scale_Value speedgoat_test_SN5659__cal_impl.shiftthedoublevalue27bitsleft_V /end REF_CHARACTERISTIC
 /begin REF_MEASUREMENT speedgoat_test_SN5659_R2021b_B.BitwiseOperator speedgoat_test_SN5659_R2021b_B.DataTypeConversion_k5 speedgoat_test_SN5659_R2021b_B.Divide speedgoat_test_SN5659_R2021b_B.Mask speedgoat_test_SN5659_R2021b_B.Multiply speedgoat_test_SN5659_R2021b_B.ShifttoSDIslot speedgoat_test_SN5659_R2021b_B.ShifttoSSMslot /end REF_MEASUREMENT
/end GROUP
/begin GROUP speedgoat_test_SN5659_R2021b_IO682_Encode_Channel_2 "speedgoat_test_SN5659_R2021b/IO682/Encode Channel 2"
 /begin SUB_GROUP speedgoat_test_SN5659_R2021b_IO682_Encode_Channel_2_Counter_Limited speedgoat_test_SN5659_R2021b_IO682_Encode_Channel_2_Prepare_RAW_value /end SUB_GROUP
 /begin REF_CHARACTERISTIC speedgoat_test_SN5659__cal_impl.Constant_Value_b speedgoat_test_SN5659__cal_impl.Encode1_P10_f speedgoat_test_SN5659__cal_impl.Encode1_P11_e speedgoat_test_SN5659__cal_impl.Encode1_P12_g speedgoat_test_SN5659__cal_impl.Encode1_P13_k speedgoat_test_SN5659__cal_impl.Encode1_P14_a speedgoat_test_SN5659__cal_impl.Encode1_P15_p speedgoat_test_SN5659__cal_impl.Encode1_P1_ft speedgoat_test_SN5659__cal_impl.Encode1_P2_hw speedgoat_test_SN5659__cal_impl.Encode1_P3_j speedgoat_test_SN5659__cal_impl.Encode1_P4_g speedgoat_test_SN5659__cal_impl.Encode1_P5_ov speedgoat_test_SN5659__cal_impl.Encode1_P6_pe speedgoat_test_SN5659__cal_impl.Encode1_P7_m speedgoat_test_SN5659__cal_impl.Encode1_P8_ck speedgoat_test_SN5659__cal_impl.Encode1_P9_ol speedgoat_test_SN5659__cal_impl.Encode2_P10_gm speedgoat_test_SN5659__cal_impl.Encode2_P11_d speedgoat_test_SN5659__cal_impl.Encode2_P12_a speedgoat_test_SN5659__cal_impl.Encode2_P13_fz speedgoat_test_SN5659__cal_impl.Encode2_P14_i speedgoat_test_SN5659__cal_impl.Encode2_P15_m speedgoat_test_SN5659__cal_impl.Encode2_P1_hz speedgoat_test_SN5659__cal_impl.Encode2_P2_mu speedgoat_test_SN5659__cal_impl.Encode2_P3_jd speedgoat_test_SN5659__cal_impl.Encode2_P4_g0 speedgoat_test_SN5659__cal_impl.Encode2_P5_h speedgoat_test_SN5659__cal_impl.Encode2_P6_d2 speedgoat_test_SN5659__cal_impl.Encode2_P7_i speedgoat_test_SN5659__cal_impl.Encode2_P8_j speedgoat_test_SN5659__cal_impl.Encode2_P9_n speedgoat_test_SN5659__cal_impl.Encode3_P10_p speedgoat_test_SN5659__cal_impl.Encode3_P11_jq speedgoat_test_SN5659__cal_impl.Encode3_P12_d speedgoat_test_SN5659__cal_impl.Encode3_P13_h speedgoat_test_SN5659__cal_impl.Encode3_P14_ny speedgoat_test_SN5659__cal_impl.Encode3_P15_g speedgoat_test_SN5659__cal_impl.Encode3_P1_m speedgoat_test_SN5659__cal_impl.Encode3_P2_m speedgoat_test_SN5659__cal_impl.Encode3_P3_gs speedgoat_test_SN5659__cal_impl.Encode3_P4_dt speedgoat_test_SN5659__cal_impl.Encode3_P5_d speedgoat_test_SN5659__cal_impl.Encode3_P6_g speedgoat_test_SN5659__cal_impl.Encode3_P7_fm speedgoat_test_SN5659__cal_impl.Encode3_P8_fh speedgoat_test_SN5659__cal_impl.Encode3_P9_n speedgoat_test_SN5659__cal_impl.Encode4_P10_o4 speedgoat_test_SN5659__cal_impl.Encode4_P11_c speedgoat_test_SN5659__cal_impl.Encode4_P12_lr speedgoat_test_SN5659__cal_impl.Encode4_P13_m speedgoat_test_SN5659__cal_impl.Encode4_P14_mx speedgoat_test_SN5659__cal_impl.Encode4_P15_k speedgoat_test_SN5659__cal_impl.Encode4_P1_g speedgoat_test_SN5659__cal_impl.Encode4_P2_h speedgoat_test_SN5659__cal_impl.Encode4_P3_m speedgoat_test_SN5659__cal_impl.Encode4_P4_i speedgoat_test_SN5659__cal_impl.Encode4_P5_j speedgoat_test_SN5659__cal_impl.Encode4_P6_n speedgoat_test_SN5659__cal_impl.Encode4_P7_pf speedgoat_test_SN5659__cal_impl.Encode4_P8_l speedgoat_test_SN5659__cal_impl.Encode4_P9_ns speedgoat_test_SN5659__cal_impl.Randomnumber_Mean_f3 speedgoat_test_SN5659__cal_impl.Randomnumber_Seed_nh speedgoat_test_SN5659__cal_impl.Randomnumber_StdDev_m speedgoat_test_SN5659__cal_impl.Sinewave_Amp_nm speedgoat_test_SN5659__cal_impl.Sinewave_Bias_jq speedgoat_test_SN5659__cal_impl.Sinewave_Freq_l speedgoat_test_SN5659__cal_impl.Sinewave_HCos_b speedgoat_test_SN5659__cal_impl.Sinewave_Hsin_e speedgoat_test_SN5659__cal_impl.Sinewave_PCos_k speedgoat_test_SN5659__cal_impl.Sinewave_PSin_g /end REF_CHARACTERISTIC
 /begin REF_MEASUREMENT speedgoat_test_SN5659_R2021b_B.DataTypeConversion1_l speedgoat_test_SN5659_R2021b_B.DataTypeConversion_hu speedgoat_test_SN5659_R2021b_B.Encode1_h speedgoat_test_SN5659_R2021b_B.Encode2_fb speedgoat_test_SN5659_R2021b_B.Encode3_d speedgoat_test_SN5659_R2021b_B.Encode4_n speedgoat_test_SN5659_R2021b_B.Output_g speedgoat_test_SN5659_R2021b_B.Randomnumber_e speedgoat_test_SN5659_R2021b_B.Sinewave_o5 speedgoat_test_SN5659_R2021b_DW.NextOutput_j speedgoat_test_SN5659_R2021b_DW.RandSeed_d speedgoat_test_SN5659_R2021b_DW.lastCos_lh speedgoat_test_SN5659_R2021b_DW.lastSin_e speedgoat_test_SN5659_R2021b_DW.systemEnable_ml /end REF_MEASUREMENT
/end GROUP
/begin GROUP speedgoat_test_SN5659_R2021b_IO682_Encode_Channel_2_Counter_Limited "speedgoat_test_SN5659_R2021b/IO682/Encode Channel 2/Counter
Limited"
 /begin SUB_GROUP speedgoat_test_SN5659_R2021b_IO682_Encode_Channel_2_Counter_Limited_Increment_Real_World speedgoat_test_SN5659_R2021b_IO682_Encode_Channel_2_Counter_Limited_Wrap_To_Zero /end SUB_GROUP
 /begin REF_CHARACTERISTIC speedgoat_test_SN5659__cal_impl.Output_InitialCondition_j /end REF_CHARACTERISTIC
 /begin REF_MEASUREMENT speedgoat_test_SN5659_R2021b_B.FixPtSwitch_jo speedgoat_test_SN5659_R2021b_B.Output_g speedgoat_test_SN5659_R2021b_DW.Output_DSTATE_e0 /end REF_MEASUREMENT
/end GROUP
/begin GROUP speedgoat_test_SN5659_R2021b_IO682_Encode_Channel_2_Counter_Limited_Increment_Real_World "speedgoat_test_SN5659_R2021b/IO682/Encode Channel 2/Counter
Limited/Increment
Real World" /begin REF_CHARACTERISTIC speedgoat_test_SN5659__cal_impl.FixPtConstant_Value_k0 /end REF_CHARACTERISTIC
 /begin REF_MEASUREMENT speedgoat_test_SN5659_R2021b_B.FixPtSum1_fe speedgoat_test_SN5659_R2021b_B.Output_g /end REF_MEASUREMENT
/end GROUP
/begin GROUP speedgoat_test_SN5659_R2021b_IO682_Encode_Channel_2_Counter_Limited_Wrap_To_Zero "speedgoat_test_SN5659_R2021b/IO682/Encode Channel 2/Counter
Limited/Wrap To Zero"
 /begin REF_CHARACTERISTIC speedgoat_test_SN5659__cal_impl.Constant_Value_ee speedgoat_test_SN5659__cal_impl.CounterLimited_uplimit_be /end REF_CHARACTERISTIC
 /begin REF_MEASUREMENT speedgoat_test_SN5659_R2021b_B.FixPtSum1_fe speedgoat_test_SN5659_R2021b_B.FixPtSwitch_jo /end REF_MEASUREMENT
/end GROUP
/begin GROUP speedgoat_test_SN5659_R2021b_IO682_Encode_Channel_2_Prepare_RAW_value "speedgoat_test_SN5659_R2021b/IO682/Encode Channel 2/Prepare RAW value"
 /begin REF_CHARACTERISTIC speedgoat_test_SN5659__cal_impl.Label_Value_n speedgoat_test_SN5659__cal_impl.Mask_BitMask_l speedgoat_test_SN5659__cal_impl.SDI_Value_l4 speedgoat_test_SN5659__cal_impl.SSM_Value_na speedgoat_test_SN5659__cal_impl.Scale_Value_k speedgoat_test_SN5659__cal_impl.shiftthedoublevalue27bitsleft_j /end REF_CHARACTERISTIC
 /begin REF_MEASUREMENT speedgoat_test_SN5659_R2021b_B.BitwiseOperator_j speedgoat_test_SN5659_R2021b_B.DataTypeConversion1_l speedgoat_test_SN5659_R2021b_B.DataTypeConversion_bh speedgoat_test_SN5659_R2021b_B.Divide_g4 speedgoat_test_SN5659_R2021b_B.Mask_d speedgoat_test_SN5659_R2021b_B.Multiply_il speedgoat_test_SN5659_R2021b_B.ShifttoSDIslot_g speedgoat_test_SN5659_R2021b_B.ShifttoSSMslot_g /end REF_MEASUREMENT
/end GROUP
/begin GROUP speedgoat_test_SN5659_R2021b_IO682_Encode_Channel_3 "speedgoat_test_SN5659_R2021b/IO682/Encode Channel 3"
 /begin SUB_GROUP speedgoat_test_SN5659_R2021b_IO682_Encode_Channel_3_Counter_Limited speedgoat_test_SN5659_R2021b_IO682_Encode_Channel_3_Prepare_RAW_value /end SUB_GROUP
 /begin REF_CHARACTERISTIC speedgoat_test_SN5659__cal_impl.Constant_Value_ek speedgoat_test_SN5659__cal_impl.Encode1_P10_l0 speedgoat_test_SN5659__cal_impl.Encode1_P11_f speedgoat_test_SN5659__cal_impl.Encode1_P12_a speedgoat_test_SN5659__cal_impl.Encode1_P13_n speedgoat_test_SN5659__cal_impl.Encode1_P14_on speedgoat_test_SN5659__cal_impl.Encode1_P15_pw speedgoat_test_SN5659__cal_impl.Encode1_P1_m speedgoat_test_SN5659__cal_impl.Encode1_P2_i speedgoat_test_SN5659__cal_impl.Encode1_P3_e speedgoat_test_SN5659__cal_impl.Encode1_P4_d2 speedgoat_test_SN5659__cal_impl.Encode1_P5_h speedgoat_test_SN5659__cal_impl.Encode1_P6_i speedgoat_test_SN5659__cal_impl.Encode1_P7_gj speedgoat_test_SN5659__cal_impl.Encode1_P8_ct speedgoat_test_SN5659__cal_impl.Encode1_P9_j speedgoat_test_SN5659__cal_impl.Encode2_P10_f speedgoat_test_SN5659__cal_impl.Encode2_P11_m speedgoat_test_SN5659__cal_impl.Encode2_P12_e speedgoat_test_SN5659__cal_impl.Encode2_P13_fx speedgoat_test_SN5659__cal_impl.Encode2_P14_d speedgoat_test_SN5659__cal_impl.Encode2_P15_ck speedgoat_test_SN5659__cal_impl.Encode2_P1_az speedgoat_test_SN5659__cal_impl.Encode2_P2_f0 speedgoat_test_SN5659__cal_impl.Encode2_P3_o2 speedgoat_test_SN5659__cal_impl.Encode2_P4_h speedgoat_test_SN5659__cal_impl.Encode2_P5_i speedgoat_test_SN5659__cal_impl.Encode2_P6_o speedgoat_test_SN5659__cal_impl.Encode2_P7_o speedgoat_test_SN5659__cal_impl.Encode2_P8_fs speedgoat_test_SN5659__cal_impl.Encode2_P9_c speedgoat_test_SN5659__cal_impl.Encode3_P10_a speedgoat_test_SN5659__cal_impl.Encode3_P11_f speedgoat_test_SN5659__cal_impl.Encode3_P12_b3 speedgoat_test_SN5659__cal_impl.Encode3_P13_c speedgoat_test_SN5659__cal_impl.Encode3_P14_do speedgoat_test_SN5659__cal_impl.Encode3_P15_pu speedgoat_test_SN5659__cal_impl.Encode3_P1_mk speedgoat_test_SN5659__cal_impl.Encode3_P2_o speedgoat_test_SN5659__cal_impl.Encode3_P3_cs speedgoat_test_SN5659__cal_impl.Encode3_P4_dq speedgoat_test_SN5659__cal_impl.Encode3_P5_im speedgoat_test_SN5659__cal_impl.Encode3_P6_d speedgoat_test_SN5659__cal_impl.Encode3_P7_o speedgoat_test_SN5659__cal_impl.Encode3_P8_en speedgoat_test_SN5659__cal_impl.Encode3_P9_m speedgoat_test_SN5659__cal_impl.Encode4_P10_b speedgoat_test_SN5659__cal_impl.Encode4_P11_jr speedgoat_test_SN5659__cal_impl.Encode4_P12_g speedgoat_test_SN5659__cal_impl.Encode4_P13_d speedgoat_test_SN5659__cal_impl.Encode4_P14_g speedgoat_test_SN5659__cal_impl.Encode4_P15_h speedgoat_test_SN5659__cal_impl.Encode4_P1_ns speedgoat_test_SN5659__cal_impl.Encode4_P2_g speedgoat_test_SN5659__cal_impl.Encode4_P3_n speedgoat_test_SN5659__cal_impl.Encode4_P4_m speedgoat_test_SN5659__cal_impl.Encode4_P5_k speedgoat_test_SN5659__cal_impl.Encode4_P6_e speedgoat_test_SN5659__cal_impl.Encode4_P7_pm speedgoat_test_SN5659__cal_impl.Encode4_P8_f speedgoat_test_SN5659__cal_impl.Encode4_P9_f speedgoat_test_SN5659__cal_impl.Randomnumber_Mean_d speedgoat_test_SN5659__cal_impl.Randomnumber_Seed_fq speedgoat_test_SN5659__cal_impl.Randomnumber_StdDev_f speedgoat_test_SN5659__cal_impl.Sinewave_Amp_a speedgoat_test_SN5659__cal_impl.Sinewave_Bias_mn speedgoat_test_SN5659__cal_impl.Sinewave_Freq_b speedgoat_test_SN5659__cal_impl.Sinewave_HCos_bz speedgoat_test_SN5659__cal_impl.Sinewave_Hsin_h4 speedgoat_test_SN5659__cal_impl.Sinewave_PCos_ma speedgoat_test_SN5659__cal_impl.Sinewave_PSin_gt /end REF_CHARACTERISTIC
 /begin REF_MEASUREMENT speedgoat_test_SN5659_R2021b_B.DataTypeConversion1_a speedgoat_test_SN5659_R2021b_B.DataTypeConversion_dd speedgoat_test_SN5659_R2021b_B.Encode1_f0 speedgoat_test_SN5659_R2021b_B.Encode2_iu speedgoat_test_SN5659_R2021b_B.Encode3_ik speedgoat_test_SN5659_R2021b_B.Encode4_ix speedgoat_test_SN5659_R2021b_B.Output_b2 speedgoat_test_SN5659_R2021b_B.Randomnumber_f speedgoat_test_SN5659_R2021b_B.Sinewave_oh speedgoat_test_SN5659_R2021b_DW.NextOutput_m speedgoat_test_SN5659_R2021b_DW.RandSeed_b speedgoat_test_SN5659_R2021b_DW.lastCos_gg speedgoat_test_SN5659_R2021b_DW.lastSin_pg speedgoat_test_SN5659_R2021b_DW.systemEnable_bx /end REF_MEASUREMENT
/end GROUP
/begin GROUP speedgoat_test_SN5659_R2021b_IO682_Encode_Channel_3_Counter_Limited "speedgoat_test_SN5659_R2021b/IO682/Encode Channel 3/Counter
Limited"
 /begin SUB_GROUP speedgoat_test_SN5659_R2021b_IO682_Encode_Channel_3_Counter_Limited_Increment_Real_World speedgoat_test_SN5659_R2021b_IO682_Encode_Channel_3_Counter_Limited_Wrap_To_Zero /end SUB_GROUP
 /begin REF_CHARACTERISTIC speedgoat_test_SN5659__cal_impl.Output_InitialCondition_h /end REF_CHARACTERISTIC
 /begin REF_MEASUREMENT speedgoat_test_SN5659_R2021b_B.FixPtSwitch_d speedgoat_test_SN5659_R2021b_B.Output_b2 speedgoat_test_SN5659_R2021b_DW.Output_DSTATE_g /end REF_MEASUREMENT
/end GROUP
/begin GROUP speedgoat_test_SN5659_R2021b_IO682_Encode_Channel_3_Counter_Limited_Increment_Real_World "speedgoat_test_SN5659_R2021b/IO682/Encode Channel 3/Counter
Limited/Increment
Real World" /begin REF_CHARACTERISTIC speedgoat_test_SN5659__cal_impl.FixPtConstant_Value_oq /end REF_CHARACTERISTIC
 /begin REF_MEASUREMENT speedgoat_test_SN5659_R2021b_B.FixPtSum1_h speedgoat_test_SN5659_R2021b_B.Output_b2 /end REF_MEASUREMENT
/end GROUP
/begin GROUP speedgoat_test_SN5659_R2021b_IO682_Encode_Channel_3_Counter_Limited_Wrap_To_Zero "speedgoat_test_SN5659_R2021b/IO682/Encode Channel 3/Counter
Limited/Wrap To Zero"
 /begin REF_CHARACTERISTIC speedgoat_test_SN5659__cal_impl.Constant_Value_j5 speedgoat_test_SN5659__cal_impl.CounterLimited_uplimit_e /end REF_CHARACTERISTIC
 /begin REF_MEASUREMENT speedgoat_test_SN5659_R2021b_B.FixPtSum1_h speedgoat_test_SN5659_R2021b_B.FixPtSwitch_d /end REF_MEASUREMENT
/end GROUP
/begin GROUP speedgoat_test_SN5659_R2021b_IO682_Encode_Channel_3_Prepare_RAW_value "speedgoat_test_SN5659_R2021b/IO682/Encode Channel 3/Prepare RAW value"
 /begin REF_CHARACTERISTIC speedgoat_test_SN5659__cal_impl.Label_Value_fv speedgoat_test_SN5659__cal_impl.Mask_BitMask_e3 speedgoat_test_SN5659__cal_impl.SDI_Value_p speedgoat_test_SN5659__cal_impl.SSM_Value_os speedgoat_test_SN5659__cal_impl.Scale_Value_e speedgoat_test_SN5659__cal_impl.shiftthedoublevalue27bitsleft_n /end REF_CHARACTERISTIC
 /begin REF_MEASUREMENT speedgoat_test_SN5659_R2021b_B.BitwiseOperator_a4 speedgoat_test_SN5659_R2021b_B.DataTypeConversion1_a speedgoat_test_SN5659_R2021b_B.DataTypeConversion_l speedgoat_test_SN5659_R2021b_B.Divide_n speedgoat_test_SN5659_R2021b_B.Mask_k speedgoat_test_SN5659_R2021b_B.Multiply_e speedgoat_test_SN5659_R2021b_B.ShifttoSDIslot_n speedgoat_test_SN5659_R2021b_B.ShifttoSSMslot_kz /end REF_MEASUREMENT
/end GROUP
/end MODULE
/end PROJECT
