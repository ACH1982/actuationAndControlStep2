ASAP2_VERSION 1 71
/begin PROJECT ProjectName "Project Comment Goes Here"
/begin HEADER "Header Comments go here" /end HEADER
/begin MODULE ModuleName "Module Comment Goes Here"
/begin MOD_COMMON "Mod Common Comment Here" BYTE_ORDER MSB_LAST ALIGNMENT_BYTE 1 ALIGNMENT_WORD 2 ALIGNMENT_LONG 4 ALIGNMENT_FLOAT32_IEEE 4 ALIGNMENT_FLOAT64_IEEE 8 ALIGNMENT_INT64 8 /end MOD_COMMON
/begin CHARACTERISTIC speedgoat_test_SN5659__cal_impl.Constant_Value "" VALUE 0x008DE6A0 Scalar_FLOAT64_IEEE 0 speedgoat_test_SN5659_R2021b_CM_double -1.7E+308 1.7E+308 /end CHARACTERISTIC
/begin CHARACTERISTIC speedgoat_test_SN5659__cal_impl.Constant_Value_c "" VALUE 0x008E4D84 Scalar_UWORD 0 speedgoat_test_SN5659_R2021b_CM_uint16 0 65535 /end CHARACTERISTIC
/begin CHARACTERISTIC speedgoat_test_SN5659__cal_impl.Constant_Value_dm "" VALUE 0x008E4D8A Scalar_UWORD 0 speedgoat_test_SN5659_R2021b_CM_uint16 0 65535 /end CHARACTERISTIC
/begin CHARACTERISTIC speedgoat_test_SN5659__cal_impl.Constant_Value_e "" VALUE 0x008DF9F0 Scalar_FLOAT64_IEEE 0 speedgoat_test_SN5659_R2021b_CM_double -1.7E+308 1.7E+308 /end CHARACTERISTIC
/begin CHARACTERISTIC speedgoat_test_SN5659__cal_impl.Constant_Value_i "" VALUE 0x008DF380 Scalar_FLOAT64_IEEE 0 speedgoat_test_SN5659_R2021b_CM_double -1.7E+308 1.7E+308 /end CHARACTERISTIC
/begin CHARACTERISTIC speedgoat_test_SN5659__cal_impl.Constant_Value_j "" VALUE 0x008DED10 Scalar_FLOAT64_IEEE 0 speedgoat_test_SN5659_R2021b_CM_double -1.7E+308 1.7E+308 /end CHARACTERISTIC
/begin CHARACTERISTIC speedgoat_test_SN5659__cal_impl.Constant_Value_n "" VALUE 0x008E4D90 Scalar_UWORD 0 speedgoat_test_SN5659_R2021b_CM_uint16 0 65535 /end CHARACTERISTIC
/begin CHARACTERISTIC speedgoat_test_SN5659__cal_impl.CounterLimited_uplimit "" VALUE 0x008D5060 Scalar_UWORD 0 speedgoat_test_SN5659_R2021b_CM_uint16 0 65535 /end CHARACTERISTIC
/begin CHARACTERISTIC speedgoat_test_SN5659__cal_impl.CounterLimited_uplimit_d "" VALUE 0x008D5062 Scalar_UWORD 0 speedgoat_test_SN5659_R2021b_CM_uint16 0 65535 /end CHARACTERISTIC
/begin CHARACTERISTIC speedgoat_test_SN5659__cal_impl.CounterLimited_uplimit_k "" VALUE 0x008D5064 Scalar_UWORD 0 speedgoat_test_SN5659_R2021b_CM_uint16 0 65535 /end CHARACTERISTIC
/begin CHARACTERISTIC speedgoat_test_SN5659__cal_impl.Decode1_P10_e1 "" VAL_BLK 0x008DCF98 Scalar_FLOAT64_IEEE 0 speedgoat_test_SN5659_R2021b_CM_double -1.7E+308 1.7E+308 MATRIX_DIM 2 1 /end CHARACTERISTIC
/begin CHARACTERISTIC speedgoat_test_SN5659__cal_impl.Decode1_P10_g "" VAL_BLK 0x008DD630 Scalar_FLOAT64_IEEE 0 speedgoat_test_SN5659_R2021b_CM_double -1.7E+308 1.7E+308 MATRIX_DIM 2 1 /end CHARACTERISTIC
/begin CHARACTERISTIC speedgoat_test_SN5659__cal_impl.Decode1_P10_l "" VAL_BLK 0x008D8710 Scalar_FLOAT64_IEEE 0 speedgoat_test_SN5659_R2021b_CM_double -1.7E+308 1.7E+308 MATRIX_DIM 2 1 /end CHARACTERISTIC
/begin CHARACTERISTIC speedgoat_test_SN5659__cal_impl.Decode1_P10_m "" VAL_BLK 0x008DDCC8 Scalar_FLOAT64_IEEE 0 speedgoat_test_SN5659_R2021b_CM_double -1.7E+308 1.7E+308 MATRIX_DIM 2 1 /end CHARACTERISTIC
/begin CHARACTERISTIC speedgoat_test_SN5659__cal_impl.Decode1_P11_al "" VALUE 0x008DCFB8 Scalar_FLOAT64_IEEE 0 speedgoat_test_SN5659_R2021b_CM_double -1.7E+308 1.7E+308 /end CHARACTERISTIC
/begin CHARACTERISTIC speedgoat_test_SN5659__cal_impl.Decode1_P11_d "" VALUE 0x008DDCE8 Scalar_FLOAT64_IEEE 0 speedgoat_test_SN5659_R2021b_CM_double -1.7E+308 1.7E+308 /end CHARACTERISTIC
/begin CHARACTERISTIC speedgoat_test_SN5659__cal_impl.Decode1_P11_eo "" VALUE 0x008DD650 Scalar_FLOAT64_IEEE 0 speedgoat_test_SN5659_R2021b_CM_double -1.7E+308 1.7E+308 /end CHARACTERISTIC
/begin CHARACTERISTIC speedgoat_test_SN5659__cal_impl.Decode1_P11_eu "" VALUE 0x008D8730 Scalar_FLOAT64_IEEE 0 speedgoat_test_SN5659_R2021b_CM_double -1.7E+308 1.7E+308 /end CHARACTERISTIC
/begin CHARACTERISTIC speedgoat_test_SN5659__cal_impl.Decode1_P12_kj "" VALUE 0x008DCFD0 Scalar_FLOAT64_IEEE 0 speedgoat_test_SN5659_R2021b_CM_double -1.7E+308 1.7E+308 /end CHARACTERISTIC
/begin CHARACTERISTIC speedgoat_test_SN5659__cal_impl.Decode1_P12_m "" VALUE 0x008DD668 Scalar_FLOAT64_IEEE 0 speedgoat_test_SN5659_R2021b_CM_double -1.7E+308 1.7E+308 /end CHARACTERISTIC
/begin CHARACTERISTIC speedgoat_test_SN5659__cal_impl.Decode1_P12_n "" VALUE 0x008DDD00 Scalar_FLOAT64_IEEE 0 speedgoat_test_SN5659_R2021b_CM_double -1.7E+308 1.7E+308 /end CHARACTERISTIC
/begin CHARACTERISTIC speedgoat_test_SN5659__cal_impl.Decode1_P12_pl "" VALUE 0x008D8748 Scalar_FLOAT64_IEEE 0 speedgoat_test_SN5659_R2021b_CM_double -1.7E+308 1.7E+308 /end CHARACTERISTIC
/begin CHARACTERISTIC speedgoat_test_SN5659__cal_impl.Decode1_P13_cn "" VALUE 0x008DDD18 Scalar_FLOAT64_IEEE 0 speedgoat_test_SN5659_R2021b_CM_double -1.7E+308 1.7E+308 /end CHARACTERISTIC
/begin CHARACTERISTIC speedgoat_test_SN5659__cal_impl.Decode1_P13_f "" VALUE 0x008D8760 Scalar_FLOAT64_IEEE 0 speedgoat_test_SN5659_R2021b_CM_double -1.7E+308 1.7E+308 /end CHARACTERISTIC
/begin CHARACTERISTIC speedgoat_test_SN5659__cal_impl.Decode1_P13_fl "" VALUE 0x008DD680 Scalar_FLOAT64_IEEE 0 speedgoat_test_SN5659_R2021b_CM_double -1.7E+308 1.7E+308 /end CHARACTERISTIC
/begin CHARACTERISTIC speedgoat_test_SN5659__cal_impl.Decode1_P13_m "" VALUE 0x008DCFE8 Scalar_FLOAT64_IEEE 0 speedgoat_test_SN5659_R2021b_CM_double -1.7E+308 1.7E+308 /end CHARACTERISTIC
/begin CHARACTERISTIC speedgoat_test_SN5659__cal_impl.Decode1_P14_a "" VALUE 0x008DD000 Scalar_FLOAT64_IEEE 0 speedgoat_test_SN5659_R2021b_CM_double -1.7E+308 1.7E+308 /end CHARACTERISTIC
/begin CHARACTERISTIC speedgoat_test_SN5659__cal_impl.Decode1_P14_f "" VALUE 0x008DD698 Scalar_FLOAT64_IEEE 0 speedgoat_test_SN5659_R2021b_CM_double -1.7E+308 1.7E+308 /end CHARACTERISTIC
/begin CHARACTERISTIC speedgoat_test_SN5659__cal_impl.Decode1_P14_fq "" VALUE 0x008DDD30 Scalar_FLOAT64_IEEE 0 speedgoat_test_SN5659_R2021b_CM_double -1.7E+308 1.7E+308 /end CHARACTERISTIC
/begin CHARACTERISTIC speedgoat_test_SN5659__cal_impl.Decode1_P14_m "" VALUE 0x008D8778 Scalar_FLOAT64_IEEE 0 speedgoat_test_SN5659_R2021b_CM_double -1.7E+308 1.7E+308 /end CHARACTERISTIC
/begin CHARACTERISTIC speedgoat_test_SN5659__cal_impl.Decode1_P15_aw "" VALUE 0x008DD018 Scalar_FLOAT64_IEEE 0 speedgoat_test_SN5659_R2021b_CM_double -1.7E+308 1.7E+308 /end CHARACTERISTIC
/begin CHARACTERISTIC speedgoat_test_SN5659__cal_impl.Decode1_P15_b "" VALUE 0x008D8790 Scalar_FLOAT64_IEEE 0 speedgoat_test_SN5659_R2021b_CM_double -1.7E+308 1.7E+308 /end CHARACTERISTIC
/begin CHARACTERISTIC speedgoat_test_SN5659__cal_impl.Decode1_P15_nq "" VALUE 0x008DD6B0 Scalar_FLOAT64_IEEE 0 speedgoat_test_SN5659_R2021b_CM_double -1.7E+308 1.7E+308 /end CHARACTERISTIC
/begin CHARACTERISTIC speedgoat_test_SN5659__cal_impl.Decode1_P15_p "" VALUE 0x008DDD48 Scalar_FLOAT64_IEEE 0 speedgoat_test_SN5659_R2021b_CM_double -1.7E+308 1.7E+308 /end CHARACTERISTIC
/begin CHARACTERISTIC speedgoat_test_SN5659__cal_impl.Decode1_P16_b "" VALUE 0x008D87A8 Scalar_FLOAT64_IEEE 0 speedgoat_test_SN5659_R2021b_CM_double -1.7E+308 1.7E+308 /end CHARACTERISTIC
/begin CHARACTERISTIC speedgoat_test_SN5659__cal_impl.Decode1_P16_eq "" VALUE 0x008DD030 Scalar_FLOAT64_IEEE 0 speedgoat_test_SN5659_R2021b_CM_double -1.7E+308 1.7E+308 /end CHARACTERISTIC
/begin CHARACTERISTIC speedgoat_test_SN5659__cal_impl.Decode1_P16_fi "" VALUE 0x008DDD60 Scalar_FLOAT64_IEEE 0 speedgoat_test_SN5659_R2021b_CM_double -1.7E+308 1.7E+308 /end CHARACTERISTIC
/begin CHARACTERISTIC speedgoat_test_SN5659__cal_impl.Decode1_P16_ju "" VALUE 0x008DD6C8 Scalar_FLOAT64_IEEE 0 speedgoat_test_SN5659_R2021b_CM_double -1.7E+308 1.7E+308 /end CHARACTERISTIC
/begin CHARACTERISTIC speedgoat_test_SN5659__cal_impl.Decode1_P1_c2 "" VALUE 0x008D8638 Scalar_FLOAT64_IEEE 0 speedgoat_test_SN5659_R2021b_CM_double -1.7E+308 1.7E+308 /end CHARACTERISTIC
/begin CHARACTERISTIC speedgoat_test_SN5659__cal_impl.Decode1_P1_cw "" VALUE 0x008DCEC0 Scalar_FLOAT64_IEEE 0 speedgoat_test_SN5659_R2021b_CM_double -1.7E+308 1.7E+308 /end CHARACTERISTIC
/begin CHARACTERISTIC speedgoat_test_SN5659__cal_impl.Decode1_P1_hw "" VALUE 0x008DD558 Scalar_FLOAT64_IEEE 0 speedgoat_test_SN5659_R2021b_CM_double -1.7E+308 1.7E+308 /end CHARACTERISTIC
/begin CHARACTERISTIC speedgoat_test_SN5659__cal_impl.Decode1_P1_pi "" VALUE 0x008DDBF0 Scalar_FLOAT64_IEEE 0 speedgoat_test_SN5659_R2021b_CM_double -1.7E+308 1.7E+308 /end CHARACTERISTIC
/begin CHARACTERISTIC speedgoat_test_SN5659__cal_impl.Decode1_P2_b "" VALUE 0x008D8650 Scalar_FLOAT64_IEEE 0 speedgoat_test_SN5659_R2021b_CM_double -1.7E+308 1.7E+308 /end CHARACTERISTIC
/begin CHARACTERISTIC speedgoat_test_SN5659__cal_impl.Decode1_P2_bu "" VALUE 0x008DCED8 Scalar_FLOAT64_IEEE 0 speedgoat_test_SN5659_R2021b_CM_double -1.7E+308 1.7E+308 /end CHARACTERISTIC
/begin CHARACTERISTIC speedgoat_test_SN5659__cal_impl.Decode1_P2_m "" VALUE 0x008DD570 Scalar_FLOAT64_IEEE 0 speedgoat_test_SN5659_R2021b_CM_double -1.7E+308 1.7E+308 /end CHARACTERISTIC
/begin CHARACTERISTIC speedgoat_test_SN5659__cal_impl.Decode1_P2_mk "" VALUE 0x008DDC08 Scalar_FLOAT64_IEEE 0 speedgoat_test_SN5659_R2021b_CM_double -1.7E+308 1.7E+308 /end CHARACTERISTIC
/begin CHARACTERISTIC speedgoat_test_SN5659__cal_impl.Decode1_P3_a "" VALUE 0x008DCEF0 Scalar_FLOAT64_IEEE 0 speedgoat_test_SN5659_R2021b_CM_double -1.7E+308 1.7E+308 /end CHARACTERISTIC
/begin CHARACTERISTIC speedgoat_test_SN5659__cal_impl.Decode1_P3_ci "" VALUE 0x008DD588 Scalar_FLOAT64_IEEE 0 speedgoat_test_SN5659_R2021b_CM_double -1.7E+308 1.7E+308 /end CHARACTERISTIC
/begin CHARACTERISTIC speedgoat_test_SN5659__cal_impl.Decode1_P3_g "" VALUE 0x008D8668 Scalar_FLOAT64_IEEE 0 speedgoat_test_SN5659_R2021b_CM_double -1.7E+308 1.7E+308 /end CHARACTERISTIC
/begin CHARACTERISTIC speedgoat_test_SN5659__cal_impl.Decode1_P3_gr "" VALUE 0x008DDC20 Scalar_FLOAT64_IEEE 0 speedgoat_test_SN5659_R2021b_CM_double -1.7E+308 1.7E+308 /end CHARACTERISTIC
/begin CHARACTERISTIC speedgoat_test_SN5659__cal_impl.Decode1_P4_bf "" VALUE 0x008DD5A0 Scalar_FLOAT64_IEEE 0 speedgoat_test_SN5659_R2021b_CM_double -1.7E+308 1.7E+308 /end CHARACTERISTIC
/begin CHARACTERISTIC speedgoat_test_SN5659__cal_impl.Decode1_P4_e "" VALUE 0x008D8680 Scalar_FLOAT64_IEEE 0 speedgoat_test_SN5659_R2021b_CM_double -1.7E+308 1.7E+308 /end CHARACTERISTIC
/begin CHARACTERISTIC speedgoat_test_SN5659__cal_impl.Decode1_P4_j "" VALUE 0x008DCF08 Scalar_FLOAT64_IEEE 0 speedgoat_test_SN5659_R2021b_CM_double -1.7E+308 1.7E+308 /end CHARACTERISTIC
/begin CHARACTERISTIC speedgoat_test_SN5659__cal_impl.Decode1_P4_n "" VALUE 0x008DDC38 Scalar_FLOAT64_IEEE 0 speedgoat_test_SN5659_R2021b_CM_double -1.7E+308 1.7E+308 /end CHARACTERISTIC
/begin CHARACTERISTIC speedgoat_test_SN5659__cal_impl.Decode1_P5_h "" VALUE 0x008DDC50 Scalar_FLOAT64_IEEE 0 speedgoat_test_SN5659_R2021b_CM_double -1.7E+308 1.7E+308 /end CHARACTERISTIC
/begin CHARACTERISTIC speedgoat_test_SN5659__cal_impl.Decode1_P5_kb "" VALUE 0x008DD5B8 Scalar_FLOAT64_IEEE 0 speedgoat_test_SN5659_R2021b_CM_double -1.7E+308 1.7E+308 /end CHARACTERISTIC
/begin CHARACTERISTIC speedgoat_test_SN5659__cal_impl.Decode1_P5_m3 "" VALUE 0x008DCF20 Scalar_FLOAT64_IEEE 0 speedgoat_test_SN5659_R2021b_CM_double -1.7E+308 1.7E+308 /end CHARACTERISTIC
/begin CHARACTERISTIC speedgoat_test_SN5659__cal_impl.Decode1_P5_n "" VALUE 0x008D8698 Scalar_FLOAT64_IEEE 0 speedgoat_test_SN5659_R2021b_CM_double -1.7E+308 1.7E+308 /end CHARACTERISTIC
/begin CHARACTERISTIC speedgoat_test_SN5659__cal_impl.Decode1_P6_bi "" VALUE 0x008DCF38 Scalar_FLOAT64_IEEE 0 speedgoat_test_SN5659_R2021b_CM_double -1.7E+308 1.7E+308 /end CHARACTERISTIC
/begin CHARACTERISTIC speedgoat_test_SN5659__cal_impl.Decode1_P6_e "" VALUE 0x008DDC68 Scalar_FLOAT64_IEEE 0 speedgoat_test_SN5659_R2021b_CM_double -1.7E+308 1.7E+308 /end CHARACTERISTIC
/begin CHARACTERISTIC speedgoat_test_SN5659__cal_impl.Decode1_P6_j "" VALUE 0x008D86B0 Scalar_FLOAT64_IEEE 0 speedgoat_test_SN5659_R2021b_CM_double -1.7E+308 1.7E+308 /end CHARACTERISTIC
/begin CHARACTERISTIC speedgoat_test_SN5659__cal_impl.Decode1_P6_jf "" VALUE 0x008DD5D0 Scalar_FLOAT64_IEEE 0 speedgoat_test_SN5659_R2021b_CM_double -1.7E+308 1.7E+308 /end CHARACTERISTIC
/begin CHARACTERISTIC speedgoat_test_SN5659__cal_impl.Decode1_P7_j "" VALUE 0x008DDC80 Scalar_FLOAT64_IEEE 0 speedgoat_test_SN5659_R2021b_CM_double -1.7E+308 1.7E+308 /end CHARACTERISTIC
/begin CHARACTERISTIC speedgoat_test_SN5659__cal_impl.Decode1_P7_k "" VALUE 0x008D86C8 Scalar_FLOAT64_IEEE 0 speedgoat_test_SN5659_R2021b_CM_double -1.7E+308 1.7E+308 /end CHARACTERISTIC
/begin CHARACTERISTIC speedgoat_test_SN5659__cal_impl.Decode1_P7_m1 "" VALUE 0x008DCF50 Scalar_FLOAT64_IEEE 0 speedgoat_test_SN5659_R2021b_CM_double -1.7E+308 1.7E+308 /end CHARACTERISTIC
/begin CHARACTERISTIC speedgoat_test_SN5659__cal_impl.Decode1_P7_ob "" VALUE 0x008DD5E8 Scalar_FLOAT64_IEEE 0 speedgoat_test_SN5659_R2021b_CM_double -1.7E+308 1.7E+308 /end CHARACTERISTIC
/begin CHARACTERISTIC speedgoat_test_SN5659__cal_impl.Decode1_P8_a "" VALUE 0x008DD600 Scalar_FLOAT64_IEEE 0 speedgoat_test_SN5659_R2021b_CM_double -1.7E+308 1.7E+308 /end CHARACTERISTIC
/begin CHARACTERISTIC speedgoat_test_SN5659__cal_impl.Decode1_P8_a1 "" VALUE 0x008DDC98 Scalar_FLOAT64_IEEE 0 speedgoat_test_SN5659_R2021b_CM_double -1.7E+308 1.7E+308 /end CHARACTERISTIC
/begin CHARACTERISTIC speedgoat_test_SN5659__cal_impl.Decode1_P8_f "" VALUE 0x008DCF68 Scalar_FLOAT64_IEEE 0 speedgoat_test_SN5659_R2021b_CM_double -1.7E+308 1.7E+308 /end CHARACTERISTIC
/begin CHARACTERISTIC speedgoat_test_SN5659__cal_impl.Decode1_P8_l "" VALUE 0x008D86E0 Scalar_FLOAT64_IEEE 0 speedgoat_test_SN5659_R2021b_CM_double -1.7E+308 1.7E+308 /end CHARACTERISTIC
/begin CHARACTERISTIC speedgoat_test_SN5659__cal_impl.Decode1_P9_dz "" VALUE 0x008DDCB0 Scalar_FLOAT64_IEEE 0 speedgoat_test_SN5659_R2021b_CM_double -1.7E+308 1.7E+308 /end CHARACTERISTIC
/begin CHARACTERISTIC speedgoat_test_SN5659__cal_impl.Decode1_P9_ie "" VALUE 0x008DCF80 Scalar_FLOAT64_IEEE 0 speedgoat_test_SN5659_R2021b_CM_double -1.7E+308 1.7E+308 /end CHARACTERISTIC
/begin CHARACTERISTIC speedgoat_test_SN5659__cal_impl.Decode1_P9_k "" VALUE 0x008D86F8 Scalar_FLOAT64_IEEE 0 speedgoat_test_SN5659_R2021b_CM_double -1.7E+308 1.7E+308 /end CHARACTERISTIC
/begin CHARACTERISTIC speedgoat_test_SN5659__cal_impl.Decode1_P9_op "" VALUE 0x008DD618 Scalar_FLOAT64_IEEE 0 speedgoat_test_SN5659_R2021b_CM_double -1.7E+308 1.7E+308 /end CHARACTERISTIC
/begin CHARACTERISTIC speedgoat_test_SN5659__cal_impl.Decode2_P10_cg "" VAL_BLK 0x008DDE50 Scalar_FLOAT64_IEEE 0 speedgoat_test_SN5659_R2021b_CM_double -1.7E+308 1.7E+308 MATRIX_DIM 2 1 /end CHARACTERISTIC
/begin CHARACTERISTIC speedgoat_test_SN5659__cal_impl.Decode2_P10_e "" VAL_BLK 0x008DD120 Scalar_FLOAT64_IEEE 0 speedgoat_test_SN5659_R2021b_CM_double -1.7E+308 1.7E+308 MATRIX_DIM 2 1 /end CHARACTERISTIC
/begin CHARACTERISTIC speedgoat_test_SN5659__cal_impl.Decode2_P10_l "" VAL_BLK 0x008DD7B8 Scalar_FLOAT64_IEEE 0 speedgoat_test_SN5659_R2021b_CM_double -1.7E+308 1.7E+308 MATRIX_DIM 2 1 /end CHARACTERISTIC
/begin CHARACTERISTIC speedgoat_test_SN5659__cal_impl.Decode2_P11_h "" VALUE 0x008DD7D8 Scalar_FLOAT64_IEEE 0 speedgoat_test_SN5659_R2021b_CM_double -1.7E+308 1.7E+308 /end CHARACTERISTIC
/begin CHARACTERISTIC speedgoat_test_SN5659__cal_impl.Decode2_P11_kl "" VALUE 0x008DDE70 Scalar_FLOAT64_IEEE 0 speedgoat_test_SN5659_R2021b_CM_double -1.7E+308 1.7E+308 /end CHARACTERISTIC
/begin CHARACTERISTIC speedgoat_test_SN5659__cal_impl.Decode2_P11_p "" VALUE 0x008DD140 Scalar_FLOAT64_IEEE 0 speedgoat_test_SN5659_R2021b_CM_double -1.7E+308 1.7E+308 /end CHARACTERISTIC
/begin CHARACTERISTIC speedgoat_test_SN5659__cal_impl.Decode2_P12_d "" VALUE 0x008DD7F0 Scalar_FLOAT64_IEEE 0 speedgoat_test_SN5659_R2021b_CM_double -1.7E+308 1.7E+308 /end CHARACTERISTIC
/begin CHARACTERISTIC speedgoat_test_SN5659__cal_impl.Decode2_P12_id "" VALUE 0x008DD158 Scalar_FLOAT64_IEEE 0 speedgoat_test_SN5659_R2021b_CM_double -1.7E+308 1.7E+308 /end CHARACTERISTIC
/begin CHARACTERISTIC speedgoat_test_SN5659__cal_impl.Decode2_P12_m "" VALUE 0x008DDE88 Scalar_FLOAT64_IEEE 0 speedgoat_test_SN5659_R2021b_CM_double -1.7E+308 1.7E+308 /end CHARACTERISTIC
/begin CHARACTERISTIC speedgoat_test_SN5659__cal_impl.Decode2_P13_b "" VALUE 0x008DD170 Scalar_FLOAT64_IEEE 0 speedgoat_test_SN5659_R2021b_CM_double -1.7E+308 1.7E+308 /end CHARACTERISTIC
/begin CHARACTERISTIC speedgoat_test_SN5659__cal_impl.Decode2_P13_bk "" VALUE 0x008DDEA0 Scalar_FLOAT64_IEEE 0 speedgoat_test_SN5659_R2021b_CM_double -1.7E+308 1.7E+308 /end CHARACTERISTIC
/begin CHARACTERISTIC speedgoat_test_SN5659__cal_impl.Decode2_P13_d "" VALUE 0x008DD808 Scalar_FLOAT64_IEEE 0 speedgoat_test_SN5659_R2021b_CM_double -1.7E+308 1.7E+308 /end CHARACTERISTIC
/begin CHARACTERISTIC speedgoat_test_SN5659__cal_impl.Decode2_P14_d "" VALUE 0x008DD188 Scalar_FLOAT64_IEEE 0 speedgoat_test_SN5659_R2021b_CM_double -1.7E+308 1.7E+308 /end CHARACTERISTIC
/begin CHARACTERISTIC speedgoat_test_SN5659__cal_impl.Decode2_P14_k "" VALUE 0x008DD820 Scalar_FLOAT64_IEEE 0 speedgoat_test_SN5659_R2021b_CM_double -1.7E+308 1.7E+308 /end CHARACTERISTIC
/begin CHARACTERISTIC speedgoat_test_SN5659__cal_impl.Decode2_P14_kg "" VALUE 0x008DDEB8 Scalar_FLOAT64_IEEE 0 speedgoat_test_SN5659_R2021b_CM_double -1.7E+308 1.7E+308 /end CHARACTERISTIC
/begin CHARACTERISTIC speedgoat_test_SN5659__cal_impl.Decode2_P15_b "" VALUE 0x008DD1A0 Scalar_FLOAT64_IEEE 0 speedgoat_test_SN5659_R2021b_CM_double -1.7E+308 1.7E+308 /end CHARACTERISTIC
/begin CHARACTERISTIC speedgoat_test_SN5659__cal_impl.Decode2_P15_gh "" VALUE 0x008DDED0 Scalar_FLOAT64_IEEE 0 speedgoat_test_SN5659_R2021b_CM_double -1.7E+308 1.7E+308 /end CHARACTERISTIC
/begin CHARACTERISTIC speedgoat_test_SN5659__cal_impl.Decode2_P15_l "" VALUE 0x008DD838 Scalar_FLOAT64_IEEE 0 speedgoat_test_SN5659_R2021b_CM_double -1.7E+308 1.7E+308 /end CHARACTERISTIC
/begin CHARACTERISTIC speedgoat_test_SN5659__cal_impl.Decode2_P16_a "" VALUE 0x008DDEE8 Scalar_FLOAT64_IEEE 0 speedgoat_test_SN5659_R2021b_CM_double -1.7E+308 1.7E+308 /end CHARACTERISTIC
/begin CHARACTERISTIC speedgoat_test_SN5659__cal_impl.Decode2_P16_d "" VALUE 0x008DD1B8 Scalar_FLOAT64_IEEE 0 speedgoat_test_SN5659_R2021b_CM_double -1.7E+308 1.7E+308 /end CHARACTERISTIC
/begin CHARACTERISTIC speedgoat_test_SN5659__cal_impl.Decode2_P16_h "" VALUE 0x008DD850 Scalar_FLOAT64_IEEE 0 speedgoat_test_SN5659_R2021b_CM_double -1.7E+308 1.7E+308 /end CHARACTERISTIC
/begin CHARACTERISTIC speedgoat_test_SN5659__cal_impl.Decode2_P1_b "" VALUE 0x008DD6E0 Scalar_FLOAT64_IEEE 0 speedgoat_test_SN5659_R2021b_CM_double -1.7E+308 1.7E+308 /end CHARACTERISTIC
/begin CHARACTERISTIC speedgoat_test_SN5659__cal_impl.Decode2_P1_i0 "" VALUE 0x008DDD78 Scalar_FLOAT64_IEEE 0 speedgoat_test_SN5659_R2021b_CM_double -1.7E+308 1.7E+308 /end CHARACTERISTIC
/begin CHARACTERISTIC speedgoat_test_SN5659__cal_impl.Decode2_P1_k "" VALUE 0x008DD048 Scalar_FLOAT64_IEEE 0 speedgoat_test_SN5659_R2021b_CM_double -1.7E+308 1.7E+308 /end CHARACTERISTIC
/begin CHARACTERISTIC speedgoat_test_SN5659__cal_impl.Decode2_P2_jg "" VALUE 0x008DD6F8 Scalar_FLOAT64_IEEE 0 speedgoat_test_SN5659_R2021b_CM_double -1.7E+308 1.7E+308 /end CHARACTERISTIC
/begin CHARACTERISTIC speedgoat_test_SN5659__cal_impl.Decode2_P2_kx "" VALUE 0x008DD060 Scalar_FLOAT64_IEEE 0 speedgoat_test_SN5659_R2021b_CM_double -1.7E+308 1.7E+308 /end CHARACTERISTIC
/begin CHARACTERISTIC speedgoat_test_SN5659__cal_impl.Decode2_P2_mg "" VALUE 0x008DDD90 Scalar_FLOAT64_IEEE 0 speedgoat_test_SN5659_R2021b_CM_double -1.7E+308 1.7E+308 /end CHARACTERISTIC
/begin CHARACTERISTIC speedgoat_test_SN5659__cal_impl.Decode2_P3_b5 "" VALUE 0x008DD078 Scalar_FLOAT64_IEEE 0 speedgoat_test_SN5659_R2021b_CM_double -1.7E+308 1.7E+308 /end CHARACTERISTIC
/begin CHARACTERISTIC speedgoat_test_SN5659__cal_impl.Decode2_P3_m "" VALUE 0x008DD710 Scalar_FLOAT64_IEEE 0 speedgoat_test_SN5659_R2021b_CM_double -1.7E+308 1.7E+308 /end CHARACTERISTIC
/begin CHARACTERISTIC speedgoat_test_SN5659__cal_impl.Decode2_P3_p "" VALUE 0x008DDDA8 Scalar_FLOAT64_IEEE 0 speedgoat_test_SN5659_R2021b_CM_double -1.7E+308 1.7E+308 /end CHARACTERISTIC
/begin CHARACTERISTIC speedgoat_test_SN5659__cal_impl.Decode2_P4_a "" VALUE 0x008DD090 Scalar_FLOAT64_IEEE 0 speedgoat_test_SN5659_R2021b_CM_double -1.7E+308 1.7E+308 /end CHARACTERISTIC
/begin CHARACTERISTIC speedgoat_test_SN5659__cal_impl.Decode2_P4_bb "" VALUE 0x008DDDC0 Scalar_FLOAT64_IEEE 0 speedgoat_test_SN5659_R2021b_CM_double -1.7E+308 1.7E+308 /end CHARACTERISTIC
/begin CHARACTERISTIC speedgoat_test_SN5659__cal_impl.Decode2_P4_ff "" VALUE 0x008DD728 Scalar_FLOAT64_IEEE 0 speedgoat_test_SN5659_R2021b_CM_double -1.7E+308 1.7E+308 /end CHARACTERISTIC
/begin CHARACTERISTIC speedgoat_test_SN5659__cal_impl.Decode2_P5_h "" VALUE 0x008DD740 Scalar_FLOAT64_IEEE 0 speedgoat_test_SN5659_R2021b_CM_double -1.7E+308 1.7E+308 /end CHARACTERISTIC
/begin CHARACTERISTIC speedgoat_test_SN5659__cal_impl.Decode2_P5_jm "" VALUE 0x008DD0A8 Scalar_FLOAT64_IEEE 0 speedgoat_test_SN5659_R2021b_CM_double -1.7E+308 1.7E+308 /end CHARACTERISTIC
/begin CHARACTERISTIC speedgoat_test_SN5659__cal_impl.Decode2_P5_ju "" VALUE 0x008DDDD8 Scalar_FLOAT64_IEEE 0 speedgoat_test_SN5659_R2021b_CM_double -1.7E+308 1.7E+308 /end CHARACTERISTIC
/begin CHARACTERISTIC speedgoat_test_SN5659__cal_impl.Decode2_P6_b "" VALUE 0x008DD758 Scalar_FLOAT64_IEEE 0 speedgoat_test_SN5659_R2021b_CM_double -1.7E+308 1.7E+308 /end CHARACTERISTIC
/begin CHARACTERISTIC speedgoat_test_SN5659__cal_impl.Decode2_P6_hg "" VALUE 0x008DDDF0 Scalar_FLOAT64_IEEE 0 speedgoat_test_SN5659_R2021b_CM_double -1.7E+308 1.7E+308 /end CHARACTERISTIC
/begin CHARACTERISTIC speedgoat_test_SN5659__cal_impl.Decode2_P6_lx "" VALUE 0x008DD0C0 Scalar_FLOAT64_IEEE 0 speedgoat_test_SN5659_R2021b_CM_double -1.7E+308 1.7E+308 /end CHARACTERISTIC
/begin CHARACTERISTIC speedgoat_test_SN5659__cal_impl.Decode2_P7_c "" VALUE 0x008DD770 Scalar_FLOAT64_IEEE 0 speedgoat_test_SN5659_R2021b_CM_double -1.7E+308 1.7E+308 /end CHARACTERISTIC
/begin CHARACTERISTIC speedgoat_test_SN5659__cal_impl.Decode2_P7_ht "" VALUE 0x008DDE08 Scalar_FLOAT64_IEEE 0 speedgoat_test_SN5659_R2021b_CM_double -1.7E+308 1.7E+308 /end CHARACTERISTIC
/begin CHARACTERISTIC speedgoat_test_SN5659__cal_impl.Decode2_P7_k "" VALUE 0x008DD0D8 Scalar_FLOAT64_IEEE 0 speedgoat_test_SN5659_R2021b_CM_double -1.7E+308 1.7E+308 /end CHARACTERISTIC
/begin CHARACTERISTIC speedgoat_test_SN5659__cal_impl.Decode2_P8_fr "" VALUE 0x008DDE20 Scalar_FLOAT64_IEEE 0 speedgoat_test_SN5659_R2021b_CM_double -1.7E+308 1.7E+308 /end CHARACTERISTIC
/begin CHARACTERISTIC speedgoat_test_SN5659__cal_impl.Decode2_P8_h4 "" VALUE 0x008DD0F0 Scalar_FLOAT64_IEEE 0 speedgoat_test_SN5659_R2021b_CM_double -1.7E+308 1.7E+308 /end CHARACTERISTIC
/begin CHARACTERISTIC speedgoat_test_SN5659__cal_impl.Decode2_P8_k "" VALUE 0x008DD788 Scalar_FLOAT64_IEEE 0 speedgoat_test_SN5659_R2021b_CM_double -1.7E+308 1.7E+308 /end CHARACTERISTIC
/begin CHARACTERISTIC speedgoat_test_SN5659__cal_impl.Decode2_P9_gj "" VALUE 0x008DD7A0 Scalar_FLOAT64_IEEE 0 speedgoat_test_SN5659_R2021b_CM_double -1.7E+308 1.7E+308 /end CHARACTERISTIC
/begin CHARACTERISTIC speedgoat_test_SN5659__cal_impl.Decode2_P9_gq "" VALUE 0x008DD108 Scalar_FLOAT64_IEEE 0 speedgoat_test_SN5659_R2021b_CM_double -1.7E+308 1.7E+308 /end CHARACTERISTIC
/begin CHARACTERISTIC speedgoat_test_SN5659__cal_impl.Decode2_P9_m "" VALUE 0x008DDE38 Scalar_FLOAT64_IEEE 0 speedgoat_test_SN5659_R2021b_CM_double -1.7E+308 1.7E+308 /end CHARACTERISTIC
/begin CHARACTERISTIC speedgoat_test_SN5659__cal_impl.Decode3_P10_av "" VAL_BLK 0x008DD2A8 Scalar_FLOAT64_IEEE 0 speedgoat_test_SN5659_R2021b_CM_double -1.7E+308 1.7E+308 MATRIX_DIM 2 1 /end CHARACTERISTIC
/begin CHARACTERISTIC speedgoat_test_SN5659__cal_impl.Decode3_P10_g "" VAL_BLK 0x008DDFD8 Scalar_FLOAT64_IEEE 0 speedgoat_test_SN5659_R2021b_CM_double -1.7E+308 1.7E+308 MATRIX_DIM 2 1 /end CHARACTERISTIC
/begin CHARACTERISTIC speedgoat_test_SN5659__cal_impl.Decode3_P10_k "" VAL_BLK 0x008D8A20 Scalar_FLOAT64_IEEE 0 speedgoat_test_SN5659_R2021b_CM_double -1.7E+308 1.7E+308 MATRIX_DIM 2 1 /end CHARACTERISTIC
/begin CHARACTERISTIC speedgoat_test_SN5659__cal_impl.Decode3_P10_lv "" VAL_BLK 0x008DD940 Scalar_FLOAT64_IEEE 0 speedgoat_test_SN5659_R2021b_CM_double -1.7E+308 1.7E+308 MATRIX_DIM 2 1 /end CHARACTERISTIC
/begin CHARACTERISTIC speedgoat_test_SN5659__cal_impl.Decode3_P11_e "" VALUE 0x008D8A40 Scalar_FLOAT64_IEEE 0 speedgoat_test_SN5659_R2021b_CM_double -1.7E+308 1.7E+308 /end CHARACTERISTIC
/begin CHARACTERISTIC speedgoat_test_SN5659__cal_impl.Decode3_P11_ku "" VALUE 0x008DD2C8 Scalar_FLOAT64_IEEE 0 speedgoat_test_SN5659_R2021b_CM_double -1.7E+308 1.7E+308 /end CHARACTERISTIC
/begin CHARACTERISTIC speedgoat_test_SN5659__cal_impl.Decode3_P11_n "" VALUE 0x008DD960 Scalar_FLOAT64_IEEE 0 speedgoat_test_SN5659_R2021b_CM_double -1.7E+308 1.7E+308 /end CHARACTERISTIC
/begin CHARACTERISTIC speedgoat_test_SN5659__cal_impl.Decode3_P11_o "" VALUE 0x008DDFF8 Scalar_FLOAT64_IEEE 0 speedgoat_test_SN5659_R2021b_CM_double -1.7E+308 1.7E+308 /end CHARACTERISTIC
/begin CHARACTERISTIC speedgoat_test_SN5659__cal_impl.Decode3_P12_ak "" VALUE 0x008DE010 Scalar_FLOAT64_IEEE 0 speedgoat_test_SN5659_R2021b_CM_double -1.7E+308 1.7E+308 /end CHARACTERISTIC
/begin CHARACTERISTIC speedgoat_test_SN5659__cal_impl.Decode3_P12_e "" VALUE 0x008DD2E0 Scalar_FLOAT64_IEEE 0 speedgoat_test_SN5659_R2021b_CM_double -1.7E+308 1.7E+308 /end CHARACTERISTIC
/begin CHARACTERISTIC speedgoat_test_SN5659__cal_impl.Decode3_P12_i "" VALUE 0x008D8A58 Scalar_FLOAT64_IEEE 0 speedgoat_test_SN5659_R2021b_CM_double -1.7E+308 1.7E+308 /end CHARACTERISTIC
/begin CHARACTERISTIC speedgoat_test_SN5659__cal_impl.Decode3_P12_pg "" VALUE 0x008DD978 Scalar_FLOAT64_IEEE 0 speedgoat_test_SN5659_R2021b_CM_double -1.7E+308 1.7E+308 /end CHARACTERISTIC
/begin CHARACTERISTIC speedgoat_test_SN5659__cal_impl.Decode3_P13_bw "" VALUE 0x008DD990 Scalar_FLOAT64_IEEE 0 speedgoat_test_SN5659_R2021b_CM_double -1.7E+308 1.7E+308 /end CHARACTERISTIC
/begin CHARACTERISTIC speedgoat_test_SN5659__cal_impl.Decode3_P13_e1 "" VALUE 0x008DE028 Scalar_FLOAT64_IEEE 0 speedgoat_test_SN5659_R2021b_CM_double -1.7E+308 1.7E+308 /end CHARACTERISTIC
/begin CHARACTERISTIC speedgoat_test_SN5659__cal_impl.Decode3_P13_fu "" VALUE 0x008DD2F8 Scalar_FLOAT64_IEEE 0 speedgoat_test_SN5659_R2021b_CM_double -1.7E+308 1.7E+308 /end CHARACTERISTIC
/begin CHARACTERISTIC speedgoat_test_SN5659__cal_impl.Decode3_P13_j "" VALUE 0x008D8A70 Scalar_FLOAT64_IEEE 0 speedgoat_test_SN5659_R2021b_CM_double -1.7E+308 1.7E+308 /end CHARACTERISTIC
/begin CHARACTERISTIC speedgoat_test_SN5659__cal_impl.Decode3_P14_o "" VALUE 0x008DD9A8 Scalar_FLOAT64_IEEE 0 speedgoat_test_SN5659_R2021b_CM_double -1.7E+308 1.7E+308 /end CHARACTERISTIC
/begin CHARACTERISTIC speedgoat_test_SN5659__cal_impl.Decode3_P14_od "" VALUE 0x008DE040 Scalar_FLOAT64_IEEE 0 speedgoat_test_SN5659_R2021b_CM_double -1.7E+308 1.7E+308 /end CHARACTERISTIC
/begin CHARACTERISTIC speedgoat_test_SN5659__cal_impl.Decode3_P14_p "" VALUE 0x008D8A88 Scalar_FLOAT64_IEEE 0 speedgoat_test_SN5659_R2021b_CM_double -1.7E+308 1.7E+308 /end CHARACTERISTIC
/begin CHARACTERISTIC speedgoat_test_SN5659__cal_impl.Decode3_P14_ph "" VALUE 0x008DD310 Scalar_FLOAT64_IEEE 0 speedgoat_test_SN5659_R2021b_CM_double -1.7E+308 1.7E+308 /end CHARACTERISTIC
/begin CHARACTERISTIC speedgoat_test_SN5659__cal_impl.Decode3_P15_hq "" VALUE 0x008DD328 Scalar_FLOAT64_IEEE 0 speedgoat_test_SN5659_R2021b_CM_double -1.7E+308 1.7E+308 /end CHARACTERISTIC
/begin CHARACTERISTIC speedgoat_test_SN5659__cal_impl.Decode3_P15_i "" VALUE 0x008DE058 Scalar_FLOAT64_IEEE 0 speedgoat_test_SN5659_R2021b_CM_double -1.7E+308 1.7E+308 /end CHARACTERISTIC
/begin CHARACTERISTIC speedgoat_test_SN5659__cal_impl.Decode3_P15_m "" VALUE 0x008D8AA0 Scalar_FLOAT64_IEEE 0 speedgoat_test_SN5659_R2021b_CM_double -1.7E+308 1.7E+308 /end CHARACTERISTIC
/begin CHARACTERISTIC speedgoat_test_SN5659__cal_impl.Decode3_P15_o "" VALUE 0x008DD9C0 Scalar_FLOAT64_IEEE 0 speedgoat_test_SN5659_R2021b_CM_double -1.7E+308 1.7E+308 /end CHARACTERISTIC
/begin CHARACTERISTIC speedgoat_test_SN5659__cal_impl.Decode3_P16_c "" VALUE 0x008DD9D8 Scalar_FLOAT64_IEEE 0 speedgoat_test_SN5659_R2021b_CM_double -1.7E+308 1.7E+308 /end CHARACTERISTIC
/begin CHARACTERISTIC speedgoat_test_SN5659__cal_impl.Decode3_P16_iz "" VALUE 0x008DD340 Scalar_FLOAT64_IEEE 0 speedgoat_test_SN5659_R2021b_CM_double -1.7E+308 1.7E+308 /end CHARACTERISTIC
/begin CHARACTERISTIC speedgoat_test_SN5659__cal_impl.Decode3_P16_m "" VALUE 0x008DE070 Scalar_FLOAT64_IEEE 0 speedgoat_test_SN5659_R2021b_CM_double -1.7E+308 1.7E+308 /end CHARACTERISTIC
/begin CHARACTERISTIC speedgoat_test_SN5659__cal_impl.Decode3_P16_n "" VALUE 0x008D8AB8 Scalar_FLOAT64_IEEE 0 speedgoat_test_SN5659_R2021b_CM_double -1.7E+308 1.7E+308 /end CHARACTERISTIC
/begin CHARACTERISTIC speedgoat_test_SN5659__cal_impl.Decode3_P1_c "" VALUE 0x008D8948 Scalar_FLOAT64_IEEE 0 speedgoat_test_SN5659_R2021b_CM_double -1.7E+308 1.7E+308 /end CHARACTERISTIC
/begin CHARACTERISTIC speedgoat_test_SN5659__cal_impl.Decode3_P1_ew "" VALUE 0x008DD868 Scalar_FLOAT64_IEEE 0 speedgoat_test_SN5659_R2021b_CM_double -1.7E+308 1.7E+308 /end CHARACTERISTIC
/begin CHARACTERISTIC speedgoat_test_SN5659__cal_impl.Decode3_P1_nz "" VALUE 0x008DDF00 Scalar_FLOAT64_IEEE 0 speedgoat_test_SN5659_R2021b_CM_double -1.7E+308 1.7E+308 /end CHARACTERISTIC
/begin CHARACTERISTIC speedgoat_test_SN5659__cal_impl.Decode3_P1_p "" VALUE 0x008DD1D0 Scalar_FLOAT64_IEEE 0 speedgoat_test_SN5659_R2021b_CM_double -1.7E+308 1.7E+308 /end CHARACTERISTIC
/begin CHARACTERISTIC speedgoat_test_SN5659__cal_impl.Decode3_P2_f "" VALUE 0x008DD1E8 Scalar_FLOAT64_IEEE 0 speedgoat_test_SN5659_R2021b_CM_double -1.7E+308 1.7E+308 /end CHARACTERISTIC
/begin CHARACTERISTIC speedgoat_test_SN5659__cal_impl.Decode3_P2_j "" VALUE 0x008D8960 Scalar_FLOAT64_IEEE 0 speedgoat_test_SN5659_R2021b_CM_double -1.7E+308 1.7E+308 /end CHARACTERISTIC
/begin CHARACTERISTIC speedgoat_test_SN5659__cal_impl.Decode3_P2_ll "" VALUE 0x008DD880 Scalar_FLOAT64_IEEE 0 speedgoat_test_SN5659_R2021b_CM_double -1.7E+308 1.7E+308 /end CHARACTERISTIC
/begin CHARACTERISTIC speedgoat_test_SN5659__cal_impl.Decode3_P2_n "" VALUE 0x008DDF18 Scalar_FLOAT64_IEEE 0 speedgoat_test_SN5659_R2021b_CM_double -1.7E+308 1.7E+308 /end CHARACTERISTIC
/begin CHARACTERISTIC speedgoat_test_SN5659__cal_impl.Decode3_P3_a "" VALUE 0x008DDF30 Scalar_FLOAT64_IEEE 0 speedgoat_test_SN5659_R2021b_CM_double -1.7E+308 1.7E+308 /end CHARACTERISTIC
/begin CHARACTERISTIC speedgoat_test_SN5659__cal_impl.Decode3_P3_d "" VALUE 0x008DD200 Scalar_FLOAT64_IEEE 0 speedgoat_test_SN5659_R2021b_CM_double -1.7E+308 1.7E+308 /end CHARACTERISTIC
/begin CHARACTERISTIC speedgoat_test_SN5659__cal_impl.Decode3_P3_j "" VALUE 0x008D8978 Scalar_FLOAT64_IEEE 0 speedgoat_test_SN5659_R2021b_CM_double -1.7E+308 1.7E+308 /end CHARACTERISTIC
/begin CHARACTERISTIC speedgoat_test_SN5659__cal_impl.Decode3_P3_o "" VALUE 0x008DD898 Scalar_FLOAT64_IEEE 0 speedgoat_test_SN5659_R2021b_CM_double -1.7E+308 1.7E+308 /end CHARACTERISTIC
/begin CHARACTERISTIC speedgoat_test_SN5659__cal_impl.Decode3_P4_av "" VALUE 0x008DD8B0 Scalar_FLOAT64_IEEE 0 speedgoat_test_SN5659_R2021b_CM_double -1.7E+308 1.7E+308 /end CHARACTERISTIC
/begin CHARACTERISTIC speedgoat_test_SN5659__cal_impl.Decode3_P4_c "" VALUE 0x008DDF48 Scalar_FLOAT64_IEEE 0 speedgoat_test_SN5659_R2021b_CM_double -1.7E+308 1.7E+308 /end CHARACTERISTIC
/begin CHARACTERISTIC speedgoat_test_SN5659__cal_impl.Decode3_P4_dj "" VALUE 0x008DD218 Scalar_FLOAT64_IEEE 0 speedgoat_test_SN5659_R2021b_CM_double -1.7E+308 1.7E+308 /end CHARACTERISTIC
/begin CHARACTERISTIC speedgoat_test_SN5659__cal_impl.Decode3_P4_p "" VALUE 0x008D8990 Scalar_FLOAT64_IEEE 0 speedgoat_test_SN5659_R2021b_CM_double -1.7E+308 1.7E+308 /end CHARACTERISTIC
/begin CHARACTERISTIC speedgoat_test_SN5659__cal_impl.Decode3_P5_as "" VALUE 0x008DD8C8 Scalar_FLOAT64_IEEE 0 speedgoat_test_SN5659_R2021b_CM_double -1.7E+308 1.7E+308 /end CHARACTERISTIC
/begin CHARACTERISTIC speedgoat_test_SN5659__cal_impl.Decode3_P5_b "" VALUE 0x008D89A8 Scalar_FLOAT64_IEEE 0 speedgoat_test_SN5659_R2021b_CM_double -1.7E+308 1.7E+308 /end CHARACTERISTIC
/begin CHARACTERISTIC speedgoat_test_SN5659__cal_impl.Decode3_P5_gt "" VALUE 0x008DDF60 Scalar_FLOAT64_IEEE 0 speedgoat_test_SN5659_R2021b_CM_double -1.7E+308 1.7E+308 /end CHARACTERISTIC
/begin CHARACTERISTIC speedgoat_test_SN5659__cal_impl.Decode3_P5_j "" VALUE 0x008DD230 Scalar_FLOAT64_IEEE 0 speedgoat_test_SN5659_R2021b_CM_double -1.7E+308 1.7E+308 /end CHARACTERISTIC
/begin CHARACTERISTIC speedgoat_test_SN5659__cal_impl.Decode3_P6_f "" VALUE 0x008DD248 Scalar_FLOAT64_IEEE 0 speedgoat_test_SN5659_R2021b_CM_double -1.7E+308 1.7E+308 /end CHARACTERISTIC
/begin CHARACTERISTIC speedgoat_test_SN5659__cal_impl.Decode3_P6_h "" VALUE 0x008D89C0 Scalar_FLOAT64_IEEE 0 speedgoat_test_SN5659_R2021b_CM_double -1.7E+308 1.7E+308 /end CHARACTERISTIC
/begin CHARACTERISTIC speedgoat_test_SN5659__cal_impl.Decode3_P6_j "" VALUE 0x008DD8E0 Scalar_FLOAT64_IEEE 0 speedgoat_test_SN5659_R2021b_CM_double -1.7E+308 1.7E+308 /end CHARACTERISTIC
/begin CHARACTERISTIC speedgoat_test_SN5659__cal_impl.Decode3_P6_ov "" VALUE 0x008DDF78 Scalar_FLOAT64_IEEE 0 speedgoat_test_SN5659_R2021b_CM_double -1.7E+308 1.7E+308 /end CHARACTERISTIC
/begin CHARACTERISTIC speedgoat_test_SN5659__cal_impl.Decode3_P7_d "" VALUE 0x008D89D8 Scalar_FLOAT64_IEEE 0 speedgoat_test_SN5659_R2021b_CM_double -1.7E+308 1.7E+308 /end CHARACTERISTIC
/begin CHARACTERISTIC speedgoat_test_SN5659__cal_impl.Decode3_P7_fb "" VALUE 0x008DD8F8 Scalar_FLOAT64_IEEE 0 speedgoat_test_SN5659_R2021b_CM_double -1.7E+308 1.7E+308 /end CHARACTERISTIC
/begin CHARACTERISTIC speedgoat_test_SN5659__cal_impl.Decode3_P7_ix "" VALUE 0x008DDF90 Scalar_FLOAT64_IEEE 0 speedgoat_test_SN5659_R2021b_CM_double -1.7E+308 1.7E+308 /end CHARACTERISTIC
/begin CHARACTERISTIC speedgoat_test_SN5659__cal_impl.Decode3_P7_p "" VALUE 0x008DD260 Scalar_FLOAT64_IEEE 0 speedgoat_test_SN5659_R2021b_CM_double -1.7E+308 1.7E+308 /end CHARACTERISTIC
/begin CHARACTERISTIC speedgoat_test_SN5659__cal_impl.Decode3_P8_d "" VALUE 0x008DD910 Scalar_FLOAT64_IEEE 0 speedgoat_test_SN5659_R2021b_CM_double -1.7E+308 1.7E+308 /end CHARACTERISTIC
/begin CHARACTERISTIC speedgoat_test_SN5659__cal_impl.Decode3_P8_f "" VALUE 0x008DD278 Scalar_FLOAT64_IEEE 0 speedgoat_test_SN5659_R2021b_CM_double -1.7E+308 1.7E+308 /end CHARACTERISTIC
/begin CHARACTERISTIC speedgoat_test_SN5659__cal_impl.Decode3_P8_h "" VALUE 0x008D89F0 Scalar_FLOAT64_IEEE 0 speedgoat_test_SN5659_R2021b_CM_double -1.7E+308 1.7E+308 /end CHARACTERISTIC
/begin CHARACTERISTIC speedgoat_test_SN5659__cal_impl.Decode3_P8_n "" VALUE 0x008DDFA8 Scalar_FLOAT64_IEEE 0 speedgoat_test_SN5659_R2021b_CM_double -1.7E+308 1.7E+308 /end CHARACTERISTIC
/begin CHARACTERISTIC speedgoat_test_SN5659__cal_impl.Decode3_P9_f "" VALUE 0x008DD928 Scalar_FLOAT64_IEEE 0 speedgoat_test_SN5659_R2021b_CM_double -1.7E+308 1.7E+308 /end CHARACTERISTIC
/begin CHARACTERISTIC speedgoat_test_SN5659__cal_impl.Decode3_P9_i "" VALUE 0x008D8A08 Scalar_FLOAT64_IEEE 0 speedgoat_test_SN5659_R2021b_CM_double -1.7E+308 1.7E+308 /end CHARACTERISTIC
/begin CHARACTERISTIC speedgoat_test_SN5659__cal_impl.Decode3_P9_ig "" VALUE 0x008DD290 Scalar_FLOAT64_IEEE 0 speedgoat_test_SN5659_R2021b_CM_double -1.7E+308 1.7E+308 /end CHARACTERISTIC
/begin CHARACTERISTIC speedgoat_test_SN5659__cal_impl.Decode3_P9_p "" VALUE 0x008DDFC0 Scalar_FLOAT64_IEEE 0 speedgoat_test_SN5659_R2021b_CM_double -1.7E+308 1.7E+308 /end CHARACTERISTIC
/begin CHARACTERISTIC speedgoat_test_SN5659__cal_impl.Decode4_P10_ax "" VAL_BLK 0x008DDAC8 Scalar_FLOAT64_IEEE 0 speedgoat_test_SN5659_R2021b_CM_double -1.7E+308 1.7E+308 MATRIX_DIM 2 1 /end CHARACTERISTIC
/begin CHARACTERISTIC speedgoat_test_SN5659__cal_impl.Decode4_P10_d "" VAL_BLK 0x008D8BA8 Scalar_FLOAT64_IEEE 0 speedgoat_test_SN5659_R2021b_CM_double -1.7E+308 1.7E+308 MATRIX_DIM 2 1 /end CHARACTERISTIC
/begin CHARACTERISTIC speedgoat_test_SN5659__cal_impl.Decode4_P10_k "" VAL_BLK 0x008DE160 Scalar_FLOAT64_IEEE 0 speedgoat_test_SN5659_R2021b_CM_double -1.7E+308 1.7E+308 MATRIX_DIM 2 1 /end CHARACTERISTIC
/begin CHARACTERISTIC speedgoat_test_SN5659__cal_impl.Decode4_P10_l "" VAL_BLK 0x008DD430 Scalar_FLOAT64_IEEE 0 speedgoat_test_SN5659_R2021b_CM_double -1.7E+308 1.7E+308 MATRIX_DIM 2 1 /end CHARACTERISTIC
/begin CHARACTERISTIC speedgoat_test_SN5659__cal_impl.Decode4_P11_dk "" VALUE 0x008DD450 Scalar_FLOAT64_IEEE 0 speedgoat_test_SN5659_R2021b_CM_double -1.7E+308 1.7E+308 /end CHARACTERISTIC
/begin CHARACTERISTIC speedgoat_test_SN5659__cal_impl.Decode4_P11_g "" VALUE 0x008D8BC8 Scalar_FLOAT64_IEEE 0 speedgoat_test_SN5659_R2021b_CM_double -1.7E+308 1.7E+308 /end CHARACTERISTIC
/begin CHARACTERISTIC speedgoat_test_SN5659__cal_impl.Decode4_P11_mg "" VALUE 0x008DE180 Scalar_FLOAT64_IEEE 0 speedgoat_test_SN5659_R2021b_CM_double -1.7E+308 1.7E+308 /end CHARACTERISTIC
/begin CHARACTERISTIC speedgoat_test_SN5659__cal_impl.Decode4_P11_mt "" VALUE 0x008DDAE8 Scalar_FLOAT64_IEEE 0 speedgoat_test_SN5659_R2021b_CM_double -1.7E+308 1.7E+308 /end CHARACTERISTIC
/begin CHARACTERISTIC speedgoat_test_SN5659__cal_impl.Decode4_P12_ci "" VALUE 0x008DE198 Scalar_FLOAT64_IEEE 0 speedgoat_test_SN5659_R2021b_CM_double -1.7E+308 1.7E+308 /end CHARACTERISTIC
/begin CHARACTERISTIC speedgoat_test_SN5659__cal_impl.Decode4_P12_e "" VALUE 0x008D8BE0 Scalar_FLOAT64_IEEE 0 speedgoat_test_SN5659_R2021b_CM_double -1.7E+308 1.7E+308 /end CHARACTERISTIC
/begin CHARACTERISTIC speedgoat_test_SN5659__cal_impl.Decode4_P12_i "" VALUE 0x008DD468 Scalar_FLOAT64_IEEE 0 speedgoat_test_SN5659_R2021b_CM_double -1.7E+308 1.7E+308 /end CHARACTERISTIC
/begin CHARACTERISTIC speedgoat_test_SN5659__cal_impl.Decode4_P12_ik "" VALUE 0x008DDB00 Scalar_FLOAT64_IEEE 0 speedgoat_test_SN5659_R2021b_CM_double -1.7E+308 1.7E+308 /end CHARACTERISTIC
/begin CHARACTERISTIC speedgoat_test_SN5659__cal_impl.Decode4_P13_cn "" VALUE 0x008DDB18 Scalar_FLOAT64_IEEE 0 speedgoat_test_SN5659_R2021b_CM_double -1.7E+308 1.7E+308 /end CHARACTERISTIC
/begin CHARACTERISTIC speedgoat_test_SN5659__cal_impl.Decode4_P13_gv "" VALUE 0x008DD480 Scalar_FLOAT64_IEEE 0 speedgoat_test_SN5659_R2021b_CM_double -1.7E+308 1.7E+308 /end CHARACTERISTIC
/begin CHARACTERISTIC speedgoat_test_SN5659__cal_impl.Decode4_P13_l "" VALUE 0x008DE1B0 Scalar_FLOAT64_IEEE 0 speedgoat_test_SN5659_R2021b_CM_double -1.7E+308 1.7E+308 /end CHARACTERISTIC
/begin CHARACTERISTIC speedgoat_test_SN5659__cal_impl.Decode4_P13_o "" VALUE 0x008D8BF8 Scalar_FLOAT64_IEEE 0 speedgoat_test_SN5659_R2021b_CM_double -1.7E+308 1.7E+308 /end CHARACTERISTIC
/begin CHARACTERISTIC speedgoat_test_SN5659__cal_impl.Decode4_P14_b "" VALUE 0x008DE1C8 Scalar_FLOAT64_IEEE 0 speedgoat_test_SN5659_R2021b_CM_double -1.7E+308 1.7E+308 /end CHARACTERISTIC
/begin CHARACTERISTIC speedgoat_test_SN5659__cal_impl.Decode4_P14_fz "" VALUE 0x008DDB30 Scalar_FLOAT64_IEEE 0 speedgoat_test_SN5659_R2021b_CM_double -1.7E+308 1.7E+308 /end CHARACTERISTIC
/begin CHARACTERISTIC speedgoat_test_SN5659__cal_impl.Decode4_P14_k "" VALUE 0x008D8C10 Scalar_FLOAT64_IEEE 0 speedgoat_test_SN5659_R2021b_CM_double -1.7E+308 1.7E+308 /end CHARACTERISTIC
/begin CHARACTERISTIC speedgoat_test_SN5659__cal_impl.Decode4_P14_m "" VALUE 0x008DD498 Scalar_FLOAT64_IEEE 0 speedgoat_test_SN5659_R2021b_CM_double -1.7E+308 1.7E+308 /end CHARACTERISTIC
/begin CHARACTERISTIC speedgoat_test_SN5659__cal_impl.Decode4_P15_h "" VALUE 0x008DE1E0 Scalar_FLOAT64_IEEE 0 speedgoat_test_SN5659_R2021b_CM_double -1.7E+308 1.7E+308 /end CHARACTERISTIC
/begin CHARACTERISTIC speedgoat_test_SN5659__cal_impl.Decode4_P15_j "" VALUE 0x008D8C28 Scalar_FLOAT64_IEEE 0 speedgoat_test_SN5659_R2021b_CM_double -1.7E+308 1.7E+308 /end CHARACTERISTIC
/begin CHARACTERISTIC speedgoat_test_SN5659__cal_impl.Decode4_P15_l "" VALUE 0x008DDB48 Scalar_FLOAT64_IEEE 0 speedgoat_test_SN5659_R2021b_CM_double -1.7E+308 1.7E+308 /end CHARACTERISTIC
/begin CHARACTERISTIC speedgoat_test_SN5659__cal_impl.Decode4_P15_pv "" VALUE 0x008DD4B0 Scalar_FLOAT64_IEEE 0 speedgoat_test_SN5659_R2021b_CM_double -1.7E+308 1.7E+308 /end CHARACTERISTIC
/begin CHARACTERISTIC speedgoat_test_SN5659__cal_impl.Decode4_P16_ad "" VALUE 0x008DD4C8 Scalar_FLOAT64_IEEE 0 speedgoat_test_SN5659_R2021b_CM_double -1.7E+308 1.7E+308 /end CHARACTERISTIC
/begin CHARACTERISTIC speedgoat_test_SN5659__cal_impl.Decode4_P16_b "" VALUE 0x008D8C40 Scalar_FLOAT64_IEEE 0 speedgoat_test_SN5659_R2021b_CM_double -1.7E+308 1.7E+308 /end CHARACTERISTIC
/begin CHARACTERISTIC speedgoat_test_SN5659__cal_impl.Decode4_P16_du "" VALUE 0x008DDB60 Scalar_FLOAT64_IEEE 0 speedgoat_test_SN5659_R2021b_CM_double -1.7E+308 1.7E+308 /end CHARACTERISTIC
/begin CHARACTERISTIC speedgoat_test_SN5659__cal_impl.Decode4_P16_n "" VALUE 0x008DE1F8 Scalar_FLOAT64_IEEE 0 speedgoat_test_SN5659_R2021b_CM_double -1.7E+308 1.7E+308 /end CHARACTERISTIC
/begin CHARACTERISTIC speedgoat_test_SN5659__cal_impl.Decode4_P1_d "" VALUE 0x008DD9F0 Scalar_FLOAT64_IEEE 0 speedgoat_test_SN5659_R2021b_CM_double -1.7E+308 1.7E+308 /end CHARACTERISTIC
/begin CHARACTERISTIC speedgoat_test_SN5659__cal_impl.Decode4_P1_fa "" VALUE 0x008DD358 Scalar_FLOAT64_IEEE 0 speedgoat_test_SN5659_R2021b_CM_double -1.7E+308 1.7E+308 /end CHARACTERISTIC
/begin CHARACTERISTIC speedgoat_test_SN5659__cal_impl.Decode4_P1_i "" VALUE 0x008D8AD0 Scalar_FLOAT64_IEEE 0 speedgoat_test_SN5659_R2021b_CM_double -1.7E+308 1.7E+308 /end CHARACTERISTIC
/begin CHARACTERISTIC speedgoat_test_SN5659__cal_impl.Decode4_P1_ml "" VALUE 0x008DE088 Scalar_FLOAT64_IEEE 0 speedgoat_test_SN5659_R2021b_CM_double -1.7E+308 1.7E+308 /end CHARACTERISTIC
/begin CHARACTERISTIC speedgoat_test_SN5659__cal_impl.Decode4_P2_b "" VALUE 0x008DDA08 Scalar_FLOAT64_IEEE 0 speedgoat_test_SN5659_R2021b_CM_double -1.7E+308 1.7E+308 /end CHARACTERISTIC
/begin CHARACTERISTIC speedgoat_test_SN5659__cal_impl.Decode4_P2_e5 "" VALUE 0x008DD370 Scalar_FLOAT64_IEEE 0 speedgoat_test_SN5659_R2021b_CM_double -1.7E+308 1.7E+308 /end CHARACTERISTIC
/begin CHARACTERISTIC speedgoat_test_SN5659__cal_impl.Decode4_P2_k "" VALUE 0x008D8AE8 Scalar_FLOAT64_IEEE 0 speedgoat_test_SN5659_R2021b_CM_double -1.7E+308 1.7E+308 /end CHARACTERISTIC
/begin CHARACTERISTIC speedgoat_test_SN5659__cal_impl.Decode4_P2_l1 "" VALUE 0x008DE0A0 Scalar_FLOAT64_IEEE 0 speedgoat_test_SN5659_R2021b_CM_double -1.7E+308 1.7E+308 /end CHARACTERISTIC
/begin CHARACTERISTIC speedgoat_test_SN5659__cal_impl.Decode4_P3_i "" VALUE 0x008DE0B8 Scalar_FLOAT64_IEEE 0 speedgoat_test_SN5659_R2021b_CM_double -1.7E+308 1.7E+308 /end CHARACTERISTIC
/begin CHARACTERISTIC speedgoat_test_SN5659__cal_impl.Decode4_P3_l "" VALUE 0x008D8B00 Scalar_FLOAT64_IEEE 0 speedgoat_test_SN5659_R2021b_CM_double -1.7E+308 1.7E+308 /end CHARACTERISTIC
/begin CHARACTERISTIC speedgoat_test_SN5659__cal_impl.Decode4_P3_mv "" VALUE 0x008DDA20 Scalar_FLOAT64_IEEE 0 speedgoat_test_SN5659_R2021b_CM_double -1.7E+308 1.7E+308 /end CHARACTERISTIC
/begin CHARACTERISTIC speedgoat_test_SN5659__cal_impl.Decode4_P3_p4 "" VALUE 0x008DD388 Scalar_FLOAT64_IEEE 0 speedgoat_test_SN5659_R2021b_CM_double -1.7E+308 1.7E+308 /end CHARACTERISTIC
/begin CHARACTERISTIC speedgoat_test_SN5659__cal_impl.Decode4_P4_f1 "" VALUE 0x008DE0D0 Scalar_FLOAT64_IEEE 0 speedgoat_test_SN5659_R2021b_CM_double -1.7E+308 1.7E+308 /end CHARACTERISTIC
/begin CHARACTERISTIC speedgoat_test_SN5659__cal_impl.Decode4_P4_k "" VALUE 0x008D8B18 Scalar_FLOAT64_IEEE 0 speedgoat_test_SN5659_R2021b_CM_double -1.7E+308 1.7E+308 /end CHARACTERISTIC
/begin CHARACTERISTIC speedgoat_test_SN5659__cal_impl.Decode4_P4_kx "" VALUE 0x008DDA38 Scalar_FLOAT64_IEEE 0 speedgoat_test_SN5659_R2021b_CM_double -1.7E+308 1.7E+308 /end CHARACTERISTIC
/begin CHARACTERISTIC speedgoat_test_SN5659__cal_impl.Decode4_P4_p2 "" VALUE 0x008DD3A0 Scalar_FLOAT64_IEEE 0 speedgoat_test_SN5659_R2021b_CM_double -1.7E+308 1.7E+308 /end CHARACTERISTIC
/begin CHARACTERISTIC speedgoat_test_SN5659__cal_impl.Decode4_P5_cd "" VALUE 0x008DD3B8 Scalar_FLOAT64_IEEE 0 speedgoat_test_SN5659_R2021b_CM_double -1.7E+308 1.7E+308 /end CHARACTERISTIC
/begin CHARACTERISTIC speedgoat_test_SN5659__cal_impl.Decode4_P5_h "" VALUE 0x008DE0E8 Scalar_FLOAT64_IEEE 0 speedgoat_test_SN5659_R2021b_CM_double -1.7E+308 1.7E+308 /end CHARACTERISTIC
/begin CHARACTERISTIC speedgoat_test_SN5659__cal_impl.Decode4_P5_i "" VALUE 0x008D8B30 Scalar_FLOAT64_IEEE 0 speedgoat_test_SN5659_R2021b_CM_double -1.7E+308 1.7E+308 /end CHARACTERISTIC
/begin CHARACTERISTIC speedgoat_test_SN5659__cal_impl.Decode4_P5_ia "" VALUE 0x008DDA50 Scalar_FLOAT64_IEEE 0 speedgoat_test_SN5659_R2021b_CM_double -1.7E+308 1.7E+308 /end CHARACTERISTIC
/begin CHARACTERISTIC speedgoat_test_SN5659__cal_impl.Decode4_P6_an "" VALUE 0x008DDA68 Scalar_FLOAT64_IEEE 0 speedgoat_test_SN5659_R2021b_CM_double -1.7E+308 1.7E+308 /end CHARACTERISTIC
/begin CHARACTERISTIC speedgoat_test_SN5659__cal_impl.Decode4_P6_fd "" VALUE 0x008DD3D0 Scalar_FLOAT64_IEEE 0 speedgoat_test_SN5659_R2021b_CM_double -1.7E+308 1.7E+308 /end CHARACTERISTIC
/begin CHARACTERISTIC speedgoat_test_SN5659__cal_impl.Decode4_P6_g "" VALUE 0x008DE100 Scalar_FLOAT64_IEEE 0 speedgoat_test_SN5659_R2021b_CM_double -1.7E+308 1.7E+308 /end CHARACTERISTIC
/begin CHARACTERISTIC speedgoat_test_SN5659__cal_impl.Decode4_P6_n "" VALUE 0x008D8B48 Scalar_FLOAT64_IEEE 0 speedgoat_test_SN5659_R2021b_CM_double -1.7E+308 1.7E+308 /end CHARACTERISTIC
/begin CHARACTERISTIC speedgoat_test_SN5659__cal_impl.Decode4_P7_c "" VALUE 0x008DDA80 Scalar_FLOAT64_IEEE 0 speedgoat_test_SN5659_R2021b_CM_double -1.7E+308 1.7E+308 /end CHARACTERISTIC
/begin CHARACTERISTIC speedgoat_test_SN5659__cal_impl.Decode4_P7_g2 "" VALUE 0x008DD3E8 Scalar_FLOAT64_IEEE 0 speedgoat_test_SN5659_R2021b_CM_double -1.7E+308 1.7E+308 /end CHARACTERISTIC
/begin CHARACTERISTIC speedgoat_test_SN5659__cal_impl.Decode4_P7_j "" VALUE 0x008DE118 Scalar_FLOAT64_IEEE 0 speedgoat_test_SN5659_R2021b_CM_double -1.7E+308 1.7E+308 /end CHARACTERISTIC
/begin CHARACTERISTIC speedgoat_test_SN5659__cal_impl.Decode4_P7_n "" VALUE 0x008D8B60 Scalar_FLOAT64_IEEE 0 speedgoat_test_SN5659_R2021b_CM_double -1.7E+308 1.7E+308 /end CHARACTERISTIC
/begin CHARACTERISTIC speedgoat_test_SN5659__cal_impl.Decode4_P8_g "" VALUE 0x008D8B78 Scalar_FLOAT64_IEEE 0 speedgoat_test_SN5659_R2021b_CM_double -1.7E+308 1.7E+308 /end CHARACTERISTIC
/begin CHARACTERISTIC speedgoat_test_SN5659__cal_impl.Decode4_P8_lu "" VALUE 0x008DD400 Scalar_FLOAT64_IEEE 0 speedgoat_test_SN5659_R2021b_CM_double -1.7E+308 1.7E+308 /end CHARACTERISTIC
/begin CHARACTERISTIC speedgoat_test_SN5659__cal_impl.Decode4_P8_mv "" VALUE 0x008DE130 Scalar_FLOAT64_IEEE 0 speedgoat_test_SN5659_R2021b_CM_double -1.7E+308 1.7E+308 /end CHARACTERISTIC
/begin CHARACTERISTIC speedgoat_test_SN5659__cal_impl.Decode4_P8_o "" VALUE 0x008DDA98 Scalar_FLOAT64_IEEE 0 speedgoat_test_SN5659_R2021b_CM_double -1.7E+308 1.7E+308 /end CHARACTERISTIC
/begin CHARACTERISTIC speedgoat_test_SN5659__cal_impl.Decode4_P9_c "" VALUE 0x008DDAB0 Scalar_FLOAT64_IEEE 0 speedgoat_test_SN5659_R2021b_CM_double -1.7E+308 1.7E+308 /end CHARACTERISTIC
/begin CHARACTERISTIC speedgoat_test_SN5659__cal_impl.Decode4_P9_e "" VALUE 0x008D8B90 Scalar_FLOAT64_IEEE 0 speedgoat_test_SN5659_R2021b_CM_double -1.7E+308 1.7E+308 /end CHARACTERISTIC
/begin CHARACTERISTIC speedgoat_test_SN5659__cal_impl.Decode4_P9_g "" VALUE 0x008DE148 Scalar_FLOAT64_IEEE 0 speedgoat_test_SN5659_R2021b_CM_double -1.7E+308 1.7E+308 /end CHARACTERISTIC
/begin CHARACTERISTIC speedgoat_test_SN5659__cal_impl.Decode4_P9_j "" VALUE 0x008DD418 Scalar_FLOAT64_IEEE 0 speedgoat_test_SN5659_R2021b_CM_double -1.7E+308 1.7E+308 /end CHARACTERISTIC
/begin CHARACTERISTIC speedgoat_test_SN5659__cal_impl.Decode5_P10_m "" VAL_BLK 0x008D8898 Scalar_FLOAT64_IEEE 0 speedgoat_test_SN5659_R2021b_CM_double -1.7E+308 1.7E+308 MATRIX_DIM 2 1 /end CHARACTERISTIC
/begin CHARACTERISTIC speedgoat_test_SN5659__cal_impl.Decode5_P11_g "" VALUE 0x008D88B8 Scalar_FLOAT64_IEEE 0 speedgoat_test_SN5659_R2021b_CM_double -1.7E+308 1.7E+308 /end CHARACTERISTIC
/begin CHARACTERISTIC speedgoat_test_SN5659__cal_impl.Decode5_P12_m "" VALUE 0x008D88D0 Scalar_FLOAT64_IEEE 0 speedgoat_test_SN5659_R2021b_CM_double -1.7E+308 1.7E+308 /end CHARACTERISTIC
/begin CHARACTERISTIC speedgoat_test_SN5659__cal_impl.Decode5_P13_c "" VALUE 0x008D88E8 Scalar_FLOAT64_IEEE 0 speedgoat_test_SN5659_R2021b_CM_double -1.7E+308 1.7E+308 /end CHARACTERISTIC
/begin CHARACTERISTIC speedgoat_test_SN5659__cal_impl.Decode5_P14_c "" VALUE 0x008D8900 Scalar_FLOAT64_IEEE 0 speedgoat_test_SN5659_R2021b_CM_double -1.7E+308 1.7E+308 /end CHARACTERISTIC
/begin CHARACTERISTIC speedgoat_test_SN5659__cal_impl.Decode5_P15_j "" VALUE 0x008D8918 Scalar_FLOAT64_IEEE 0 speedgoat_test_SN5659_R2021b_CM_double -1.7E+308 1.7E+308 /end CHARACTERISTIC
/begin CHARACTERISTIC speedgoat_test_SN5659__cal_impl.Decode5_P16_a "" VALUE 0x008D8930 Scalar_FLOAT64_IEEE 0 speedgoat_test_SN5659_R2021b_CM_double -1.7E+308 1.7E+308 /end CHARACTERISTIC
/begin CHARACTERISTIC speedgoat_test_SN5659__cal_impl.Decode5_P1_n "" VALUE 0x008D87C0 Scalar_FLOAT64_IEEE 0 speedgoat_test_SN5659_R2021b_CM_double -1.7E+308 1.7E+308 /end CHARACTERISTIC
/begin CHARACTERISTIC speedgoat_test_SN5659__cal_impl.Decode5_P2_m "" VALUE 0x008D87D8 Scalar_FLOAT64_IEEE 0 speedgoat_test_SN5659_R2021b_CM_double -1.7E+308 1.7E+308 /end CHARACTERISTIC
/begin CHARACTERISTIC speedgoat_test_SN5659__cal_impl.Decode5_P3_i "" VALUE 0x008D87F0 Scalar_FLOAT64_IEEE 0 speedgoat_test_SN5659_R2021b_CM_double -1.7E+308 1.7E+308 /end CHARACTERISTIC
/begin CHARACTERISTIC speedgoat_test_SN5659__cal_impl.Decode5_P4_f "" VALUE 0x008D8808 Scalar_FLOAT64_IEEE 0 speedgoat_test_SN5659_R2021b_CM_double -1.7E+308 1.7E+308 /end CHARACTERISTIC
/begin CHARACTERISTIC speedgoat_test_SN5659__cal_impl.Decode5_P5_m "" VALUE 0x008D8820 Scalar_FLOAT64_IEEE 0 speedgoat_test_SN5659_R2021b_CM_double -1.7E+308 1.7E+308 /end CHARACTERISTIC
/begin CHARACTERISTIC speedgoat_test_SN5659__cal_impl.Decode5_P6_m "" VALUE 0x008D8838 Scalar_FLOAT64_IEEE 0 speedgoat_test_SN5659_R2021b_CM_double -1.7E+308 1.7E+308 /end CHARACTERISTIC
/begin CHARACTERISTIC speedgoat_test_SN5659__cal_impl.Decode5_P7_n "" VALUE 0x008D8850 Scalar_FLOAT64_IEEE 0 speedgoat_test_SN5659_R2021b_CM_double -1.7E+308 1.7E+308 /end CHARACTERISTIC
/begin CHARACTERISTIC speedgoat_test_SN5659__cal_impl.Decode5_P8_b "" VALUE 0x008D8868 Scalar_FLOAT64_IEEE 0 speedgoat_test_SN5659_R2021b_CM_double -1.7E+308 1.7E+308 /end CHARACTERISTIC
/begin CHARACTERISTIC speedgoat_test_SN5659__cal_impl.Decode5_P9_n "" VALUE 0x008D8880 Scalar_FLOAT64_IEEE 0 speedgoat_test_SN5659_R2021b_CM_double -1.7E+308 1.7E+308 /end CHARACTERISTIC
/begin CHARACTERISTIC speedgoat_test_SN5659__cal_impl.Encode1_P1 "" VALUE 0x008DE228 Scalar_FLOAT64_IEEE 0 speedgoat_test_SN5659_R2021b_CM_double -1.7E+308 1.7E+308 /end CHARACTERISTIC
/begin CHARACTERISTIC speedgoat_test_SN5659__cal_impl.Encode1_P10 "" VALUE 0x008DE300 Scalar_FLOAT64_IEEE 0 speedgoat_test_SN5659_R2021b_CM_double -1.7E+308 1.7E+308 /end CHARACTERISTIC
/begin CHARACTERISTIC speedgoat_test_SN5659__cal_impl.Encode1_P10_a "" VALUE 0x008DE970 Scalar_FLOAT64_IEEE 0 speedgoat_test_SN5659_R2021b_CM_double -1.7E+308 1.7E+308 /end CHARACTERISTIC
/begin CHARACTERISTIC speedgoat_test_SN5659__cal_impl.Encode1_P10_i "" VALUE 0x008DEFE0 Scalar_FLOAT64_IEEE 0 speedgoat_test_SN5659_R2021b_CM_double -1.7E+308 1.7E+308 /end CHARACTERISTIC
/begin CHARACTERISTIC speedgoat_test_SN5659__cal_impl.Encode1_P10_p "" VALUE 0x008DF650 Scalar_FLOAT64_IEEE 0 speedgoat_test_SN5659_R2021b_CM_double -1.7E+308 1.7E+308 /end CHARACTERISTIC
/begin CHARACTERISTIC speedgoat_test_SN5659__cal_impl.Encode1_P11 "" VAL_BLK 0x008DE318 Scalar_FLOAT64_IEEE 0 speedgoat_test_SN5659_R2021b_CM_double -1.7E+308 1.7E+308 MATRIX_DIM 2 1 /end CHARACTERISTIC
/begin CHARACTERISTIC speedgoat_test_SN5659__cal_impl.Encode1_P11_b "" VAL_BLK 0x008DF668 Scalar_FLOAT64_IEEE 0 speedgoat_test_SN5659_R2021b_CM_double -1.7E+308 1.7E+308 MATRIX_DIM 2 1 /end CHARACTERISTIC
/begin CHARACTERISTIC speedgoat_test_SN5659__cal_impl.Encode1_P11_g "" VAL_BLK 0x008DE988 Scalar_FLOAT64_IEEE 0 speedgoat_test_SN5659_R2021b_CM_double -1.7E+308 1.7E+308 MATRIX_DIM 2 1 /end CHARACTERISTIC
/begin CHARACTERISTIC speedgoat_test_SN5659__cal_impl.Encode1_P11_l "" VAL_BLK 0x008DEFF8 Scalar_FLOAT64_IEEE 0 speedgoat_test_SN5659_R2021b_CM_double -1.7E+308 1.7E+308 MATRIX_DIM 2 1 /end CHARACTERISTIC
/begin CHARACTERISTIC speedgoat_test_SN5659__cal_impl.Encode1_P12 "" VALUE 0x008DE338 Scalar_FLOAT64_IEEE 0 speedgoat_test_SN5659_R2021b_CM_double -1.7E+308 1.7E+308 /end CHARACTERISTIC
/begin CHARACTERISTIC speedgoat_test_SN5659__cal_impl.Encode1_P12_k "" VALUE 0x008DF018 Scalar_FLOAT64_IEEE 0 speedgoat_test_SN5659_R2021b_CM_double -1.7E+308 1.7E+308 /end CHARACTERISTIC
/begin CHARACTERISTIC speedgoat_test_SN5659__cal_impl.Encode1_P12_n "" VALUE 0x008DE9A8 Scalar_FLOAT64_IEEE 0 speedgoat_test_SN5659_R2021b_CM_double -1.7E+308 1.7E+308 /end CHARACTERISTIC
/begin CHARACTERISTIC speedgoat_test_SN5659__cal_impl.Encode1_P12_no "" VALUE 0x008DF688 Scalar_FLOAT64_IEEE 0 speedgoat_test_SN5659_R2021b_CM_double -1.7E+308 1.7E+308 /end CHARACTERISTIC
/begin CHARACTERISTIC speedgoat_test_SN5659__cal_impl.Encode1_P13 "" VALUE 0x008DE350 Scalar_FLOAT64_IEEE 0 speedgoat_test_SN5659_R2021b_CM_double -1.7E+308 1.7E+308 /end CHARACTERISTIC
/begin CHARACTERISTIC speedgoat_test_SN5659__cal_impl.Encode1_P13_i "" VALUE 0x008DF030 Scalar_FLOAT64_IEEE 0 speedgoat_test_SN5659_R2021b_CM_double -1.7E+308 1.7E+308 /end CHARACTERISTIC
/begin CHARACTERISTIC speedgoat_test_SN5659__cal_impl.Encode1_P13_it "" VALUE 0x008DF6A0 Scalar_FLOAT64_IEEE 0 speedgoat_test_SN5659_R2021b_CM_double -1.7E+308 1.7E+308 /end CHARACTERISTIC
/begin CHARACTERISTIC speedgoat_test_SN5659__cal_impl.Encode1_P13_j "" VALUE 0x008DE9C0 Scalar_FLOAT64_IEEE 0 speedgoat_test_SN5659_R2021b_CM_double -1.7E+308 1.7E+308 /end CHARACTERISTIC
/begin CHARACTERISTIC speedgoat_test_SN5659__cal_impl.Encode1_P14 "" VALUE 0x008DE368 Scalar_FLOAT64_IEEE 0 speedgoat_test_SN5659_R2021b_CM_double -1.7E+308 1.7E+308 /end CHARACTERISTIC
/begin CHARACTERISTIC speedgoat_test_SN5659__cal_impl.Encode1_P14_h "" VALUE 0x008DE9D8 Scalar_FLOAT64_IEEE 0 speedgoat_test_SN5659_R2021b_CM_double -1.7E+308 1.7E+308 /end CHARACTERISTIC
/begin CHARACTERISTIC speedgoat_test_SN5659__cal_impl.Encode1_P14_ho "" VALUE 0x008DF6B8 Scalar_FLOAT64_IEEE 0 speedgoat_test_SN5659_R2021b_CM_double -1.7E+308 1.7E+308 /end CHARACTERISTIC
/begin CHARACTERISTIC speedgoat_test_SN5659__cal_impl.Encode1_P14_o "" VALUE 0x008DF048 Scalar_FLOAT64_IEEE 0 speedgoat_test_SN5659_R2021b_CM_double -1.7E+308 1.7E+308 /end CHARACTERISTIC
/begin CHARACTERISTIC speedgoat_test_SN5659__cal_impl.Encode1_P15 "" VALUE 0x008DE380 Scalar_FLOAT64_IEEE 0 speedgoat_test_SN5659_R2021b_CM_double -1.7E+308 1.7E+308 /end CHARACTERISTIC
/begin CHARACTERISTIC speedgoat_test_SN5659__cal_impl.Encode1_P15_b "" VALUE 0x008DF060 Scalar_FLOAT64_IEEE 0 speedgoat_test_SN5659_R2021b_CM_double -1.7E+308 1.7E+308 /end CHARACTERISTIC
/begin CHARACTERISTIC speedgoat_test_SN5659__cal_impl.Encode1_P15_h "" VALUE 0x008DE9F0 Scalar_FLOAT64_IEEE 0 speedgoat_test_SN5659_R2021b_CM_double -1.7E+308 1.7E+308 /end CHARACTERISTIC
/begin CHARACTERISTIC speedgoat_test_SN5659__cal_impl.Encode1_P15_k "" VALUE 0x008DF6D0 Scalar_FLOAT64_IEEE 0 speedgoat_test_SN5659_R2021b_CM_double -1.7E+308 1.7E+308 /end CHARACTERISTIC
/begin CHARACTERISTIC speedgoat_test_SN5659__cal_impl.Encode1_P1_a "" VALUE 0x008DE898 Scalar_FLOAT64_IEEE 0 speedgoat_test_SN5659_R2021b_CM_double -1.7E+308 1.7E+308 /end CHARACTERISTIC
/begin CHARACTERISTIC speedgoat_test_SN5659__cal_impl.Encode1_P1_c "" VALUE 0x008DEF08 Scalar_FLOAT64_IEEE 0 speedgoat_test_SN5659_R2021b_CM_double -1.7E+308 1.7E+308 /end CHARACTERISTIC
/begin CHARACTERISTIC speedgoat_test_SN5659__cal_impl.Encode1_P1_i "" VALUE 0x008DF578 Scalar_FLOAT64_IEEE 0 speedgoat_test_SN5659_R2021b_CM_double -1.7E+308 1.7E+308 /end CHARACTERISTIC
/begin CHARACTERISTIC speedgoat_test_SN5659__cal_impl.Encode1_P2 "" VALUE 0x008DE240 Scalar_FLOAT64_IEEE 0 speedgoat_test_SN5659_R2021b_CM_double -1.7E+308 1.7E+308 /end CHARACTERISTIC
/begin CHARACTERISTIC speedgoat_test_SN5659__cal_impl.Encode1_P2_g "" VALUE 0x008DEF20 Scalar_FLOAT64_IEEE 0 speedgoat_test_SN5659_R2021b_CM_double -1.7E+308 1.7E+308 /end CHARACTERISTIC
/begin CHARACTERISTIC speedgoat_test_SN5659__cal_impl.Encode1_P2_h "" VALUE 0x008DE8B0 Scalar_FLOAT64_IEEE 0 speedgoat_test_SN5659_R2021b_CM_double -1.7E+308 1.7E+308 /end CHARACTERISTIC
/begin CHARACTERISTIC speedgoat_test_SN5659__cal_impl.Encode1_P2_l "" VALUE 0x008DF590 Scalar_FLOAT64_IEEE 0 speedgoat_test_SN5659_R2021b_CM_double -1.7E+308 1.7E+308 /end CHARACTERISTIC
/begin CHARACTERISTIC speedgoat_test_SN5659__cal_impl.Encode1_P3 "" VALUE 0x008DE258 Scalar_FLOAT64_IEEE 0 speedgoat_test_SN5659_R2021b_CM_double -1.7E+308 1.7E+308 /end CHARACTERISTIC
/begin CHARACTERISTIC speedgoat_test_SN5659__cal_impl.Encode1_P3_b "" VALUE 0x008DF5A8 Scalar_FLOAT64_IEEE 0 speedgoat_test_SN5659_R2021b_CM_double -1.7E+308 1.7E+308 /end CHARACTERISTIC
/begin CHARACTERISTIC speedgoat_test_SN5659__cal_impl.Encode1_P3_l "" VALUE 0x008DEF38 Scalar_FLOAT64_IEEE 0 speedgoat_test_SN5659_R2021b_CM_double -1.7E+308 1.7E+308 /end CHARACTERISTIC
/begin CHARACTERISTIC speedgoat_test_SN5659__cal_impl.Encode1_P3_o "" VALUE 0x008DE8C8 Scalar_FLOAT64_IEEE 0 speedgoat_test_SN5659_R2021b_CM_double -1.7E+308 1.7E+308 /end CHARACTERISTIC
/begin CHARACTERISTIC speedgoat_test_SN5659__cal_impl.Encode1_P4 "" VALUE 0x008DE270 Scalar_FLOAT64_IEEE 0 speedgoat_test_SN5659_R2021b_CM_double -1.7E+308 1.7E+308 /end CHARACTERISTIC
/begin CHARACTERISTIC speedgoat_test_SN5659__cal_impl.Encode1_P4_a "" VALUE 0x008DF5C0 Scalar_FLOAT64_IEEE 0 speedgoat_test_SN5659_R2021b_CM_double -1.7E+308 1.7E+308 /end CHARACTERISTIC
/begin CHARACTERISTIC speedgoat_test_SN5659__cal_impl.Encode1_P4_d "" VALUE 0x008DE8E0 Scalar_FLOAT64_IEEE 0 speedgoat_test_SN5659_R2021b_CM_double -1.7E+308 1.7E+308 /end CHARACTERISTIC
/begin CHARACTERISTIC speedgoat_test_SN5659__cal_impl.Encode1_P4_e "" VALUE 0x008DEF50 Scalar_FLOAT64_IEEE 0 speedgoat_test_SN5659_R2021b_CM_double -1.7E+308 1.7E+308 /end CHARACTERISTIC
/begin CHARACTERISTIC speedgoat_test_SN5659__cal_impl.Encode1_P5 "" VALUE 0x008DE288 Scalar_FLOAT64_IEEE 0 speedgoat_test_SN5659_R2021b_CM_double -1.7E+308 1.7E+308 /end CHARACTERISTIC
/begin CHARACTERISTIC speedgoat_test_SN5659__cal_impl.Encode1_P5_i "" VALUE 0x008DEF68 Scalar_FLOAT64_IEEE 0 speedgoat_test_SN5659_R2021b_CM_double -1.7E+308 1.7E+308 /end CHARACTERISTIC
/begin CHARACTERISTIC speedgoat_test_SN5659__cal_impl.Encode1_P5_j "" VALUE 0x008DF5D8 Scalar_FLOAT64_IEEE 0 speedgoat_test_SN5659_R2021b_CM_double -1.7E+308 1.7E+308 /end CHARACTERISTIC
/begin CHARACTERISTIC speedgoat_test_SN5659__cal_impl.Encode1_P5_o "" VALUE 0x008DE8F8 Scalar_FLOAT64_IEEE 0 speedgoat_test_SN5659_R2021b_CM_double -1.7E+308 1.7E+308 /end CHARACTERISTIC
/begin CHARACTERISTIC speedgoat_test_SN5659__cal_impl.Encode1_P6 "" VALUE 0x008DE2A0 Scalar_FLOAT64_IEEE 0 speedgoat_test_SN5659_R2021b_CM_double -1.7E+308 1.7E+308 /end CHARACTERISTIC
/begin CHARACTERISTIC speedgoat_test_SN5659__cal_impl.Encode1_P6_e "" VALUE 0x008DF5F0 Scalar_FLOAT64_IEEE 0 speedgoat_test_SN5659_R2021b_CM_double -1.7E+308 1.7E+308 /end CHARACTERISTIC
/begin CHARACTERISTIC speedgoat_test_SN5659__cal_impl.Encode1_P6_n "" VALUE 0x008DE910 Scalar_FLOAT64_IEEE 0 speedgoat_test_SN5659_R2021b_CM_double -1.7E+308 1.7E+308 /end CHARACTERISTIC
/begin CHARACTERISTIC speedgoat_test_SN5659__cal_impl.Encode1_P6_p "" VALUE 0x008DEF80 Scalar_FLOAT64_IEEE 0 speedgoat_test_SN5659_R2021b_CM_double -1.7E+308 1.7E+308 /end CHARACTERISTIC
/begin CHARACTERISTIC speedgoat_test_SN5659__cal_impl.Encode1_P7 "" VALUE 0x008DE2B8 Scalar_FLOAT64_IEEE 0 speedgoat_test_SN5659_R2021b_CM_double -1.7E+308 1.7E+308 /end CHARACTERISTIC
/begin CHARACTERISTIC speedgoat_test_SN5659__cal_impl.Encode1_P7_d "" VALUE 0x008DEF98 Scalar_FLOAT64_IEEE 0 speedgoat_test_SN5659_R2021b_CM_double -1.7E+308 1.7E+308 /end CHARACTERISTIC
/begin CHARACTERISTIC speedgoat_test_SN5659__cal_impl.Encode1_P7_db "" VALUE 0x008DF608 Scalar_FLOAT64_IEEE 0 speedgoat_test_SN5659_R2021b_CM_double -1.7E+308 1.7E+308 /end CHARACTERISTIC
/begin CHARACTERISTIC speedgoat_test_SN5659__cal_impl.Encode1_P7_g "" VALUE 0x008DE928 Scalar_FLOAT64_IEEE 0 speedgoat_test_SN5659_R2021b_CM_double -1.7E+308 1.7E+308 /end CHARACTERISTIC
/begin CHARACTERISTIC speedgoat_test_SN5659__cal_impl.Encode1_P8 "" VALUE 0x008DE2D0 Scalar_FLOAT64_IEEE 0 speedgoat_test_SN5659_R2021b_CM_double -1.7E+308 1.7E+308 /end CHARACTERISTIC
/begin CHARACTERISTIC speedgoat_test_SN5659__cal_impl.Encode1_P8_b "" VALUE 0x008DF620 Scalar_FLOAT64_IEEE 0 speedgoat_test_SN5659_R2021b_CM_double -1.7E+308 1.7E+308 /end CHARACTERISTIC
/begin CHARACTERISTIC speedgoat_test_SN5659__cal_impl.Encode1_P8_c "" VALUE 0x008DEFB0 Scalar_FLOAT64_IEEE 0 speedgoat_test_SN5659_R2021b_CM_double -1.7E+308 1.7E+308 /end CHARACTERISTIC
/begin CHARACTERISTIC speedgoat_test_SN5659__cal_impl.Encode1_P8_p "" VALUE 0x008DE940 Scalar_FLOAT64_IEEE 0 speedgoat_test_SN5659_R2021b_CM_double -1.7E+308 1.7E+308 /end CHARACTERISTIC
/begin CHARACTERISTIC speedgoat_test_SN5659__cal_impl.Encode1_P9 "" VALUE 0x008DE2E8 Scalar_FLOAT64_IEEE 0 speedgoat_test_SN5659_R2021b_CM_double -1.7E+308 1.7E+308 /end CHARACTERISTIC
/begin CHARACTERISTIC speedgoat_test_SN5659__cal_impl.Encode1_P9_m "" VALUE 0x008DE958 Scalar_FLOAT64_IEEE 0 speedgoat_test_SN5659_R2021b_CM_double -1.7E+308 1.7E+308 /end CHARACTERISTIC
/begin CHARACTERISTIC speedgoat_test_SN5659__cal_impl.Encode1_P9_md "" VALUE 0x008DF638 Scalar_FLOAT64_IEEE 0 speedgoat_test_SN5659_R2021b_CM_double -1.7E+308 1.7E+308 /end CHARACTERISTIC
/begin CHARACTERISTIC speedgoat_test_SN5659__cal_impl.Encode1_P9_n "" VALUE 0x008DEFC8 Scalar_FLOAT64_IEEE 0 speedgoat_test_SN5659_R2021b_CM_double -1.7E+308 1.7E+308 /end CHARACTERISTIC
/begin CHARACTERISTIC speedgoat_test_SN5659__cal_impl.Encode2_P1 "" VALUE 0x008DE6C8 Scalar_FLOAT64_IEEE 0 speedgoat_test_SN5659_R2021b_CM_double -1.7E+308 1.7E+308 /end CHARACTERISTIC
/begin CHARACTERISTIC speedgoat_test_SN5659__cal_impl.Encode2_P10 "" VALUE 0x008DE7A0 Scalar_FLOAT64_IEEE 0 speedgoat_test_SN5659_R2021b_CM_double -1.7E+308 1.7E+308 /end CHARACTERISTIC
/begin CHARACTERISTIC speedgoat_test_SN5659__cal_impl.Encode2_P10_c "" VALUE 0x008DF150 Scalar_FLOAT64_IEEE 0 speedgoat_test_SN5659_R2021b_CM_double -1.7E+308 1.7E+308 /end CHARACTERISTIC
/begin CHARACTERISTIC speedgoat_test_SN5659__cal_impl.Encode2_P10_i "" VALUE 0x008DF7C0 Scalar_FLOAT64_IEEE 0 speedgoat_test_SN5659_R2021b_CM_double -1.7E+308 1.7E+308 /end CHARACTERISTIC
/begin CHARACTERISTIC speedgoat_test_SN5659__cal_impl.Encode2_P10_n "" VALUE 0x008DEAE0 Scalar_FLOAT64_IEEE 0 speedgoat_test_SN5659_R2021b_CM_double -1.7E+308 1.7E+308 /end CHARACTERISTIC
/begin CHARACTERISTIC speedgoat_test_SN5659__cal_impl.Encode2_P11 "" VAL_BLK 0x008DE7B8 Scalar_FLOAT64_IEEE 0 speedgoat_test_SN5659_R2021b_CM_double -1.7E+308 1.7E+308 MATRIX_DIM 2 1 /end CHARACTERISTIC
/begin CHARACTERISTIC speedgoat_test_SN5659__cal_impl.Encode2_P11_g "" VAL_BLK 0x008DF168 Scalar_FLOAT64_IEEE 0 speedgoat_test_SN5659_R2021b_CM_double -1.7E+308 1.7E+308 MATRIX_DIM 2 1 /end CHARACTERISTIC
/begin CHARACTERISTIC speedgoat_test_SN5659__cal_impl.Encode2_P11_h "" VAL_BLK 0x008DF7D8 Scalar_FLOAT64_IEEE 0 speedgoat_test_SN5659_R2021b_CM_double -1.7E+308 1.7E+308 MATRIX_DIM 2 1 /end CHARACTERISTIC
/begin CHARACTERISTIC speedgoat_test_SN5659__cal_impl.Encode2_P11_j "" VAL_BLK 0x008DEAF8 Scalar_FLOAT64_IEEE 0 speedgoat_test_SN5659_R2021b_CM_double -1.7E+308 1.7E+308 MATRIX_DIM 2 1 /end CHARACTERISTIC
/begin CHARACTERISTIC speedgoat_test_SN5659__cal_impl.Encode2_P12 "" VALUE 0x008DE7D8 Scalar_FLOAT64_IEEE 0 speedgoat_test_SN5659_R2021b_CM_double -1.7E+308 1.7E+308 /end CHARACTERISTIC
/begin CHARACTERISTIC speedgoat_test_SN5659__cal_impl.Encode2_P12_b "" VALUE 0x008DEB18 Scalar_FLOAT64_IEEE 0 speedgoat_test_SN5659_R2021b_CM_double -1.7E+308 1.7E+308 /end CHARACTERISTIC
/begin CHARACTERISTIC speedgoat_test_SN5659__cal_impl.Encode2_P12_k "" VALUE 0x008DF7F8 Scalar_FLOAT64_IEEE 0 speedgoat_test_SN5659_R2021b_CM_double -1.7E+308 1.7E+308 /end CHARACTERISTIC
/begin CHARACTERISTIC speedgoat_test_SN5659__cal_impl.Encode2_P12_m "" VALUE 0x008DF188 Scalar_FLOAT64_IEEE 0 speedgoat_test_SN5659_R2021b_CM_double -1.7E+308 1.7E+308 /end CHARACTERISTIC
/begin CHARACTERISTIC speedgoat_test_SN5659__cal_impl.Encode2_P13 "" VALUE 0x008DE7F0 Scalar_FLOAT64_IEEE 0 speedgoat_test_SN5659_R2021b_CM_double -1.7E+308 1.7E+308 /end CHARACTERISTIC
/begin CHARACTERISTIC speedgoat_test_SN5659__cal_impl.Encode2_P13_f "" VALUE 0x008DF810 Scalar_FLOAT64_IEEE 0 speedgoat_test_SN5659_R2021b_CM_double -1.7E+308 1.7E+308 /end CHARACTERISTIC
/begin CHARACTERISTIC speedgoat_test_SN5659__cal_impl.Encode2_P13_j "" VALUE 0x008DEB30 Scalar_FLOAT64_IEEE 0 speedgoat_test_SN5659_R2021b_CM_double -1.7E+308 1.7E+308 /end CHARACTERISTIC
/begin CHARACTERISTIC speedgoat_test_SN5659__cal_impl.Encode2_P13_p "" VALUE 0x008DF1A0 Scalar_FLOAT64_IEEE 0 speedgoat_test_SN5659_R2021b_CM_double -1.7E+308 1.7E+308 /end CHARACTERISTIC
/begin CHARACTERISTIC speedgoat_test_SN5659__cal_impl.Encode2_P14 "" VALUE 0x008DE808 Scalar_FLOAT64_IEEE 0 speedgoat_test_SN5659_R2021b_CM_double -1.7E+308 1.7E+308 /end CHARACTERISTIC
/begin CHARACTERISTIC speedgoat_test_SN5659__cal_impl.Encode2_P14_c "" VALUE 0x008DEB48 Scalar_FLOAT64_IEEE 0 speedgoat_test_SN5659_R2021b_CM_double -1.7E+308 1.7E+308 /end CHARACTERISTIC
/begin CHARACTERISTIC speedgoat_test_SN5659__cal_impl.Encode2_P14_f "" VALUE 0x008DF828 Scalar_FLOAT64_IEEE 0 speedgoat_test_SN5659_R2021b_CM_double -1.7E+308 1.7E+308 /end CHARACTERISTIC
/begin CHARACTERISTIC speedgoat_test_SN5659__cal_impl.Encode2_P14_p "" VALUE 0x008DF1B8 Scalar_FLOAT64_IEEE 0 speedgoat_test_SN5659_R2021b_CM_double -1.7E+308 1.7E+308 /end CHARACTERISTIC
/begin CHARACTERISTIC speedgoat_test_SN5659__cal_impl.Encode2_P15 "" VALUE 0x008DE820 Scalar_FLOAT64_IEEE 0 speedgoat_test_SN5659_R2021b_CM_double -1.7E+308 1.7E+308 /end CHARACTERISTIC
/begin CHARACTERISTIC speedgoat_test_SN5659__cal_impl.Encode2_P15_c "" VALUE 0x008DF1D0 Scalar_FLOAT64_IEEE 0 speedgoat_test_SN5659_R2021b_CM_double -1.7E+308 1.7E+308 /end CHARACTERISTIC
/begin CHARACTERISTIC speedgoat_test_SN5659__cal_impl.Encode2_P15_j "" VALUE 0x008DEB60 Scalar_FLOAT64_IEEE 0 speedgoat_test_SN5659_R2021b_CM_double -1.7E+308 1.7E+308 /end CHARACTERISTIC
/begin CHARACTERISTIC speedgoat_test_SN5659__cal_impl.Encode2_P15_o "" VALUE 0x008DF840 Scalar_FLOAT64_IEEE 0 speedgoat_test_SN5659_R2021b_CM_double -1.7E+308 1.7E+308 /end CHARACTERISTIC
/begin CHARACTERISTIC speedgoat_test_SN5659__cal_impl.Encode2_P1_a "" VALUE 0x008DF078 Scalar_FLOAT64_IEEE 0 speedgoat_test_SN5659_R2021b_CM_double -1.7E+308 1.7E+308 /end CHARACTERISTIC
/begin CHARACTERISTIC speedgoat_test_SN5659__cal_impl.Encode2_P1_h "" VALUE 0x008DEA08 Scalar_FLOAT64_IEEE 0 speedgoat_test_SN5659_R2021b_CM_double -1.7E+308 1.7E+308 /end CHARACTERISTIC
/begin CHARACTERISTIC speedgoat_test_SN5659__cal_impl.Encode2_P1_p "" VALUE 0x008DF6E8 Scalar_FLOAT64_IEEE 0 speedgoat_test_SN5659_R2021b_CM_double -1.7E+308 1.7E+308 /end CHARACTERISTIC
/begin CHARACTERISTIC speedgoat_test_SN5659__cal_impl.Encode2_P2 "" VALUE 0x008DE6E0 Scalar_FLOAT64_IEEE 0 speedgoat_test_SN5659_R2021b_CM_double -1.7E+308 1.7E+308 /end CHARACTERISTIC
/begin CHARACTERISTIC speedgoat_test_SN5659__cal_impl.Encode2_P2_i "" VALUE 0x008DF090 Scalar_FLOAT64_IEEE 0 speedgoat_test_SN5659_R2021b_CM_double -1.7E+308 1.7E+308 /end CHARACTERISTIC
/begin CHARACTERISTIC speedgoat_test_SN5659__cal_impl.Encode2_P2_k "" VALUE 0x008DF700 Scalar_FLOAT64_IEEE 0 speedgoat_test_SN5659_R2021b_CM_double -1.7E+308 1.7E+308 /end CHARACTERISTIC
/begin CHARACTERISTIC speedgoat_test_SN5659__cal_impl.Encode2_P2_m "" VALUE 0x008DEA20 Scalar_FLOAT64_IEEE 0 speedgoat_test_SN5659_R2021b_CM_double -1.7E+308 1.7E+308 /end CHARACTERISTIC
/begin CHARACTERISTIC speedgoat_test_SN5659__cal_impl.Encode2_P3 "" VALUE 0x008DE6F8 Scalar_FLOAT64_IEEE 0 speedgoat_test_SN5659_R2021b_CM_double -1.7E+308 1.7E+308 /end CHARACTERISTIC
/begin CHARACTERISTIC speedgoat_test_SN5659__cal_impl.Encode2_P3_k "" VALUE 0x008DF0A8 Scalar_FLOAT64_IEEE 0 speedgoat_test_SN5659_R2021b_CM_double -1.7E+308 1.7E+308 /end CHARACTERISTIC
/begin CHARACTERISTIC speedgoat_test_SN5659__cal_impl.Encode2_P3_l "" VALUE 0x008DF718 Scalar_FLOAT64_IEEE 0 speedgoat_test_SN5659_R2021b_CM_double -1.7E+308 1.7E+308 /end CHARACTERISTIC
/begin CHARACTERISTIC speedgoat_test_SN5659__cal_impl.Encode2_P3_o "" VALUE 0x008DEA38 Scalar_FLOAT64_IEEE 0 speedgoat_test_SN5659_R2021b_CM_double -1.7E+308 1.7E+308 /end CHARACTERISTIC
/begin CHARACTERISTIC speedgoat_test_SN5659__cal_impl.Encode2_P4 "" VALUE 0x008DE710 Scalar_FLOAT64_IEEE 0 speedgoat_test_SN5659_R2021b_CM_double -1.7E+308 1.7E+308 /end CHARACTERISTIC
/begin CHARACTERISTIC speedgoat_test_SN5659__cal_impl.Encode2_P4_g "" VALUE 0x008DEA50 Scalar_FLOAT64_IEEE 0 speedgoat_test_SN5659_R2021b_CM_double -1.7E+308 1.7E+308 /end CHARACTERISTIC
/begin CHARACTERISTIC speedgoat_test_SN5659__cal_impl.Encode2_P4_j "" VALUE 0x008DF730 Scalar_FLOAT64_IEEE 0 speedgoat_test_SN5659_R2021b_CM_double -1.7E+308 1.7E+308 /end CHARACTERISTIC
/begin CHARACTERISTIC speedgoat_test_SN5659__cal_impl.Encode2_P4_o "" VALUE 0x008DF0C0 Scalar_FLOAT64_IEEE 0 speedgoat_test_SN5659_R2021b_CM_double -1.7E+308 1.7E+308 /end CHARACTERISTIC
/begin CHARACTERISTIC speedgoat_test_SN5659__cal_impl.Encode2_P5 "" VALUE 0x008DE728 Scalar_FLOAT64_IEEE 0 speedgoat_test_SN5659_R2021b_CM_double -1.7E+308 1.7E+308 /end CHARACTERISTIC
/begin CHARACTERISTIC speedgoat_test_SN5659__cal_impl.Encode2_P5_d "" VALUE 0x008DF748 Scalar_FLOAT64_IEEE 0 speedgoat_test_SN5659_R2021b_CM_double -1.7E+308 1.7E+308 /end CHARACTERISTIC
/begin CHARACTERISTIC speedgoat_test_SN5659__cal_impl.Encode2_P5_g "" VALUE 0x008DEA68 Scalar_FLOAT64_IEEE 0 speedgoat_test_SN5659_R2021b_CM_double -1.7E+308 1.7E+308 /end CHARACTERISTIC
/begin CHARACTERISTIC speedgoat_test_SN5659__cal_impl.Encode2_P5_l "" VALUE 0x008DF0D8 Scalar_FLOAT64_IEEE 0 speedgoat_test_SN5659_R2021b_CM_double -1.7E+308 1.7E+308 /end CHARACTERISTIC
/begin CHARACTERISTIC speedgoat_test_SN5659__cal_impl.Encode2_P6 "" VALUE 0x008DE740 Scalar_FLOAT64_IEEE 0 speedgoat_test_SN5659_R2021b_CM_double -1.7E+308 1.7E+308 /end CHARACTERISTIC
/begin CHARACTERISTIC speedgoat_test_SN5659__cal_impl.Encode2_P6_e "" VALUE 0x008DF760 Scalar_FLOAT64_IEEE 0 speedgoat_test_SN5659_R2021b_CM_double -1.7E+308 1.7E+308 /end CHARACTERISTIC
/begin CHARACTERISTIC speedgoat_test_SN5659__cal_impl.Encode2_P6_j "" VALUE 0x008DEA80 Scalar_FLOAT64_IEEE 0 speedgoat_test_SN5659_R2021b_CM_double -1.7E+308 1.7E+308 /end CHARACTERISTIC
/begin CHARACTERISTIC speedgoat_test_SN5659__cal_impl.Encode2_P6_n "" VALUE 0x008DF0F0 Scalar_FLOAT64_IEEE 0 speedgoat_test_SN5659_R2021b_CM_double -1.7E+308 1.7E+308 /end CHARACTERISTIC
/begin CHARACTERISTIC speedgoat_test_SN5659__cal_impl.Encode2_P7 "" VALUE 0x008DE758 Scalar_FLOAT64_IEEE 0 speedgoat_test_SN5659_R2021b_CM_double -1.7E+308 1.7E+308 /end CHARACTERISTIC
/begin CHARACTERISTIC speedgoat_test_SN5659__cal_impl.Encode2_P7_b "" VALUE 0x008DF108 Scalar_FLOAT64_IEEE 0 speedgoat_test_SN5659_R2021b_CM_double -1.7E+308 1.7E+308 /end CHARACTERISTIC
/begin CHARACTERISTIC speedgoat_test_SN5659__cal_impl.Encode2_P7_d "" VALUE 0x008DEA98 Scalar_FLOAT64_IEEE 0 speedgoat_test_SN5659_R2021b_CM_double -1.7E+308 1.7E+308 /end CHARACTERISTIC
/begin CHARACTERISTIC speedgoat_test_SN5659__cal_impl.Encode2_P7_f "" VALUE 0x008DF778 Scalar_FLOAT64_IEEE 0 speedgoat_test_SN5659_R2021b_CM_double -1.7E+308 1.7E+308 /end CHARACTERISTIC
/begin CHARACTERISTIC speedgoat_test_SN5659__cal_impl.Encode2_P8 "" VALUE 0x008DE770 Scalar_FLOAT64_IEEE 0 speedgoat_test_SN5659_R2021b_CM_double -1.7E+308 1.7E+308 /end CHARACTERISTIC
/begin CHARACTERISTIC speedgoat_test_SN5659__cal_impl.Encode2_P8_f "" VALUE 0x008DEAB0 Scalar_FLOAT64_IEEE 0 speedgoat_test_SN5659_R2021b_CM_double -1.7E+308 1.7E+308 /end CHARACTERISTIC
/begin CHARACTERISTIC speedgoat_test_SN5659__cal_impl.Encode2_P8_h "" VALUE 0x008DF120 Scalar_FLOAT64_IEEE 0 speedgoat_test_SN5659_R2021b_CM_double -1.7E+308 1.7E+308 /end CHARACTERISTIC
/begin CHARACTERISTIC speedgoat_test_SN5659__cal_impl.Encode2_P8_i "" VALUE 0x008DF790 Scalar_FLOAT64_IEEE 0 speedgoat_test_SN5659_R2021b_CM_double -1.7E+308 1.7E+308 /end CHARACTERISTIC
/begin CHARACTERISTIC speedgoat_test_SN5659__cal_impl.Encode2_P9 "" VALUE 0x008DE788 Scalar_FLOAT64_IEEE 0 speedgoat_test_SN5659_R2021b_CM_double -1.7E+308 1.7E+308 /end CHARACTERISTIC
/begin CHARACTERISTIC speedgoat_test_SN5659__cal_impl.Encode2_P9_m "" VALUE 0x008DF138 Scalar_FLOAT64_IEEE 0 speedgoat_test_SN5659_R2021b_CM_double -1.7E+308 1.7E+308 /end CHARACTERISTIC
/begin CHARACTERISTIC speedgoat_test_SN5659__cal_impl.Encode2_P9_p "" VALUE 0x008DEAC8 Scalar_FLOAT64_IEEE 0 speedgoat_test_SN5659_R2021b_CM_double -1.7E+308 1.7E+308 /end CHARACTERISTIC
/begin CHARACTERISTIC speedgoat_test_SN5659__cal_impl.Encode2_P9_pe "" VALUE 0x008DF7A8 Scalar_FLOAT64_IEEE 0 speedgoat_test_SN5659_R2021b_CM_double -1.7E+308 1.7E+308 /end CHARACTERISTIC
/begin CHARACTERISTIC speedgoat_test_SN5659__cal_impl.Encode3_P1 "" VALUE 0x008DE540 Scalar_FLOAT64_IEEE 0 speedgoat_test_SN5659_R2021b_CM_double -1.7E+308 1.7E+308 /end CHARACTERISTIC
/begin CHARACTERISTIC speedgoat_test_SN5659__cal_impl.Encode3_P10 "" VALUE 0x008DE618 Scalar_FLOAT64_IEEE 0 speedgoat_test_SN5659_R2021b_CM_double -1.7E+308 1.7E+308 /end CHARACTERISTIC
/begin CHARACTERISTIC speedgoat_test_SN5659__cal_impl.Encode3_P10_j "" VALUE 0x008DF2F8 Scalar_FLOAT64_IEEE 0 speedgoat_test_SN5659_R2021b_CM_double -1.7E+308 1.7E+308 /end CHARACTERISTIC
/begin CHARACTERISTIC speedgoat_test_SN5659__cal_impl.Encode3_P10_m "" VALUE 0x008DF968 Scalar_FLOAT64_IEEE 0 speedgoat_test_SN5659_R2021b_CM_double -1.7E+308 1.7E+308 /end CHARACTERISTIC
/begin CHARACTERISTIC speedgoat_test_SN5659__cal_impl.Encode3_P10_n "" VALUE 0x008DEC88 Scalar_FLOAT64_IEEE 0 speedgoat_test_SN5659_R2021b_CM_double -1.7E+308 1.7E+308 /end CHARACTERISTIC
/begin CHARACTERISTIC speedgoat_test_SN5659__cal_impl.Encode3_P11 "" VAL_BLK 0x008DE630 Scalar_FLOAT64_IEEE 0 speedgoat_test_SN5659_R2021b_CM_double -1.7E+308 1.7E+308 MATRIX_DIM 2 1 /end CHARACTERISTIC
/begin CHARACTERISTIC speedgoat_test_SN5659__cal_impl.Encode3_P11_i "" VAL_BLK 0x008DF980 Scalar_FLOAT64_IEEE 0 speedgoat_test_SN5659_R2021b_CM_double -1.7E+308 1.7E+308 MATRIX_DIM 2 1 /end CHARACTERISTIC
/begin CHARACTERISTIC speedgoat_test_SN5659__cal_impl.Encode3_P11_j "" VAL_BLK 0x008DF310 Scalar_FLOAT64_IEEE 0 speedgoat_test_SN5659_R2021b_CM_double -1.7E+308 1.7E+308 MATRIX_DIM 2 1 /end CHARACTERISTIC
/begin CHARACTERISTIC speedgoat_test_SN5659__cal_impl.Encode3_P11_l "" VAL_BLK 0x008DECA0 Scalar_FLOAT64_IEEE 0 speedgoat_test_SN5659_R2021b_CM_double -1.7E+308 1.7E+308 MATRIX_DIM 2 1 /end CHARACTERISTIC
/begin CHARACTERISTIC speedgoat_test_SN5659__cal_impl.Encode3_P12 "" VALUE 0x008DE650 Scalar_FLOAT64_IEEE 0 speedgoat_test_SN5659_R2021b_CM_double -1.7E+308 1.7E+308 /end CHARACTERISTIC
/begin CHARACTERISTIC speedgoat_test_SN5659__cal_impl.Encode3_P12_b "" VALUE 0x008DF9A0 Scalar_FLOAT64_IEEE 0 speedgoat_test_SN5659_R2021b_CM_double -1.7E+308 1.7E+308 /end CHARACTERISTIC
/begin CHARACTERISTIC speedgoat_test_SN5659__cal_impl.Encode3_P12_e "" VALUE 0x008DECC0 Scalar_FLOAT64_IEEE 0 speedgoat_test_SN5659_R2021b_CM_double -1.7E+308 1.7E+308 /end CHARACTERISTIC
/begin CHARACTERISTIC speedgoat_test_SN5659__cal_impl.Encode3_P12_j "" VALUE 0x008DF330 Scalar_FLOAT64_IEEE 0 speedgoat_test_SN5659_R2021b_CM_double -1.7E+308 1.7E+308 /end CHARACTERISTIC
/begin CHARACTERISTIC speedgoat_test_SN5659__cal_impl.Encode3_P13 "" VALUE 0x008DE668 Scalar_FLOAT64_IEEE 0 speedgoat_test_SN5659_R2021b_CM_double -1.7E+308 1.7E+308 /end CHARACTERISTIC
/begin CHARACTERISTIC speedgoat_test_SN5659__cal_impl.Encode3_P13_g "" VALUE 0x008DF9B8 Scalar_FLOAT64_IEEE 0 speedgoat_test_SN5659_R2021b_CM_double -1.7E+308 1.7E+308 /end CHARACTERISTIC
/begin CHARACTERISTIC speedgoat_test_SN5659__cal_impl.Encode3_P13_i "" VALUE 0x008DF348 Scalar_FLOAT64_IEEE 0 speedgoat_test_SN5659_R2021b_CM_double -1.7E+308 1.7E+308 /end CHARACTERISTIC
/begin CHARACTERISTIC speedgoat_test_SN5659__cal_impl.Encode3_P13_o "" VALUE 0x008DECD8 Scalar_FLOAT64_IEEE 0 speedgoat_test_SN5659_R2021b_CM_double -1.7E+308 1.7E+308 /end CHARACTERISTIC
/begin CHARACTERISTIC speedgoat_test_SN5659__cal_impl.Encode3_P14 "" VALUE 0x008DE680 Scalar_FLOAT64_IEEE 0 speedgoat_test_SN5659_R2021b_CM_double -1.7E+308 1.7E+308 /end CHARACTERISTIC
/begin CHARACTERISTIC speedgoat_test_SN5659__cal_impl.Encode3_P14_d "" VALUE 0x008DF360 Scalar_FLOAT64_IEEE 0 speedgoat_test_SN5659_R2021b_CM_double -1.7E+308 1.7E+308 /end CHARACTERISTIC
/begin CHARACTERISTIC speedgoat_test_SN5659__cal_impl.Encode3_P14_e "" VALUE 0x008DECF0 Scalar_FLOAT64_IEEE 0 speedgoat_test_SN5659_R2021b_CM_double -1.7E+308 1.7E+308 /end CHARACTERISTIC
/begin CHARACTERISTIC speedgoat_test_SN5659__cal_impl.Encode3_P14_o "" VALUE 0x008DF9D0 Scalar_FLOAT64_IEEE 0 speedgoat_test_SN5659_R2021b_CM_double -1.7E+308 1.7E+308 /end CHARACTERISTIC
/begin CHARACTERISTIC speedgoat_test_SN5659__cal_impl.Encode3_P15 "" VALUE 0x008DE698 Scalar_FLOAT64_IEEE 0 speedgoat_test_SN5659_R2021b_CM_double -1.7E+308 1.7E+308 /end CHARACTERISTIC
/begin CHARACTERISTIC speedgoat_test_SN5659__cal_impl.Encode3_P15_h "" VALUE 0x008DF378 Scalar_FLOAT64_IEEE 0 speedgoat_test_SN5659_R2021b_CM_double -1.7E+308 1.7E+308 /end CHARACTERISTIC
/begin CHARACTERISTIC speedgoat_test_SN5659__cal_impl.Encode3_P15_hk "" VALUE 0x008DF9E8 Scalar_FLOAT64_IEEE 0 speedgoat_test_SN5659_R2021b_CM_double -1.7E+308 1.7E+308 /end CHARACTERISTIC
/begin CHARACTERISTIC speedgoat_test_SN5659__cal_impl.Encode3_P15_p "" VALUE 0x008DED08 Scalar_FLOAT64_IEEE 0 speedgoat_test_SN5659_R2021b_CM_double -1.7E+308 1.7E+308 /end CHARACTERISTIC
/begin CHARACTERISTIC speedgoat_test_SN5659__cal_impl.Encode3_P1_e "" VALUE 0x008DF220 Scalar_FLOAT64_IEEE 0 speedgoat_test_SN5659_R2021b_CM_double -1.7E+308 1.7E+308 /end CHARACTERISTIC
/begin CHARACTERISTIC speedgoat_test_SN5659__cal_impl.Encode3_P1_l "" VALUE 0x008DEBB0 Scalar_FLOAT64_IEEE 0 speedgoat_test_SN5659_R2021b_CM_double -1.7E+308 1.7E+308 /end CHARACTERISTIC
/begin CHARACTERISTIC speedgoat_test_SN5659__cal_impl.Encode3_P1_n "" VALUE 0x008DF890 Scalar_FLOAT64_IEEE 0 speedgoat_test_SN5659_R2021b_CM_double -1.7E+308 1.7E+308 /end CHARACTERISTIC
/begin CHARACTERISTIC speedgoat_test_SN5659__cal_impl.Encode3_P2 "" VALUE 0x008DE558 Scalar_FLOAT64_IEEE 0 speedgoat_test_SN5659_R2021b_CM_double -1.7E+308 1.7E+308 /end CHARACTERISTIC
/begin CHARACTERISTIC speedgoat_test_SN5659__cal_impl.Encode3_P2_f "" VALUE 0x008DF238 Scalar_FLOAT64_IEEE 0 speedgoat_test_SN5659_R2021b_CM_double -1.7E+308 1.7E+308 /end CHARACTERISTIC
/begin CHARACTERISTIC speedgoat_test_SN5659__cal_impl.Encode3_P2_i "" VALUE 0x008DF8A8 Scalar_FLOAT64_IEEE 0 speedgoat_test_SN5659_R2021b_CM_double -1.7E+308 1.7E+308 /end CHARACTERISTIC
/begin CHARACTERISTIC speedgoat_test_SN5659__cal_impl.Encode3_P2_j "" VALUE 0x008DEBC8 Scalar_FLOAT64_IEEE 0 speedgoat_test_SN5659_R2021b_CM_double -1.7E+308 1.7E+308 /end CHARACTERISTIC
/begin CHARACTERISTIC speedgoat_test_SN5659__cal_impl.Encode3_P3 "" VALUE 0x008DE570 Scalar_FLOAT64_IEEE 0 speedgoat_test_SN5659_R2021b_CM_double -1.7E+308 1.7E+308 /end CHARACTERISTIC
/begin CHARACTERISTIC speedgoat_test_SN5659__cal_impl.Encode3_P3_b "" VALUE 0x008DF250 Scalar_FLOAT64_IEEE 0 speedgoat_test_SN5659_R2021b_CM_double -1.7E+308 1.7E+308 /end CHARACTERISTIC
/begin CHARACTERISTIC speedgoat_test_SN5659__cal_impl.Encode3_P3_j "" VALUE 0x008DF8C0 Scalar_FLOAT64_IEEE 0 speedgoat_test_SN5659_R2021b_CM_double -1.7E+308 1.7E+308 /end CHARACTERISTIC
/begin CHARACTERISTIC speedgoat_test_SN5659__cal_impl.Encode3_P3_n "" VALUE 0x008DEBE0 Scalar_FLOAT64_IEEE 0 speedgoat_test_SN5659_R2021b_CM_double -1.7E+308 1.7E+308 /end CHARACTERISTIC
/begin CHARACTERISTIC speedgoat_test_SN5659__cal_impl.Encode3_P4 "" VALUE 0x008DE588 Scalar_FLOAT64_IEEE 0 speedgoat_test_SN5659_R2021b_CM_double -1.7E+308 1.7E+308 /end CHARACTERISTIC
/begin CHARACTERISTIC speedgoat_test_SN5659__cal_impl.Encode3_P4_d "" VALUE 0x008DF268 Scalar_FLOAT64_IEEE 0 speedgoat_test_SN5659_R2021b_CM_double -1.7E+308 1.7E+308 /end CHARACTERISTIC
/begin CHARACTERISTIC speedgoat_test_SN5659__cal_impl.Encode3_P4_g "" VALUE 0x008DEBF8 Scalar_FLOAT64_IEEE 0 speedgoat_test_SN5659_R2021b_CM_double -1.7E+308 1.7E+308 /end CHARACTERISTIC
/begin CHARACTERISTIC speedgoat_test_SN5659__cal_impl.Encode3_P4_l "" VALUE 0x008DF8D8 Scalar_FLOAT64_IEEE 0 speedgoat_test_SN5659_R2021b_CM_double -1.7E+308 1.7E+308 /end CHARACTERISTIC
/begin CHARACTERISTIC speedgoat_test_SN5659__cal_impl.Encode3_P5 "" VALUE 0x008DE5A0 Scalar_FLOAT64_IEEE 0 speedgoat_test_SN5659_R2021b_CM_double -1.7E+308 1.7E+308 /end CHARACTERISTIC
/begin CHARACTERISTIC speedgoat_test_SN5659__cal_impl.Encode3_P5_b "" VALUE 0x008DF8F0 Scalar_FLOAT64_IEEE 0 speedgoat_test_SN5659_R2021b_CM_double -1.7E+308 1.7E+308 /end CHARACTERISTIC
/begin CHARACTERISTIC speedgoat_test_SN5659__cal_impl.Encode3_P5_i "" VALUE 0x008DF280 Scalar_FLOAT64_IEEE 0 speedgoat_test_SN5659_R2021b_CM_double -1.7E+308 1.7E+308 /end CHARACTERISTIC
/begin CHARACTERISTIC speedgoat_test_SN5659__cal_impl.Encode3_P5_k "" VALUE 0x008DEC10 Scalar_FLOAT64_IEEE 0 speedgoat_test_SN5659_R2021b_CM_double -1.7E+308 1.7E+308 /end CHARACTERISTIC
/begin CHARACTERISTIC speedgoat_test_SN5659__cal_impl.Encode3_P6 "" VALUE 0x008DE5B8 Scalar_FLOAT64_IEEE 0 speedgoat_test_SN5659_R2021b_CM_double -1.7E+308 1.7E+308 /end CHARACTERISTIC
/begin CHARACTERISTIC speedgoat_test_SN5659__cal_impl.Encode3_P6_e "" VALUE 0x008DF298 Scalar_FLOAT64_IEEE 0 speedgoat_test_SN5659_R2021b_CM_double -1.7E+308 1.7E+308 /end CHARACTERISTIC
/begin CHARACTERISTIC speedgoat_test_SN5659__cal_impl.Encode3_P6_h "" VALUE 0x008DEC28 Scalar_FLOAT64_IEEE 0 speedgoat_test_SN5659_R2021b_CM_double -1.7E+308 1.7E+308 /end CHARACTERISTIC
/begin CHARACTERISTIC speedgoat_test_SN5659__cal_impl.Encode3_P6_j "" VALUE 0x008DF908 Scalar_FLOAT64_IEEE 0 speedgoat_test_SN5659_R2021b_CM_double -1.7E+308 1.7E+308 /end CHARACTERISTIC
/begin CHARACTERISTIC speedgoat_test_SN5659__cal_impl.Encode3_P7 "" VALUE 0x008DE5D0 Scalar_FLOAT64_IEEE 0 speedgoat_test_SN5659_R2021b_CM_double -1.7E+308 1.7E+308 /end CHARACTERISTIC
/begin CHARACTERISTIC speedgoat_test_SN5659__cal_impl.Encode3_P7_b "" VALUE 0x008DEC40 Scalar_FLOAT64_IEEE 0 speedgoat_test_SN5659_R2021b_CM_double -1.7E+308 1.7E+308 /end CHARACTERISTIC
/begin CHARACTERISTIC speedgoat_test_SN5659__cal_impl.Encode3_P7_h "" VALUE 0x008DF2B0 Scalar_FLOAT64_IEEE 0 speedgoat_test_SN5659_R2021b_CM_double -1.7E+308 1.7E+308 /end CHARACTERISTIC
/begin CHARACTERISTIC speedgoat_test_SN5659__cal_impl.Encode3_P7_l "" VALUE 0x008DF920 Scalar_FLOAT64_IEEE 0 speedgoat_test_SN5659_R2021b_CM_double -1.7E+308 1.7E+308 /end CHARACTERISTIC
/begin CHARACTERISTIC speedgoat_test_SN5659__cal_impl.Encode3_P8 "" VALUE 0x008DE5E8 Scalar_FLOAT64_IEEE 0 speedgoat_test_SN5659_R2021b_CM_double -1.7E+308 1.7E+308 /end CHARACTERISTIC
/begin CHARACTERISTIC speedgoat_test_SN5659__cal_impl.Encode3_P8_e "" VALUE 0x008DEC58 Scalar_FLOAT64_IEEE 0 speedgoat_test_SN5659_R2021b_CM_double -1.7E+308 1.7E+308 /end CHARACTERISTIC
/begin CHARACTERISTIC speedgoat_test_SN5659__cal_impl.Encode3_P8_f "" VALUE 0x008DF2C8 Scalar_FLOAT64_IEEE 0 speedgoat_test_SN5659_R2021b_CM_double -1.7E+308 1.7E+308 /end CHARACTERISTIC
/begin CHARACTERISTIC speedgoat_test_SN5659__cal_impl.Encode3_P8_h "" VALUE 0x008DF938 Scalar_FLOAT64_IEEE 0 speedgoat_test_SN5659_R2021b_CM_double -1.7E+308 1.7E+308 /end CHARACTERISTIC
/begin CHARACTERISTIC speedgoat_test_SN5659__cal_impl.Encode3_P9 "" VALUE 0x008DE600 Scalar_FLOAT64_IEEE 0 speedgoat_test_SN5659_R2021b_CM_double -1.7E+308 1.7E+308 /end CHARACTERISTIC
/begin CHARACTERISTIC speedgoat_test_SN5659__cal_impl.Encode3_P9_b "" VALUE 0x008DF950 Scalar_FLOAT64_IEEE 0 speedgoat_test_SN5659_R2021b_CM_double -1.7E+308 1.7E+308 /end CHARACTERISTIC
/begin CHARACTERISTIC speedgoat_test_SN5659__cal_impl.Encode3_P9_g "" VALUE 0x008DEC70 Scalar_FLOAT64_IEEE 0 speedgoat_test_SN5659_R2021b_CM_double -1.7E+308 1.7E+308 /end CHARACTERISTIC
/begin CHARACTERISTIC speedgoat_test_SN5659__cal_impl.Encode3_P9_k "" VALUE 0x008DF2E0 Scalar_FLOAT64_IEEE 0 speedgoat_test_SN5659_R2021b_CM_double -1.7E+308 1.7E+308 /end CHARACTERISTIC
/begin CHARACTERISTIC speedgoat_test_SN5659__cal_impl.Encode4_P1 "" VALUE 0x008DED38 Scalar_FLOAT64_IEEE 0 speedgoat_test_SN5659_R2021b_CM_double -1.7E+308 1.7E+308 /end CHARACTERISTIC
/begin CHARACTERISTIC speedgoat_test_SN5659__cal_impl.Encode4_P10 "" VALUE 0x008DEE10 Scalar_FLOAT64_IEEE 0 speedgoat_test_SN5659_R2021b_CM_double -1.7E+308 1.7E+308 /end CHARACTERISTIC
/begin CHARACTERISTIC speedgoat_test_SN5659__cal_impl.Encode4_P10_h "" VALUE 0x008DF480 Scalar_FLOAT64_IEEE 0 speedgoat_test_SN5659_R2021b_CM_double -1.7E+308 1.7E+308 /end CHARACTERISTIC
/begin CHARACTERISTIC speedgoat_test_SN5659__cal_impl.Encode4_P10_o "" VALUE 0x008DFAF0 Scalar_FLOAT64_IEEE 0 speedgoat_test_SN5659_R2021b_CM_double -1.7E+308 1.7E+308 /end CHARACTERISTIC
/begin CHARACTERISTIC speedgoat_test_SN5659__cal_impl.Encode4_P11 "" VAL_BLK 0x008DEE28 Scalar_FLOAT64_IEEE 0 speedgoat_test_SN5659_R2021b_CM_double -1.7E+308 1.7E+308 MATRIX_DIM 2 1 /end CHARACTERISTIC
/begin CHARACTERISTIC speedgoat_test_SN5659__cal_impl.Encode4_P11_j "" VAL_BLK 0x008DF498 Scalar_FLOAT64_IEEE 0 speedgoat_test_SN5659_R2021b_CM_double -1.7E+308 1.7E+308 MATRIX_DIM 2 1 /end CHARACTERISTIC
/begin CHARACTERISTIC speedgoat_test_SN5659__cal_impl.Encode4_P11_o "" VAL_BLK 0x008DFB08 Scalar_FLOAT64_IEEE 0 speedgoat_test_SN5659_R2021b_CM_double -1.7E+308 1.7E+308 MATRIX_DIM 2 1 /end CHARACTERISTIC
/begin CHARACTERISTIC speedgoat_test_SN5659__cal_impl.Encode4_P12 "" VALUE 0x008DEE48 Scalar_FLOAT64_IEEE 0 speedgoat_test_SN5659_R2021b_CM_double -1.7E+308 1.7E+308 /end CHARACTERISTIC
/begin CHARACTERISTIC speedgoat_test_SN5659__cal_impl.Encode4_P12_d "" VALUE 0x008DFB28 Scalar_FLOAT64_IEEE 0 speedgoat_test_SN5659_R2021b_CM_double -1.7E+308 1.7E+308 /end CHARACTERISTIC
/begin CHARACTERISTIC speedgoat_test_SN5659__cal_impl.Encode4_P12_l "" VALUE 0x008DF4B8 Scalar_FLOAT64_IEEE 0 speedgoat_test_SN5659_R2021b_CM_double -1.7E+308 1.7E+308 /end CHARACTERISTIC
/begin CHARACTERISTIC speedgoat_test_SN5659__cal_impl.Encode4_P13 "" VALUE 0x008DEE60 Scalar_FLOAT64_IEEE 0 speedgoat_test_SN5659_R2021b_CM_double -1.7E+308 1.7E+308 /end CHARACTERISTIC
/begin CHARACTERISTIC speedgoat_test_SN5659__cal_impl.Encode4_P13_a "" VALUE 0x008DF4D0 Scalar_FLOAT64_IEEE 0 speedgoat_test_SN5659_R2021b_CM_double -1.7E+308 1.7E+308 /end CHARACTERISTIC
/begin CHARACTERISTIC speedgoat_test_SN5659__cal_impl.Encode4_P13_f "" VALUE 0x008DFB40 Scalar_FLOAT64_IEEE 0 speedgoat_test_SN5659_R2021b_CM_double -1.7E+308 1.7E+308 /end CHARACTERISTIC
/begin CHARACTERISTIC speedgoat_test_SN5659__cal_impl.Encode4_P14 "" VALUE 0x008DEE78 Scalar_FLOAT64_IEEE 0 speedgoat_test_SN5659_R2021b_CM_double -1.7E+308 1.7E+308 /end CHARACTERISTIC
/begin CHARACTERISTIC speedgoat_test_SN5659__cal_impl.Encode4_P14_j "" VALUE 0x008DFB58 Scalar_FLOAT64_IEEE 0 speedgoat_test_SN5659_R2021b_CM_double -1.7E+308 1.7E+308 /end CHARACTERISTIC
/begin CHARACTERISTIC speedgoat_test_SN5659__cal_impl.Encode4_P14_l "" VALUE 0x008DF4E8 Scalar_FLOAT64_IEEE 0 speedgoat_test_SN5659_R2021b_CM_double -1.7E+308 1.7E+308 /end CHARACTERISTIC
/begin CHARACTERISTIC speedgoat_test_SN5659__cal_impl.Encode4_P15 "" VALUE 0x008DEE90 Scalar_FLOAT64_IEEE 0 speedgoat_test_SN5659_R2021b_CM_double -1.7E+308 1.7E+308 /end CHARACTERISTIC
/begin CHARACTERISTIC speedgoat_test_SN5659__cal_impl.Encode4_P15_g "" VALUE 0x008DFB70 Scalar_FLOAT64_IEEE 0 speedgoat_test_SN5659_R2021b_CM_double -1.7E+308 1.7E+308 /end CHARACTERISTIC
/begin CHARACTERISTIC speedgoat_test_SN5659__cal_impl.Encode4_P15_i "" VALUE 0x008DF500 Scalar_FLOAT64_IEEE 0 speedgoat_test_SN5659_R2021b_CM_double -1.7E+308 1.7E+308 /end CHARACTERISTIC
/begin CHARACTERISTIC speedgoat_test_SN5659__cal_impl.Encode4_P1_e "" VALUE 0x008DF3A8 Scalar_FLOAT64_IEEE 0 speedgoat_test_SN5659_R2021b_CM_double -1.7E+308 1.7E+308 /end CHARACTERISTIC
/begin CHARACTERISTIC speedgoat_test_SN5659__cal_impl.Encode4_P1_f "" VALUE 0x008DFA18 Scalar_FLOAT64_IEEE 0 speedgoat_test_SN5659_R2021b_CM_double -1.7E+308 1.7E+308 /end CHARACTERISTIC
/begin CHARACTERISTIC speedgoat_test_SN5659__cal_impl.Encode4_P2 "" VALUE 0x008DED50 Scalar_FLOAT64_IEEE 0 speedgoat_test_SN5659_R2021b_CM_double -1.7E+308 1.7E+308 /end CHARACTERISTIC
/begin CHARACTERISTIC speedgoat_test_SN5659__cal_impl.Encode4_P2_d "" VALUE 0x008DF3C0 Scalar_FLOAT64_IEEE 0 speedgoat_test_SN5659_R2021b_CM_double -1.7E+308 1.7E+308 /end CHARACTERISTIC
/begin CHARACTERISTIC speedgoat_test_SN5659__cal_impl.Encode4_P2_l "" VALUE 0x008DFA30 Scalar_FLOAT64_IEEE 0 speedgoat_test_SN5659_R2021b_CM_double -1.7E+308 1.7E+308 /end CHARACTERISTIC
/begin CHARACTERISTIC speedgoat_test_SN5659__cal_impl.Encode4_P3 "" VALUE 0x008DED68 Scalar_FLOAT64_IEEE 0 speedgoat_test_SN5659_R2021b_CM_double -1.7E+308 1.7E+308 /end CHARACTERISTIC
/begin CHARACTERISTIC speedgoat_test_SN5659__cal_impl.Encode4_P3_o "" VALUE 0x008DF3D8 Scalar_FLOAT64_IEEE 0 speedgoat_test_SN5659_R2021b_CM_double -1.7E+308 1.7E+308 /end CHARACTERISTIC
/begin CHARACTERISTIC speedgoat_test_SN5659__cal_impl.Encode4_P3_p "" VALUE 0x008DFA48 Scalar_FLOAT64_IEEE 0 speedgoat_test_SN5659_R2021b_CM_double -1.7E+308 1.7E+308 /end CHARACTERISTIC
/begin CHARACTERISTIC speedgoat_test_SN5659__cal_impl.Encode4_P4 "" VALUE 0x008DED80 Scalar_FLOAT64_IEEE 0 speedgoat_test_SN5659_R2021b_CM_double -1.7E+308 1.7E+308 /end CHARACTERISTIC
/begin CHARACTERISTIC speedgoat_test_SN5659__cal_impl.Encode4_P4_a "" VALUE 0x008DF3F0 Scalar_FLOAT64_IEEE 0 speedgoat_test_SN5659_R2021b_CM_double -1.7E+308 1.7E+308 /end CHARACTERISTIC
/begin CHARACTERISTIC speedgoat_test_SN5659__cal_impl.Encode4_P4_k "" VALUE 0x008DFA60 Scalar_FLOAT64_IEEE 0 speedgoat_test_SN5659_R2021b_CM_double -1.7E+308 1.7E+308 /end CHARACTERISTIC
/begin CHARACTERISTIC speedgoat_test_SN5659__cal_impl.Encode4_P5 "" VALUE 0x008DED98 Scalar_FLOAT64_IEEE 0 speedgoat_test_SN5659_R2021b_CM_double -1.7E+308 1.7E+308 /end CHARACTERISTIC
/begin CHARACTERISTIC speedgoat_test_SN5659__cal_impl.Encode4_P5_a "" VALUE 0x008DF408 Scalar_FLOAT64_IEEE 0 speedgoat_test_SN5659_R2021b_CM_double -1.7E+308 1.7E+308 /end CHARACTERISTIC
/begin CHARACTERISTIC speedgoat_test_SN5659__cal_impl.Encode4_P5_p "" VALUE 0x008DFA78 Scalar_FLOAT64_IEEE 0 speedgoat_test_SN5659_R2021b_CM_double -1.7E+308 1.7E+308 /end CHARACTERISTIC
/begin CHARACTERISTIC speedgoat_test_SN5659__cal_impl.Encode4_P6 "" VALUE 0x008DEDB0 Scalar_FLOAT64_IEEE 0 speedgoat_test_SN5659_R2021b_CM_double -1.7E+308 1.7E+308 /end CHARACTERISTIC
/begin CHARACTERISTIC speedgoat_test_SN5659__cal_impl.Encode4_P6_a "" VALUE 0x008DF420 Scalar_FLOAT64_IEEE 0 speedgoat_test_SN5659_R2021b_CM_double -1.7E+308 1.7E+308 /end CHARACTERISTIC
/begin CHARACTERISTIC speedgoat_test_SN5659__cal_impl.Encode4_P6_k "" VALUE 0x008DFA90 Scalar_FLOAT64_IEEE 0 speedgoat_test_SN5659_R2021b_CM_double -1.7E+308 1.7E+308 /end CHARACTERISTIC
/begin CHARACTERISTIC speedgoat_test_SN5659__cal_impl.Encode4_P7 "" VALUE 0x008DEDC8 Scalar_FLOAT64_IEEE 0 speedgoat_test_SN5659_R2021b_CM_double -1.7E+308 1.7E+308 /end CHARACTERISTIC
/begin CHARACTERISTIC speedgoat_test_SN5659__cal_impl.Encode4_P7_c "" VALUE 0x008DFAA8 Scalar_FLOAT64_IEEE 0 speedgoat_test_SN5659_R2021b_CM_double -1.7E+308 1.7E+308 /end CHARACTERISTIC
/begin CHARACTERISTIC speedgoat_test_SN5659__cal_impl.Encode4_P7_p "" VALUE 0x008DF438 Scalar_FLOAT64_IEEE 0 speedgoat_test_SN5659_R2021b_CM_double -1.7E+308 1.7E+308 /end CHARACTERISTIC
/begin CHARACTERISTIC speedgoat_test_SN5659__cal_impl.Encode4_P8 "" VALUE 0x008DEDE0 Scalar_FLOAT64_IEEE 0 speedgoat_test_SN5659_R2021b_CM_double -1.7E+308 1.7E+308 /end CHARACTERISTIC
/begin CHARACTERISTIC speedgoat_test_SN5659__cal_impl.Encode4_P8_j "" VALUE 0x008DFAC0 Scalar_FLOAT64_IEEE 0 speedgoat_test_SN5659_R2021b_CM_double -1.7E+308 1.7E+308 /end CHARACTERISTIC
/begin CHARACTERISTIC speedgoat_test_SN5659__cal_impl.Encode4_P8_o "" VALUE 0x008DF450 Scalar_FLOAT64_IEEE 0 speedgoat_test_SN5659_R2021b_CM_double -1.7E+308 1.7E+308 /end CHARACTERISTIC
/begin CHARACTERISTIC speedgoat_test_SN5659__cal_impl.Encode4_P9 "" VALUE 0x008DEDF8 Scalar_FLOAT64_IEEE 0 speedgoat_test_SN5659_R2021b_CM_double -1.7E+308 1.7E+308 /end CHARACTERISTIC
/begin CHARACTERISTIC speedgoat_test_SN5659__cal_impl.Encode4_P9_c "" VALUE 0x008DFAD8 Scalar_FLOAT64_IEEE 0 speedgoat_test_SN5659_R2021b_CM_double -1.7E+308 1.7E+308 /end CHARACTERISTIC
/begin CHARACTERISTIC speedgoat_test_SN5659__cal_impl.Encode4_P9_i "" VALUE 0x008DF468 Scalar_FLOAT64_IEEE 0 speedgoat_test_SN5659_R2021b_CM_double -1.7E+308 1.7E+308 /end CHARACTERISTIC
/begin CHARACTERISTIC speedgoat_test_SN5659__cal_impl.Encode5_P1 "" VALUE 0x008DE398 Scalar_FLOAT64_IEEE 0 speedgoat_test_SN5659_R2021b_CM_double -1.7E+308 1.7E+308 /end CHARACTERISTIC
/begin CHARACTERISTIC speedgoat_test_SN5659__cal_impl.Encode5_P10 "" VALUE 0x008DE470 Scalar_FLOAT64_IEEE 0 speedgoat_test_SN5659_R2021b_CM_double -1.7E+308 1.7E+308 /end CHARACTERISTIC
/begin CHARACTERISTIC speedgoat_test_SN5659__cal_impl.Encode5_P11 "" VAL_BLK 0x008DE488 Scalar_FLOAT64_IEEE 0 speedgoat_test_SN5659_R2021b_CM_double -1.7E+308 1.7E+308 MATRIX_DIM 2 1 /end CHARACTERISTIC
/begin CHARACTERISTIC speedgoat_test_SN5659__cal_impl.Encode5_P12 "" VALUE 0x008DE4A8 Scalar_FLOAT64_IEEE 0 speedgoat_test_SN5659_R2021b_CM_double -1.7E+308 1.7E+308 /end CHARACTERISTIC
/begin CHARACTERISTIC speedgoat_test_SN5659__cal_impl.Encode5_P13 "" VALUE 0x008DE4C0 Scalar_FLOAT64_IEEE 0 speedgoat_test_SN5659_R2021b_CM_double -1.7E+308 1.7E+308 /end CHARACTERISTIC
/begin CHARACTERISTIC speedgoat_test_SN5659__cal_impl.Encode5_P14 "" VALUE 0x008DE4D8 Scalar_FLOAT64_IEEE 0 speedgoat_test_SN5659_R2021b_CM_double -1.7E+308 1.7E+308 /end CHARACTERISTIC
/begin CHARACTERISTIC speedgoat_test_SN5659__cal_impl.Encode5_P15 "" VALUE 0x008DE4F0 Scalar_FLOAT64_IEEE 0 speedgoat_test_SN5659_R2021b_CM_double -1.7E+308 1.7E+308 /end CHARACTERISTIC
/begin CHARACTERISTIC speedgoat_test_SN5659__cal_impl.Encode5_P2 "" VALUE 0x008DE3B0 Scalar_FLOAT64_IEEE 0 speedgoat_test_SN5659_R2021b_CM_double -1.7E+308 1.7E+308 /end CHARACTERISTIC
/begin CHARACTERISTIC speedgoat_test_SN5659__cal_impl.Encode5_P3 "" VALUE 0x008DE3C8 Scalar_FLOAT64_IEEE 0 speedgoat_test_SN5659_R2021b_CM_double -1.7E+308 1.7E+308 /end CHARACTERISTIC
/begin CHARACTERISTIC speedgoat_test_SN5659__cal_impl.Encode5_P4 "" VALUE 0x008DE3E0 Scalar_FLOAT64_IEEE 0 speedgoat_test_SN5659_R2021b_CM_double -1.7E+308 1.7E+308 /end CHARACTERISTIC
/begin CHARACTERISTIC speedgoat_test_SN5659__cal_impl.Encode5_P5 "" VALUE 0x008DE3F8 Scalar_FLOAT64_IEEE 0 speedgoat_test_SN5659_R2021b_CM_double -1.7E+308 1.7E+308 /end CHARACTERISTIC
/begin CHARACTERISTIC speedgoat_test_SN5659__cal_impl.Encode5_P6 "" VALUE 0x008DE410 Scalar_FLOAT64_IEEE 0 speedgoat_test_SN5659_R2021b_CM_double -1.7E+308 1.7E+308 /end CHARACTERISTIC
/begin CHARACTERISTIC speedgoat_test_SN5659__cal_impl.Encode5_P7 "" VALUE 0x008DE428 Scalar_FLOAT64_IEEE 0 speedgoat_test_SN5659_R2021b_CM_double -1.7E+308 1.7E+308 /end CHARACTERISTIC
/begin CHARACTERISTIC speedgoat_test_SN5659__cal_impl.Encode5_P8 "" VALUE 0x008DE440 Scalar_FLOAT64_IEEE 0 speedgoat_test_SN5659_R2021b_CM_double -1.7E+308 1.7E+308 /end CHARACTERISTIC
/begin CHARACTERISTIC speedgoat_test_SN5659__cal_impl.Encode5_P9 "" VALUE 0x008DE458 Scalar_FLOAT64_IEEE 0 speedgoat_test_SN5659_R2021b_CM_double -1.7E+308 1.7E+308 /end CHARACTERISTIC
/begin CHARACTERISTIC speedgoat_test_SN5659__cal_impl.FixPtConstant_Value "" VALUE 0x008E4D82 Scalar_UWORD 0 speedgoat_test_SN5659_R2021b_CM_uint16 0 65535 /end CHARACTERISTIC
/begin CHARACTERISTIC speedgoat_test_SN5659__cal_impl.FixPtConstant_Value_a "" VALUE 0x008E4D88 Scalar_UWORD 0 speedgoat_test_SN5659_R2021b_CM_uint16 0 65535 /end CHARACTERISTIC
/begin CHARACTERISTIC speedgoat_test_SN5659__cal_impl.FixPtConstant_Value_o "" VALUE 0x008E4D8E Scalar_UWORD 0 speedgoat_test_SN5659_R2021b_CM_uint16 0 65535 /end CHARACTERISTIC
/begin CHARACTERISTIC speedgoat_test_SN5659__cal_impl.Label_Value_d "" VALUE 0x008E4CD4 Scalar_ULONG 0 speedgoat_test_SN5659_R2021b_CM_uint32 0 2147483646 /end CHARACTERISTIC
/begin CHARACTERISTIC speedgoat_test_SN5659__cal_impl.Label_Value_e "" VALUE 0x008E4CE0 Scalar_ULONG 0 speedgoat_test_SN5659_R2021b_CM_uint32 0 2147483646 /end CHARACTERISTIC
/begin CHARACTERISTIC speedgoat_test_SN5659__cal_impl.Label_Value_j "" VALUE 0x008E4CEC Scalar_ULONG 0 speedgoat_test_SN5659_R2021b_CM_uint32 0 2147483646 /end CHARACTERISTIC
/begin CHARACTERISTIC speedgoat_test_SN5659__cal_impl.Mask_BitMask_d "" VALUE 0x008D502C Scalar_ULONG 0 speedgoat_test_SN5659_R2021b_CM_uint32 0 2147483646 /end CHARACTERISTIC
/begin CHARACTERISTIC speedgoat_test_SN5659__cal_impl.Mask_BitMask_h "" VALUE 0x008D5024 Scalar_ULONG 0 speedgoat_test_SN5659_R2021b_CM_uint32 0 2147483646 /end CHARACTERISTIC
/begin CHARACTERISTIC speedgoat_test_SN5659__cal_impl.Mask_BitMask_k "" VALUE 0x008D5028 Scalar_ULONG 0 speedgoat_test_SN5659_R2021b_CM_uint32 0 2147483646 /end CHARACTERISTIC
/begin CHARACTERISTIC speedgoat_test_SN5659__cal_impl.Output_InitialCondition "" VALUE 0x008E4D80 Scalar_UWORD 0 speedgoat_test_SN5659_R2021b_CM_uint16 0 65535 /end CHARACTERISTIC
/begin CHARACTERISTIC speedgoat_test_SN5659__cal_impl.Output_InitialCondition_c "" VALUE 0x008E4D8C Scalar_UWORD 0 speedgoat_test_SN5659_R2021b_CM_uint16 0 65535 /end CHARACTERISTIC
/begin CHARACTERISTIC speedgoat_test_SN5659__cal_impl.Output_InitialCondition_n "" VALUE 0x008E4D86 Scalar_UWORD 0 speedgoat_test_SN5659_R2021b_CM_uint16 0 65535 /end CHARACTERISTIC
/begin CHARACTERISTIC speedgoat_test_SN5659__cal_impl.Randomnumber_Mean "" VALUE 0x008DE200 Scalar_FLOAT64_IEEE 0 speedgoat_test_SN5659_R2021b_CM_double -1.7E+308 1.7E+308 /end CHARACTERISTIC
/begin CHARACTERISTIC speedgoat_test_SN5659__cal_impl.Randomnumber_Mean_f "" VALUE 0x008DE870 Scalar_FLOAT64_IEEE 0 speedgoat_test_SN5659_R2021b_CM_double -1.7E+308 1.7E+308 /end CHARACTERISTIC
/begin CHARACTERISTIC speedgoat_test_SN5659__cal_impl.Randomnumber_Mean_fn "" VALUE 0x008DF550 Scalar_FLOAT64_IEEE 0 speedgoat_test_SN5659_R2021b_CM_double -1.7E+308 1.7E+308 /end CHARACTERISTIC
/begin CHARACTERISTIC speedgoat_test_SN5659__cal_impl.Randomnumber_Mean_k "" VALUE 0x008DEEE0 Scalar_FLOAT64_IEEE 0 speedgoat_test_SN5659_R2021b_CM_double -1.7E+308 1.7E+308 /end CHARACTERISTIC
/begin CHARACTERISTIC speedgoat_test_SN5659__cal_impl.Randomnumber_Seed "" VALUE 0x008DE210 Scalar_FLOAT64_IEEE 0 speedgoat_test_SN5659_R2021b_CM_double -1.7E+308 1.7E+308 /end CHARACTERISTIC
/begin CHARACTERISTIC speedgoat_test_SN5659__cal_impl.Randomnumber_Seed_f "" VALUE 0x008DF560 Scalar_FLOAT64_IEEE 0 speedgoat_test_SN5659_R2021b_CM_double -1.7E+308 1.7E+308 /end CHARACTERISTIC
/begin CHARACTERISTIC speedgoat_test_SN5659__cal_impl.Randomnumber_Seed_h "" VALUE 0x008DEEF0 Scalar_FLOAT64_IEEE 0 speedgoat_test_SN5659_R2021b_CM_double -1.7E+308 1.7E+308 /end CHARACTERISTIC
/begin CHARACTERISTIC speedgoat_test_SN5659__cal_impl.Randomnumber_Seed_n "" VALUE 0x008DE880 Scalar_FLOAT64_IEEE 0 speedgoat_test_SN5659_R2021b_CM_double -1.7E+308 1.7E+308 /end CHARACTERISTIC
/begin CHARACTERISTIC speedgoat_test_SN5659__cal_impl.Randomnumber_StdDev "" VALUE 0x008DE208 Scalar_FLOAT64_IEEE 0 speedgoat_test_SN5659_R2021b_CM_double -1.7E+308 1.7E+308 /end CHARACTERISTIC
/begin CHARACTERISTIC speedgoat_test_SN5659__cal_impl.Randomnumber_StdDev_a "" VALUE 0x008DE878 Scalar_FLOAT64_IEEE 0 speedgoat_test_SN5659_R2021b_CM_double -1.7E+308 1.7E+308 /end CHARACTERISTIC
/begin CHARACTERISTIC speedgoat_test_SN5659__cal_impl.Randomnumber_StdDev_j "" VALUE 0x008DF558 Scalar_FLOAT64_IEEE 0 speedgoat_test_SN5659_R2021b_CM_double -1.7E+308 1.7E+308 /end CHARACTERISTIC
/begin CHARACTERISTIC speedgoat_test_SN5659__cal_impl.Randomnumber_StdDev_l "" VALUE 0x008DEEE8 Scalar_FLOAT64_IEEE 0 speedgoat_test_SN5659_R2021b_CM_double -1.7E+308 1.7E+308 /end CHARACTERISTIC
/begin CHARACTERISTIC speedgoat_test_SN5659__cal_impl.SDI_Value_d "" VALUE 0x008E4CD0 Scalar_ULONG 0 speedgoat_test_SN5659_R2021b_CM_uint32 0 2147483646 /end CHARACTERISTIC
/begin CHARACTERISTIC speedgoat_test_SN5659__cal_impl.SDI_Value_l "" VALUE 0x008E4CE8 Scalar_ULONG 0 speedgoat_test_SN5659_R2021b_CM_uint32 0 2147483646 /end CHARACTERISTIC
/begin CHARACTERISTIC speedgoat_test_SN5659__cal_impl.SDI_Value_m "" VALUE 0x008E4CDC Scalar_ULONG 0 speedgoat_test_SN5659_R2021b_CM_uint32 0 2147483646 /end CHARACTERISTIC
/begin CHARACTERISTIC speedgoat_test_SN5659__cal_impl.SSM_Value_l "" VALUE 0x008E4CD8 Scalar_ULONG 0 speedgoat_test_SN5659_R2021b_CM_uint32 0 2147483646 /end CHARACTERISTIC
/begin CHARACTERISTIC speedgoat_test_SN5659__cal_impl.SSM_Value_n "" VALUE 0x008E4CE4 Scalar_ULONG 0 speedgoat_test_SN5659_R2021b_CM_uint32 0 2147483646 /end CHARACTERISTIC
/begin CHARACTERISTIC speedgoat_test_SN5659__cal_impl.SSM_Value_o "" VALUE 0x008E4CCC Scalar_ULONG 0 speedgoat_test_SN5659_R2021b_CM_uint32 0 2147483646 /end CHARACTERISTIC
/begin CHARACTERISTIC speedgoat_test_SN5659__cal_impl.Scale_Value_a "" VALUE 0x008DF388 Scalar_FLOAT64_IEEE 0 speedgoat_test_SN5659_R2021b_CM_double -1.7E+308 1.7E+308 /end CHARACTERISTIC
/begin CHARACTERISTIC speedgoat_test_SN5659__cal_impl.Scale_Value_b "" VALUE 0x008DF9F8 Scalar_FLOAT64_IEEE 0 speedgoat_test_SN5659_R2021b_CM_double -1.7E+308 1.7E+308 /end CHARACTERISTIC
/begin CHARACTERISTIC speedgoat_test_SN5659__cal_impl.Scale_Value_l "" VALUE 0x008DED18 Scalar_FLOAT64_IEEE 0 speedgoat_test_SN5659_R2021b_CM_double -1.7E+308 1.7E+308 /end CHARACTERISTIC
/begin CHARACTERISTIC speedgoat_test_SN5659__cal_impl.Sinewave_Amp "" VALUE 0x008DE4F8 Scalar_FLOAT64_IEEE 0 speedgoat_test_SN5659_R2021b_CM_double -1.7E+308 1.7E+308 /end CHARACTERISTIC
/begin CHARACTERISTIC speedgoat_test_SN5659__cal_impl.Sinewave_Amp_d "" VALUE 0x008DF848 Scalar_FLOAT64_IEEE 0 speedgoat_test_SN5659_R2021b_CM_double -1.7E+308 1.7E+308 /end CHARACTERISTIC
/begin CHARACTERISTIC speedgoat_test_SN5659__cal_impl.Sinewave_Amp_i "" VALUE 0x008DF1D8 Scalar_FLOAT64_IEEE 0 speedgoat_test_SN5659_R2021b_CM_double -1.7E+308 1.7E+308 /end CHARACTERISTIC
/begin CHARACTERISTIC speedgoat_test_SN5659__cal_impl.Sinewave_Amp_o "" VALUE 0x008DEB68 Scalar_FLOAT64_IEEE 0 speedgoat_test_SN5659_R2021b_CM_double -1.7E+308 1.7E+308 /end CHARACTERISTIC
/begin CHARACTERISTIC speedgoat_test_SN5659__cal_impl.Sinewave_Bias "" VALUE 0x008DE500 Scalar_FLOAT64_IEEE 0 speedgoat_test_SN5659_R2021b_CM_double -1.7E+308 1.7E+308 /end CHARACTERISTIC
/begin CHARACTERISTIC speedgoat_test_SN5659__cal_impl.Sinewave_Bias_c "" VALUE 0x008DF1E0 Scalar_FLOAT64_IEEE 0 speedgoat_test_SN5659_R2021b_CM_double -1.7E+308 1.7E+308 /end CHARACTERISTIC
/begin CHARACTERISTIC speedgoat_test_SN5659__cal_impl.Sinewave_Bias_e "" VALUE 0x008DF850 Scalar_FLOAT64_IEEE 0 speedgoat_test_SN5659_R2021b_CM_double -1.7E+308 1.7E+308 /end CHARACTERISTIC
/begin CHARACTERISTIC speedgoat_test_SN5659__cal_impl.Sinewave_Bias_k "" VALUE 0x008DEB70 Scalar_FLOAT64_IEEE 0 speedgoat_test_SN5659_R2021b_CM_double -1.7E+308 1.7E+308 /end CHARACTERISTIC
/begin CHARACTERISTIC speedgoat_test_SN5659__cal_impl.Sinewave_Freq "" VALUE 0x008DE508 Scalar_FLOAT64_IEEE 0 speedgoat_test_SN5659_R2021b_CM_double -1.7E+308 1.7E+308 /end CHARACTERISTIC
/begin CHARACTERISTIC speedgoat_test_SN5659__cal_impl.Sinewave_Freq_a "" VALUE 0x008DF858 Scalar_FLOAT64_IEEE 0 speedgoat_test_SN5659_R2021b_CM_double -1.7E+308 1.7E+308 /end CHARACTERISTIC
/begin CHARACTERISTIC speedgoat_test_SN5659__cal_impl.Sinewave_Freq_g "" VALUE 0x008DF1E8 Scalar_FLOAT64_IEEE 0 speedgoat_test_SN5659_R2021b_CM_double -1.7E+308 1.7E+308 /end CHARACTERISTIC
/begin CHARACTERISTIC speedgoat_test_SN5659__cal_impl.Sinewave_Freq_p "" VALUE 0x008DEB78 Scalar_FLOAT64_IEEE 0 speedgoat_test_SN5659_R2021b_CM_double -1.7E+308 1.7E+308 /end CHARACTERISTIC
/begin CHARACTERISTIC speedgoat_test_SN5659__cal_impl.Sinewave_HCos "" VALUE 0x008DE518 Scalar_FLOAT64_IEEE 0 speedgoat_test_SN5659_R2021b_CM_double -1.7E+308 1.7E+308 /end CHARACTERISTIC
/begin CHARACTERISTIC speedgoat_test_SN5659__cal_impl.Sinewave_HCos_j "" VALUE 0x008DF1F8 Scalar_FLOAT64_IEEE 0 speedgoat_test_SN5659_R2021b_CM_double -1.7E+308 1.7E+308 /end CHARACTERISTIC
/begin CHARACTERISTIC speedgoat_test_SN5659__cal_impl.Sinewave_HCos_j4 "" VALUE 0x008DF868 Scalar_FLOAT64_IEEE 0 speedgoat_test_SN5659_R2021b_CM_double -1.7E+308 1.7E+308 /end CHARACTERISTIC
/begin CHARACTERISTIC speedgoat_test_SN5659__cal_impl.Sinewave_HCos_l "" VALUE 0x008DEB88 Scalar_FLOAT64_IEEE 0 speedgoat_test_SN5659_R2021b_CM_double -1.7E+308 1.7E+308 /end CHARACTERISTIC
/begin CHARACTERISTIC speedgoat_test_SN5659__cal_impl.Sinewave_Hsin "" VALUE 0x008DE510 Scalar_FLOAT64_IEEE 0 speedgoat_test_SN5659_R2021b_CM_double -1.7E+308 1.7E+308 /end CHARACTERISTIC
/begin CHARACTERISTIC speedgoat_test_SN5659__cal_impl.Sinewave_Hsin_d "" VALUE 0x008DF860 Scalar_FLOAT64_IEEE 0 speedgoat_test_SN5659_R2021b_CM_double -1.7E+308 1.7E+308 /end CHARACTERISTIC
/begin CHARACTERISTIC speedgoat_test_SN5659__cal_impl.Sinewave_Hsin_j "" VALUE 0x008DEB80 Scalar_FLOAT64_IEEE 0 speedgoat_test_SN5659_R2021b_CM_double -1.7E+308 1.7E+308 /end CHARACTERISTIC
/begin CHARACTERISTIC speedgoat_test_SN5659__cal_impl.Sinewave_Hsin_n "" VALUE 0x008DF1F0 Scalar_FLOAT64_IEEE 0 speedgoat_test_SN5659_R2021b_CM_double -1.7E+308 1.7E+308 /end CHARACTERISTIC
/begin CHARACTERISTIC speedgoat_test_SN5659__cal_impl.Sinewave_PCos "" VALUE 0x008DE528 Scalar_FLOAT64_IEEE 0 speedgoat_test_SN5659_R2021b_CM_double -1.7E+308 1.7E+308 /end CHARACTERISTIC
/begin CHARACTERISTIC speedgoat_test_SN5659__cal_impl.Sinewave_PCos_c "" VALUE 0x008DEB98 Scalar_FLOAT64_IEEE 0 speedgoat_test_SN5659_R2021b_CM_double -1.7E+308 1.7E+308 /end CHARACTERISTIC
/begin CHARACTERISTIC speedgoat_test_SN5659__cal_impl.Sinewave_PCos_j "" VALUE 0x008DF208 Scalar_FLOAT64_IEEE 0 speedgoat_test_SN5659_R2021b_CM_double -1.7E+308 1.7E+308 /end CHARACTERISTIC
/begin CHARACTERISTIC speedgoat_test_SN5659__cal_impl.Sinewave_PCos_p "" VALUE 0x008DF878 Scalar_FLOAT64_IEEE 0 speedgoat_test_SN5659_R2021b_CM_double -1.7E+308 1.7E+308 /end CHARACTERISTIC
/begin CHARACTERISTIC speedgoat_test_SN5659__cal_impl.Sinewave_PSin "" VALUE 0x008DE520 Scalar_FLOAT64_IEEE 0 speedgoat_test_SN5659_R2021b_CM_double -1.7E+308 1.7E+308 /end CHARACTERISTIC
/begin CHARACTERISTIC speedgoat_test_SN5659__cal_impl.Sinewave_PSin_c "" VALUE 0x008DF870 Scalar_FLOAT64_IEEE 0 speedgoat_test_SN5659_R2021b_CM_double -1.7E+308 1.7E+308 /end CHARACTERISTIC
/begin CHARACTERISTIC speedgoat_test_SN5659__cal_impl.Sinewave_PSin_h "" VALUE 0x008DF200 Scalar_FLOAT64_IEEE 0 speedgoat_test_SN5659_R2021b_CM_double -1.7E+308 1.7E+308 /end CHARACTERISTIC
/begin CHARACTERISTIC speedgoat_test_SN5659__cal_impl.Sinewave_PSin_p "" VALUE 0x008DEB90 Scalar_FLOAT64_IEEE 0 speedgoat_test_SN5659_R2021b_CM_double -1.7E+308 1.7E+308 /end CHARACTERISTIC
/begin CHARACTERISTIC speedgoat_test_SN5659__cal_impl.shiftthedoublevalue27bitsleft_g "" VALUE 0x008DFA00 Scalar_FLOAT64_IEEE 0 speedgoat_test_SN5659_R2021b_CM_double -1.7E+308 1.7E+308 /end CHARACTERISTIC
/begin CHARACTERISTIC speedgoat_test_SN5659__cal_impl.shiftthedoublevalue27bitsleft_o "" VALUE 0x008DED20 Scalar_FLOAT64_IEEE 0 speedgoat_test_SN5659_R2021b_CM_double -1.7E+308 1.7E+308 /end CHARACTERISTIC
/begin CHARACTERISTIC speedgoat_test_SN5659__cal_impl.shiftthedoublevalue27bitsleft_p "" VALUE 0x008DF390 Scalar_FLOAT64_IEEE 0 speedgoat_test_SN5659_R2021b_CM_double -1.7E+308 1.7E+308 /end CHARACTERISTIC
/begin MEASUREMENT speedgoat_test_SN5659_R2021b_B.BitwiseOperator_a "" ULONG speedgoat_test_SN5659_R2021b_CM_uint32 0 0 0 2147483646 ECU_ADDRESS 0x009482B8 /end MEASUREMENT
/begin MEASUREMENT speedgoat_test_SN5659_R2021b_B.BitwiseOperator_m "" ULONG speedgoat_test_SN5659_R2021b_CM_uint32 0 0 0 2147483646 ECU_ADDRESS 0x009482A4 /end MEASUREMENT
/begin MEASUREMENT speedgoat_test_SN5659_R2021b_B.BitwiseOperator_p "" ULONG speedgoat_test_SN5659_R2021b_CM_uint32 0 0 0 2147483646 ECU_ADDRESS 0x009482CC /end MEASUREMENT
/begin MEASUREMENT speedgoat_test_SN5659_R2021b_B.DataTypeConversion "" FLOAT64_IEEE speedgoat_test_SN5659_R2021b_CM_double 0 0 -1.7E+308 1.7E+308 ECU_ADDRESS 0x00947D58 /end MEASUREMENT
/begin MEASUREMENT speedgoat_test_SN5659_R2021b_B.DataTypeConversion1 "" FLOAT64_IEEE speedgoat_test_SN5659_R2021b_CM_double 0 0 -1.7E+308 1.7E+308 ECU_ADDRESS 0x00947D88 /end MEASUREMENT
/begin MEASUREMENT speedgoat_test_SN5659_R2021b_B.DataTypeConversion1_g "" FLOAT64_IEEE speedgoat_test_SN5659_R2021b_CM_double 0 0 -1.7E+308 1.7E+308 ECU_ADDRESS 0x00947DD8 /end MEASUREMENT
/begin MEASUREMENT speedgoat_test_SN5659_R2021b_B.DataTypeConversion1_i "" FLOAT64_IEEE speedgoat_test_SN5659_R2021b_CM_double 0 0 -1.7E+308 1.7E+308 ECU_ADDRESS 0x00947E28 /end MEASUREMENT
/begin MEASUREMENT speedgoat_test_SN5659_R2021b_B.DataTypeConversion1_p "" FLOAT64_IEEE speedgoat_test_SN5659_R2021b_CM_double 0 0 -1.7E+308 1.7E+308 ECU_ADDRESS 0x00947E78 /end MEASUREMENT
/begin MEASUREMENT speedgoat_test_SN5659_R2021b_B.DataTypeConversion_c "" ULONG speedgoat_test_SN5659_R2021b_CM_uint32 0 0 0 2147483646 ECU_ADDRESS 0x00948294 /end MEASUREMENT
/begin MEASUREMENT speedgoat_test_SN5659_R2021b_B.DataTypeConversion_e "" FLOAT64_IEEE speedgoat_test_SN5659_R2021b_CM_double 0 0 -1.7E+308 1.7E+308 ECU_ADDRESS 0x00947DF8 /end MEASUREMENT
/begin MEASUREMENT speedgoat_test_SN5659_R2021b_B.DataTypeConversion_ec "" ULONG speedgoat_test_SN5659_R2021b_CM_uint32 0 0 0 2147483646 ECU_ADDRESS 0x009482A8 /end MEASUREMENT
/begin MEASUREMENT speedgoat_test_SN5659_R2021b_B.DataTypeConversion_h "" FLOAT64_IEEE speedgoat_test_SN5659_R2021b_CM_double 0 0 -1.7E+308 1.7E+308 ECU_ADDRESS 0x00947DA8 /end MEASUREMENT
/begin MEASUREMENT speedgoat_test_SN5659_R2021b_B.DataTypeConversion_j "" FLOAT64_IEEE speedgoat_test_SN5659_R2021b_CM_double 0 0 -1.7E+308 1.7E+308 ECU_ADDRESS 0x00947E48 /end MEASUREMENT
/begin MEASUREMENT speedgoat_test_SN5659_R2021b_B.DataTypeConversion_jj "" ULONG speedgoat_test_SN5659_R2021b_CM_uint32 0 0 0 2147483646 ECU_ADDRESS 0x009482BC /end MEASUREMENT
/begin MEASUREMENT speedgoat_test_SN5659_R2021b_B.Decode1_b "" FLOAT64_IEEE speedgoat_test_SN5659_R2021b_CM_double 0 0 -1.7E+308 1.7E+308 ECU_ADDRESS 0x00947D08 /end MEASUREMENT
/begin MEASUREMENT speedgoat_test_SN5659_R2021b_B.Decode1_d "" FLOAT64_IEEE speedgoat_test_SN5659_R2021b_CM_double 0 0 -1.7E+308 1.7E+308 ECU_ADDRESS 0x00946510 /end MEASUREMENT
/begin MEASUREMENT speedgoat_test_SN5659_R2021b_B.Decode1_gi "" FLOAT64_IEEE speedgoat_test_SN5659_R2021b_CM_double 0 0 -1.7E+308 1.7E+308 ECU_ADDRESS 0x00947958 /end MEASUREMENT
/begin MEASUREMENT speedgoat_test_SN5659_R2021b_B.Decode1_p1 "" FLOAT64_IEEE speedgoat_test_SN5659_R2021b_CM_double 0 0 -1.7E+308 1.7E+308 ECU_ADDRESS 0x00947B30 /end MEASUREMENT
/begin MEASUREMENT speedgoat_test_SN5659_R2021b_B.Decode2_f "" FLOAT64_IEEE speedgoat_test_SN5659_R2021b_CM_double 0 0 -1.7E+308 1.7E+308 ECU_ADDRESS 0x00947960 /end MEASUREMENT
/begin MEASUREMENT speedgoat_test_SN5659_R2021b_B.Decode2_h "" FLOAT64_IEEE speedgoat_test_SN5659_R2021b_CM_double 0 0 -1.7E+308 1.7E+308 ECU_ADDRESS 0x00947B38 /end MEASUREMENT
/begin MEASUREMENT speedgoat_test_SN5659_R2021b_B.Decode2_nz "" FLOAT64_IEEE speedgoat_test_SN5659_R2021b_CM_double 0 0 -1.7E+308 1.7E+308 ECU_ADDRESS 0x00947D10 /end MEASUREMENT
/begin MEASUREMENT speedgoat_test_SN5659_R2021b_B.Decode3_c "" FLOAT64_IEEE speedgoat_test_SN5659_R2021b_CM_double 0 0 -1.7E+308 1.7E+308 ECU_ADDRESS 0x00946520 /end MEASUREMENT
/begin MEASUREMENT speedgoat_test_SN5659_R2021b_B.Decode3_lc "" FLOAT64_IEEE speedgoat_test_SN5659_R2021b_CM_double 0 0 -1.7E+308 1.7E+308 ECU_ADDRESS 0x00947B40 /end MEASUREMENT
/begin MEASUREMENT speedgoat_test_SN5659_R2021b_B.Decode3_mj "" FLOAT64_IEEE speedgoat_test_SN5659_R2021b_CM_double 0 0 -1.7E+308 1.7E+308 ECU_ADDRESS 0x00947D18 /end MEASUREMENT
/begin MEASUREMENT speedgoat_test_SN5659_R2021b_B.Decode3_o4 "" FLOAT64_IEEE speedgoat_test_SN5659_R2021b_CM_double 0 0 -1.7E+308 1.7E+308 ECU_ADDRESS 0x00947968 /end MEASUREMENT
/begin MEASUREMENT speedgoat_test_SN5659_R2021b_B.Decode4_f4 "" FLOAT64_IEEE speedgoat_test_SN5659_R2021b_CM_double 0 0 -1.7E+308 1.7E+308 ECU_ADDRESS 0x00947970 /end MEASUREMENT
/begin MEASUREMENT speedgoat_test_SN5659_R2021b_B.Decode4_l "" FLOAT64_IEEE speedgoat_test_SN5659_R2021b_CM_double 0 0 -1.7E+308 1.7E+308 ECU_ADDRESS 0x00947B48 /end MEASUREMENT
/begin MEASUREMENT speedgoat_test_SN5659_R2021b_B.Decode4_m "" FLOAT64_IEEE speedgoat_test_SN5659_R2021b_CM_double 0 0 -1.7E+308 1.7E+308 ECU_ADDRESS 0x00947D20 /end MEASUREMENT
/begin MEASUREMENT speedgoat_test_SN5659_R2021b_B.Decode4_o "" FLOAT64_IEEE speedgoat_test_SN5659_R2021b_CM_double 0 0 -1.7E+308 1.7E+308 ECU_ADDRESS 0x00946528 /end MEASUREMENT
/begin MEASUREMENT speedgoat_test_SN5659_R2021b_B.Decode5_p "" FLOAT64_IEEE speedgoat_test_SN5659_R2021b_CM_double 0 0 -1.7E+308 1.7E+308 ECU_ADDRESS 0x00946518 /end MEASUREMENT
/begin MEASUREMENT speedgoat_test_SN5659_R2021b_B.Divide_h "" FLOAT64_IEEE speedgoat_test_SN5659_R2021b_CM_double 0 0 -1.7E+308 1.7E+308 ECU_ADDRESS 0x00947E18 /end MEASUREMENT
/begin MEASUREMENT speedgoat_test_SN5659_R2021b_B.Divide_k "" FLOAT64_IEEE speedgoat_test_SN5659_R2021b_CM_double 0 0 -1.7E+308 1.7E+308 ECU_ADDRESS 0x00947DC8 /end MEASUREMENT
/begin MEASUREMENT speedgoat_test_SN5659_R2021b_B.Divide_p "" FLOAT64_IEEE speedgoat_test_SN5659_R2021b_CM_double 0 0 -1.7E+308 1.7E+308 ECU_ADDRESS 0x00947E68 /end MEASUREMENT
/begin MEASUREMENT speedgoat_test_SN5659_R2021b_B.Encode1 "" FLOAT64_IEEE speedgoat_test_SN5659_R2021b_CM_double 0 0 -1.7E+308 1.7E+308 ECU_ADDRESS 0x00947D50 /end MEASUREMENT
/begin MEASUREMENT speedgoat_test_SN5659_R2021b_B.Encode1_b "" FLOAT64_IEEE speedgoat_test_SN5659_R2021b_CM_double 0 0 -1.7E+308 1.7E+308 ECU_ADDRESS 0x00947DA0 /end MEASUREMENT
/begin MEASUREMENT speedgoat_test_SN5659_R2021b_B.Encode1_f "" FLOAT64_IEEE speedgoat_test_SN5659_R2021b_CM_double 0 0 -1.7E+308 1.7E+308 ECU_ADDRESS 0x00947DF0 /end MEASUREMENT
/begin MEASUREMENT speedgoat_test_SN5659_R2021b_B.Encode1_k "" FLOAT64_IEEE speedgoat_test_SN5659_R2021b_CM_double 0 0 -1.7E+308 1.7E+308 ECU_ADDRESS 0x00947E40 /end MEASUREMENT
/begin MEASUREMENT speedgoat_test_SN5659_R2021b_B.Encode2 "" FLOAT64_IEEE speedgoat_test_SN5659_R2021b_CM_double 0 0 -1.7E+308 1.7E+308 ECU_ADDRESS 0x00947D90 /end MEASUREMENT
/begin MEASUREMENT speedgoat_test_SN5659_R2021b_B.Encode2_f "" FLOAT64_IEEE speedgoat_test_SN5659_R2021b_CM_double 0 0 -1.7E+308 1.7E+308 ECU_ADDRESS 0x00947E00 /end MEASUREMENT
/begin MEASUREMENT speedgoat_test_SN5659_R2021b_B.Encode2_i "" FLOAT64_IEEE speedgoat_test_SN5659_R2021b_CM_double 0 0 -1.7E+308 1.7E+308 ECU_ADDRESS 0x00947E50 /end MEASUREMENT
/begin MEASUREMENT speedgoat_test_SN5659_R2021b_B.Encode2_p "" FLOAT64_IEEE speedgoat_test_SN5659_R2021b_CM_double 0 0 -1.7E+308 1.7E+308 ECU_ADDRESS 0x00947DB0 /end MEASUREMENT
/begin MEASUREMENT speedgoat_test_SN5659_R2021b_B.Encode3 "" FLOAT64_IEEE speedgoat_test_SN5659_R2021b_CM_double 0 0 -1.7E+308 1.7E+308 ECU_ADDRESS 0x00947D70 /end MEASUREMENT
/begin MEASUREMENT speedgoat_test_SN5659_R2021b_B.Encode3_b "" FLOAT64_IEEE speedgoat_test_SN5659_R2021b_CM_double 0 0 -1.7E+308 1.7E+308 ECU_ADDRESS 0x00947E10 /end MEASUREMENT
/begin MEASUREMENT speedgoat_test_SN5659_R2021b_B.Encode3_i "" FLOAT64_IEEE speedgoat_test_SN5659_R2021b_CM_double 0 0 -1.7E+308 1.7E+308 ECU_ADDRESS 0x00947DC0 /end MEASUREMENT
/begin MEASUREMENT speedgoat_test_SN5659_R2021b_B.Encode3_o "" FLOAT64_IEEE speedgoat_test_SN5659_R2021b_CM_double 0 0 -1.7E+308 1.7E+308 ECU_ADDRESS 0x00947E60 /end MEASUREMENT
/begin MEASUREMENT speedgoat_test_SN5659_R2021b_B.Encode4 "" FLOAT64_IEEE speedgoat_test_SN5659_R2021b_CM_double 0 0 -1.7E+308 1.7E+308 ECU_ADDRESS 0x00947DE0 /end MEASUREMENT
/begin MEASUREMENT speedgoat_test_SN5659_R2021b_B.Encode4_c "" FLOAT64_IEEE speedgoat_test_SN5659_R2021b_CM_double 0 0 -1.7E+308 1.7E+308 ECU_ADDRESS 0x00947E80 /end MEASUREMENT
/begin MEASUREMENT speedgoat_test_SN5659_R2021b_B.Encode4_i "" FLOAT64_IEEE speedgoat_test_SN5659_R2021b_CM_double 0 0 -1.7E+308 1.7E+308 ECU_ADDRESS 0x00947E30 /end MEASUREMENT
/begin MEASUREMENT speedgoat_test_SN5659_R2021b_B.Encode5 "" FLOAT64_IEEE speedgoat_test_SN5659_R2021b_CM_double 0 0 -1.7E+308 1.7E+308 ECU_ADDRESS 0x00947D60 /end MEASUREMENT
/begin MEASUREMENT speedgoat_test_SN5659_R2021b_B.FixPtSum1 "" UWORD speedgoat_test_SN5659_R2021b_CM_uint16 0 0 0 65535 ECU_ADDRESS 0x009483C2 /end MEASUREMENT
/begin MEASUREMENT speedgoat_test_SN5659_R2021b_B.FixPtSum1_a "" UWORD speedgoat_test_SN5659_R2021b_CM_uint16 0 0 0 65535 ECU_ADDRESS 0x009483CE /end MEASUREMENT
/begin MEASUREMENT speedgoat_test_SN5659_R2021b_B.FixPtSum1_n "" UWORD speedgoat_test_SN5659_R2021b_CM_uint16 0 0 0 65535 ECU_ADDRESS 0x009483C8 /end MEASUREMENT
/begin MEASUREMENT speedgoat_test_SN5659_R2021b_B.FixPtSwitch "" UWORD speedgoat_test_SN5659_R2021b_CM_uint16 0 0 0 65535 ECU_ADDRESS 0x009483C4 /end MEASUREMENT
/begin MEASUREMENT speedgoat_test_SN5659_R2021b_B.FixPtSwitch_b "" UWORD speedgoat_test_SN5659_R2021b_CM_uint16 0 0 0 65535 ECU_ADDRESS 0x009483D0 /end MEASUREMENT
/begin MEASUREMENT speedgoat_test_SN5659_R2021b_B.FixPtSwitch_h "" UWORD speedgoat_test_SN5659_R2021b_CM_uint16 0 0 0 65535 ECU_ADDRESS 0x009483CA /end MEASUREMENT
/begin MEASUREMENT speedgoat_test_SN5659_R2021b_B.Mask_a "" ULONG speedgoat_test_SN5659_R2021b_CM_uint32 0 0 0 2147483646 ECU_ADDRESS 0x00948298 /end MEASUREMENT
/begin MEASUREMENT speedgoat_test_SN5659_R2021b_B.Mask_i "" ULONG speedgoat_test_SN5659_R2021b_CM_uint32 0 0 0 2147483646 ECU_ADDRESS 0x009482C0 /end MEASUREMENT
/begin MEASUREMENT speedgoat_test_SN5659_R2021b_B.Mask_n "" ULONG speedgoat_test_SN5659_R2021b_CM_uint32 0 0 0 2147483646 ECU_ADDRESS 0x009482AC /end MEASUREMENT
/begin MEASUREMENT speedgoat_test_SN5659_R2021b_B.Multiply_a "" FLOAT64_IEEE speedgoat_test_SN5659_R2021b_CM_double 0 0 -1.7E+308 1.7E+308 ECU_ADDRESS 0x00947E20 /end MEASUREMENT
/begin MEASUREMENT speedgoat_test_SN5659_R2021b_B.Multiply_h "" FLOAT64_IEEE speedgoat_test_SN5659_R2021b_CM_double 0 0 -1.7E+308 1.7E+308 ECU_ADDRESS 0x00947DD0 /end MEASUREMENT
/begin MEASUREMENT speedgoat_test_SN5659_R2021b_B.Multiply_j "" FLOAT64_IEEE speedgoat_test_SN5659_R2021b_CM_double 0 0 -1.7E+308 1.7E+308 ECU_ADDRESS 0x00947E70 /end MEASUREMENT
/begin MEASUREMENT speedgoat_test_SN5659_R2021b_B.Output "" UWORD speedgoat_test_SN5659_R2021b_CM_uint16 0 0 0 65535 ECU_ADDRESS 0x009483C0 /end MEASUREMENT
/begin MEASUREMENT speedgoat_test_SN5659_R2021b_B.Output_b "" UWORD speedgoat_test_SN5659_R2021b_CM_uint16 0 0 0 65535 ECU_ADDRESS 0x009483C6 /end MEASUREMENT
/begin MEASUREMENT speedgoat_test_SN5659_R2021b_B.Output_o "" UBYTE speedgoat_test_SN5659_R2021b_CM_uint8 0 0 0 255 ECU_ADDRESS 0x00948414 /end MEASUREMENT
/begin MEASUREMENT speedgoat_test_SN5659_R2021b_B.Output_p "" UWORD speedgoat_test_SN5659_R2021b_CM_uint16 0 0 0 65535 ECU_ADDRESS 0x009483CC /end MEASUREMENT
/begin MEASUREMENT speedgoat_test_SN5659_R2021b_B.Randomnumber "" FLOAT64_IEEE speedgoat_test_SN5659_R2021b_CM_double 0 0 -1.7E+308 1.7E+308 ECU_ADDRESS 0x00947D48 /end MEASUREMENT
/begin MEASUREMENT speedgoat_test_SN5659_R2021b_B.Randomnumber_b "" FLOAT64_IEEE speedgoat_test_SN5659_R2021b_CM_double 0 0 -1.7E+308 1.7E+308 ECU_ADDRESS 0x00947E38 /end MEASUREMENT
/begin MEASUREMENT speedgoat_test_SN5659_R2021b_B.Randomnumber_c "" FLOAT64_IEEE speedgoat_test_SN5659_R2021b_CM_double 0 0 -1.7E+308 1.7E+308 ECU_ADDRESS 0x00947D98 /end MEASUREMENT
/begin MEASUREMENT speedgoat_test_SN5659_R2021b_B.Randomnumber_p "" FLOAT64_IEEE speedgoat_test_SN5659_R2021b_CM_double 0 0 -1.7E+308 1.7E+308 ECU_ADDRESS 0x00947DE8 /end MEASUREMENT
/begin MEASUREMENT speedgoat_test_SN5659_R2021b_B.ShifttoSDIslot_a "" ULONG speedgoat_test_SN5659_R2021b_CM_uint32 0 0 0 2147483646 ECU_ADDRESS 0x009482B4 /end MEASUREMENT
/begin MEASUREMENT speedgoat_test_SN5659_R2021b_B.ShifttoSDIslot_k "" ULONG speedgoat_test_SN5659_R2021b_CM_uint32 0 0 0 2147483646 ECU_ADDRESS 0x009482C8 /end MEASUREMENT
/begin MEASUREMENT speedgoat_test_SN5659_R2021b_B.ShifttoSDIslot_l "" ULONG speedgoat_test_SN5659_R2021b_CM_uint32 0 0 0 2147483646 ECU_ADDRESS 0x009482A0 /end MEASUREMENT
/begin MEASUREMENT speedgoat_test_SN5659_R2021b_B.ShifttoSSMslot_b "" ULONG speedgoat_test_SN5659_R2021b_CM_uint32 0 0 0 2147483646 ECU_ADDRESS 0x009482C4 /end MEASUREMENT
/begin MEASUREMENT speedgoat_test_SN5659_R2021b_B.ShifttoSSMslot_h "" ULONG speedgoat_test_SN5659_R2021b_CM_uint32 0 0 0 2147483646 ECU_ADDRESS 0x0094829C /end MEASUREMENT
/begin MEASUREMENT speedgoat_test_SN5659_R2021b_B.ShifttoSSMslot_m "" ULONG speedgoat_test_SN5659_R2021b_CM_uint32 0 0 0 2147483646 ECU_ADDRESS 0x009482B0 /end MEASUREMENT
/begin MEASUREMENT speedgoat_test_SN5659_R2021b_B.Sinewave "" FLOAT64_IEEE speedgoat_test_SN5659_R2021b_CM_double 0 0 -1.7E+308 1.7E+308 ECU_ADDRESS 0x00947D68 /end MEASUREMENT
/begin MEASUREMENT speedgoat_test_SN5659_R2021b_B.Sinewave_f "" FLOAT64_IEEE speedgoat_test_SN5659_R2021b_CM_double 0 0 -1.7E+308 1.7E+308 ECU_ADDRESS 0x00947E08 /end MEASUREMENT
/begin MEASUREMENT speedgoat_test_SN5659_R2021b_B.Sinewave_k "" FLOAT64_IEEE speedgoat_test_SN5659_R2021b_CM_double 0 0 -1.7E+308 1.7E+308 ECU_ADDRESS 0x00947E58 /end MEASUREMENT
/begin MEASUREMENT speedgoat_test_SN5659_R2021b_B.Sinewave_o "" FLOAT64_IEEE speedgoat_test_SN5659_R2021b_CM_double 0 0 -1.7E+308 1.7E+308 ECU_ADDRESS 0x00947DB8 /end MEASUREMENT
/begin MEASUREMENT speedgoat_test_SN5659_R2021b_DW.NextOutput "" FLOAT64_IEEE speedgoat_test_SN5659_R2021b_CM_double 0 0 -1.7E+308 1.7E+308 ECU_ADDRESS 0x009450A0 /end MEASUREMENT
/begin MEASUREMENT speedgoat_test_SN5659_R2021b_DW.NextOutput_a "" FLOAT64_IEEE speedgoat_test_SN5659_R2021b_CM_double 0 0 -1.7E+308 1.7E+308 ECU_ADDRESS 0x009450B8 /end MEASUREMENT
/begin MEASUREMENT speedgoat_test_SN5659_R2021b_DW.NextOutput_f "" FLOAT64_IEEE speedgoat_test_SN5659_R2021b_CM_double 0 0 -1.7E+308 1.7E+308 ECU_ADDRESS 0x009450E8 /end MEASUREMENT
/begin MEASUREMENT speedgoat_test_SN5659_R2021b_DW.NextOutput_n "" FLOAT64_IEEE speedgoat_test_SN5659_R2021b_CM_double 0 0 -1.7E+308 1.7E+308 ECU_ADDRESS 0x009450D0 /end MEASUREMENT
/begin MEASUREMENT speedgoat_test_SN5659_R2021b_DW.Output_DSTATE "" UWORD speedgoat_test_SN5659_R2021b_CM_uint16 0 0 0 65535 ECU_ADDRESS 0x00945D70 /end MEASUREMENT
/begin MEASUREMENT speedgoat_test_SN5659_R2021b_DW.Output_DSTATE_o "" UWORD speedgoat_test_SN5659_R2021b_CM_uint16 0 0 0 65535 ECU_ADDRESS 0x00945D72 /end MEASUREMENT
/begin MEASUREMENT speedgoat_test_SN5659_R2021b_DW.Output_DSTATE_o0 "" UWORD speedgoat_test_SN5659_R2021b_CM_uint16 0 0 0 65535 ECU_ADDRESS 0x00945D74 /end MEASUREMENT
/begin MEASUREMENT speedgoat_test_SN5659_R2021b_DW.RandSeed "" ULONG speedgoat_test_SN5659_R2021b_CM_uint32 0 0 0 2147483646 ECU_ADDRESS 0x00945A98 /end MEASUREMENT
/begin MEASUREMENT speedgoat_test_SN5659_R2021b_DW.RandSeed_h "" ULONG speedgoat_test_SN5659_R2021b_CM_uint32 0 0 0 2147483646 ECU_ADDRESS 0x00945AA0 /end MEASUREMENT
/begin MEASUREMENT speedgoat_test_SN5659_R2021b_DW.RandSeed_k "" ULONG speedgoat_test_SN5659_R2021b_CM_uint32 0 0 0 2147483646 ECU_ADDRESS 0x00945AA4 /end MEASUREMENT
/begin MEASUREMENT speedgoat_test_SN5659_R2021b_DW.RandSeed_m "" ULONG speedgoat_test_SN5659_R2021b_CM_uint32 0 0 0 2147483646 ECU_ADDRESS 0x00945A9C /end MEASUREMENT
/begin MEASUREMENT speedgoat_test_SN5659_R2021b_DW.lastCos_a "" FLOAT64_IEEE speedgoat_test_SN5659_R2021b_CM_double 0 0 -1.7E+308 1.7E+308 ECU_ADDRESS 0x009450F8 /end MEASUREMENT
/begin MEASUREMENT speedgoat_test_SN5659_R2021b_DW.lastCos_h "" FLOAT64_IEEE speedgoat_test_SN5659_R2021b_CM_double 0 0 -1.7E+308 1.7E+308 ECU_ADDRESS 0x009450B0 /end MEASUREMENT
/begin MEASUREMENT speedgoat_test_SN5659_R2021b_DW.lastCos_m "" FLOAT64_IEEE speedgoat_test_SN5659_R2021b_CM_double 0 0 -1.7E+308 1.7E+308 ECU_ADDRESS 0x009450E0 /end MEASUREMENT
/begin MEASUREMENT speedgoat_test_SN5659_R2021b_DW.lastCos_p "" FLOAT64_IEEE speedgoat_test_SN5659_R2021b_CM_double 0 0 -1.7E+308 1.7E+308 ECU_ADDRESS 0x009450C8 /end MEASUREMENT
/begin MEASUREMENT speedgoat_test_SN5659_R2021b_DW.lastSin_cq "" FLOAT64_IEEE speedgoat_test_SN5659_R2021b_CM_double 0 0 -1.7E+308 1.7E+308 ECU_ADDRESS 0x009450C0 /end MEASUREMENT
/begin MEASUREMENT speedgoat_test_SN5659_R2021b_DW.lastSin_ct "" FLOAT64_IEEE speedgoat_test_SN5659_R2021b_CM_double 0 0 -1.7E+308 1.7E+308 ECU_ADDRESS 0x009450F0 /end MEASUREMENT
/begin MEASUREMENT speedgoat_test_SN5659_R2021b_DW.lastSin_m "" FLOAT64_IEEE speedgoat_test_SN5659_R2021b_CM_double 0 0 -1.7E+308 1.7E+308 ECU_ADDRESS 0x009450D8 /end MEASUREMENT
/begin MEASUREMENT speedgoat_test_SN5659_R2021b_DW.lastSin_o "" FLOAT64_IEEE speedgoat_test_SN5659_R2021b_CM_double 0 0 -1.7E+308 1.7E+308 ECU_ADDRESS 0x009450A8 /end MEASUREMENT
/begin MEASUREMENT speedgoat_test_SN5659_R2021b_DW.systemEnable_bt "" SLONG speedgoat_test_SN5659_R2021b_CM_int32 0 0 -2147483648 2147483647 ECU_ADDRESS 0x00945A5C /end MEASUREMENT
/begin MEASUREMENT speedgoat_test_SN5659_R2021b_DW.systemEnable_f "" SLONG speedgoat_test_SN5659_R2021b_CM_int32 0 0 -2147483648 2147483647 ECU_ADDRESS 0x00945A60 /end MEASUREMENT
/begin MEASUREMENT speedgoat_test_SN5659_R2021b_DW.systemEnable_i2 "" SLONG speedgoat_test_SN5659_R2021b_CM_int32 0 0 -2147483648 2147483647 ECU_ADDRESS 0x00945A54 /end MEASUREMENT
/begin MEASUREMENT speedgoat_test_SN5659_R2021b_DW.systemEnable_n "" SLONG speedgoat_test_SN5659_R2021b_CM_int32 0 0 -2147483648 2147483647 ECU_ADDRESS 0x00945A58 /end MEASUREMENT
/begin COMPU_METHOD speedgoat_test_SN5659_R2021b_CM_double "" IDENTICAL "%15.10" "" /end COMPU_METHOD
/begin COMPU_METHOD speedgoat_test_SN5659_R2021b_CM_int32 "" IDENTICAL "%10.0" "" /end COMPU_METHOD
/begin COMPU_METHOD speedgoat_test_SN5659_R2021b_CM_uint16 "" IDENTICAL "%5.0" "" /end COMPU_METHOD
/begin COMPU_METHOD speedgoat_test_SN5659_R2021b_CM_uint32 "" IDENTICAL "%10.0" "" /end COMPU_METHOD
/begin COMPU_METHOD speedgoat_test_SN5659_R2021b_CM_uint8 "" IDENTICAL "%3.0" "" /end COMPU_METHOD
/begin RECORD_LAYOUT Scalar_FLOAT64_IEEE FNC_VALUES 1 FLOAT64_IEEE COLUMN_DIR DIRECT /end RECORD_LAYOUT
/begin RECORD_LAYOUT Scalar_ULONG FNC_VALUES 1 ULONG COLUMN_DIR DIRECT /end RECORD_LAYOUT
/begin RECORD_LAYOUT Scalar_UWORD FNC_VALUES 1 UWORD COLUMN_DIR DIRECT /end RECORD_LAYOUT
/begin GROUP speedgoat_test_SN5659_R2021b_IO682_Decode_Channel_6 "speedgoat_test_SN5659_R2021b/IO682/Decode Channel 6"
 /begin REF_CHARACTERISTIC speedgoat_test_SN5659__cal_impl.Decode1_P10_e1 speedgoat_test_SN5659__cal_impl.Decode1_P11_al speedgoat_test_SN5659__cal_impl.Decode1_P12_kj speedgoat_test_SN5659__cal_impl.Decode1_P13_m speedgoat_test_SN5659__cal_impl.Decode1_P14_a speedgoat_test_SN5659__cal_impl.Decode1_P15_aw speedgoat_test_SN5659__cal_impl.Decode1_P16_eq speedgoat_test_SN5659__cal_impl.Decode1_P1_cw speedgoat_test_SN5659__cal_impl.Decode1_P2_bu speedgoat_test_SN5659__cal_impl.Decode1_P3_a speedgoat_test_SN5659__cal_impl.Decode1_P4_j speedgoat_test_SN5659__cal_impl.Decode1_P5_m3 speedgoat_test_SN5659__cal_impl.Decode1_P6_bi speedgoat_test_SN5659__cal_impl.Decode1_P7_m1 speedgoat_test_SN5659__cal_impl.Decode1_P8_f speedgoat_test_SN5659__cal_impl.Decode1_P9_ie speedgoat_test_SN5659__cal_impl.Decode2_P10_e speedgoat_test_SN5659__cal_impl.Decode2_P11_p speedgoat_test_SN5659__cal_impl.Decode2_P12_id speedgoat_test_SN5659__cal_impl.Decode2_P13_b speedgoat_test_SN5659__cal_impl.Decode2_P14_d speedgoat_test_SN5659__cal_impl.Decode2_P15_b speedgoat_test_SN5659__cal_impl.Decode2_P16_d speedgoat_test_SN5659__cal_impl.Decode2_P1_k speedgoat_test_SN5659__cal_impl.Decode2_P2_kx speedgoat_test_SN5659__cal_impl.Decode2_P3_b5 speedgoat_test_SN5659__cal_impl.Decode2_P4_a speedgoat_test_SN5659__cal_impl.Decode2_P5_jm speedgoat_test_SN5659__cal_impl.Decode2_P6_lx speedgoat_test_SN5659__cal_impl.Decode2_P7_k speedgoat_test_SN5659__cal_impl.Decode2_P8_h4 speedgoat_test_SN5659__cal_impl.Decode2_P9_gq speedgoat_test_SN5659__cal_impl.Decode3_P10_av speedgoat_test_SN5659__cal_impl.Decode3_P11_ku speedgoat_test_SN5659__cal_impl.Decode3_P12_e speedgoat_test_SN5659__cal_impl.Decode3_P13_fu speedgoat_test_SN5659__cal_impl.Decode3_P14_ph speedgoat_test_SN5659__cal_impl.Decode3_P15_hq speedgoat_test_SN5659__cal_impl.Decode3_P16_iz speedgoat_test_SN5659__cal_impl.Decode3_P1_p speedgoat_test_SN5659__cal_impl.Decode3_P2_f speedgoat_test_SN5659__cal_impl.Decode3_P3_d speedgoat_test_SN5659__cal_impl.Decode3_P4_dj speedgoat_test_SN5659__cal_impl.Decode3_P5_j speedgoat_test_SN5659__cal_impl.Decode3_P6_f speedgoat_test_SN5659__cal_impl.Decode3_P7_p speedgoat_test_SN5659__cal_impl.Decode3_P8_f speedgoat_test_SN5659__cal_impl.Decode3_P9_ig speedgoat_test_SN5659__cal_impl.Decode4_P10_l speedgoat_test_SN5659__cal_impl.Decode4_P11_dk speedgoat_test_SN5659__cal_impl.Decode4_P12_i speedgoat_test_SN5659__cal_impl.Decode4_P13_gv speedgoat_test_SN5659__cal_impl.Decode4_P14_m speedgoat_test_SN5659__cal_impl.Decode4_P15_pv speedgoat_test_SN5659__cal_impl.Decode4_P16_ad speedgoat_test_SN5659__cal_impl.Decode4_P1_fa speedgoat_test_SN5659__cal_impl.Decode4_P2_e5 speedgoat_test_SN5659__cal_impl.Decode4_P3_p4 speedgoat_test_SN5659__cal_impl.Decode4_P4_p2 speedgoat_test_SN5659__cal_impl.Decode4_P5_cd speedgoat_test_SN5659__cal_impl.Decode4_P6_fd speedgoat_test_SN5659__cal_impl.Decode4_P7_g2 speedgoat_test_SN5659__cal_impl.Decode4_P8_lu speedgoat_test_SN5659__cal_impl.Decode4_P9_j /end REF_CHARACTERISTIC
 /begin REF_MEASUREMENT speedgoat_test_SN5659_R2021b_B.Decode1_gi speedgoat_test_SN5659_R2021b_B.Decode2_f speedgoat_test_SN5659_R2021b_B.Decode3_o4 speedgoat_test_SN5659_R2021b_B.Decode4_f4 /end REF_MEASUREMENT
/end GROUP
/begin GROUP speedgoat_test_SN5659_R2021b_IO682_Decode_Channel_7 "speedgoat_test_SN5659_R2021b/IO682/Decode Channel 7"
 /begin REF_CHARACTERISTIC speedgoat_test_SN5659__cal_impl.Decode1_P10_g speedgoat_test_SN5659__cal_impl.Decode1_P11_eo speedgoat_test_SN5659__cal_impl.Decode1_P12_m speedgoat_test_SN5659__cal_impl.Decode1_P13_fl speedgoat_test_SN5659__cal_impl.Decode1_P14_f speedgoat_test_SN5659__cal_impl.Decode1_P15_nq speedgoat_test_SN5659__cal_impl.Decode1_P16_ju speedgoat_test_SN5659__cal_impl.Decode1_P1_hw speedgoat_test_SN5659__cal_impl.Decode1_P2_m speedgoat_test_SN5659__cal_impl.Decode1_P3_ci speedgoat_test_SN5659__cal_impl.Decode1_P4_bf speedgoat_test_SN5659__cal_impl.Decode1_P5_kb speedgoat_test_SN5659__cal_impl.Decode1_P6_jf speedgoat_test_SN5659__cal_impl.Decode1_P7_ob speedgoat_test_SN5659__cal_impl.Decode1_P8_a speedgoat_test_SN5659__cal_impl.Decode1_P9_op speedgoat_test_SN5659__cal_impl.Decode2_P10_l speedgoat_test_SN5659__cal_impl.Decode2_P11_h speedgoat_test_SN5659__cal_impl.Decode2_P12_d speedgoat_test_SN5659__cal_impl.Decode2_P13_d speedgoat_test_SN5659__cal_impl.Decode2_P14_k speedgoat_test_SN5659__cal_impl.Decode2_P15_l speedgoat_test_SN5659__cal_impl.Decode2_P16_h speedgoat_test_SN5659__cal_impl.Decode2_P1_b speedgoat_test_SN5659__cal_impl.Decode2_P2_jg speedgoat_test_SN5659__cal_impl.Decode2_P3_m speedgoat_test_SN5659__cal_impl.Decode2_P4_ff speedgoat_test_SN5659__cal_impl.Decode2_P5_h speedgoat_test_SN5659__cal_impl.Decode2_P6_b speedgoat_test_SN5659__cal_impl.Decode2_P7_c speedgoat_test_SN5659__cal_impl.Decode2_P8_k speedgoat_test_SN5659__cal_impl.Decode2_P9_gj speedgoat_test_SN5659__cal_impl.Decode3_P10_lv speedgoat_test_SN5659__cal_impl.Decode3_P11_n speedgoat_test_SN5659__cal_impl.Decode3_P12_pg speedgoat_test_SN5659__cal_impl.Decode3_P13_bw speedgoat_test_SN5659__cal_impl.Decode3_P14_o speedgoat_test_SN5659__cal_impl.Decode3_P15_o speedgoat_test_SN5659__cal_impl.Decode3_P16_c speedgoat_test_SN5659__cal_impl.Decode3_P1_ew speedgoat_test_SN5659__cal_impl.Decode3_P2_ll speedgoat_test_SN5659__cal_impl.Decode3_P3_o speedgoat_test_SN5659__cal_impl.Decode3_P4_av speedgoat_test_SN5659__cal_impl.Decode3_P5_as speedgoat_test_SN5659__cal_impl.Decode3_P6_j speedgoat_test_SN5659__cal_impl.Decode3_P7_fb speedgoat_test_SN5659__cal_impl.Decode3_P8_d speedgoat_test_SN5659__cal_impl.Decode3_P9_f speedgoat_test_SN5659__cal_impl.Decode4_P10_ax speedgoat_test_SN5659__cal_impl.Decode4_P11_mt speedgoat_test_SN5659__cal_impl.Decode4_P12_ik speedgoat_test_SN5659__cal_impl.Decode4_P13_cn speedgoat_test_SN5659__cal_impl.Decode4_P14_fz speedgoat_test_SN5659__cal_impl.Decode4_P15_l speedgoat_test_SN5659__cal_impl.Decode4_P16_du speedgoat_test_SN5659__cal_impl.Decode4_P1_d speedgoat_test_SN5659__cal_impl.Decode4_P2_b speedgoat_test_SN5659__cal_impl.Decode4_P3_mv speedgoat_test_SN5659__cal_impl.Decode4_P4_kx speedgoat_test_SN5659__cal_impl.Decode4_P5_ia speedgoat_test_SN5659__cal_impl.Decode4_P6_an speedgoat_test_SN5659__cal_impl.Decode4_P7_c speedgoat_test_SN5659__cal_impl.Decode4_P8_o speedgoat_test_SN5659__cal_impl.Decode4_P9_c /end REF_CHARACTERISTIC
 /begin REF_MEASUREMENT speedgoat_test_SN5659_R2021b_B.Decode1_p1 speedgoat_test_SN5659_R2021b_B.Decode2_h speedgoat_test_SN5659_R2021b_B.Decode3_lc speedgoat_test_SN5659_R2021b_B.Decode4_l /end REF_MEASUREMENT
/end GROUP
/begin GROUP speedgoat_test_SN5659_R2021b_IO682_Decode_Channel_8 "speedgoat_test_SN5659_R2021b/IO682/Decode Channel 8"
 /begin REF_CHARACTERISTIC speedgoat_test_SN5659__cal_impl.Decode1_P10_m speedgoat_test_SN5659__cal_impl.Decode1_P11_d speedgoat_test_SN5659__cal_impl.Decode1_P12_n speedgoat_test_SN5659__cal_impl.Decode1_P13_cn speedgoat_test_SN5659__cal_impl.Decode1_P14_fq speedgoat_test_SN5659__cal_impl.Decode1_P15_p speedgoat_test_SN5659__cal_impl.Decode1_P16_fi speedgoat_test_SN5659__cal_impl.Decode1_P1_pi speedgoat_test_SN5659__cal_impl.Decode1_P2_mk speedgoat_test_SN5659__cal_impl.Decode1_P3_gr speedgoat_test_SN5659__cal_impl.Decode1_P4_n speedgoat_test_SN5659__cal_impl.Decode1_P5_h speedgoat_test_SN5659__cal_impl.Decode1_P6_e speedgoat_test_SN5659__cal_impl.Decode1_P7_j speedgoat_test_SN5659__cal_impl.Decode1_P8_a1 speedgoat_test_SN5659__cal_impl.Decode1_P9_dz speedgoat_test_SN5659__cal_impl.Decode2_P10_cg speedgoat_test_SN5659__cal_impl.Decode2_P11_kl speedgoat_test_SN5659__cal_impl.Decode2_P12_m speedgoat_test_SN5659__cal_impl.Decode2_P13_bk speedgoat_test_SN5659__cal_impl.Decode2_P14_kg speedgoat_test_SN5659__cal_impl.Decode2_P15_gh speedgoat_test_SN5659__cal_impl.Decode2_P16_a speedgoat_test_SN5659__cal_impl.Decode2_P1_i0 speedgoat_test_SN5659__cal_impl.Decode2_P2_mg speedgoat_test_SN5659__cal_impl.Decode2_P3_p speedgoat_test_SN5659__cal_impl.Decode2_P4_bb speedgoat_test_SN5659__cal_impl.Decode2_P5_ju speedgoat_test_SN5659__cal_impl.Decode2_P6_hg speedgoat_test_SN5659__cal_impl.Decode2_P7_ht speedgoat_test_SN5659__cal_impl.Decode2_P8_fr speedgoat_test_SN5659__cal_impl.Decode2_P9_m speedgoat_test_SN5659__cal_impl.Decode3_P10_g speedgoat_test_SN5659__cal_impl.Decode3_P11_o speedgoat_test_SN5659__cal_impl.Decode3_P12_ak speedgoat_test_SN5659__cal_impl.Decode3_P13_e1 speedgoat_test_SN5659__cal_impl.Decode3_P14_od speedgoat_test_SN5659__cal_impl.Decode3_P15_i speedgoat_test_SN5659__cal_impl.Decode3_P16_m speedgoat_test_SN5659__cal_impl.Decode3_P1_nz speedgoat_test_SN5659__cal_impl.Decode3_P2_n speedgoat_test_SN5659__cal_impl.Decode3_P3_a speedgoat_test_SN5659__cal_impl.Decode3_P4_c speedgoat_test_SN5659__cal_impl.Decode3_P5_gt speedgoat_test_SN5659__cal_impl.Decode3_P6_ov speedgoat_test_SN5659__cal_impl.Decode3_P7_ix speedgoat_test_SN5659__cal_impl.Decode3_P8_n speedgoat_test_SN5659__cal_impl.Decode3_P9_p speedgoat_test_SN5659__cal_impl.Decode4_P10_k speedgoat_test_SN5659__cal_impl.Decode4_P11_mg speedgoat_test_SN5659__cal_impl.Decode4_P12_ci speedgoat_test_SN5659__cal_impl.Decode4_P13_l speedgoat_test_SN5659__cal_impl.Decode4_P14_b speedgoat_test_SN5659__cal_impl.Decode4_P15_h speedgoat_test_SN5659__cal_impl.Decode4_P16_n speedgoat_test_SN5659__cal_impl.Decode4_P1_ml speedgoat_test_SN5659__cal_impl.Decode4_P2_l1 speedgoat_test_SN5659__cal_impl.Decode4_P3_i speedgoat_test_SN5659__cal_impl.Decode4_P4_f1 speedgoat_test_SN5659__cal_impl.Decode4_P5_h speedgoat_test_SN5659__cal_impl.Decode4_P6_g speedgoat_test_SN5659__cal_impl.Decode4_P7_j speedgoat_test_SN5659__cal_impl.Decode4_P8_mv speedgoat_test_SN5659__cal_impl.Decode4_P9_g /end REF_CHARACTERISTIC
 /begin REF_MEASUREMENT speedgoat_test_SN5659_R2021b_B.Decode1_b speedgoat_test_SN5659_R2021b_B.Decode2_nz speedgoat_test_SN5659_R2021b_B.Decode3_mj speedgoat_test_SN5659_R2021b_B.Decode4_m /end REF_MEASUREMENT
/end GROUP
/begin GROUP speedgoat_test_SN5659_R2021b_IO682_Decode_Channel_9 "speedgoat_test_SN5659_R2021b/IO682/Decode Channel 9"
 /begin REF_CHARACTERISTIC speedgoat_test_SN5659__cal_impl.Decode1_P10_l speedgoat_test_SN5659__cal_impl.Decode1_P11_eu speedgoat_test_SN5659__cal_impl.Decode1_P12_pl speedgoat_test_SN5659__cal_impl.Decode1_P13_f speedgoat_test_SN5659__cal_impl.Decode1_P14_m speedgoat_test_SN5659__cal_impl.Decode1_P15_b speedgoat_test_SN5659__cal_impl.Decode1_P16_b speedgoat_test_SN5659__cal_impl.Decode1_P1_c2 speedgoat_test_SN5659__cal_impl.Decode1_P2_b speedgoat_test_SN5659__cal_impl.Decode1_P3_g speedgoat_test_SN5659__cal_impl.Decode1_P4_e speedgoat_test_SN5659__cal_impl.Decode1_P5_n speedgoat_test_SN5659__cal_impl.Decode1_P6_j speedgoat_test_SN5659__cal_impl.Decode1_P7_k speedgoat_test_SN5659__cal_impl.Decode1_P8_l speedgoat_test_SN5659__cal_impl.Decode1_P9_k speedgoat_test_SN5659__cal_impl.Decode3_P10_k speedgoat_test_SN5659__cal_impl.Decode3_P11_e speedgoat_test_SN5659__cal_impl.Decode3_P12_i speedgoat_test_SN5659__cal_impl.Decode3_P13_j speedgoat_test_SN5659__cal_impl.Decode3_P14_p speedgoat_test_SN5659__cal_impl.Decode3_P15_m speedgoat_test_SN5659__cal_impl.Decode3_P16_n speedgoat_test_SN5659__cal_impl.Decode3_P1_c speedgoat_test_SN5659__cal_impl.Decode3_P2_j speedgoat_test_SN5659__cal_impl.Decode3_P3_j speedgoat_test_SN5659__cal_impl.Decode3_P4_p speedgoat_test_SN5659__cal_impl.Decode3_P5_b speedgoat_test_SN5659__cal_impl.Decode3_P6_h speedgoat_test_SN5659__cal_impl.Decode3_P7_d speedgoat_test_SN5659__cal_impl.Decode3_P8_h speedgoat_test_SN5659__cal_impl.Decode3_P9_i speedgoat_test_SN5659__cal_impl.Decode4_P10_d speedgoat_test_SN5659__cal_impl.Decode4_P11_g speedgoat_test_SN5659__cal_impl.Decode4_P12_e speedgoat_test_SN5659__cal_impl.Decode4_P13_o speedgoat_test_SN5659__cal_impl.Decode4_P14_k speedgoat_test_SN5659__cal_impl.Decode4_P15_j speedgoat_test_SN5659__cal_impl.Decode4_P16_b speedgoat_test_SN5659__cal_impl.Decode4_P1_i speedgoat_test_SN5659__cal_impl.Decode4_P2_k speedgoat_test_SN5659__cal_impl.Decode4_P3_l speedgoat_test_SN5659__cal_impl.Decode4_P4_k speedgoat_test_SN5659__cal_impl.Decode4_P5_i speedgoat_test_SN5659__cal_impl.Decode4_P6_n speedgoat_test_SN5659__cal_impl.Decode4_P7_n speedgoat_test_SN5659__cal_impl.Decode4_P8_g speedgoat_test_SN5659__cal_impl.Decode4_P9_e speedgoat_test_SN5659__cal_impl.Decode5_P10_m speedgoat_test_SN5659__cal_impl.Decode5_P11_g speedgoat_test_SN5659__cal_impl.Decode5_P12_m speedgoat_test_SN5659__cal_impl.Decode5_P13_c speedgoat_test_SN5659__cal_impl.Decode5_P14_c speedgoat_test_SN5659__cal_impl.Decode5_P15_j speedgoat_test_SN5659__cal_impl.Decode5_P16_a speedgoat_test_SN5659__cal_impl.Decode5_P1_n speedgoat_test_SN5659__cal_impl.Decode5_P2_m speedgoat_test_SN5659__cal_impl.Decode5_P3_i speedgoat_test_SN5659__cal_impl.Decode5_P4_f speedgoat_test_SN5659__cal_impl.Decode5_P5_m speedgoat_test_SN5659__cal_impl.Decode5_P6_m speedgoat_test_SN5659__cal_impl.Decode5_P7_n speedgoat_test_SN5659__cal_impl.Decode5_P8_b speedgoat_test_SN5659__cal_impl.Decode5_P9_n /end REF_CHARACTERISTIC
 /begin REF_MEASUREMENT speedgoat_test_SN5659_R2021b_B.Decode1_d speedgoat_test_SN5659_R2021b_B.Decode3_c speedgoat_test_SN5659_R2021b_B.Decode4_o speedgoat_test_SN5659_R2021b_B.Decode5_p /end REF_MEASUREMENT
/end GROUP
/begin GROUP speedgoat_test_SN5659_R2021b_IO682_Encode_Channel_1 "speedgoat_test_SN5659_R2021b/IO682/Encode Channel 1"
 /begin SUB_GROUP speedgoat_test_SN5659_R2021b_IO682_Encode_Channel_1_Counter_Limited speedgoat_test_SN5659_R2021b_IO682_Encode_Channel_1_Prepare_RAW_value /end SUB_GROUP
 /begin REF_CHARACTERISTIC speedgoat_test_SN5659__cal_impl.Constant_Value speedgoat_test_SN5659__cal_impl.Encode1_P1 speedgoat_test_SN5659__cal_impl.Encode1_P10 speedgoat_test_SN5659__cal_impl.Encode1_P11 speedgoat_test_SN5659__cal_impl.Encode1_P12 speedgoat_test_SN5659__cal_impl.Encode1_P13 speedgoat_test_SN5659__cal_impl.Encode1_P14 speedgoat_test_SN5659__cal_impl.Encode1_P15 speedgoat_test_SN5659__cal_impl.Encode1_P2 speedgoat_test_SN5659__cal_impl.Encode1_P3 speedgoat_test_SN5659__cal_impl.Encode1_P4 speedgoat_test_SN5659__cal_impl.Encode1_P5 speedgoat_test_SN5659__cal_impl.Encode1_P6 speedgoat_test_SN5659__cal_impl.Encode1_P7 speedgoat_test_SN5659__cal_impl.Encode1_P8 speedgoat_test_SN5659__cal_impl.Encode1_P9 speedgoat_test_SN5659__cal_impl.Encode2_P1 speedgoat_test_SN5659__cal_impl.Encode2_P10 speedgoat_test_SN5659__cal_impl.Encode2_P11 speedgoat_test_SN5659__cal_impl.Encode2_P12 speedgoat_test_SN5659__cal_impl.Encode2_P13 speedgoat_test_SN5659__cal_impl.Encode2_P14 speedgoat_test_SN5659__cal_impl.Encode2_P15 speedgoat_test_SN5659__cal_impl.Encode2_P2 speedgoat_test_SN5659__cal_impl.Encode2_P3 speedgoat_test_SN5659__cal_impl.Encode2_P4 speedgoat_test_SN5659__cal_impl.Encode2_P5 speedgoat_test_SN5659__cal_impl.Encode2_P6 speedgoat_test_SN5659__cal_impl.Encode2_P7 speedgoat_test_SN5659__cal_impl.Encode2_P8 speedgoat_test_SN5659__cal_impl.Encode2_P9 speedgoat_test_SN5659__cal_impl.Encode3_P1 speedgoat_test_SN5659__cal_impl.Encode3_P10 speedgoat_test_SN5659__cal_impl.Encode3_P11 speedgoat_test_SN5659__cal_impl.Encode3_P12 speedgoat_test_SN5659__cal_impl.Encode3_P13 speedgoat_test_SN5659__cal_impl.Encode3_P14 speedgoat_test_SN5659__cal_impl.Encode3_P15 speedgoat_test_SN5659__cal_impl.Encode3_P2 speedgoat_test_SN5659__cal_impl.Encode3_P3 speedgoat_test_SN5659__cal_impl.Encode3_P4 speedgoat_test_SN5659__cal_impl.Encode3_P5 speedgoat_test_SN5659__cal_impl.Encode3_P6 speedgoat_test_SN5659__cal_impl.Encode3_P7 speedgoat_test_SN5659__cal_impl.Encode3_P8 speedgoat_test_SN5659__cal_impl.Encode3_P9 speedgoat_test_SN5659__cal_impl.Encode5_P1 speedgoat_test_SN5659__cal_impl.Encode5_P10 speedgoat_test_SN5659__cal_impl.Encode5_P11 speedgoat_test_SN5659__cal_impl.Encode5_P12 speedgoat_test_SN5659__cal_impl.Encode5_P13 speedgoat_test_SN5659__cal_impl.Encode5_P14 speedgoat_test_SN5659__cal_impl.Encode5_P15 speedgoat_test_SN5659__cal_impl.Encode5_P2 speedgoat_test_SN5659__cal_impl.Encode5_P3 speedgoat_test_SN5659__cal_impl.Encode5_P4 speedgoat_test_SN5659__cal_impl.Encode5_P5 speedgoat_test_SN5659__cal_impl.Encode5_P6 speedgoat_test_SN5659__cal_impl.Encode5_P7 speedgoat_test_SN5659__cal_impl.Encode5_P8 speedgoat_test_SN5659__cal_impl.Encode5_P9 speedgoat_test_SN5659__cal_impl.Randomnumber_Mean speedgoat_test_SN5659__cal_impl.Randomnumber_Seed speedgoat_test_SN5659__cal_impl.Randomnumber_StdDev speedgoat_test_SN5659__cal_impl.Sinewave_Amp speedgoat_test_SN5659__cal_impl.Sinewave_Bias speedgoat_test_SN5659__cal_impl.Sinewave_Freq speedgoat_test_SN5659__cal_impl.Sinewave_HCos speedgoat_test_SN5659__cal_impl.Sinewave_Hsin speedgoat_test_SN5659__cal_impl.Sinewave_PCos speedgoat_test_SN5659__cal_impl.Sinewave_PSin /end REF_CHARACTERISTIC
 /begin REF_MEASUREMENT speedgoat_test_SN5659_R2021b_B.DataTypeConversion speedgoat_test_SN5659_R2021b_B.DataTypeConversion1 speedgoat_test_SN5659_R2021b_B.Encode1 speedgoat_test_SN5659_R2021b_B.Encode2 speedgoat_test_SN5659_R2021b_B.Encode3 speedgoat_test_SN5659_R2021b_B.Encode5 speedgoat_test_SN5659_R2021b_B.Output_o speedgoat_test_SN5659_R2021b_B.Randomnumber speedgoat_test_SN5659_R2021b_B.Sinewave speedgoat_test_SN5659_R2021b_DW.NextOutput speedgoat_test_SN5659_R2021b_DW.RandSeed speedgoat_test_SN5659_R2021b_DW.lastCos_h speedgoat_test_SN5659_R2021b_DW.lastSin_o speedgoat_test_SN5659_R2021b_DW.systemEnable_i2 /end REF_MEASUREMENT
/end GROUP
/begin GROUP speedgoat_test_SN5659_R2021b_IO682_Encode_Channel_10 "speedgoat_test_SN5659_R2021b/IO682/Encode Channel 10"
 /begin SUB_GROUP speedgoat_test_SN5659_R2021b_IO682_Encode_Channel_10_Counter_Limited speedgoat_test_SN5659_R2021b_IO682_Encode_Channel_10_Prepare_RAW_value /end SUB_GROUP
 /begin REF_CHARACTERISTIC speedgoat_test_SN5659__cal_impl.Constant_Value_j speedgoat_test_SN5659__cal_impl.Encode1_P10_a speedgoat_test_SN5659__cal_impl.Encode1_P11_g speedgoat_test_SN5659__cal_impl.Encode1_P12_n speedgoat_test_SN5659__cal_impl.Encode1_P13_j speedgoat_test_SN5659__cal_impl.Encode1_P14_h speedgoat_test_SN5659__cal_impl.Encode1_P15_h speedgoat_test_SN5659__cal_impl.Encode1_P1_a speedgoat_test_SN5659__cal_impl.Encode1_P2_h speedgoat_test_SN5659__cal_impl.Encode1_P3_o speedgoat_test_SN5659__cal_impl.Encode1_P4_d speedgoat_test_SN5659__cal_impl.Encode1_P5_o speedgoat_test_SN5659__cal_impl.Encode1_P6_n speedgoat_test_SN5659__cal_impl.Encode1_P7_g speedgoat_test_SN5659__cal_impl.Encode1_P8_p speedgoat_test_SN5659__cal_impl.Encode1_P9_m speedgoat_test_SN5659__cal_impl.Encode2_P10_n speedgoat_test_SN5659__cal_impl.Encode2_P11_j speedgoat_test_SN5659__cal_impl.Encode2_P12_b speedgoat_test_SN5659__cal_impl.Encode2_P13_j speedgoat_test_SN5659__cal_impl.Encode2_P14_c speedgoat_test_SN5659__cal_impl.Encode2_P15_j speedgoat_test_SN5659__cal_impl.Encode2_P1_h speedgoat_test_SN5659__cal_impl.Encode2_P2_m speedgoat_test_SN5659__cal_impl.Encode2_P3_o speedgoat_test_SN5659__cal_impl.Encode2_P4_g speedgoat_test_SN5659__cal_impl.Encode2_P5_g speedgoat_test_SN5659__cal_impl.Encode2_P6_j speedgoat_test_SN5659__cal_impl.Encode2_P7_d speedgoat_test_SN5659__cal_impl.Encode2_P8_f speedgoat_test_SN5659__cal_impl.Encode2_P9_p speedgoat_test_SN5659__cal_impl.Encode3_P10_n speedgoat_test_SN5659__cal_impl.Encode3_P11_l speedgoat_test_SN5659__cal_impl.Encode3_P12_e speedgoat_test_SN5659__cal_impl.Encode3_P13_o speedgoat_test_SN5659__cal_impl.Encode3_P14_e speedgoat_test_SN5659__cal_impl.Encode3_P15_p speedgoat_test_SN5659__cal_impl.Encode3_P1_l speedgoat_test_SN5659__cal_impl.Encode3_P2_j speedgoat_test_SN5659__cal_impl.Encode3_P3_n speedgoat_test_SN5659__cal_impl.Encode3_P4_g speedgoat_test_SN5659__cal_impl.Encode3_P5_k speedgoat_test_SN5659__cal_impl.Encode3_P6_h speedgoat_test_SN5659__cal_impl.Encode3_P7_b speedgoat_test_SN5659__cal_impl.Encode3_P8_e speedgoat_test_SN5659__cal_impl.Encode3_P9_g speedgoat_test_SN5659__cal_impl.Encode4_P1 speedgoat_test_SN5659__cal_impl.Encode4_P10 speedgoat_test_SN5659__cal_impl.Encode4_P11 speedgoat_test_SN5659__cal_impl.Encode4_P12 speedgoat_test_SN5659__cal_impl.Encode4_P13 speedgoat_test_SN5659__cal_impl.Encode4_P14 speedgoat_test_SN5659__cal_impl.Encode4_P15 speedgoat_test_SN5659__cal_impl.Encode4_P2 speedgoat_test_SN5659__cal_impl.Encode4_P3 speedgoat_test_SN5659__cal_impl.Encode4_P4 speedgoat_test_SN5659__cal_impl.Encode4_P5 speedgoat_test_SN5659__cal_impl.Encode4_P6 speedgoat_test_SN5659__cal_impl.Encode4_P7 speedgoat_test_SN5659__cal_impl.Encode4_P8 speedgoat_test_SN5659__cal_impl.Encode4_P9 speedgoat_test_SN5659__cal_impl.Randomnumber_Mean_f speedgoat_test_SN5659__cal_impl.Randomnumber_Seed_n speedgoat_test_SN5659__cal_impl.Randomnumber_StdDev_a speedgoat_test_SN5659__cal_impl.Sinewave_Amp_o speedgoat_test_SN5659__cal_impl.Sinewave_Bias_k speedgoat_test_SN5659__cal_impl.Sinewave_Freq_p speedgoat_test_SN5659__cal_impl.Sinewave_HCos_l speedgoat_test_SN5659__cal_impl.Sinewave_Hsin_j speedgoat_test_SN5659__cal_impl.Sinewave_PCos_c speedgoat_test_SN5659__cal_impl.Sinewave_PSin_p /end REF_CHARACTERISTIC
 /begin REF_MEASUREMENT speedgoat_test_SN5659_R2021b_B.DataTypeConversion1_g speedgoat_test_SN5659_R2021b_B.DataTypeConversion_h speedgoat_test_SN5659_R2021b_B.Encode1_b speedgoat_test_SN5659_R2021b_B.Encode2_p speedgoat_test_SN5659_R2021b_B.Encode3_i speedgoat_test_SN5659_R2021b_B.Encode4 speedgoat_test_SN5659_R2021b_B.Output speedgoat_test_SN5659_R2021b_B.Randomnumber_c speedgoat_test_SN5659_R2021b_B.Sinewave_o speedgoat_test_SN5659_R2021b_DW.NextOutput_a speedgoat_test_SN5659_R2021b_DW.RandSeed_m speedgoat_test_SN5659_R2021b_DW.lastCos_p speedgoat_test_SN5659_R2021b_DW.lastSin_cq speedgoat_test_SN5659_R2021b_DW.systemEnable_n /end REF_MEASUREMENT
/end GROUP
/begin GROUP speedgoat_test_SN5659_R2021b_IO682_Encode_Channel_10_Counter_Limited "speedgoat_test_SN5659_R2021b/IO682/Encode Channel 10/Counter
Limited"
 /begin SUB_GROUP speedgoat_test_SN5659_R2021b_IO682_Encode_Channel_10_Counter_Limited_Increment_Real_World speedgoat_test_SN5659_R2021b_IO682_Encode_Channel_10_Counter_Limited_Wrap_To_Zero /end SUB_GROUP
 /begin REF_CHARACTERISTIC speedgoat_test_SN5659__cal_impl.Output_InitialCondition /end REF_CHARACTERISTIC
 /begin REF_MEASUREMENT speedgoat_test_SN5659_R2021b_B.FixPtSwitch speedgoat_test_SN5659_R2021b_B.Output speedgoat_test_SN5659_R2021b_DW.Output_DSTATE /end REF_MEASUREMENT
/end GROUP
/begin GROUP speedgoat_test_SN5659_R2021b_IO682_Encode_Channel_10_Counter_Limited_Increment_Real_World "speedgoat_test_SN5659_R2021b/IO682/Encode Channel 10/Counter
Limited/Increment
Real World" /begin REF_CHARACTERISTIC speedgoat_test_SN5659__cal_impl.FixPtConstant_Value /end REF_CHARACTERISTIC
 /begin REF_MEASUREMENT speedgoat_test_SN5659_R2021b_B.FixPtSum1 speedgoat_test_SN5659_R2021b_B.Output /end REF_MEASUREMENT
/end GROUP
/begin GROUP speedgoat_test_SN5659_R2021b_IO682_Encode_Channel_10_Counter_Limited_Wrap_To_Zero "speedgoat_test_SN5659_R2021b/IO682/Encode Channel 10/Counter
Limited/Wrap To Zero"
 /begin REF_CHARACTERISTIC speedgoat_test_SN5659__cal_impl.Constant_Value_c speedgoat_test_SN5659__cal_impl.CounterLimited_uplimit /end REF_CHARACTERISTIC
 /begin REF_MEASUREMENT speedgoat_test_SN5659_R2021b_B.FixPtSum1 speedgoat_test_SN5659_R2021b_B.FixPtSwitch /end REF_MEASUREMENT
/end GROUP
/begin GROUP speedgoat_test_SN5659_R2021b_IO682_Encode_Channel_10_Prepare_RAW_value "speedgoat_test_SN5659_R2021b/IO682/Encode Channel 10/Prepare RAW value"
 /begin REF_CHARACTERISTIC speedgoat_test_SN5659__cal_impl.Label_Value_d speedgoat_test_SN5659__cal_impl.Mask_BitMask_h speedgoat_test_SN5659__cal_impl.SDI_Value_d speedgoat_test_SN5659__cal_impl.SSM_Value_o speedgoat_test_SN5659__cal_impl.Scale_Value_l speedgoat_test_SN5659__cal_impl.shiftthedoublevalue27bitsleft_o /end REF_CHARACTERISTIC
 /begin REF_MEASUREMENT speedgoat_test_SN5659_R2021b_B.BitwiseOperator_m speedgoat_test_SN5659_R2021b_B.DataTypeConversion1_g speedgoat_test_SN5659_R2021b_B.DataTypeConversion_c speedgoat_test_SN5659_R2021b_B.Divide_k speedgoat_test_SN5659_R2021b_B.Mask_a speedgoat_test_SN5659_R2021b_B.Multiply_h speedgoat_test_SN5659_R2021b_B.ShifttoSDIslot_l speedgoat_test_SN5659_R2021b_B.ShifttoSSMslot_h /end REF_MEASUREMENT
/end GROUP
/begin GROUP speedgoat_test_SN5659_R2021b_IO682_Encode_Channel_11 "speedgoat_test_SN5659_R2021b/IO682/Encode Channel 11"
 /begin SUB_GROUP speedgoat_test_SN5659_R2021b_IO682_Encode_Channel_11_Counter_Limited speedgoat_test_SN5659_R2021b_IO682_Encode_Channel_11_Prepare_RAW_value /end SUB_GROUP
 /begin REF_CHARACTERISTIC speedgoat_test_SN5659__cal_impl.Constant_Value_i speedgoat_test_SN5659__cal_impl.Encode1_P10_i speedgoat_test_SN5659__cal_impl.Encode1_P11_l speedgoat_test_SN5659__cal_impl.Encode1_P12_k speedgoat_test_SN5659__cal_impl.Encode1_P13_i speedgoat_test_SN5659__cal_impl.Encode1_P14_o speedgoat_test_SN5659__cal_impl.Encode1_P15_b speedgoat_test_SN5659__cal_impl.Encode1_P1_c speedgoat_test_SN5659__cal_impl.Encode1_P2_g speedgoat_test_SN5659__cal_impl.Encode1_P3_l speedgoat_test_SN5659__cal_impl.Encode1_P4_e speedgoat_test_SN5659__cal_impl.Encode1_P5_i speedgoat_test_SN5659__cal_impl.Encode1_P6_p speedgoat_test_SN5659__cal_impl.Encode1_P7_d speedgoat_test_SN5659__cal_impl.Encode1_P8_c speedgoat_test_SN5659__cal_impl.Encode1_P9_n speedgoat_test_SN5659__cal_impl.Encode2_P10_c speedgoat_test_SN5659__cal_impl.Encode2_P11_g speedgoat_test_SN5659__cal_impl.Encode2_P12_m speedgoat_test_SN5659__cal_impl.Encode2_P13_p speedgoat_test_SN5659__cal_impl.Encode2_P14_p speedgoat_test_SN5659__cal_impl.Encode2_P15_c speedgoat_test_SN5659__cal_impl.Encode2_P1_a speedgoat_test_SN5659__cal_impl.Encode2_P2_i speedgoat_test_SN5659__cal_impl.Encode2_P3_k speedgoat_test_SN5659__cal_impl.Encode2_P4_o speedgoat_test_SN5659__cal_impl.Encode2_P5_l speedgoat_test_SN5659__cal_impl.Encode2_P6_n speedgoat_test_SN5659__cal_impl.Encode2_P7_b speedgoat_test_SN5659__cal_impl.Encode2_P8_h speedgoat_test_SN5659__cal_impl.Encode2_P9_m speedgoat_test_SN5659__cal_impl.Encode3_P10_j speedgoat_test_SN5659__cal_impl.Encode3_P11_j speedgoat_test_SN5659__cal_impl.Encode3_P12_j speedgoat_test_SN5659__cal_impl.Encode3_P13_i speedgoat_test_SN5659__cal_impl.Encode3_P14_d speedgoat_test_SN5659__cal_impl.Encode3_P15_h speedgoat_test_SN5659__cal_impl.Encode3_P1_e speedgoat_test_SN5659__cal_impl.Encode3_P2_f speedgoat_test_SN5659__cal_impl.Encode3_P3_b speedgoat_test_SN5659__cal_impl.Encode3_P4_d speedgoat_test_SN5659__cal_impl.Encode3_P5_i speedgoat_test_SN5659__cal_impl.Encode3_P6_e speedgoat_test_SN5659__cal_impl.Encode3_P7_h speedgoat_test_SN5659__cal_impl.Encode3_P8_f speedgoat_test_SN5659__cal_impl.Encode3_P9_k speedgoat_test_SN5659__cal_impl.Encode4_P10_h speedgoat_test_SN5659__cal_impl.Encode4_P11_j speedgoat_test_SN5659__cal_impl.Encode4_P12_l speedgoat_test_SN5659__cal_impl.Encode4_P13_a speedgoat_test_SN5659__cal_impl.Encode4_P14_l speedgoat_test_SN5659__cal_impl.Encode4_P15_i speedgoat_test_SN5659__cal_impl.Encode4_P1_e speedgoat_test_SN5659__cal_impl.Encode4_P2_d speedgoat_test_SN5659__cal_impl.Encode4_P3_o speedgoat_test_SN5659__cal_impl.Encode4_P4_a speedgoat_test_SN5659__cal_impl.Encode4_P5_a speedgoat_test_SN5659__cal_impl.Encode4_P6_a speedgoat_test_SN5659__cal_impl.Encode4_P7_p speedgoat_test_SN5659__cal_impl.Encode4_P8_o speedgoat_test_SN5659__cal_impl.Encode4_P9_i speedgoat_test_SN5659__cal_impl.Randomnumber_Mean_k speedgoat_test_SN5659__cal_impl.Randomnumber_Seed_h speedgoat_test_SN5659__cal_impl.Randomnumber_StdDev_l speedgoat_test_SN5659__cal_impl.Sinewave_Amp_i speedgoat_test_SN5659__cal_impl.Sinewave_Bias_c speedgoat_test_SN5659__cal_impl.Sinewave_Freq_g speedgoat_test_SN5659__cal_impl.Sinewave_HCos_j speedgoat_test_SN5659__cal_impl.Sinewave_Hsin_n speedgoat_test_SN5659__cal_impl.Sinewave_PCos_j speedgoat_test_SN5659__cal_impl.Sinewave_PSin_h /end REF_CHARACTERISTIC
 /begin REF_MEASUREMENT speedgoat_test_SN5659_R2021b_B.DataTypeConversion1_i speedgoat_test_SN5659_R2021b_B.DataTypeConversion_e speedgoat_test_SN5659_R2021b_B.Encode1_f speedgoat_test_SN5659_R2021b_B.Encode2_f speedgoat_test_SN5659_R2021b_B.Encode3_b speedgoat_test_SN5659_R2021b_B.Encode4_i speedgoat_test_SN5659_R2021b_B.Output_b speedgoat_test_SN5659_R2021b_B.Randomnumber_p speedgoat_test_SN5659_R2021b_B.Sinewave_f speedgoat_test_SN5659_R2021b_DW.NextOutput_n speedgoat_test_SN5659_R2021b_DW.RandSeed_h speedgoat_test_SN5659_R2021b_DW.lastCos_m speedgoat_test_SN5659_R2021b_DW.lastSin_m speedgoat_test_SN5659_R2021b_DW.systemEnable_bt /end REF_MEASUREMENT
/end GROUP
/begin GROUP speedgoat_test_SN5659_R2021b_IO682_Encode_Channel_11_Counter_Limited "speedgoat_test_SN5659_R2021b/IO682/Encode Channel 11/Counter
Limited"
 /begin SUB_GROUP speedgoat_test_SN5659_R2021b_IO682_Encode_Channel_11_Counter_Limited_Increment_Real_World speedgoat_test_SN5659_R2021b_IO682_Encode_Channel_11_Counter_Limited_Wrap_To_Zero /end SUB_GROUP
 /begin REF_CHARACTERISTIC speedgoat_test_SN5659__cal_impl.Output_InitialCondition_n /end REF_CHARACTERISTIC
 /begin REF_MEASUREMENT speedgoat_test_SN5659_R2021b_B.FixPtSwitch_h speedgoat_test_SN5659_R2021b_B.Output_b speedgoat_test_SN5659_R2021b_DW.Output_DSTATE_o /end REF_MEASUREMENT
/end GROUP
/begin GROUP speedgoat_test_SN5659_R2021b_IO682_Encode_Channel_11_Counter_Limited_Increment_Real_World "speedgoat_test_SN5659_R2021b/IO682/Encode Channel 11/Counter
Limited/Increment
Real World" /begin REF_CHARACTERISTIC speedgoat_test_SN5659__cal_impl.FixPtConstant_Value_a /end REF_CHARACTERISTIC
 /begin REF_MEASUREMENT speedgoat_test_SN5659_R2021b_B.FixPtSum1_n speedgoat_test_SN5659_R2021b_B.Output_b /end REF_MEASUREMENT
/end GROUP
/begin GROUP speedgoat_test_SN5659_R2021b_IO682_Encode_Channel_11_Counter_Limited_Wrap_To_Zero "speedgoat_test_SN5659_R2021b/IO682/Encode Channel 11/Counter
Limited/Wrap To Zero"
 /begin REF_CHARACTERISTIC speedgoat_test_SN5659__cal_impl.Constant_Value_dm speedgoat_test_SN5659__cal_impl.CounterLimited_uplimit_d /end REF_CHARACTERISTIC
 /begin REF_MEASUREMENT speedgoat_test_SN5659_R2021b_B.FixPtSum1_n speedgoat_test_SN5659_R2021b_B.FixPtSwitch_h /end REF_MEASUREMENT
/end GROUP
/begin GROUP speedgoat_test_SN5659_R2021b_IO682_Encode_Channel_11_Prepare_RAW_value "speedgoat_test_SN5659_R2021b/IO682/Encode Channel 11/Prepare RAW value"
 /begin REF_CHARACTERISTIC speedgoat_test_SN5659__cal_impl.Label_Value_e speedgoat_test_SN5659__cal_impl.Mask_BitMask_k speedgoat_test_SN5659__cal_impl.SDI_Value_m speedgoat_test_SN5659__cal_impl.SSM_Value_l speedgoat_test_SN5659__cal_impl.Scale_Value_a speedgoat_test_SN5659__cal_impl.shiftthedoublevalue27bitsleft_p /end REF_CHARACTERISTIC
 /begin REF_MEASUREMENT speedgoat_test_SN5659_R2021b_B.BitwiseOperator_a speedgoat_test_SN5659_R2021b_B.DataTypeConversion1_i speedgoat_test_SN5659_R2021b_B.DataTypeConversion_ec speedgoat_test_SN5659_R2021b_B.Divide_h speedgoat_test_SN5659_R2021b_B.Mask_n speedgoat_test_SN5659_R2021b_B.Multiply_a speedgoat_test_SN5659_R2021b_B.ShifttoSDIslot_a speedgoat_test_SN5659_R2021b_B.ShifttoSSMslot_m /end REF_MEASUREMENT
/end GROUP
/begin GROUP speedgoat_test_SN5659_R2021b_IO682_Encode_Channel_12 "speedgoat_test_SN5659_R2021b/IO682/Encode Channel 12"
 /begin SUB_GROUP speedgoat_test_SN5659_R2021b_IO682_Encode_Channel_12_Counter_Limited speedgoat_test_SN5659_R2021b_IO682_Encode_Channel_12_Prepare_RAW_value /end SUB_GROUP
 /begin REF_CHARACTERISTIC speedgoat_test_SN5659__cal_impl.Constant_Value_e speedgoat_test_SN5659__cal_impl.Encode1_P10_p speedgoat_test_SN5659__cal_impl.Encode1_P11_b speedgoat_test_SN5659__cal_impl.Encode1_P12_no speedgoat_test_SN5659__cal_impl.Encode1_P13_it speedgoat_test_SN5659__cal_impl.Encode1_P14_ho speedgoat_test_SN5659__cal_impl.Encode1_P15_k speedgoat_test_SN5659__cal_impl.Encode1_P1_i speedgoat_test_SN5659__cal_impl.Encode1_P2_l speedgoat_test_SN5659__cal_impl.Encode1_P3_b speedgoat_test_SN5659__cal_impl.Encode1_P4_a speedgoat_test_SN5659__cal_impl.Encode1_P5_j speedgoat_test_SN5659__cal_impl.Encode1_P6_e speedgoat_test_SN5659__cal_impl.Encode1_P7_db speedgoat_test_SN5659__cal_impl.Encode1_P8_b speedgoat_test_SN5659__cal_impl.Encode1_P9_md speedgoat_test_SN5659__cal_impl.Encode2_P10_i speedgoat_test_SN5659__cal_impl.Encode2_P11_h speedgoat_test_SN5659__cal_impl.Encode2_P12_k speedgoat_test_SN5659__cal_impl.Encode2_P13_f speedgoat_test_SN5659__cal_impl.Encode2_P14_f speedgoat_test_SN5659__cal_impl.Encode2_P15_o speedgoat_test_SN5659__cal_impl.Encode2_P1_p speedgoat_test_SN5659__cal_impl.Encode2_P2_k speedgoat_test_SN5659__cal_impl.Encode2_P3_l speedgoat_test_SN5659__cal_impl.Encode2_P4_j speedgoat_test_SN5659__cal_impl.Encode2_P5_d speedgoat_test_SN5659__cal_impl.Encode2_P6_e speedgoat_test_SN5659__cal_impl.Encode2_P7_f speedgoat_test_SN5659__cal_impl.Encode2_P8_i speedgoat_test_SN5659__cal_impl.Encode2_P9_pe speedgoat_test_SN5659__cal_impl.Encode3_P10_m speedgoat_test_SN5659__cal_impl.Encode3_P11_i speedgoat_test_SN5659__cal_impl.Encode3_P12_b speedgoat_test_SN5659__cal_impl.Encode3_P13_g speedgoat_test_SN5659__cal_impl.Encode3_P14_o speedgoat_test_SN5659__cal_impl.Encode3_P15_hk speedgoat_test_SN5659__cal_impl.Encode3_P1_n speedgoat_test_SN5659__cal_impl.Encode3_P2_i speedgoat_test_SN5659__cal_impl.Encode3_P3_j speedgoat_test_SN5659__cal_impl.Encode3_P4_l speedgoat_test_SN5659__cal_impl.Encode3_P5_b speedgoat_test_SN5659__cal_impl.Encode3_P6_j speedgoat_test_SN5659__cal_impl.Encode3_P7_l speedgoat_test_SN5659__cal_impl.Encode3_P8_h speedgoat_test_SN5659__cal_impl.Encode3_P9_b speedgoat_test_SN5659__cal_impl.Encode4_P10_o speedgoat_test_SN5659__cal_impl.Encode4_P11_o speedgoat_test_SN5659__cal_impl.Encode4_P12_d speedgoat_test_SN5659__cal_impl.Encode4_P13_f speedgoat_test_SN5659__cal_impl.Encode4_P14_j speedgoat_test_SN5659__cal_impl.Encode4_P15_g speedgoat_test_SN5659__cal_impl.Encode4_P1_f speedgoat_test_SN5659__cal_impl.Encode4_P2_l speedgoat_test_SN5659__cal_impl.Encode4_P3_p speedgoat_test_SN5659__cal_impl.Encode4_P4_k speedgoat_test_SN5659__cal_impl.Encode4_P5_p speedgoat_test_SN5659__cal_impl.Encode4_P6_k speedgoat_test_SN5659__cal_impl.Encode4_P7_c speedgoat_test_SN5659__cal_impl.Encode4_P8_j speedgoat_test_SN5659__cal_impl.Encode4_P9_c speedgoat_test_SN5659__cal_impl.Randomnumber_Mean_fn speedgoat_test_SN5659__cal_impl.Randomnumber_Seed_f speedgoat_test_SN5659__cal_impl.Randomnumber_StdDev_j speedgoat_test_SN5659__cal_impl.Sinewave_Amp_d speedgoat_test_SN5659__cal_impl.Sinewave_Bias_e speedgoat_test_SN5659__cal_impl.Sinewave_Freq_a speedgoat_test_SN5659__cal_impl.Sinewave_HCos_j4 speedgoat_test_SN5659__cal_impl.Sinewave_Hsin_d speedgoat_test_SN5659__cal_impl.Sinewave_PCos_p speedgoat_test_SN5659__cal_impl.Sinewave_PSin_c /end REF_CHARACTERISTIC
 /begin REF_MEASUREMENT speedgoat_test_SN5659_R2021b_B.DataTypeConversion1_p speedgoat_test_SN5659_R2021b_B.DataTypeConversion_j speedgoat_test_SN5659_R2021b_B.Encode1_k speedgoat_test_SN5659_R2021b_B.Encode2_i speedgoat_test_SN5659_R2021b_B.Encode3_o speedgoat_test_SN5659_R2021b_B.Encode4_c speedgoat_test_SN5659_R2021b_B.Output_p speedgoat_test_SN5659_R2021b_B.Randomnumber_b speedgoat_test_SN5659_R2021b_B.Sinewave_k speedgoat_test_SN5659_R2021b_DW.NextOutput_f speedgoat_test_SN5659_R2021b_DW.RandSeed_k speedgoat_test_SN5659_R2021b_DW.lastCos_a speedgoat_test_SN5659_R2021b_DW.lastSin_ct speedgoat_test_SN5659_R2021b_DW.systemEnable_f /end REF_MEASUREMENT
/end GROUP
/begin GROUP speedgoat_test_SN5659_R2021b_IO682_Encode_Channel_12_Counter_Limited "speedgoat_test_SN5659_R2021b/IO682/Encode Channel 12/Counter
Limited"
 /begin SUB_GROUP speedgoat_test_SN5659_R2021b_IO682_Encode_Channel_12_Counter_Limited_Increment_Real_World speedgoat_test_SN5659_R2021b_IO682_Encode_Channel_12_Counter_Limited_Wrap_To_Zero /end SUB_GROUP
 /begin REF_CHARACTERISTIC speedgoat_test_SN5659__cal_impl.Output_InitialCondition_c /end REF_CHARACTERISTIC
 /begin REF_MEASUREMENT speedgoat_test_SN5659_R2021b_B.FixPtSwitch_b speedgoat_test_SN5659_R2021b_B.Output_p speedgoat_test_SN5659_R2021b_DW.Output_DSTATE_o0 /end REF_MEASUREMENT
/end GROUP
/begin GROUP speedgoat_test_SN5659_R2021b_IO682_Encode_Channel_12_Counter_Limited_Increment_Real_World "speedgoat_test_SN5659_R2021b/IO682/Encode Channel 12/Counter
Limited/Increment
Real World" /begin REF_CHARACTERISTIC speedgoat_test_SN5659__cal_impl.FixPtConstant_Value_o /end REF_CHARACTERISTIC
 /begin REF_MEASUREMENT speedgoat_test_SN5659_R2021b_B.FixPtSum1_a speedgoat_test_SN5659_R2021b_B.Output_p /end REF_MEASUREMENT
/end GROUP
/begin GROUP speedgoat_test_SN5659_R2021b_IO682_Encode_Channel_12_Counter_Limited_Wrap_To_Zero "speedgoat_test_SN5659_R2021b/IO682/Encode Channel 12/Counter
Limited/Wrap To Zero"
 /begin REF_CHARACTERISTIC speedgoat_test_SN5659__cal_impl.Constant_Value_n speedgoat_test_SN5659__cal_impl.CounterLimited_uplimit_k /end REF_CHARACTERISTIC
 /begin REF_MEASUREMENT speedgoat_test_SN5659_R2021b_B.FixPtSum1_a speedgoat_test_SN5659_R2021b_B.FixPtSwitch_b /end REF_MEASUREMENT
/end GROUP
/begin GROUP speedgoat_test_SN5659_R2021b_IO682_Encode_Channel_12_Prepare_RAW_value "speedgoat_test_SN5659_R2021b/IO682/Encode Channel 12/Prepare RAW value"
 /begin REF_CHARACTERISTIC speedgoat_test_SN5659__cal_impl.Label_Value_j speedgoat_test_SN5659__cal_impl.Mask_BitMask_d speedgoat_test_SN5659__cal_impl.SDI_Value_l speedgoat_test_SN5659__cal_impl.SSM_Value_n speedgoat_test_SN5659__cal_impl.Scale_Value_b speedgoat_test_SN5659__cal_impl.shiftthedoublevalue27bitsleft_g /end REF_CHARACTERISTIC
 /begin REF_MEASUREMENT speedgoat_test_SN5659_R2021b_B.BitwiseOperator_p speedgoat_test_SN5659_R2021b_B.DataTypeConversion1_p speedgoat_test_SN5659_R2021b_B.DataTypeConversion_jj speedgoat_test_SN5659_R2021b_B.Divide_p speedgoat_test_SN5659_R2021b_B.Mask_i speedgoat_test_SN5659_R2021b_B.Multiply_j speedgoat_test_SN5659_R2021b_B.ShifttoSDIslot_k speedgoat_test_SN5659_R2021b_B.ShifttoSSMslot_b /end REF_MEASUREMENT
/end GROUP
/begin GROUP speedgoat_test_SN5659_R2021b_IO682_Encode_Channel_1_Counter_Limited "speedgoat_test_SN5659_R2021b/IO682/Encode Channel 1/Counter
Limited" /begin REF_MEASUREMENT speedgoat_test_SN5659_R2021b_B.Output_o /end REF_MEASUREMENT /end GROUP
/begin GROUP speedgoat_test_SN5659_R2021b_IO682_Encode_Channel_1_Counter_Limited_Increment_Real_World "speedgoat_test_SN5659_R2021b/IO682/Encode Channel 1/Counter
Limited/Increment
Real World" /begin REF_MEASUREMENT speedgoat_test_SN5659_R2021b_B.Output_o /end REF_MEASUREMENT /end GROUP
/begin GROUP speedgoat_test_SN5659_R2021b_IO682_Encode_Channel_1_Prepare_RAW_value "speedgoat_test_SN5659_R2021b/IO682/Encode Channel 1/Prepare RAW value" /begin REF_MEASUREMENT speedgoat_test_SN5659_R2021b_B.DataTypeConversion1 /end REF_MEASUREMENT /end GROUP
/end MODULE
/end PROJECT
