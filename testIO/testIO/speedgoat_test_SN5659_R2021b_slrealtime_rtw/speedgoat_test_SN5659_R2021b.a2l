ASAP2_VERSION 1 71
/begin PROJECT ProjectName "Project Comment Goes Here"
/begin HEADER "Header Comments go here" /end HEADER
/begin MODULE ModuleName "Module Comment Goes Here"
/begin MOD_COMMON "Mod Common Comment Here" BYTE_ORDER MSB_LAST ALIGNMENT_BYTE 1 ALIGNMENT_WORD 2 ALIGNMENT_LONG 4 ALIGNMENT_FLOAT32_IEEE 4 ALIGNMENT_FLOAT64_IEEE 8 ALIGNMENT_INT64 8 /end MOD_COMMON
/begin CHARACTERISTIC speedgoat_test_SN5659__cal_impl.Decode1_P10_a "" VAL_BLK 0x008DA808 Scalar_FLOAT64_IEEE 0 speedgoat_test_SN5659_R2021b_CM_double -1.7E+308 1.7E+308 MATRIX_DIM 2 1 /end CHARACTERISTIC
/begin CHARACTERISTIC speedgoat_test_SN5659__cal_impl.Decode1_P10_aa "" VAL_BLK 0x008DBBD0 Scalar_FLOAT64_IEEE 0 speedgoat_test_SN5659_R2021b_CM_double -1.7E+308 1.7E+308 MATRIX_DIM 2 1 /end CHARACTERISTIC
/begin CHARACTERISTIC speedgoat_test_SN5659__cal_impl.Decode1_P10_d "" VAL_BLK 0x008DC268 Scalar_FLOAT64_IEEE 0 speedgoat_test_SN5659_R2021b_CM_double -1.7E+308 1.7E+308 MATRIX_DIM 2 1 /end CHARACTERISTIC
/begin CHARACTERISTIC speedgoat_test_SN5659__cal_impl.Decode1_P10_e "" VAL_BLK 0x008DB538 Scalar_FLOAT64_IEEE 0 speedgoat_test_SN5659_R2021b_CM_double -1.7E+308 1.7E+308 MATRIX_DIM 2 1 /end CHARACTERISTIC
/begin CHARACTERISTIC speedgoat_test_SN5659__cal_impl.Decode1_P10_h "" VAL_BLK 0x008D8DA8 Scalar_FLOAT64_IEEE 0 speedgoat_test_SN5659_R2021b_CM_double -1.7E+308 1.7E+308 MATRIX_DIM 2 1 /end CHARACTERISTIC
/begin CHARACTERISTIC speedgoat_test_SN5659__cal_impl.Decode1_P10_j "" VAL_BLK 0x008DC900 Scalar_FLOAT64_IEEE 0 speedgoat_test_SN5659_R2021b_CM_double -1.7E+308 1.7E+308 MATRIX_DIM 2 1 /end CHARACTERISTIC
/begin CHARACTERISTIC speedgoat_test_SN5659__cal_impl.Decode1_P10_k "" VAL_BLK 0x008D8078 Scalar_FLOAT64_IEEE 0 speedgoat_test_SN5659_R2021b_CM_double -1.7E+308 1.7E+308 MATRIX_DIM 2 1 /end CHARACTERISTIC
/begin CHARACTERISTIC speedgoat_test_SN5659__cal_impl.Decode1_P10_k1 "" VAL_BLK 0x008D9AD8 Scalar_FLOAT64_IEEE 0 speedgoat_test_SN5659_R2021b_CM_double -1.7E+308 1.7E+308 MATRIX_DIM 2 1 /end CHARACTERISTIC
/begin CHARACTERISTIC speedgoat_test_SN5659__cal_impl.Decode1_P10_lb "" VAL_BLK 0x008DA170 Scalar_FLOAT64_IEEE 0 speedgoat_test_SN5659_R2021b_CM_double -1.7E+308 1.7E+308 MATRIX_DIM 2 1 /end CHARACTERISTIC
/begin CHARACTERISTIC speedgoat_test_SN5659__cal_impl.Decode1_P10_lbu "" VAL_BLK 0x008DAEA0 Scalar_FLOAT64_IEEE 0 speedgoat_test_SN5659_R2021b_CM_double -1.7E+308 1.7E+308 MATRIX_DIM 2 1 /end CHARACTERISTIC
/begin CHARACTERISTIC speedgoat_test_SN5659__cal_impl.Decode1_P10_lm "" VAL_BLK 0x008D9440 Scalar_FLOAT64_IEEE 0 speedgoat_test_SN5659_R2021b_CM_double -1.7E+308 1.7E+308 MATRIX_DIM 2 1 /end CHARACTERISTIC
/begin CHARACTERISTIC speedgoat_test_SN5659__cal_impl.Decode1_P11_a "" VALUE 0x008DB558 Scalar_FLOAT64_IEEE 0 speedgoat_test_SN5659_R2021b_CM_double -1.7E+308 1.7E+308 /end CHARACTERISTIC
/begin CHARACTERISTIC speedgoat_test_SN5659__cal_impl.Decode1_P11_c "" VALUE 0x008DC288 Scalar_FLOAT64_IEEE 0 speedgoat_test_SN5659_R2021b_CM_double -1.7E+308 1.7E+308 /end CHARACTERISTIC
/begin CHARACTERISTIC speedgoat_test_SN5659__cal_impl.Decode1_P11_e "" VALUE 0x008D8098 Scalar_FLOAT64_IEEE 0 speedgoat_test_SN5659_R2021b_CM_double -1.7E+308 1.7E+308 /end CHARACTERISTIC
/begin CHARACTERISTIC speedgoat_test_SN5659__cal_impl.Decode1_P11_ee "" VALUE 0x008DC920 Scalar_FLOAT64_IEEE 0 speedgoat_test_SN5659_R2021b_CM_double -1.7E+308 1.7E+308 /end CHARACTERISTIC
/begin CHARACTERISTIC speedgoat_test_SN5659__cal_impl.Decode1_P11_ei "" VALUE 0x008DBBF0 Scalar_FLOAT64_IEEE 0 speedgoat_test_SN5659_R2021b_CM_double -1.7E+308 1.7E+308 /end CHARACTERISTIC
/begin CHARACTERISTIC speedgoat_test_SN5659__cal_impl.Decode1_P11_f "" VALUE 0x008D9460 Scalar_FLOAT64_IEEE 0 speedgoat_test_SN5659_R2021b_CM_double -1.7E+308 1.7E+308 /end CHARACTERISTIC
/begin CHARACTERISTIC speedgoat_test_SN5659__cal_impl.Decode1_P11_fz "" VALUE 0x008DAEC0 Scalar_FLOAT64_IEEE 0 speedgoat_test_SN5659_R2021b_CM_double -1.7E+308 1.7E+308 /end CHARACTERISTIC
/begin CHARACTERISTIC speedgoat_test_SN5659__cal_impl.Decode1_P11_g "" VALUE 0x008DA828 Scalar_FLOAT64_IEEE 0 speedgoat_test_SN5659_R2021b_CM_double -1.7E+308 1.7E+308 /end CHARACTERISTIC
/begin CHARACTERISTIC speedgoat_test_SN5659__cal_impl.Decode1_P11_i "" VALUE 0x008D9AF8 Scalar_FLOAT64_IEEE 0 speedgoat_test_SN5659_R2021b_CM_double -1.7E+308 1.7E+308 /end CHARACTERISTIC
/begin CHARACTERISTIC speedgoat_test_SN5659__cal_impl.Decode1_P11_m "" VALUE 0x008DA190 Scalar_FLOAT64_IEEE 0 speedgoat_test_SN5659_R2021b_CM_double -1.7E+308 1.7E+308 /end CHARACTERISTIC
/begin CHARACTERISTIC speedgoat_test_SN5659__cal_impl.Decode1_P11_p "" VALUE 0x008D8DC8 Scalar_FLOAT64_IEEE 0 speedgoat_test_SN5659_R2021b_CM_double -1.7E+308 1.7E+308 /end CHARACTERISTIC
/begin CHARACTERISTIC speedgoat_test_SN5659__cal_impl.Decode1_P12_a "" VALUE 0x008DB570 Scalar_FLOAT64_IEEE 0 speedgoat_test_SN5659_R2021b_CM_double -1.7E+308 1.7E+308 /end CHARACTERISTIC
/begin CHARACTERISTIC speedgoat_test_SN5659__cal_impl.Decode1_P12_b "" VALUE 0x008DA1A8 Scalar_FLOAT64_IEEE 0 speedgoat_test_SN5659_R2021b_CM_double -1.7E+308 1.7E+308 /end CHARACTERISTIC
/begin CHARACTERISTIC speedgoat_test_SN5659__cal_impl.Decode1_P12_d "" VALUE 0x008DA840 Scalar_FLOAT64_IEEE 0 speedgoat_test_SN5659_R2021b_CM_double -1.7E+308 1.7E+308 /end CHARACTERISTIC
/begin CHARACTERISTIC speedgoat_test_SN5659__cal_impl.Decode1_P12_d5 "" VALUE 0x008DC938 Scalar_FLOAT64_IEEE 0 speedgoat_test_SN5659_R2021b_CM_double -1.7E+308 1.7E+308 /end CHARACTERISTIC
/begin CHARACTERISTIC speedgoat_test_SN5659__cal_impl.Decode1_P12_h "" VALUE 0x008D8DE0 Scalar_FLOAT64_IEEE 0 speedgoat_test_SN5659_R2021b_CM_double -1.7E+308 1.7E+308 /end CHARACTERISTIC
/begin CHARACTERISTIC speedgoat_test_SN5659__cal_impl.Decode1_P12_j "" VALUE 0x008D9B10 Scalar_FLOAT64_IEEE 0 speedgoat_test_SN5659_R2021b_CM_double -1.7E+308 1.7E+308 /end CHARACTERISTIC
/begin CHARACTERISTIC speedgoat_test_SN5659__cal_impl.Decode1_P12_jm "" VALUE 0x008DBC08 Scalar_FLOAT64_IEEE 0 speedgoat_test_SN5659_R2021b_CM_double -1.7E+308 1.7E+308 /end CHARACTERISTIC
/begin CHARACTERISTIC speedgoat_test_SN5659__cal_impl.Decode1_P12_k "" VALUE 0x008DAED8 Scalar_FLOAT64_IEEE 0 speedgoat_test_SN5659_R2021b_CM_double -1.7E+308 1.7E+308 /end CHARACTERISTIC
/begin CHARACTERISTIC speedgoat_test_SN5659__cal_impl.Decode1_P12_p "" VALUE 0x008D80B0 Scalar_FLOAT64_IEEE 0 speedgoat_test_SN5659_R2021b_CM_double -1.7E+308 1.7E+308 /end CHARACTERISTIC
/begin CHARACTERISTIC speedgoat_test_SN5659__cal_impl.Decode1_P12_po "" VALUE 0x008DC2A0 Scalar_FLOAT64_IEEE 0 speedgoat_test_SN5659_R2021b_CM_double -1.7E+308 1.7E+308 /end CHARACTERISTIC
/begin CHARACTERISTIC speedgoat_test_SN5659__cal_impl.Decode1_P12_pv "" VALUE 0x008D9478 Scalar_FLOAT64_IEEE 0 speedgoat_test_SN5659_R2021b_CM_double -1.7E+308 1.7E+308 /end CHARACTERISTIC
/begin CHARACTERISTIC speedgoat_test_SN5659__cal_impl.Decode1_P13_a "" VALUE 0x008D80C8 Scalar_FLOAT64_IEEE 0 speedgoat_test_SN5659_R2021b_CM_double -1.7E+308 1.7E+308 /end CHARACTERISTIC
/begin CHARACTERISTIC speedgoat_test_SN5659__cal_impl.Decode1_P13_aa "" VALUE 0x008D9B28 Scalar_FLOAT64_IEEE 0 speedgoat_test_SN5659_R2021b_CM_double -1.7E+308 1.7E+308 /end CHARACTERISTIC
/begin CHARACTERISTIC speedgoat_test_SN5659__cal_impl.Decode1_P13_ad "" VALUE 0x008DC950 Scalar_FLOAT64_IEEE 0 speedgoat_test_SN5659_R2021b_CM_double -1.7E+308 1.7E+308 /end CHARACTERISTIC
/begin CHARACTERISTIC speedgoat_test_SN5659__cal_impl.Decode1_P13_c "" VALUE 0x008DA858 Scalar_FLOAT64_IEEE 0 speedgoat_test_SN5659_R2021b_CM_double -1.7E+308 1.7E+308 /end CHARACTERISTIC
/begin CHARACTERISTIC speedgoat_test_SN5659__cal_impl.Decode1_P13_d "" VALUE 0x008DAEF0 Scalar_FLOAT64_IEEE 0 speedgoat_test_SN5659_R2021b_CM_double -1.7E+308 1.7E+308 /end CHARACTERISTIC
/begin CHARACTERISTIC speedgoat_test_SN5659__cal_impl.Decode1_P13_e "" VALUE 0x008DBC20 Scalar_FLOAT64_IEEE 0 speedgoat_test_SN5659_R2021b_CM_double -1.7E+308 1.7E+308 /end CHARACTERISTIC
/begin CHARACTERISTIC speedgoat_test_SN5659__cal_impl.Decode1_P13_fg "" VALUE 0x008D9490 Scalar_FLOAT64_IEEE 0 speedgoat_test_SN5659_R2021b_CM_double -1.7E+308 1.7E+308 /end CHARACTERISTIC
/begin CHARACTERISTIC speedgoat_test_SN5659__cal_impl.Decode1_P13_k "" VALUE 0x008DB588 Scalar_FLOAT64_IEEE 0 speedgoat_test_SN5659_R2021b_CM_double -1.7E+308 1.7E+308 /end CHARACTERISTIC
/begin CHARACTERISTIC speedgoat_test_SN5659__cal_impl.Decode1_P13_l "" VALUE 0x008D8DF8 Scalar_FLOAT64_IEEE 0 speedgoat_test_SN5659_R2021b_CM_double -1.7E+308 1.7E+308 /end CHARACTERISTIC
/begin CHARACTERISTIC speedgoat_test_SN5659__cal_impl.Decode1_P13_lz "" VALUE 0x008DA1C0 Scalar_FLOAT64_IEEE 0 speedgoat_test_SN5659_R2021b_CM_double -1.7E+308 1.7E+308 /end CHARACTERISTIC
/begin CHARACTERISTIC speedgoat_test_SN5659__cal_impl.Decode1_P13_p "" VALUE 0x008DC2B8 Scalar_FLOAT64_IEEE 0 speedgoat_test_SN5659_R2021b_CM_double -1.7E+308 1.7E+308 /end CHARACTERISTIC
/begin CHARACTERISTIC speedgoat_test_SN5659__cal_impl.Decode1_P14_d "" VALUE 0x008D9B40 Scalar_FLOAT64_IEEE 0 speedgoat_test_SN5659_R2021b_CM_double -1.7E+308 1.7E+308 /end CHARACTERISTIC
/begin CHARACTERISTIC speedgoat_test_SN5659__cal_impl.Decode1_P14_da "" VALUE 0x008DC2D0 Scalar_FLOAT64_IEEE 0 speedgoat_test_SN5659_R2021b_CM_double -1.7E+308 1.7E+308 /end CHARACTERISTIC
/begin CHARACTERISTIC speedgoat_test_SN5659__cal_impl.Decode1_P14_g "" VALUE 0x008D8E10 Scalar_FLOAT64_IEEE 0 speedgoat_test_SN5659_R2021b_CM_double -1.7E+308 1.7E+308 /end CHARACTERISTIC
/begin CHARACTERISTIC speedgoat_test_SN5659__cal_impl.Decode1_P14_gc "" VALUE 0x008DA870 Scalar_FLOAT64_IEEE 0 speedgoat_test_SN5659_R2021b_CM_double -1.7E+308 1.7E+308 /end CHARACTERISTIC
/begin CHARACTERISTIC speedgoat_test_SN5659__cal_impl.Decode1_P14_gk "" VALUE 0x008D94A8 Scalar_FLOAT64_IEEE 0 speedgoat_test_SN5659_R2021b_CM_double -1.7E+308 1.7E+308 /end CHARACTERISTIC
/begin CHARACTERISTIC speedgoat_test_SN5659__cal_impl.Decode1_P14_i "" VALUE 0x008DAF08 Scalar_FLOAT64_IEEE 0 speedgoat_test_SN5659_R2021b_CM_double -1.7E+308 1.7E+308 /end CHARACTERISTIC
/begin CHARACTERISTIC speedgoat_test_SN5659__cal_impl.Decode1_P14_id "" VALUE 0x008DBC38 Scalar_FLOAT64_IEEE 0 speedgoat_test_SN5659_R2021b_CM_double -1.7E+308 1.7E+308 /end CHARACTERISTIC
/begin CHARACTERISTIC speedgoat_test_SN5659__cal_impl.Decode1_P14_j "" VALUE 0x008DC968 Scalar_FLOAT64_IEEE 0 speedgoat_test_SN5659_R2021b_CM_double -1.7E+308 1.7E+308 /end CHARACTERISTIC
/begin CHARACTERISTIC speedgoat_test_SN5659__cal_impl.Decode1_P14_k "" VALUE 0x008DA1D8 Scalar_FLOAT64_IEEE 0 speedgoat_test_SN5659_R2021b_CM_double -1.7E+308 1.7E+308 /end CHARACTERISTIC
/begin CHARACTERISTIC speedgoat_test_SN5659__cal_impl.Decode1_P14_o "" VALUE 0x008D80E0 Scalar_FLOAT64_IEEE 0 speedgoat_test_SN5659_R2021b_CM_double -1.7E+308 1.7E+308 /end CHARACTERISTIC
/begin CHARACTERISTIC speedgoat_test_SN5659__cal_impl.Decode1_P14_o4 "" VALUE 0x008DB5A0 Scalar_FLOAT64_IEEE 0 speedgoat_test_SN5659_R2021b_CM_double -1.7E+308 1.7E+308 /end CHARACTERISTIC
/begin CHARACTERISTIC speedgoat_test_SN5659__cal_impl.Decode1_P15_a "" VALUE 0x008D94C0 Scalar_FLOAT64_IEEE 0 speedgoat_test_SN5659_R2021b_CM_double -1.7E+308 1.7E+308 /end CHARACTERISTIC
/begin CHARACTERISTIC speedgoat_test_SN5659__cal_impl.Decode1_P15_au "" VALUE 0x008DC980 Scalar_FLOAT64_IEEE 0 speedgoat_test_SN5659_R2021b_CM_double -1.7E+308 1.7E+308 /end CHARACTERISTIC
/begin CHARACTERISTIC speedgoat_test_SN5659__cal_impl.Decode1_P15_be "" VALUE 0x008DB5B8 Scalar_FLOAT64_IEEE 0 speedgoat_test_SN5659_R2021b_CM_double -1.7E+308 1.7E+308 /end CHARACTERISTIC
/begin CHARACTERISTIC speedgoat_test_SN5659__cal_impl.Decode1_P15_g "" VALUE 0x008D8E28 Scalar_FLOAT64_IEEE 0 speedgoat_test_SN5659_R2021b_CM_double -1.7E+308 1.7E+308 /end CHARACTERISTIC
/begin CHARACTERISTIC speedgoat_test_SN5659__cal_impl.Decode1_P15_gw "" VALUE 0x008DC2E8 Scalar_FLOAT64_IEEE 0 speedgoat_test_SN5659_R2021b_CM_double -1.7E+308 1.7E+308 /end CHARACTERISTIC
/begin CHARACTERISTIC speedgoat_test_SN5659__cal_impl.Decode1_P15_h "" VALUE 0x008D9B58 Scalar_FLOAT64_IEEE 0 speedgoat_test_SN5659_R2021b_CM_double -1.7E+308 1.7E+308 /end CHARACTERISTIC
/begin CHARACTERISTIC speedgoat_test_SN5659__cal_impl.Decode1_P15_h1 "" VALUE 0x008DA1F0 Scalar_FLOAT64_IEEE 0 speedgoat_test_SN5659_R2021b_CM_double -1.7E+308 1.7E+308 /end CHARACTERISTIC
/begin CHARACTERISTIC speedgoat_test_SN5659__cal_impl.Decode1_P15_j "" VALUE 0x008DA888 Scalar_FLOAT64_IEEE 0 speedgoat_test_SN5659_R2021b_CM_double -1.7E+308 1.7E+308 /end CHARACTERISTIC
/begin CHARACTERISTIC speedgoat_test_SN5659__cal_impl.Decode1_P15_l "" VALUE 0x008D80F8 Scalar_FLOAT64_IEEE 0 speedgoat_test_SN5659_R2021b_CM_double -1.7E+308 1.7E+308 /end CHARACTERISTIC
/begin CHARACTERISTIC speedgoat_test_SN5659__cal_impl.Decode1_P15_l0 "" VALUE 0x008DBC50 Scalar_FLOAT64_IEEE 0 speedgoat_test_SN5659_R2021b_CM_double -1.7E+308 1.7E+308 /end CHARACTERISTIC
/begin CHARACTERISTIC speedgoat_test_SN5659__cal_impl.Decode1_P15_n "" VALUE 0x008DAF20 Scalar_FLOAT64_IEEE 0 speedgoat_test_SN5659_R2021b_CM_double -1.7E+308 1.7E+308 /end CHARACTERISTIC
/begin CHARACTERISTIC speedgoat_test_SN5659__cal_impl.Decode1_P16_be "" VALUE 0x008DC300 Scalar_FLOAT64_IEEE 0 speedgoat_test_SN5659_R2021b_CM_double -1.7E+308 1.7E+308 /end CHARACTERISTIC
/begin CHARACTERISTIC speedgoat_test_SN5659__cal_impl.Decode1_P16_e "" VALUE 0x008D8E40 Scalar_FLOAT64_IEEE 0 speedgoat_test_SN5659_R2021b_CM_double -1.7E+308 1.7E+308 /end CHARACTERISTIC
/begin CHARACTERISTIC speedgoat_test_SN5659__cal_impl.Decode1_P16_ey "" VALUE 0x008DB5D0 Scalar_FLOAT64_IEEE 0 speedgoat_test_SN5659_R2021b_CM_double -1.7E+308 1.7E+308 /end CHARACTERISTIC
/begin CHARACTERISTIC speedgoat_test_SN5659__cal_impl.Decode1_P16_f "" VALUE 0x008DA208 Scalar_FLOAT64_IEEE 0 speedgoat_test_SN5659_R2021b_CM_double -1.7E+308 1.7E+308 /end CHARACTERISTIC
/begin CHARACTERISTIC speedgoat_test_SN5659__cal_impl.Decode1_P16_g "" VALUE 0x008DBC68 Scalar_FLOAT64_IEEE 0 speedgoat_test_SN5659_R2021b_CM_double -1.7E+308 1.7E+308 /end CHARACTERISTIC
/begin CHARACTERISTIC speedgoat_test_SN5659__cal_impl.Decode1_P16_j "" VALUE 0x008D8110 Scalar_FLOAT64_IEEE 0 speedgoat_test_SN5659_R2021b_CM_double -1.7E+308 1.7E+308 /end CHARACTERISTIC
/begin CHARACTERISTIC speedgoat_test_SN5659__cal_impl.Decode1_P16_jd "" VALUE 0x008DA8A0 Scalar_FLOAT64_IEEE 0 speedgoat_test_SN5659_R2021b_CM_double -1.7E+308 1.7E+308 /end CHARACTERISTIC
/begin CHARACTERISTIC speedgoat_test_SN5659__cal_impl.Decode1_P16_js "" VALUE 0x008DAF38 Scalar_FLOAT64_IEEE 0 speedgoat_test_SN5659_R2021b_CM_double -1.7E+308 1.7E+308 /end CHARACTERISTIC
/begin CHARACTERISTIC speedgoat_test_SN5659__cal_impl.Decode1_P16_l "" VALUE 0x008DC998 Scalar_FLOAT64_IEEE 0 speedgoat_test_SN5659_R2021b_CM_double -1.7E+308 1.7E+308 /end CHARACTERISTIC
/begin CHARACTERISTIC speedgoat_test_SN5659__cal_impl.Decode1_P16_m "" VALUE 0x008D9B70 Scalar_FLOAT64_IEEE 0 speedgoat_test_SN5659_R2021b_CM_double -1.7E+308 1.7E+308 /end CHARACTERISTIC
/begin CHARACTERISTIC speedgoat_test_SN5659__cal_impl.Decode1_P16_n "" VALUE 0x008D94D8 Scalar_FLOAT64_IEEE 0 speedgoat_test_SN5659_R2021b_CM_double -1.7E+308 1.7E+308 /end CHARACTERISTIC
/begin CHARACTERISTIC speedgoat_test_SN5659__cal_impl.Decode1_P1_c "" VALUE 0x008D7FA0 Scalar_FLOAT64_IEEE 0 speedgoat_test_SN5659_R2021b_CM_double -1.7E+308 1.7E+308 /end CHARACTERISTIC
/begin CHARACTERISTIC speedgoat_test_SN5659__cal_impl.Decode1_P1_d "" VALUE 0x008DA730 Scalar_FLOAT64_IEEE 0 speedgoat_test_SN5659_R2021b_CM_double -1.7E+308 1.7E+308 /end CHARACTERISTIC
/begin CHARACTERISTIC speedgoat_test_SN5659__cal_impl.Decode1_P1_e "" VALUE 0x008D9A00 Scalar_FLOAT64_IEEE 0 speedgoat_test_SN5659_R2021b_CM_double -1.7E+308 1.7E+308 /end CHARACTERISTIC
/begin CHARACTERISTIC speedgoat_test_SN5659__cal_impl.Decode1_P1_e3 "" VALUE 0x008DA098 Scalar_FLOAT64_IEEE 0 speedgoat_test_SN5659_R2021b_CM_double -1.7E+308 1.7E+308 /end CHARACTERISTIC
/begin CHARACTERISTIC speedgoat_test_SN5659__cal_impl.Decode1_P1_h "" VALUE 0x008DC828 Scalar_FLOAT64_IEEE 0 speedgoat_test_SN5659_R2021b_CM_double -1.7E+308 1.7E+308 /end CHARACTERISTIC
/begin CHARACTERISTIC speedgoat_test_SN5659__cal_impl.Decode1_P1_i "" VALUE 0x008DB460 Scalar_FLOAT64_IEEE 0 speedgoat_test_SN5659_R2021b_CM_double -1.7E+308 1.7E+308 /end CHARACTERISTIC
/begin CHARACTERISTIC speedgoat_test_SN5659__cal_impl.Decode1_P1_k "" VALUE 0x008DC190 Scalar_FLOAT64_IEEE 0 speedgoat_test_SN5659_R2021b_CM_double -1.7E+308 1.7E+308 /end CHARACTERISTIC
/begin CHARACTERISTIC speedgoat_test_SN5659__cal_impl.Decode1_P1_l "" VALUE 0x008DADC8 Scalar_FLOAT64_IEEE 0 speedgoat_test_SN5659_R2021b_CM_double -1.7E+308 1.7E+308 /end CHARACTERISTIC
/begin CHARACTERISTIC speedgoat_test_SN5659__cal_impl.Decode1_P1_n "" VALUE 0x008D8CD0 Scalar_FLOAT64_IEEE 0 speedgoat_test_SN5659_R2021b_CM_double -1.7E+308 1.7E+308 /end CHARACTERISTIC
/begin CHARACTERISTIC speedgoat_test_SN5659__cal_impl.Decode1_P1_ng "" VALUE 0x008D9368 Scalar_FLOAT64_IEEE 0 speedgoat_test_SN5659_R2021b_CM_double -1.7E+308 1.7E+308 /end CHARACTERISTIC
/begin CHARACTERISTIC speedgoat_test_SN5659__cal_impl.Decode1_P1_p "" VALUE 0x008DBAF8 Scalar_FLOAT64_IEEE 0 speedgoat_test_SN5659_R2021b_CM_double -1.7E+308 1.7E+308 /end CHARACTERISTIC
/begin CHARACTERISTIC speedgoat_test_SN5659__cal_impl.Decode1_P2_c "" VALUE 0x008DC840 Scalar_FLOAT64_IEEE 0 speedgoat_test_SN5659_R2021b_CM_double -1.7E+308 1.7E+308 /end CHARACTERISTIC
/begin CHARACTERISTIC speedgoat_test_SN5659__cal_impl.Decode1_P2_d "" VALUE 0x008DBB10 Scalar_FLOAT64_IEEE 0 speedgoat_test_SN5659_R2021b_CM_double -1.7E+308 1.7E+308 /end CHARACTERISTIC
/begin CHARACTERISTIC speedgoat_test_SN5659__cal_impl.Decode1_P2_e "" VALUE 0x008DA0B0 Scalar_FLOAT64_IEEE 0 speedgoat_test_SN5659_R2021b_CM_double -1.7E+308 1.7E+308 /end CHARACTERISTIC
/begin CHARACTERISTIC speedgoat_test_SN5659__cal_impl.Decode1_P2_e1 "" VALUE 0x008DC1A8 Scalar_FLOAT64_IEEE 0 speedgoat_test_SN5659_R2021b_CM_double -1.7E+308 1.7E+308 /end CHARACTERISTIC
/begin CHARACTERISTIC speedgoat_test_SN5659__cal_impl.Decode1_P2_en "" VALUE 0x008DA748 Scalar_FLOAT64_IEEE 0 speedgoat_test_SN5659_R2021b_CM_double -1.7E+308 1.7E+308 /end CHARACTERISTIC
/begin CHARACTERISTIC speedgoat_test_SN5659__cal_impl.Decode1_P2_f "" VALUE 0x008DADE0 Scalar_FLOAT64_IEEE 0 speedgoat_test_SN5659_R2021b_CM_double -1.7E+308 1.7E+308 /end CHARACTERISTIC
/begin CHARACTERISTIC speedgoat_test_SN5659__cal_impl.Decode1_P2_g "" VALUE 0x008D7FB8 Scalar_FLOAT64_IEEE 0 speedgoat_test_SN5659_R2021b_CM_double -1.7E+308 1.7E+308 /end CHARACTERISTIC
/begin CHARACTERISTIC speedgoat_test_SN5659__cal_impl.Decode1_P2_j "" VALUE 0x008DB478 Scalar_FLOAT64_IEEE 0 speedgoat_test_SN5659_R2021b_CM_double -1.7E+308 1.7E+308 /end CHARACTERISTIC
/begin CHARACTERISTIC speedgoat_test_SN5659__cal_impl.Decode1_P2_k "" VALUE 0x008D9380 Scalar_FLOAT64_IEEE 0 speedgoat_test_SN5659_R2021b_CM_double -1.7E+308 1.7E+308 /end CHARACTERISTIC
/begin CHARACTERISTIC speedgoat_test_SN5659__cal_impl.Decode1_P2_o "" VALUE 0x008D8CE8 Scalar_FLOAT64_IEEE 0 speedgoat_test_SN5659_R2021b_CM_double -1.7E+308 1.7E+308 /end CHARACTERISTIC
/begin CHARACTERISTIC speedgoat_test_SN5659__cal_impl.Decode1_P2_ov "" VALUE 0x008D9A18 Scalar_FLOAT64_IEEE 0 speedgoat_test_SN5659_R2021b_CM_double -1.7E+308 1.7E+308 /end CHARACTERISTIC
/begin CHARACTERISTIC speedgoat_test_SN5659__cal_impl.Decode1_P3_b "" VALUE 0x008D7FD0 Scalar_FLOAT64_IEEE 0 speedgoat_test_SN5659_R2021b_CM_double -1.7E+308 1.7E+308 /end CHARACTERISTIC
/begin CHARACTERISTIC speedgoat_test_SN5659__cal_impl.Decode1_P3_c "" VALUE 0x008DA760 Scalar_FLOAT64_IEEE 0 speedgoat_test_SN5659_R2021b_CM_double -1.7E+308 1.7E+308 /end CHARACTERISTIC
/begin CHARACTERISTIC speedgoat_test_SN5659__cal_impl.Decode1_P3_d "" VALUE 0x008DC858 Scalar_FLOAT64_IEEE 0 speedgoat_test_SN5659_R2021b_CM_double -1.7E+308 1.7E+308 /end CHARACTERISTIC
/begin CHARACTERISTIC speedgoat_test_SN5659__cal_impl.Decode1_P3_f "" VALUE 0x008D9398 Scalar_FLOAT64_IEEE 0 speedgoat_test_SN5659_R2021b_CM_double -1.7E+308 1.7E+308 /end CHARACTERISTIC
/begin CHARACTERISTIC speedgoat_test_SN5659__cal_impl.Decode1_P3_f2 "" VALUE 0x008DB490 Scalar_FLOAT64_IEEE 0 speedgoat_test_SN5659_R2021b_CM_double -1.7E+308 1.7E+308 /end CHARACTERISTIC
/begin CHARACTERISTIC speedgoat_test_SN5659__cal_impl.Decode1_P3_j "" VALUE 0x008DA0C8 Scalar_FLOAT64_IEEE 0 speedgoat_test_SN5659_R2021b_CM_double -1.7E+308 1.7E+308 /end CHARACTERISTIC
/begin CHARACTERISTIC speedgoat_test_SN5659__cal_impl.Decode1_P3_j5 "" VALUE 0x008DADF8 Scalar_FLOAT64_IEEE 0 speedgoat_test_SN5659_R2021b_CM_double -1.7E+308 1.7E+308 /end CHARACTERISTIC
/begin CHARACTERISTIC speedgoat_test_SN5659__cal_impl.Decode1_P3_n "" VALUE 0x008DBB28 Scalar_FLOAT64_IEEE 0 speedgoat_test_SN5659_R2021b_CM_double -1.7E+308 1.7E+308 /end CHARACTERISTIC
/begin CHARACTERISTIC speedgoat_test_SN5659__cal_impl.Decode1_P3_ng "" VALUE 0x008DC1C0 Scalar_FLOAT64_IEEE 0 speedgoat_test_SN5659_R2021b_CM_double -1.7E+308 1.7E+308 /end CHARACTERISTIC
/begin CHARACTERISTIC speedgoat_test_SN5659__cal_impl.Decode1_P3_o "" VALUE 0x008D8D00 Scalar_FLOAT64_IEEE 0 speedgoat_test_SN5659_R2021b_CM_double -1.7E+308 1.7E+308 /end CHARACTERISTIC
/begin CHARACTERISTIC speedgoat_test_SN5659__cal_impl.Decode1_P3_p "" VALUE 0x008D9A30 Scalar_FLOAT64_IEEE 0 speedgoat_test_SN5659_R2021b_CM_double -1.7E+308 1.7E+308 /end CHARACTERISTIC
/begin CHARACTERISTIC speedgoat_test_SN5659__cal_impl.Decode1_P4_b "" VALUE 0x008D7FE8 Scalar_FLOAT64_IEEE 0 speedgoat_test_SN5659_R2021b_CM_double -1.7E+308 1.7E+308 /end CHARACTERISTIC
/begin CHARACTERISTIC speedgoat_test_SN5659__cal_impl.Decode1_P4_c "" VALUE 0x008D93B0 Scalar_FLOAT64_IEEE 0 speedgoat_test_SN5659_R2021b_CM_double -1.7E+308 1.7E+308 /end CHARACTERISTIC
/begin CHARACTERISTIC speedgoat_test_SN5659__cal_impl.Decode1_P4_cf "" VALUE 0x008DAE10 Scalar_FLOAT64_IEEE 0 speedgoat_test_SN5659_R2021b_CM_double -1.7E+308 1.7E+308 /end CHARACTERISTIC
/begin CHARACTERISTIC speedgoat_test_SN5659__cal_impl.Decode1_P4_h "" VALUE 0x008DC1D8 Scalar_FLOAT64_IEEE 0 speedgoat_test_SN5659_R2021b_CM_double -1.7E+308 1.7E+308 /end CHARACTERISTIC
/begin CHARACTERISTIC speedgoat_test_SN5659__cal_impl.Decode1_P4_i "" VALUE 0x008DA0E0 Scalar_FLOAT64_IEEE 0 speedgoat_test_SN5659_R2021b_CM_double -1.7E+308 1.7E+308 /end CHARACTERISTIC
/begin CHARACTERISTIC speedgoat_test_SN5659__cal_impl.Decode1_P4_l "" VALUE 0x008D8D18 Scalar_FLOAT64_IEEE 0 speedgoat_test_SN5659_R2021b_CM_double -1.7E+308 1.7E+308 /end CHARACTERISTIC
/begin CHARACTERISTIC speedgoat_test_SN5659__cal_impl.Decode1_P4_ls "" VALUE 0x008D9A48 Scalar_FLOAT64_IEEE 0 speedgoat_test_SN5659_R2021b_CM_double -1.7E+308 1.7E+308 /end CHARACTERISTIC
/begin CHARACTERISTIC speedgoat_test_SN5659__cal_impl.Decode1_P4_m "" VALUE 0x008DA778 Scalar_FLOAT64_IEEE 0 speedgoat_test_SN5659_R2021b_CM_double -1.7E+308 1.7E+308 /end CHARACTERISTIC
/begin CHARACTERISTIC speedgoat_test_SN5659__cal_impl.Decode1_P4_me "" VALUE 0x008DC870 Scalar_FLOAT64_IEEE 0 speedgoat_test_SN5659_R2021b_CM_double -1.7E+308 1.7E+308 /end CHARACTERISTIC
/begin CHARACTERISTIC speedgoat_test_SN5659__cal_impl.Decode1_P4_p "" VALUE 0x008DB4A8 Scalar_FLOAT64_IEEE 0 speedgoat_test_SN5659_R2021b_CM_double -1.7E+308 1.7E+308 /end CHARACTERISTIC
/begin CHARACTERISTIC speedgoat_test_SN5659__cal_impl.Decode1_P4_pr "" VALUE 0x008DBB40 Scalar_FLOAT64_IEEE 0 speedgoat_test_SN5659_R2021b_CM_double -1.7E+308 1.7E+308 /end CHARACTERISTIC
/begin CHARACTERISTIC speedgoat_test_SN5659__cal_impl.Decode1_P5_a "" VALUE 0x008DAE28 Scalar_FLOAT64_IEEE 0 speedgoat_test_SN5659_R2021b_CM_double -1.7E+308 1.7E+308 /end CHARACTERISTIC
/begin CHARACTERISTIC speedgoat_test_SN5659__cal_impl.Decode1_P5_c "" VALUE 0x008DA790 Scalar_FLOAT64_IEEE 0 speedgoat_test_SN5659_R2021b_CM_double -1.7E+308 1.7E+308 /end CHARACTERISTIC
/begin CHARACTERISTIC speedgoat_test_SN5659__cal_impl.Decode1_P5_d "" VALUE 0x008DC1F0 Scalar_FLOAT64_IEEE 0 speedgoat_test_SN5659_R2021b_CM_double -1.7E+308 1.7E+308 /end CHARACTERISTIC
/begin CHARACTERISTIC speedgoat_test_SN5659__cal_impl.Decode1_P5_d5 "" VALUE 0x008DC888 Scalar_FLOAT64_IEEE 0 speedgoat_test_SN5659_R2021b_CM_double -1.7E+308 1.7E+308 /end CHARACTERISTIC
/begin CHARACTERISTIC speedgoat_test_SN5659__cal_impl.Decode1_P5_f "" VALUE 0x008D8000 Scalar_FLOAT64_IEEE 0 speedgoat_test_SN5659_R2021b_CM_double -1.7E+308 1.7E+308 /end CHARACTERISTIC
/begin CHARACTERISTIC speedgoat_test_SN5659__cal_impl.Decode1_P5_fb "" VALUE 0x008D93C8 Scalar_FLOAT64_IEEE 0 speedgoat_test_SN5659_R2021b_CM_double -1.7E+308 1.7E+308 /end CHARACTERISTIC
/begin CHARACTERISTIC speedgoat_test_SN5659__cal_impl.Decode1_P5_k "" VALUE 0x008D8D30 Scalar_FLOAT64_IEEE 0 speedgoat_test_SN5659_R2021b_CM_double -1.7E+308 1.7E+308 /end CHARACTERISTIC
/begin CHARACTERISTIC speedgoat_test_SN5659__cal_impl.Decode1_P5_m "" VALUE 0x008D9A60 Scalar_FLOAT64_IEEE 0 speedgoat_test_SN5659_R2021b_CM_double -1.7E+308 1.7E+308 /end CHARACTERISTIC
/begin CHARACTERISTIC speedgoat_test_SN5659__cal_impl.Decode1_P5_nq "" VALUE 0x008DB4C0 Scalar_FLOAT64_IEEE 0 speedgoat_test_SN5659_R2021b_CM_double -1.7E+308 1.7E+308 /end CHARACTERISTIC
/begin CHARACTERISTIC speedgoat_test_SN5659__cal_impl.Decode1_P5_o "" VALUE 0x008DA0F8 Scalar_FLOAT64_IEEE 0 speedgoat_test_SN5659_R2021b_CM_double -1.7E+308 1.7E+308 /end CHARACTERISTIC
/begin CHARACTERISTIC speedgoat_test_SN5659__cal_impl.Decode1_P5_p "" VALUE 0x008DBB58 Scalar_FLOAT64_IEEE 0 speedgoat_test_SN5659_R2021b_CM_double -1.7E+308 1.7E+308 /end CHARACTERISTIC
/begin CHARACTERISTIC speedgoat_test_SN5659__cal_impl.Decode1_P6_b "" VALUE 0x008D93E0 Scalar_FLOAT64_IEEE 0 speedgoat_test_SN5659_R2021b_CM_double -1.7E+308 1.7E+308 /end CHARACTERISTIC
/begin CHARACTERISTIC speedgoat_test_SN5659__cal_impl.Decode1_P6_ba "" VALUE 0x008DB4D8 Scalar_FLOAT64_IEEE 0 speedgoat_test_SN5659_R2021b_CM_double -1.7E+308 1.7E+308 /end CHARACTERISTIC
/begin CHARACTERISTIC speedgoat_test_SN5659__cal_impl.Decode1_P6_d "" VALUE 0x008D8D48 Scalar_FLOAT64_IEEE 0 speedgoat_test_SN5659_R2021b_CM_double -1.7E+308 1.7E+308 /end CHARACTERISTIC
/begin CHARACTERISTIC speedgoat_test_SN5659__cal_impl.Decode1_P6_f "" VALUE 0x008D8018 Scalar_FLOAT64_IEEE 0 speedgoat_test_SN5659_R2021b_CM_double -1.7E+308 1.7E+308 /end CHARACTERISTIC
/begin CHARACTERISTIC speedgoat_test_SN5659__cal_impl.Decode1_P6_fp "" VALUE 0x008DAE40 Scalar_FLOAT64_IEEE 0 speedgoat_test_SN5659_R2021b_CM_double -1.7E+308 1.7E+308 /end CHARACTERISTIC
/begin CHARACTERISTIC speedgoat_test_SN5659__cal_impl.Decode1_P6_i "" VALUE 0x008DA7A8 Scalar_FLOAT64_IEEE 0 speedgoat_test_SN5659_R2021b_CM_double -1.7E+308 1.7E+308 /end CHARACTERISTIC
/begin CHARACTERISTIC speedgoat_test_SN5659__cal_impl.Decode1_P6_i3 "" VALUE 0x008DC8A0 Scalar_FLOAT64_IEEE 0 speedgoat_test_SN5659_R2021b_CM_double -1.7E+308 1.7E+308 /end CHARACTERISTIC
/begin CHARACTERISTIC speedgoat_test_SN5659__cal_impl.Decode1_P6_n "" VALUE 0x008D9A78 Scalar_FLOAT64_IEEE 0 speedgoat_test_SN5659_R2021b_CM_double -1.7E+308 1.7E+308 /end CHARACTERISTIC
/begin CHARACTERISTIC speedgoat_test_SN5659__cal_impl.Decode1_P6_o "" VALUE 0x008DBB70 Scalar_FLOAT64_IEEE 0 speedgoat_test_SN5659_R2021b_CM_double -1.7E+308 1.7E+308 /end CHARACTERISTIC
/begin CHARACTERISTIC speedgoat_test_SN5659__cal_impl.Decode1_P6_p "" VALUE 0x008DA110 Scalar_FLOAT64_IEEE 0 speedgoat_test_SN5659_R2021b_CM_double -1.7E+308 1.7E+308 /end CHARACTERISTIC
/begin CHARACTERISTIC speedgoat_test_SN5659__cal_impl.Decode1_P6_pa "" VALUE 0x008DC208 Scalar_FLOAT64_IEEE 0 speedgoat_test_SN5659_R2021b_CM_double -1.7E+308 1.7E+308 /end CHARACTERISTIC
/begin CHARACTERISTIC speedgoat_test_SN5659__cal_impl.Decode1_P7_a "" VALUE 0x008D8D60 Scalar_FLOAT64_IEEE 0 speedgoat_test_SN5659_R2021b_CM_double -1.7E+308 1.7E+308 /end CHARACTERISTIC
/begin CHARACTERISTIC speedgoat_test_SN5659__cal_impl.Decode1_P7_b "" VALUE 0x008DAE58 Scalar_FLOAT64_IEEE 0 speedgoat_test_SN5659_R2021b_CM_double -1.7E+308 1.7E+308 /end CHARACTERISTIC
/begin CHARACTERISTIC speedgoat_test_SN5659__cal_impl.Decode1_P7_bo "" VALUE 0x008DBB88 Scalar_FLOAT64_IEEE 0 speedgoat_test_SN5659_R2021b_CM_double -1.7E+308 1.7E+308 /end CHARACTERISTIC
/begin CHARACTERISTIC speedgoat_test_SN5659__cal_impl.Decode1_P7_d "" VALUE 0x008D9A90 Scalar_FLOAT64_IEEE 0 speedgoat_test_SN5659_R2021b_CM_double -1.7E+308 1.7E+308 /end CHARACTERISTIC
/begin CHARACTERISTIC speedgoat_test_SN5659__cal_impl.Decode1_P7_d3 "" VALUE 0x008DC8B8 Scalar_FLOAT64_IEEE 0 speedgoat_test_SN5659_R2021b_CM_double -1.7E+308 1.7E+308 /end CHARACTERISTIC
/begin CHARACTERISTIC speedgoat_test_SN5659__cal_impl.Decode1_P7_dn "" VALUE 0x008DA128 Scalar_FLOAT64_IEEE 0 speedgoat_test_SN5659_R2021b_CM_double -1.7E+308 1.7E+308 /end CHARACTERISTIC
/begin CHARACTERISTIC speedgoat_test_SN5659__cal_impl.Decode1_P7_h "" VALUE 0x008D8030 Scalar_FLOAT64_IEEE 0 speedgoat_test_SN5659_R2021b_CM_double -1.7E+308 1.7E+308 /end CHARACTERISTIC
/begin CHARACTERISTIC speedgoat_test_SN5659__cal_impl.Decode1_P7_hm "" VALUE 0x008DB4F0 Scalar_FLOAT64_IEEE 0 speedgoat_test_SN5659_R2021b_CM_double -1.7E+308 1.7E+308 /end CHARACTERISTIC
/begin CHARACTERISTIC speedgoat_test_SN5659__cal_impl.Decode1_P7_l "" VALUE 0x008DC220 Scalar_FLOAT64_IEEE 0 speedgoat_test_SN5659_R2021b_CM_double -1.7E+308 1.7E+308 /end CHARACTERISTIC
/begin CHARACTERISTIC speedgoat_test_SN5659__cal_impl.Decode1_P7_m "" VALUE 0x008D93F8 Scalar_FLOAT64_IEEE 0 speedgoat_test_SN5659_R2021b_CM_double -1.7E+308 1.7E+308 /end CHARACTERISTIC
/begin CHARACTERISTIC speedgoat_test_SN5659__cal_impl.Decode1_P7_o "" VALUE 0x008DA7C0 Scalar_FLOAT64_IEEE 0 speedgoat_test_SN5659_R2021b_CM_double -1.7E+308 1.7E+308 /end CHARACTERISTIC
/begin CHARACTERISTIC speedgoat_test_SN5659__cal_impl.Decode1_P8_c "" VALUE 0x008D8048 Scalar_FLOAT64_IEEE 0 speedgoat_test_SN5659_R2021b_CM_double -1.7E+308 1.7E+308 /end CHARACTERISTIC
/begin CHARACTERISTIC speedgoat_test_SN5659__cal_impl.Decode1_P8_c5 "" VALUE 0x008DC8D0 Scalar_FLOAT64_IEEE 0 speedgoat_test_SN5659_R2021b_CM_double -1.7E+308 1.7E+308 /end CHARACTERISTIC
/begin CHARACTERISTIC speedgoat_test_SN5659__cal_impl.Decode1_P8_e "" VALUE 0x008D9410 Scalar_FLOAT64_IEEE 0 speedgoat_test_SN5659_R2021b_CM_double -1.7E+308 1.7E+308 /end CHARACTERISTIC
/begin CHARACTERISTIC speedgoat_test_SN5659__cal_impl.Decode1_P8_g "" VALUE 0x008D8D78 Scalar_FLOAT64_IEEE 0 speedgoat_test_SN5659_R2021b_CM_double -1.7E+308 1.7E+308 /end CHARACTERISTIC
/begin CHARACTERISTIC speedgoat_test_SN5659__cal_impl.Decode1_P8_ga "" VALUE 0x008DBBA0 Scalar_FLOAT64_IEEE 0 speedgoat_test_SN5659_R2021b_CM_double -1.7E+308 1.7E+308 /end CHARACTERISTIC
/begin CHARACTERISTIC speedgoat_test_SN5659__cal_impl.Decode1_P8_gl "" VALUE 0x008DB508 Scalar_FLOAT64_IEEE 0 speedgoat_test_SN5659_R2021b_CM_double -1.7E+308 1.7E+308 /end CHARACTERISTIC
/begin CHARACTERISTIC speedgoat_test_SN5659__cal_impl.Decode1_P8_i "" VALUE 0x008DA7D8 Scalar_FLOAT64_IEEE 0 speedgoat_test_SN5659_R2021b_CM_double -1.7E+308 1.7E+308 /end CHARACTERISTIC
/begin CHARACTERISTIC speedgoat_test_SN5659__cal_impl.Decode1_P8_lr "" VALUE 0x008DA140 Scalar_FLOAT64_IEEE 0 speedgoat_test_SN5659_R2021b_CM_double -1.7E+308 1.7E+308 /end CHARACTERISTIC
/begin CHARACTERISTIC speedgoat_test_SN5659__cal_impl.Decode1_P8_o "" VALUE 0x008DC238 Scalar_FLOAT64_IEEE 0 speedgoat_test_SN5659_R2021b_CM_double -1.7E+308 1.7E+308 /end CHARACTERISTIC
/begin CHARACTERISTIC speedgoat_test_SN5659__cal_impl.Decode1_P8_p "" VALUE 0x008D9AA8 Scalar_FLOAT64_IEEE 0 speedgoat_test_SN5659_R2021b_CM_double -1.7E+308 1.7E+308 /end CHARACTERISTIC
/begin CHARACTERISTIC speedgoat_test_SN5659__cal_impl.Decode1_P8_pw "" VALUE 0x008DAE70 Scalar_FLOAT64_IEEE 0 speedgoat_test_SN5659_R2021b_CM_double -1.7E+308 1.7E+308 /end CHARACTERISTIC
/begin CHARACTERISTIC speedgoat_test_SN5659__cal_impl.Decode1_P9_a "" VALUE 0x008DC250 Scalar_FLOAT64_IEEE 0 speedgoat_test_SN5659_R2021b_CM_double -1.7E+308 1.7E+308 /end CHARACTERISTIC
/begin CHARACTERISTIC speedgoat_test_SN5659__cal_impl.Decode1_P9_b "" VALUE 0x008D9428 Scalar_FLOAT64_IEEE 0 speedgoat_test_SN5659_R2021b_CM_double -1.7E+308 1.7E+308 /end CHARACTERISTIC
/begin CHARACTERISTIC speedgoat_test_SN5659__cal_impl.Decode1_P9_c "" VALUE 0x008DBBB8 Scalar_FLOAT64_IEEE 0 speedgoat_test_SN5659_R2021b_CM_double -1.7E+308 1.7E+308 /end CHARACTERISTIC
/begin CHARACTERISTIC speedgoat_test_SN5659__cal_impl.Decode1_P9_d "" VALUE 0x008DAE88 Scalar_FLOAT64_IEEE 0 speedgoat_test_SN5659_R2021b_CM_double -1.7E+308 1.7E+308 /end CHARACTERISTIC
/begin CHARACTERISTIC speedgoat_test_SN5659__cal_impl.Decode1_P9_dd "" VALUE 0x008DB520 Scalar_FLOAT64_IEEE 0 speedgoat_test_SN5659_R2021b_CM_double -1.7E+308 1.7E+308 /end CHARACTERISTIC
/begin CHARACTERISTIC speedgoat_test_SN5659__cal_impl.Decode1_P9_g "" VALUE 0x008D9AC0 Scalar_FLOAT64_IEEE 0 speedgoat_test_SN5659_R2021b_CM_double -1.7E+308 1.7E+308 /end CHARACTERISTIC
/begin CHARACTERISTIC speedgoat_test_SN5659__cal_impl.Decode1_P9_i "" VALUE 0x008DA158 Scalar_FLOAT64_IEEE 0 speedgoat_test_SN5659_R2021b_CM_double -1.7E+308 1.7E+308 /end CHARACTERISTIC
/begin CHARACTERISTIC speedgoat_test_SN5659__cal_impl.Decode1_P9_l "" VALUE 0x008DA7F0 Scalar_FLOAT64_IEEE 0 speedgoat_test_SN5659_R2021b_CM_double -1.7E+308 1.7E+308 /end CHARACTERISTIC
/begin CHARACTERISTIC speedgoat_test_SN5659__cal_impl.Decode1_P9_o "" VALUE 0x008D8D90 Scalar_FLOAT64_IEEE 0 speedgoat_test_SN5659_R2021b_CM_double -1.7E+308 1.7E+308 /end CHARACTERISTIC
/begin CHARACTERISTIC speedgoat_test_SN5659__cal_impl.Decode1_P9_p "" VALUE 0x008D8060 Scalar_FLOAT64_IEEE 0 speedgoat_test_SN5659_R2021b_CM_double -1.7E+308 1.7E+308 /end CHARACTERISTIC
/begin CHARACTERISTIC speedgoat_test_SN5659__cal_impl.Decode1_P9_pu "" VALUE 0x008DC8E8 Scalar_FLOAT64_IEEE 0 speedgoat_test_SN5659_R2021b_CM_double -1.7E+308 1.7E+308 /end CHARACTERISTIC
/begin CHARACTERISTIC speedgoat_test_SN5659__cal_impl.Decode2_P1 "" VALUE 0x008D8128 Scalar_FLOAT64_IEEE 0 speedgoat_test_SN5659_R2021b_CM_double -1.7E+308 1.7E+308 /end CHARACTERISTIC
/begin CHARACTERISTIC speedgoat_test_SN5659__cal_impl.Decode2_P10 "" VAL_BLK 0x008D8200 Scalar_FLOAT64_IEEE 0 speedgoat_test_SN5659_R2021b_CM_double -1.7E+308 1.7E+308 MATRIX_DIM 2 1 /end CHARACTERISTIC
/begin CHARACTERISTIC speedgoat_test_SN5659__cal_impl.Decode2_P10_b "" VAL_BLK 0x008DB028 Scalar_FLOAT64_IEEE 0 speedgoat_test_SN5659_R2021b_CM_double -1.7E+308 1.7E+308 MATRIX_DIM 2 1 /end CHARACTERISTIC
/begin CHARACTERISTIC speedgoat_test_SN5659__cal_impl.Decode2_P10_bf "" VAL_BLK 0x008DBD58 Scalar_FLOAT64_IEEE 0 speedgoat_test_SN5659_R2021b_CM_double -1.7E+308 1.7E+308 MATRIX_DIM 2 1 /end CHARACTERISTIC
/begin CHARACTERISTIC speedgoat_test_SN5659__cal_impl.Decode2_P10_c "" VAL_BLK 0x008D95C8 Scalar_FLOAT64_IEEE 0 speedgoat_test_SN5659_R2021b_CM_double -1.7E+308 1.7E+308 MATRIX_DIM 2 1 /end CHARACTERISTIC
/begin CHARACTERISTIC speedgoat_test_SN5659__cal_impl.Decode2_P10_f "" VAL_BLK 0x008DC3F0 Scalar_FLOAT64_IEEE 0 speedgoat_test_SN5659_R2021b_CM_double -1.7E+308 1.7E+308 MATRIX_DIM 2 1 /end CHARACTERISTIC
/begin CHARACTERISTIC speedgoat_test_SN5659__cal_impl.Decode2_P10_h "" VAL_BLK 0x008D8F30 Scalar_FLOAT64_IEEE 0 speedgoat_test_SN5659_R2021b_CM_double -1.7E+308 1.7E+308 MATRIX_DIM 2 1 /end CHARACTERISTIC
/begin CHARACTERISTIC speedgoat_test_SN5659__cal_impl.Decode2_P10_j "" VAL_BLK 0x008D9C60 Scalar_FLOAT64_IEEE 0 speedgoat_test_SN5659_R2021b_CM_double -1.7E+308 1.7E+308 MATRIX_DIM 2 1 /end CHARACTERISTIC
/begin CHARACTERISTIC speedgoat_test_SN5659__cal_impl.Decode2_P10_js "" VAL_BLK 0x008DB6C0 Scalar_FLOAT64_IEEE 0 speedgoat_test_SN5659_R2021b_CM_double -1.7E+308 1.7E+308 MATRIX_DIM 2 1 /end CHARACTERISTIC
/begin CHARACTERISTIC speedgoat_test_SN5659__cal_impl.Decode2_P10_n "" VAL_BLK 0x008DA990 Scalar_FLOAT64_IEEE 0 speedgoat_test_SN5659_R2021b_CM_double -1.7E+308 1.7E+308 MATRIX_DIM 2 1 /end CHARACTERISTIC
/begin CHARACTERISTIC speedgoat_test_SN5659__cal_impl.Decode2_P11 "" VALUE 0x008D8220 Scalar_FLOAT64_IEEE 0 speedgoat_test_SN5659_R2021b_CM_double -1.7E+308 1.7E+308 /end CHARACTERISTIC
/begin CHARACTERISTIC speedgoat_test_SN5659__cal_impl.Decode2_P11_b "" VALUE 0x008DB048 Scalar_FLOAT64_IEEE 0 speedgoat_test_SN5659_R2021b_CM_double -1.7E+308 1.7E+308 /end CHARACTERISTIC
/begin CHARACTERISTIC speedgoat_test_SN5659__cal_impl.Decode2_P11_f "" VALUE 0x008D95E8 Scalar_FLOAT64_IEEE 0 speedgoat_test_SN5659_R2021b_CM_double -1.7E+308 1.7E+308 /end CHARACTERISTIC
/begin CHARACTERISTIC speedgoat_test_SN5659__cal_impl.Decode2_P11_ff "" VALUE 0x008DBD78 Scalar_FLOAT64_IEEE 0 speedgoat_test_SN5659_R2021b_CM_double -1.7E+308 1.7E+308 /end CHARACTERISTIC
/begin CHARACTERISTIC speedgoat_test_SN5659__cal_impl.Decode2_P11_fz "" VALUE 0x008DC410 Scalar_FLOAT64_IEEE 0 speedgoat_test_SN5659_R2021b_CM_double -1.7E+308 1.7E+308 /end CHARACTERISTIC
/begin CHARACTERISTIC speedgoat_test_SN5659__cal_impl.Decode2_P11_j "" VALUE 0x008D8F50 Scalar_FLOAT64_IEEE 0 speedgoat_test_SN5659_R2021b_CM_double -1.7E+308 1.7E+308 /end CHARACTERISTIC
/begin CHARACTERISTIC speedgoat_test_SN5659__cal_impl.Decode2_P11_jv "" VALUE 0x008DB6E0 Scalar_FLOAT64_IEEE 0 speedgoat_test_SN5659_R2021b_CM_double -1.7E+308 1.7E+308 /end CHARACTERISTIC
/begin CHARACTERISTIC speedgoat_test_SN5659__cal_impl.Decode2_P11_k "" VALUE 0x008DA9B0 Scalar_FLOAT64_IEEE 0 speedgoat_test_SN5659_R2021b_CM_double -1.7E+308 1.7E+308 /end CHARACTERISTIC
/begin CHARACTERISTIC speedgoat_test_SN5659__cal_impl.Decode2_P11_m "" VALUE 0x008D9C80 Scalar_FLOAT64_IEEE 0 speedgoat_test_SN5659_R2021b_CM_double -1.7E+308 1.7E+308 /end CHARACTERISTIC
/begin CHARACTERISTIC speedgoat_test_SN5659__cal_impl.Decode2_P12 "" VALUE 0x008D8238 Scalar_FLOAT64_IEEE 0 speedgoat_test_SN5659_R2021b_CM_double -1.7E+308 1.7E+308 /end CHARACTERISTIC
/begin CHARACTERISTIC speedgoat_test_SN5659__cal_impl.Decode2_P12_b "" VALUE 0x008DBD90 Scalar_FLOAT64_IEEE 0 speedgoat_test_SN5659_R2021b_CM_double -1.7E+308 1.7E+308 /end CHARACTERISTIC
/begin CHARACTERISTIC speedgoat_test_SN5659__cal_impl.Decode2_P12_bf "" VALUE 0x008DC428 Scalar_FLOAT64_IEEE 0 speedgoat_test_SN5659_R2021b_CM_double -1.7E+308 1.7E+308 /end CHARACTERISTIC
/begin CHARACTERISTIC speedgoat_test_SN5659__cal_impl.Decode2_P12_f "" VALUE 0x008D9600 Scalar_FLOAT64_IEEE 0 speedgoat_test_SN5659_R2021b_CM_double -1.7E+308 1.7E+308 /end CHARACTERISTIC
/begin CHARACTERISTIC speedgoat_test_SN5659__cal_impl.Decode2_P12_g "" VALUE 0x008D8F68 Scalar_FLOAT64_IEEE 0 speedgoat_test_SN5659_R2021b_CM_double -1.7E+308 1.7E+308 /end CHARACTERISTIC
/begin CHARACTERISTIC speedgoat_test_SN5659__cal_impl.Decode2_P12_i "" VALUE 0x008DA9C8 Scalar_FLOAT64_IEEE 0 speedgoat_test_SN5659_R2021b_CM_double -1.7E+308 1.7E+308 /end CHARACTERISTIC
/begin CHARACTERISTIC speedgoat_test_SN5659__cal_impl.Decode2_P12_k "" VALUE 0x008D9C98 Scalar_FLOAT64_IEEE 0 speedgoat_test_SN5659_R2021b_CM_double -1.7E+308 1.7E+308 /end CHARACTERISTIC
/begin CHARACTERISTIC speedgoat_test_SN5659__cal_impl.Decode2_P12_l "" VALUE 0x008DB060 Scalar_FLOAT64_IEEE 0 speedgoat_test_SN5659_R2021b_CM_double -1.7E+308 1.7E+308 /end CHARACTERISTIC
/begin CHARACTERISTIC speedgoat_test_SN5659__cal_impl.Decode2_P12_p "" VALUE 0x008DB6F8 Scalar_FLOAT64_IEEE 0 speedgoat_test_SN5659_R2021b_CM_double -1.7E+308 1.7E+308 /end CHARACTERISTIC
/begin CHARACTERISTIC speedgoat_test_SN5659__cal_impl.Decode2_P13 "" VALUE 0x008D8250 Scalar_FLOAT64_IEEE 0 speedgoat_test_SN5659_R2021b_CM_double -1.7E+308 1.7E+308 /end CHARACTERISTIC
/begin CHARACTERISTIC speedgoat_test_SN5659__cal_impl.Decode2_P13_c "" VALUE 0x008DBDA8 Scalar_FLOAT64_IEEE 0 speedgoat_test_SN5659_R2021b_CM_double -1.7E+308 1.7E+308 /end CHARACTERISTIC
/begin CHARACTERISTIC speedgoat_test_SN5659__cal_impl.Decode2_P13_e "" VALUE 0x008DA9E0 Scalar_FLOAT64_IEEE 0 speedgoat_test_SN5659_R2021b_CM_double -1.7E+308 1.7E+308 /end CHARACTERISTIC
/begin CHARACTERISTIC speedgoat_test_SN5659__cal_impl.Decode2_P13_f "" VALUE 0x008DB078 Scalar_FLOAT64_IEEE 0 speedgoat_test_SN5659_R2021b_CM_double -1.7E+308 1.7E+308 /end CHARACTERISTIC
/begin CHARACTERISTIC speedgoat_test_SN5659__cal_impl.Decode2_P13_i "" VALUE 0x008D8F80 Scalar_FLOAT64_IEEE 0 speedgoat_test_SN5659_R2021b_CM_double -1.7E+308 1.7E+308 /end CHARACTERISTIC
/begin CHARACTERISTIC speedgoat_test_SN5659__cal_impl.Decode2_P13_iy "" VALUE 0x008DB710 Scalar_FLOAT64_IEEE 0 speedgoat_test_SN5659_R2021b_CM_double -1.7E+308 1.7E+308 /end CHARACTERISTIC
/begin CHARACTERISTIC speedgoat_test_SN5659__cal_impl.Decode2_P13_j "" VALUE 0x008D9CB0 Scalar_FLOAT64_IEEE 0 speedgoat_test_SN5659_R2021b_CM_double -1.7E+308 1.7E+308 /end CHARACTERISTIC
/begin CHARACTERISTIC speedgoat_test_SN5659__cal_impl.Decode2_P13_k "" VALUE 0x008D9618 Scalar_FLOAT64_IEEE 0 speedgoat_test_SN5659_R2021b_CM_double -1.7E+308 1.7E+308 /end CHARACTERISTIC
/begin CHARACTERISTIC speedgoat_test_SN5659__cal_impl.Decode2_P13_m "" VALUE 0x008DC440 Scalar_FLOAT64_IEEE 0 speedgoat_test_SN5659_R2021b_CM_double -1.7E+308 1.7E+308 /end CHARACTERISTIC
/begin CHARACTERISTIC speedgoat_test_SN5659__cal_impl.Decode2_P14 "" VALUE 0x008D8268 Scalar_FLOAT64_IEEE 0 speedgoat_test_SN5659_R2021b_CM_double -1.7E+308 1.7E+308 /end CHARACTERISTIC
/begin CHARACTERISTIC speedgoat_test_SN5659__cal_impl.Decode2_P14_b "" VALUE 0x008DA9F8 Scalar_FLOAT64_IEEE 0 speedgoat_test_SN5659_R2021b_CM_double -1.7E+308 1.7E+308 /end CHARACTERISTIC
/begin CHARACTERISTIC speedgoat_test_SN5659__cal_impl.Decode2_P14_e "" VALUE 0x008D8F98 Scalar_FLOAT64_IEEE 0 speedgoat_test_SN5659_R2021b_CM_double -1.7E+308 1.7E+308 /end CHARACTERISTIC
/begin CHARACTERISTIC speedgoat_test_SN5659__cal_impl.Decode2_P14_f "" VALUE 0x008DB728 Scalar_FLOAT64_IEEE 0 speedgoat_test_SN5659_R2021b_CM_double -1.7E+308 1.7E+308 /end CHARACTERISTIC
/begin CHARACTERISTIC speedgoat_test_SN5659__cal_impl.Decode2_P14_f2 "" VALUE 0x008DBDC0 Scalar_FLOAT64_IEEE 0 speedgoat_test_SN5659_R2021b_CM_double -1.7E+308 1.7E+308 /end CHARACTERISTIC
/begin CHARACTERISTIC speedgoat_test_SN5659__cal_impl.Decode2_P14_j "" VALUE 0x008DC458 Scalar_FLOAT64_IEEE 0 speedgoat_test_SN5659_R2021b_CM_double -1.7E+308 1.7E+308 /end CHARACTERISTIC
/begin CHARACTERISTIC speedgoat_test_SN5659__cal_impl.Decode2_P14_m "" VALUE 0x008D9630 Scalar_FLOAT64_IEEE 0 speedgoat_test_SN5659_R2021b_CM_double -1.7E+308 1.7E+308 /end CHARACTERISTIC
/begin CHARACTERISTIC speedgoat_test_SN5659__cal_impl.Decode2_P14_mb "" VALUE 0x008DB090 Scalar_FLOAT64_IEEE 0 speedgoat_test_SN5659_R2021b_CM_double -1.7E+308 1.7E+308 /end CHARACTERISTIC
/begin CHARACTERISTIC speedgoat_test_SN5659__cal_impl.Decode2_P14_o "" VALUE 0x008D9CC8 Scalar_FLOAT64_IEEE 0 speedgoat_test_SN5659_R2021b_CM_double -1.7E+308 1.7E+308 /end CHARACTERISTIC
/begin CHARACTERISTIC speedgoat_test_SN5659__cal_impl.Decode2_P15 "" VALUE 0x008D8280 Scalar_FLOAT64_IEEE 0 speedgoat_test_SN5659_R2021b_CM_double -1.7E+308 1.7E+308 /end CHARACTERISTIC
/begin CHARACTERISTIC speedgoat_test_SN5659__cal_impl.Decode2_P15_a "" VALUE 0x008D8FB0 Scalar_FLOAT64_IEEE 0 speedgoat_test_SN5659_R2021b_CM_double -1.7E+308 1.7E+308 /end CHARACTERISTIC
/begin CHARACTERISTIC speedgoat_test_SN5659__cal_impl.Decode2_P15_c "" VALUE 0x008D9648 Scalar_FLOAT64_IEEE 0 speedgoat_test_SN5659_R2021b_CM_double -1.7E+308 1.7E+308 /end CHARACTERISTIC
/begin CHARACTERISTIC speedgoat_test_SN5659__cal_impl.Decode2_P15_cj "" VALUE 0x008DB740 Scalar_FLOAT64_IEEE 0 speedgoat_test_SN5659_R2021b_CM_double -1.7E+308 1.7E+308 /end CHARACTERISTIC
/begin CHARACTERISTIC speedgoat_test_SN5659__cal_impl.Decode2_P15_g "" VALUE 0x008D9CE0 Scalar_FLOAT64_IEEE 0 speedgoat_test_SN5659_R2021b_CM_double -1.7E+308 1.7E+308 /end CHARACTERISTIC
/begin CHARACTERISTIC speedgoat_test_SN5659__cal_impl.Decode2_P15_go "" VALUE 0x008DBDD8 Scalar_FLOAT64_IEEE 0 speedgoat_test_SN5659_R2021b_CM_double -1.7E+308 1.7E+308 /end CHARACTERISTIC
/begin CHARACTERISTIC speedgoat_test_SN5659__cal_impl.Decode2_P15_j "" VALUE 0x008DB0A8 Scalar_FLOAT64_IEEE 0 speedgoat_test_SN5659_R2021b_CM_double -1.7E+308 1.7E+308 /end CHARACTERISTIC
/begin CHARACTERISTIC speedgoat_test_SN5659__cal_impl.Decode2_P15_jl "" VALUE 0x008DC470 Scalar_FLOAT64_IEEE 0 speedgoat_test_SN5659_R2021b_CM_double -1.7E+308 1.7E+308 /end CHARACTERISTIC
/begin CHARACTERISTIC speedgoat_test_SN5659__cal_impl.Decode2_P15_n "" VALUE 0x008DAA10 Scalar_FLOAT64_IEEE 0 speedgoat_test_SN5659_R2021b_CM_double -1.7E+308 1.7E+308 /end CHARACTERISTIC
/begin CHARACTERISTIC speedgoat_test_SN5659__cal_impl.Decode2_P16 "" VALUE 0x008D8298 Scalar_FLOAT64_IEEE 0 speedgoat_test_SN5659_R2021b_CM_double -1.7E+308 1.7E+308 /end CHARACTERISTIC
/begin CHARACTERISTIC speedgoat_test_SN5659__cal_impl.Decode2_P16_c "" VALUE 0x008D8FC8 Scalar_FLOAT64_IEEE 0 speedgoat_test_SN5659_R2021b_CM_double -1.7E+308 1.7E+308 /end CHARACTERISTIC
/begin CHARACTERISTIC speedgoat_test_SN5659__cal_impl.Decode2_P16_cj "" VALUE 0x008D9CF8 Scalar_FLOAT64_IEEE 0 speedgoat_test_SN5659_R2021b_CM_double -1.7E+308 1.7E+308 /end CHARACTERISTIC
/begin CHARACTERISTIC speedgoat_test_SN5659__cal_impl.Decode2_P16_cw "" VALUE 0x008DBDF0 Scalar_FLOAT64_IEEE 0 speedgoat_test_SN5659_R2021b_CM_double -1.7E+308 1.7E+308 /end CHARACTERISTIC
/begin CHARACTERISTIC speedgoat_test_SN5659__cal_impl.Decode2_P16_f "" VALUE 0x008DC488 Scalar_FLOAT64_IEEE 0 speedgoat_test_SN5659_R2021b_CM_double -1.7E+308 1.7E+308 /end CHARACTERISTIC
/begin CHARACTERISTIC speedgoat_test_SN5659__cal_impl.Decode2_P16_i "" VALUE 0x008DB758 Scalar_FLOAT64_IEEE 0 speedgoat_test_SN5659_R2021b_CM_double -1.7E+308 1.7E+308 /end CHARACTERISTIC
/begin CHARACTERISTIC speedgoat_test_SN5659__cal_impl.Decode2_P16_j "" VALUE 0x008DB0C0 Scalar_FLOAT64_IEEE 0 speedgoat_test_SN5659_R2021b_CM_double -1.7E+308 1.7E+308 /end CHARACTERISTIC
/begin CHARACTERISTIC speedgoat_test_SN5659__cal_impl.Decode2_P16_m "" VALUE 0x008D9660 Scalar_FLOAT64_IEEE 0 speedgoat_test_SN5659_R2021b_CM_double -1.7E+308 1.7E+308 /end CHARACTERISTIC
/begin CHARACTERISTIC speedgoat_test_SN5659__cal_impl.Decode2_P16_n "" VALUE 0x008DAA28 Scalar_FLOAT64_IEEE 0 speedgoat_test_SN5659_R2021b_CM_double -1.7E+308 1.7E+308 /end CHARACTERISTIC
/begin CHARACTERISTIC speedgoat_test_SN5659__cal_impl.Decode2_P1_c "" VALUE 0x008DB5E8 Scalar_FLOAT64_IEEE 0 speedgoat_test_SN5659_R2021b_CM_double -1.7E+308 1.7E+308 /end CHARACTERISTIC
/begin CHARACTERISTIC speedgoat_test_SN5659__cal_impl.Decode2_P1_d "" VALUE 0x008D8E58 Scalar_FLOAT64_IEEE 0 speedgoat_test_SN5659_R2021b_CM_double -1.7E+308 1.7E+308 /end CHARACTERISTIC
/begin CHARACTERISTIC speedgoat_test_SN5659__cal_impl.Decode2_P1_e "" VALUE 0x008D9B88 Scalar_FLOAT64_IEEE 0 speedgoat_test_SN5659_R2021b_CM_double -1.7E+308 1.7E+308 /end CHARACTERISTIC
/begin CHARACTERISTIC speedgoat_test_SN5659__cal_impl.Decode2_P1_g "" VALUE 0x008D94F0 Scalar_FLOAT64_IEEE 0 speedgoat_test_SN5659_R2021b_CM_double -1.7E+308 1.7E+308 /end CHARACTERISTIC
/begin CHARACTERISTIC speedgoat_test_SN5659__cal_impl.Decode2_P1_h "" VALUE 0x008DA8B8 Scalar_FLOAT64_IEEE 0 speedgoat_test_SN5659_R2021b_CM_double -1.7E+308 1.7E+308 /end CHARACTERISTIC
/begin CHARACTERISTIC speedgoat_test_SN5659__cal_impl.Decode2_P1_i "" VALUE 0x008DBC80 Scalar_FLOAT64_IEEE 0 speedgoat_test_SN5659_R2021b_CM_double -1.7E+308 1.7E+308 /end CHARACTERISTIC
/begin CHARACTERISTIC speedgoat_test_SN5659__cal_impl.Decode2_P1_o "" VALUE 0x008DAF50 Scalar_FLOAT64_IEEE 0 speedgoat_test_SN5659_R2021b_CM_double -1.7E+308 1.7E+308 /end CHARACTERISTIC
/begin CHARACTERISTIC speedgoat_test_SN5659__cal_impl.Decode2_P1_p "" VALUE 0x008DC318 Scalar_FLOAT64_IEEE 0 speedgoat_test_SN5659_R2021b_CM_double -1.7E+308 1.7E+308 /end CHARACTERISTIC
/begin CHARACTERISTIC speedgoat_test_SN5659__cal_impl.Decode2_P2 "" VALUE 0x008D8140 Scalar_FLOAT64_IEEE 0 speedgoat_test_SN5659_R2021b_CM_double -1.7E+308 1.7E+308 /end CHARACTERISTIC
/begin CHARACTERISTIC speedgoat_test_SN5659__cal_impl.Decode2_P2_e "" VALUE 0x008D9508 Scalar_FLOAT64_IEEE 0 speedgoat_test_SN5659_R2021b_CM_double -1.7E+308 1.7E+308 /end CHARACTERISTIC
/begin CHARACTERISTIC speedgoat_test_SN5659__cal_impl.Decode2_P2_ef "" VALUE 0x008DBC98 Scalar_FLOAT64_IEEE 0 speedgoat_test_SN5659_R2021b_CM_double -1.7E+308 1.7E+308 /end CHARACTERISTIC
/begin CHARACTERISTIC speedgoat_test_SN5659__cal_impl.Decode2_P2_ex "" VALUE 0x008DAF68 Scalar_FLOAT64_IEEE 0 speedgoat_test_SN5659_R2021b_CM_double -1.7E+308 1.7E+308 /end CHARACTERISTIC
/begin CHARACTERISTIC speedgoat_test_SN5659__cal_impl.Decode2_P2_h "" VALUE 0x008DA8D0 Scalar_FLOAT64_IEEE 0 speedgoat_test_SN5659_R2021b_CM_double -1.7E+308 1.7E+308 /end CHARACTERISTIC
/begin CHARACTERISTIC speedgoat_test_SN5659__cal_impl.Decode2_P2_j "" VALUE 0x008D9BA0 Scalar_FLOAT64_IEEE 0 speedgoat_test_SN5659_R2021b_CM_double -1.7E+308 1.7E+308 /end CHARACTERISTIC
/begin CHARACTERISTIC speedgoat_test_SN5659__cal_impl.Decode2_P2_k "" VALUE 0x008DB600 Scalar_FLOAT64_IEEE 0 speedgoat_test_SN5659_R2021b_CM_double -1.7E+308 1.7E+308 /end CHARACTERISTIC
/begin CHARACTERISTIC speedgoat_test_SN5659__cal_impl.Decode2_P2_kc "" VALUE 0x008DC330 Scalar_FLOAT64_IEEE 0 speedgoat_test_SN5659_R2021b_CM_double -1.7E+308 1.7E+308 /end CHARACTERISTIC
/begin CHARACTERISTIC speedgoat_test_SN5659__cal_impl.Decode2_P2_m "" VALUE 0x008D8E70 Scalar_FLOAT64_IEEE 0 speedgoat_test_SN5659_R2021b_CM_double -1.7E+308 1.7E+308 /end CHARACTERISTIC
/begin CHARACTERISTIC speedgoat_test_SN5659__cal_impl.Decode2_P3 "" VALUE 0x008D8158 Scalar_FLOAT64_IEEE 0 speedgoat_test_SN5659_R2021b_CM_double -1.7E+308 1.7E+308 /end CHARACTERISTIC
/begin CHARACTERISTIC speedgoat_test_SN5659__cal_impl.Decode2_P3_a "" VALUE 0x008D8E88 Scalar_FLOAT64_IEEE 0 speedgoat_test_SN5659_R2021b_CM_double -1.7E+308 1.7E+308 /end CHARACTERISTIC
/begin CHARACTERISTIC speedgoat_test_SN5659__cal_impl.Decode2_P3_b "" VALUE 0x008DB618 Scalar_FLOAT64_IEEE 0 speedgoat_test_SN5659_R2021b_CM_double -1.7E+308 1.7E+308 /end CHARACTERISTIC
/begin CHARACTERISTIC speedgoat_test_SN5659__cal_impl.Decode2_P3_c "" VALUE 0x008DBCB0 Scalar_FLOAT64_IEEE 0 speedgoat_test_SN5659_R2021b_CM_double -1.7E+308 1.7E+308 /end CHARACTERISTIC
/begin CHARACTERISTIC speedgoat_test_SN5659__cal_impl.Decode2_P3_d "" VALUE 0x008DA8E8 Scalar_FLOAT64_IEEE 0 speedgoat_test_SN5659_R2021b_CM_double -1.7E+308 1.7E+308 /end CHARACTERISTIC
/begin CHARACTERISTIC speedgoat_test_SN5659__cal_impl.Decode2_P3_e "" VALUE 0x008D9520 Scalar_FLOAT64_IEEE 0 speedgoat_test_SN5659_R2021b_CM_double -1.7E+308 1.7E+308 /end CHARACTERISTIC
/begin CHARACTERISTIC speedgoat_test_SN5659__cal_impl.Decode2_P3_g "" VALUE 0x008DAF80 Scalar_FLOAT64_IEEE 0 speedgoat_test_SN5659_R2021b_CM_double -1.7E+308 1.7E+308 /end CHARACTERISTIC
/begin CHARACTERISTIC speedgoat_test_SN5659__cal_impl.Decode2_P3_i "" VALUE 0x008DC348 Scalar_FLOAT64_IEEE 0 speedgoat_test_SN5659_R2021b_CM_double -1.7E+308 1.7E+308 /end CHARACTERISTIC
/begin CHARACTERISTIC speedgoat_test_SN5659__cal_impl.Decode2_P3_k "" VALUE 0x008D9BB8 Scalar_FLOAT64_IEEE 0 speedgoat_test_SN5659_R2021b_CM_double -1.7E+308 1.7E+308 /end CHARACTERISTIC
/begin CHARACTERISTIC speedgoat_test_SN5659__cal_impl.Decode2_P4 "" VALUE 0x008D8170 Scalar_FLOAT64_IEEE 0 speedgoat_test_SN5659_R2021b_CM_double -1.7E+308 1.7E+308 /end CHARACTERISTIC
/begin CHARACTERISTIC speedgoat_test_SN5659__cal_impl.Decode2_P4_b "" VALUE 0x008DC360 Scalar_FLOAT64_IEEE 0 speedgoat_test_SN5659_R2021b_CM_double -1.7E+308 1.7E+308 /end CHARACTERISTIC
/begin CHARACTERISTIC speedgoat_test_SN5659__cal_impl.Decode2_P4_c "" VALUE 0x008D9BD0 Scalar_FLOAT64_IEEE 0 speedgoat_test_SN5659_R2021b_CM_double -1.7E+308 1.7E+308 /end CHARACTERISTIC
/begin CHARACTERISTIC speedgoat_test_SN5659__cal_impl.Decode2_P4_e "" VALUE 0x008DBCC8 Scalar_FLOAT64_IEEE 0 speedgoat_test_SN5659_R2021b_CM_double -1.7E+308 1.7E+308 /end CHARACTERISTIC
/begin CHARACTERISTIC speedgoat_test_SN5659__cal_impl.Decode2_P4_f "" VALUE 0x008DA900 Scalar_FLOAT64_IEEE 0 speedgoat_test_SN5659_R2021b_CM_double -1.7E+308 1.7E+308 /end CHARACTERISTIC
/begin CHARACTERISTIC speedgoat_test_SN5659__cal_impl.Decode2_P4_g "" VALUE 0x008D8EA0 Scalar_FLOAT64_IEEE 0 speedgoat_test_SN5659_R2021b_CM_double -1.7E+308 1.7E+308 /end CHARACTERISTIC
/begin CHARACTERISTIC speedgoat_test_SN5659__cal_impl.Decode2_P4_j "" VALUE 0x008DAF98 Scalar_FLOAT64_IEEE 0 speedgoat_test_SN5659_R2021b_CM_double -1.7E+308 1.7E+308 /end CHARACTERISTIC
/begin CHARACTERISTIC speedgoat_test_SN5659__cal_impl.Decode2_P4_l "" VALUE 0x008D9538 Scalar_FLOAT64_IEEE 0 speedgoat_test_SN5659_R2021b_CM_double -1.7E+308 1.7E+308 /end CHARACTERISTIC
/begin CHARACTERISTIC speedgoat_test_SN5659__cal_impl.Decode2_P4_o "" VALUE 0x008DB630 Scalar_FLOAT64_IEEE 0 speedgoat_test_SN5659_R2021b_CM_double -1.7E+308 1.7E+308 /end CHARACTERISTIC
/begin CHARACTERISTIC speedgoat_test_SN5659__cal_impl.Decode2_P5 "" VALUE 0x008D8188 Scalar_FLOAT64_IEEE 0 speedgoat_test_SN5659_R2021b_CM_double -1.7E+308 1.7E+308 /end CHARACTERISTIC
/begin CHARACTERISTIC speedgoat_test_SN5659__cal_impl.Decode2_P5_c "" VALUE 0x008D9BE8 Scalar_FLOAT64_IEEE 0 speedgoat_test_SN5659_R2021b_CM_double -1.7E+308 1.7E+308 /end CHARACTERISTIC
/begin CHARACTERISTIC speedgoat_test_SN5659__cal_impl.Decode2_P5_d "" VALUE 0x008DC378 Scalar_FLOAT64_IEEE 0 speedgoat_test_SN5659_R2021b_CM_double -1.7E+308 1.7E+308 /end CHARACTERISTIC
/begin CHARACTERISTIC speedgoat_test_SN5659__cal_impl.Decode2_P5_e "" VALUE 0x008DAFB0 Scalar_FLOAT64_IEEE 0 speedgoat_test_SN5659_R2021b_CM_double -1.7E+308 1.7E+308 /end CHARACTERISTIC
/begin CHARACTERISTIC speedgoat_test_SN5659__cal_impl.Decode2_P5_f "" VALUE 0x008D9550 Scalar_FLOAT64_IEEE 0 speedgoat_test_SN5659_R2021b_CM_double -1.7E+308 1.7E+308 /end CHARACTERISTIC
/begin CHARACTERISTIC speedgoat_test_SN5659__cal_impl.Decode2_P5_g "" VALUE 0x008D8EB8 Scalar_FLOAT64_IEEE 0 speedgoat_test_SN5659_R2021b_CM_double -1.7E+308 1.7E+308 /end CHARACTERISTIC
/begin CHARACTERISTIC speedgoat_test_SN5659__cal_impl.Decode2_P5_gd "" VALUE 0x008DA918 Scalar_FLOAT64_IEEE 0 speedgoat_test_SN5659_R2021b_CM_double -1.7E+308 1.7E+308 /end CHARACTERISTIC
/begin CHARACTERISTIC speedgoat_test_SN5659__cal_impl.Decode2_P5_j "" VALUE 0x008DB648 Scalar_FLOAT64_IEEE 0 speedgoat_test_SN5659_R2021b_CM_double -1.7E+308 1.7E+308 /end CHARACTERISTIC
/begin CHARACTERISTIC speedgoat_test_SN5659__cal_impl.Decode2_P5_l "" VALUE 0x008DBCE0 Scalar_FLOAT64_IEEE 0 speedgoat_test_SN5659_R2021b_CM_double -1.7E+308 1.7E+308 /end CHARACTERISTIC
/begin CHARACTERISTIC speedgoat_test_SN5659__cal_impl.Decode2_P6 "" VALUE 0x008D81A0 Scalar_FLOAT64_IEEE 0 speedgoat_test_SN5659_R2021b_CM_double -1.7E+308 1.7E+308 /end CHARACTERISTIC
/begin CHARACTERISTIC speedgoat_test_SN5659__cal_impl.Decode2_P6_h "" VALUE 0x008DB660 Scalar_FLOAT64_IEEE 0 speedgoat_test_SN5659_R2021b_CM_double -1.7E+308 1.7E+308 /end CHARACTERISTIC
/begin CHARACTERISTIC speedgoat_test_SN5659__cal_impl.Decode2_P6_l "" VALUE 0x008D8ED0 Scalar_FLOAT64_IEEE 0 speedgoat_test_SN5659_R2021b_CM_double -1.7E+308 1.7E+308 /end CHARACTERISTIC
/begin CHARACTERISTIC speedgoat_test_SN5659__cal_impl.Decode2_P6_m "" VALUE 0x008DC390 Scalar_FLOAT64_IEEE 0 speedgoat_test_SN5659_R2021b_CM_double -1.7E+308 1.7E+308 /end CHARACTERISTIC
/begin CHARACTERISTIC speedgoat_test_SN5659__cal_impl.Decode2_P6_n "" VALUE 0x008DBCF8 Scalar_FLOAT64_IEEE 0 speedgoat_test_SN5659_R2021b_CM_double -1.7E+308 1.7E+308 /end CHARACTERISTIC
/begin CHARACTERISTIC speedgoat_test_SN5659__cal_impl.Decode2_P6_o "" VALUE 0x008D9568 Scalar_FLOAT64_IEEE 0 speedgoat_test_SN5659_R2021b_CM_double -1.7E+308 1.7E+308 /end CHARACTERISTIC
/begin CHARACTERISTIC speedgoat_test_SN5659__cal_impl.Decode2_P6_oa "" VALUE 0x008DA930 Scalar_FLOAT64_IEEE 0 speedgoat_test_SN5659_R2021b_CM_double -1.7E+308 1.7E+308 /end CHARACTERISTIC
/begin CHARACTERISTIC speedgoat_test_SN5659__cal_impl.Decode2_P6_p "" VALUE 0x008D9C00 Scalar_FLOAT64_IEEE 0 speedgoat_test_SN5659_R2021b_CM_double -1.7E+308 1.7E+308 /end CHARACTERISTIC
/begin CHARACTERISTIC speedgoat_test_SN5659__cal_impl.Decode2_P6_pp "" VALUE 0x008DAFC8 Scalar_FLOAT64_IEEE 0 speedgoat_test_SN5659_R2021b_CM_double -1.7E+308 1.7E+308 /end CHARACTERISTIC
/begin CHARACTERISTIC speedgoat_test_SN5659__cal_impl.Decode2_P7 "" VALUE 0x008D81B8 Scalar_FLOAT64_IEEE 0 speedgoat_test_SN5659_R2021b_CM_double -1.7E+308 1.7E+308 /end CHARACTERISTIC
/begin CHARACTERISTIC speedgoat_test_SN5659__cal_impl.Decode2_P7_g "" VALUE 0x008D8EE8 Scalar_FLOAT64_IEEE 0 speedgoat_test_SN5659_R2021b_CM_double -1.7E+308 1.7E+308 /end CHARACTERISTIC
/begin CHARACTERISTIC speedgoat_test_SN5659__cal_impl.Decode2_P7_h "" VALUE 0x008DC3A8 Scalar_FLOAT64_IEEE 0 speedgoat_test_SN5659_R2021b_CM_double -1.7E+308 1.7E+308 /end CHARACTERISTIC
/begin CHARACTERISTIC speedgoat_test_SN5659__cal_impl.Decode2_P7_j "" VALUE 0x008DA948 Scalar_FLOAT64_IEEE 0 speedgoat_test_SN5659_R2021b_CM_double -1.7E+308 1.7E+308 /end CHARACTERISTIC
/begin CHARACTERISTIC speedgoat_test_SN5659__cal_impl.Decode2_P7_ja "" VALUE 0x008DBD10 Scalar_FLOAT64_IEEE 0 speedgoat_test_SN5659_R2021b_CM_double -1.7E+308 1.7E+308 /end CHARACTERISTIC
/begin CHARACTERISTIC speedgoat_test_SN5659__cal_impl.Decode2_P7_jq "" VALUE 0x008DB678 Scalar_FLOAT64_IEEE 0 speedgoat_test_SN5659_R2021b_CM_double -1.7E+308 1.7E+308 /end CHARACTERISTIC
/begin CHARACTERISTIC speedgoat_test_SN5659__cal_impl.Decode2_P7_m "" VALUE 0x008D9580 Scalar_FLOAT64_IEEE 0 speedgoat_test_SN5659_R2021b_CM_double -1.7E+308 1.7E+308 /end CHARACTERISTIC
/begin CHARACTERISTIC speedgoat_test_SN5659__cal_impl.Decode2_P7_mb "" VALUE 0x008DAFE0 Scalar_FLOAT64_IEEE 0 speedgoat_test_SN5659_R2021b_CM_double -1.7E+308 1.7E+308 /end CHARACTERISTIC
/begin CHARACTERISTIC speedgoat_test_SN5659__cal_impl.Decode2_P7_o "" VALUE 0x008D9C18 Scalar_FLOAT64_IEEE 0 speedgoat_test_SN5659_R2021b_CM_double -1.7E+308 1.7E+308 /end CHARACTERISTIC
/begin CHARACTERISTIC speedgoat_test_SN5659__cal_impl.Decode2_P8 "" VALUE 0x008D81D0 Scalar_FLOAT64_IEEE 0 speedgoat_test_SN5659_R2021b_CM_double -1.7E+308 1.7E+308 /end CHARACTERISTIC
/begin CHARACTERISTIC speedgoat_test_SN5659__cal_impl.Decode2_P8_b "" VALUE 0x008D9C30 Scalar_FLOAT64_IEEE 0 speedgoat_test_SN5659_R2021b_CM_double -1.7E+308 1.7E+308 /end CHARACTERISTIC
/begin CHARACTERISTIC speedgoat_test_SN5659__cal_impl.Decode2_P8_bd "" VALUE 0x008DC3C0 Scalar_FLOAT64_IEEE 0 speedgoat_test_SN5659_R2021b_CM_double -1.7E+308 1.7E+308 /end CHARACTERISTIC
/begin CHARACTERISTIC speedgoat_test_SN5659__cal_impl.Decode2_P8_c "" VALUE 0x008DAFF8 Scalar_FLOAT64_IEEE 0 speedgoat_test_SN5659_R2021b_CM_double -1.7E+308 1.7E+308 /end CHARACTERISTIC
/begin CHARACTERISTIC speedgoat_test_SN5659__cal_impl.Decode2_P8_f "" VALUE 0x008D9598 Scalar_FLOAT64_IEEE 0 speedgoat_test_SN5659_R2021b_CM_double -1.7E+308 1.7E+308 /end CHARACTERISTIC
/begin CHARACTERISTIC speedgoat_test_SN5659__cal_impl.Decode2_P8_g "" VALUE 0x008DBD28 Scalar_FLOAT64_IEEE 0 speedgoat_test_SN5659_R2021b_CM_double -1.7E+308 1.7E+308 /end CHARACTERISTIC
/begin CHARACTERISTIC speedgoat_test_SN5659__cal_impl.Decode2_P8_h "" VALUE 0x008DA960 Scalar_FLOAT64_IEEE 0 speedgoat_test_SN5659_R2021b_CM_double -1.7E+308 1.7E+308 /end CHARACTERISTIC
/begin CHARACTERISTIC speedgoat_test_SN5659__cal_impl.Decode2_P8_j "" VALUE 0x008DB690 Scalar_FLOAT64_IEEE 0 speedgoat_test_SN5659_R2021b_CM_double -1.7E+308 1.7E+308 /end CHARACTERISTIC
/begin CHARACTERISTIC speedgoat_test_SN5659__cal_impl.Decode2_P8_l "" VALUE 0x008D8F00 Scalar_FLOAT64_IEEE 0 speedgoat_test_SN5659_R2021b_CM_double -1.7E+308 1.7E+308 /end CHARACTERISTIC
/begin CHARACTERISTIC speedgoat_test_SN5659__cal_impl.Decode2_P9 "" VALUE 0x008D81E8 Scalar_FLOAT64_IEEE 0 speedgoat_test_SN5659_R2021b_CM_double -1.7E+308 1.7E+308 /end CHARACTERISTIC
/begin CHARACTERISTIC speedgoat_test_SN5659__cal_impl.Decode2_P9_c "" VALUE 0x008DB6A8 Scalar_FLOAT64_IEEE 0 speedgoat_test_SN5659_R2021b_CM_double -1.7E+308 1.7E+308 /end CHARACTERISTIC
/begin CHARACTERISTIC speedgoat_test_SN5659__cal_impl.Decode2_P9_e "" VALUE 0x008DBD40 Scalar_FLOAT64_IEEE 0 speedgoat_test_SN5659_R2021b_CM_double -1.7E+308 1.7E+308 /end CHARACTERISTIC
/begin CHARACTERISTIC speedgoat_test_SN5659__cal_impl.Decode2_P9_g "" VALUE 0x008D9C48 Scalar_FLOAT64_IEEE 0 speedgoat_test_SN5659_R2021b_CM_double -1.7E+308 1.7E+308 /end CHARACTERISTIC
/begin CHARACTERISTIC speedgoat_test_SN5659__cal_impl.Decode2_P9_l "" VALUE 0x008D8F18 Scalar_FLOAT64_IEEE 0 speedgoat_test_SN5659_R2021b_CM_double -1.7E+308 1.7E+308 /end CHARACTERISTIC
/begin CHARACTERISTIC speedgoat_test_SN5659__cal_impl.Decode2_P9_lp "" VALUE 0x008DC3D8 Scalar_FLOAT64_IEEE 0 speedgoat_test_SN5659_R2021b_CM_double -1.7E+308 1.7E+308 /end CHARACTERISTIC
/begin CHARACTERISTIC speedgoat_test_SN5659__cal_impl.Decode2_P9_n "" VALUE 0x008DB010 Scalar_FLOAT64_IEEE 0 speedgoat_test_SN5659_R2021b_CM_double -1.7E+308 1.7E+308 /end CHARACTERISTIC
/begin CHARACTERISTIC speedgoat_test_SN5659__cal_impl.Decode2_P9_p "" VALUE 0x008D95B0 Scalar_FLOAT64_IEEE 0 speedgoat_test_SN5659_R2021b_CM_double -1.7E+308 1.7E+308 /end CHARACTERISTIC
/begin CHARACTERISTIC speedgoat_test_SN5659__cal_impl.Decode2_P9_pb "" VALUE 0x008DA978 Scalar_FLOAT64_IEEE 0 speedgoat_test_SN5659_R2021b_CM_double -1.7E+308 1.7E+308 /end CHARACTERISTIC
/begin CHARACTERISTIC speedgoat_test_SN5659__cal_impl.Decode3_P10_a "" VAL_BLK 0x008D8388 Scalar_FLOAT64_IEEE 0 speedgoat_test_SN5659_R2021b_CM_double -1.7E+308 1.7E+308 MATRIX_DIM 2 1 /end CHARACTERISTIC
/begin CHARACTERISTIC speedgoat_test_SN5659__cal_impl.Decode3_P10_b "" VAL_BLK 0x008DA480 Scalar_FLOAT64_IEEE 0 speedgoat_test_SN5659_R2021b_CM_double -1.7E+308 1.7E+308 MATRIX_DIM 2 1 /end CHARACTERISTIC
/begin CHARACTERISTIC speedgoat_test_SN5659__cal_impl.Decode3_P10_c "" VAL_BLK 0x008DAB18 Scalar_FLOAT64_IEEE 0 speedgoat_test_SN5659_R2021b_CM_double -1.7E+308 1.7E+308 MATRIX_DIM 2 1 /end CHARACTERISTIC
/begin CHARACTERISTIC speedgoat_test_SN5659__cal_impl.Decode3_P10_f "" VAL_BLK 0x008D9750 Scalar_FLOAT64_IEEE 0 speedgoat_test_SN5659_R2021b_CM_double -1.7E+308 1.7E+308 MATRIX_DIM 2 1 /end CHARACTERISTIC
/begin CHARACTERISTIC speedgoat_test_SN5659__cal_impl.Decode3_P10_i "" VAL_BLK 0x008DBEE0 Scalar_FLOAT64_IEEE 0 speedgoat_test_SN5659_R2021b_CM_double -1.7E+308 1.7E+308 MATRIX_DIM 2 1 /end CHARACTERISTIC
/begin CHARACTERISTIC speedgoat_test_SN5659__cal_impl.Decode3_P10_k5 "" VAL_BLK 0x008DCC10 Scalar_FLOAT64_IEEE 0 speedgoat_test_SN5659_R2021b_CM_double -1.7E+308 1.7E+308 MATRIX_DIM 2 1 /end CHARACTERISTIC
/begin CHARACTERISTIC speedgoat_test_SN5659__cal_impl.Decode3_P10_l "" VAL_BLK 0x008D90B8 Scalar_FLOAT64_IEEE 0 speedgoat_test_SN5659_R2021b_CM_double -1.7E+308 1.7E+308 MATRIX_DIM 2 1 /end CHARACTERISTIC
/begin CHARACTERISTIC speedgoat_test_SN5659__cal_impl.Decode3_P10_m "" VAL_BLK 0x008DB848 Scalar_FLOAT64_IEEE 0 speedgoat_test_SN5659_R2021b_CM_double -1.7E+308 1.7E+308 MATRIX_DIM 2 1 /end CHARACTERISTIC
/begin CHARACTERISTIC speedgoat_test_SN5659__cal_impl.Decode3_P10_n "" VAL_BLK 0x008DB1B0 Scalar_FLOAT64_IEEE 0 speedgoat_test_SN5659_R2021b_CM_double -1.7E+308 1.7E+308 MATRIX_DIM 2 1 /end CHARACTERISTIC
/begin CHARACTERISTIC speedgoat_test_SN5659__cal_impl.Decode3_P10_o "" VAL_BLK 0x008D9DE8 Scalar_FLOAT64_IEEE 0 speedgoat_test_SN5659_R2021b_CM_double -1.7E+308 1.7E+308 MATRIX_DIM 2 1 /end CHARACTERISTIC
/begin CHARACTERISTIC speedgoat_test_SN5659__cal_impl.Decode3_P10_oo "" VAL_BLK 0x008DC578 Scalar_FLOAT64_IEEE 0 speedgoat_test_SN5659_R2021b_CM_double -1.7E+308 1.7E+308 MATRIX_DIM 2 1 /end CHARACTERISTIC
/begin CHARACTERISTIC speedgoat_test_SN5659__cal_impl.Decode3_P11_a "" VALUE 0x008DA4A0 Scalar_FLOAT64_IEEE 0 speedgoat_test_SN5659_R2021b_CM_double -1.7E+308 1.7E+308 /end CHARACTERISTIC
/begin CHARACTERISTIC speedgoat_test_SN5659__cal_impl.Decode3_P11_b "" VALUE 0x008D83A8 Scalar_FLOAT64_IEEE 0 speedgoat_test_SN5659_R2021b_CM_double -1.7E+308 1.7E+308 /end CHARACTERISTIC
/begin CHARACTERISTIC speedgoat_test_SN5659__cal_impl.Decode3_P11_bg "" VALUE 0x008DCC30 Scalar_FLOAT64_IEEE 0 speedgoat_test_SN5659_R2021b_CM_double -1.7E+308 1.7E+308 /end CHARACTERISTIC
/begin CHARACTERISTIC speedgoat_test_SN5659__cal_impl.Decode3_P11_bu "" VALUE 0x008DB868 Scalar_FLOAT64_IEEE 0 speedgoat_test_SN5659_R2021b_CM_double -1.7E+308 1.7E+308 /end CHARACTERISTIC
/begin CHARACTERISTIC speedgoat_test_SN5659__cal_impl.Decode3_P11_d "" VALUE 0x008DAB38 Scalar_FLOAT64_IEEE 0 speedgoat_test_SN5659_R2021b_CM_double -1.7E+308 1.7E+308 /end CHARACTERISTIC
/begin CHARACTERISTIC speedgoat_test_SN5659__cal_impl.Decode3_P11_h "" VALUE 0x008D9770 Scalar_FLOAT64_IEEE 0 speedgoat_test_SN5659_R2021b_CM_double -1.7E+308 1.7E+308 /end CHARACTERISTIC
/begin CHARACTERISTIC speedgoat_test_SN5659__cal_impl.Decode3_P11_i "" VALUE 0x008D90D8 Scalar_FLOAT64_IEEE 0 speedgoat_test_SN5659_R2021b_CM_double -1.7E+308 1.7E+308 /end CHARACTERISTIC
/begin CHARACTERISTIC speedgoat_test_SN5659__cal_impl.Decode3_P11_k "" VALUE 0x008D9E08 Scalar_FLOAT64_IEEE 0 speedgoat_test_SN5659_R2021b_CM_double -1.7E+308 1.7E+308 /end CHARACTERISTIC
/begin CHARACTERISTIC speedgoat_test_SN5659__cal_impl.Decode3_P11_k1 "" VALUE 0x008DB1D0 Scalar_FLOAT64_IEEE 0 speedgoat_test_SN5659_R2021b_CM_double -1.7E+308 1.7E+308 /end CHARACTERISTIC
/begin CHARACTERISTIC speedgoat_test_SN5659__cal_impl.Decode3_P11_m "" VALUE 0x008DBF00 Scalar_FLOAT64_IEEE 0 speedgoat_test_SN5659_R2021b_CM_double -1.7E+308 1.7E+308 /end CHARACTERISTIC
/begin CHARACTERISTIC speedgoat_test_SN5659__cal_impl.Decode3_P11_mj "" VALUE 0x008DC598 Scalar_FLOAT64_IEEE 0 speedgoat_test_SN5659_R2021b_CM_double -1.7E+308 1.7E+308 /end CHARACTERISTIC
/begin CHARACTERISTIC speedgoat_test_SN5659__cal_impl.Decode3_P12_a "" VALUE 0x008D90F0 Scalar_FLOAT64_IEEE 0 speedgoat_test_SN5659_R2021b_CM_double -1.7E+308 1.7E+308 /end CHARACTERISTIC
/begin CHARACTERISTIC speedgoat_test_SN5659__cal_impl.Decode3_P12_b "" VALUE 0x008DAB50 Scalar_FLOAT64_IEEE 0 speedgoat_test_SN5659_R2021b_CM_double -1.7E+308 1.7E+308 /end CHARACTERISTIC
/begin CHARACTERISTIC speedgoat_test_SN5659__cal_impl.Decode3_P12_f "" VALUE 0x008DB880 Scalar_FLOAT64_IEEE 0 speedgoat_test_SN5659_R2021b_CM_double -1.7E+308 1.7E+308 /end CHARACTERISTIC
/begin CHARACTERISTIC speedgoat_test_SN5659__cal_impl.Decode3_P12_k "" VALUE 0x008D9788 Scalar_FLOAT64_IEEE 0 speedgoat_test_SN5659_R2021b_CM_double -1.7E+308 1.7E+308 /end CHARACTERISTIC
/begin CHARACTERISTIC speedgoat_test_SN5659__cal_impl.Decode3_P12_ku "" VALUE 0x008D9E20 Scalar_FLOAT64_IEEE 0 speedgoat_test_SN5659_R2021b_CM_double -1.7E+308 1.7E+308 /end CHARACTERISTIC
/begin CHARACTERISTIC speedgoat_test_SN5659__cal_impl.Decode3_P12_kuc "" VALUE 0x008DC5B0 Scalar_FLOAT64_IEEE 0 speedgoat_test_SN5659_R2021b_CM_double -1.7E+308 1.7E+308 /end CHARACTERISTIC
/begin CHARACTERISTIC speedgoat_test_SN5659__cal_impl.Decode3_P12_l "" VALUE 0x008DB1E8 Scalar_FLOAT64_IEEE 0 speedgoat_test_SN5659_R2021b_CM_double -1.7E+308 1.7E+308 /end CHARACTERISTIC
/begin CHARACTERISTIC speedgoat_test_SN5659__cal_impl.Decode3_P12_ls "" VALUE 0x008DBF18 Scalar_FLOAT64_IEEE 0 speedgoat_test_SN5659_R2021b_CM_double -1.7E+308 1.7E+308 /end CHARACTERISTIC
/begin CHARACTERISTIC speedgoat_test_SN5659__cal_impl.Decode3_P12_p "" VALUE 0x008D83C0 Scalar_FLOAT64_IEEE 0 speedgoat_test_SN5659_R2021b_CM_double -1.7E+308 1.7E+308 /end CHARACTERISTIC
/begin CHARACTERISTIC speedgoat_test_SN5659__cal_impl.Decode3_P12_pa "" VALUE 0x008DCC48 Scalar_FLOAT64_IEEE 0 speedgoat_test_SN5659_R2021b_CM_double -1.7E+308 1.7E+308 /end CHARACTERISTIC
/begin CHARACTERISTIC speedgoat_test_SN5659__cal_impl.Decode3_P12_pk "" VALUE 0x008DA4B8 Scalar_FLOAT64_IEEE 0 speedgoat_test_SN5659_R2021b_CM_double -1.7E+308 1.7E+308 /end CHARACTERISTIC
/begin CHARACTERISTIC speedgoat_test_SN5659__cal_impl.Decode3_P13_b "" VALUE 0x008D9108 Scalar_FLOAT64_IEEE 0 speedgoat_test_SN5659_R2021b_CM_double -1.7E+308 1.7E+308 /end CHARACTERISTIC
/begin CHARACTERISTIC speedgoat_test_SN5659__cal_impl.Decode3_P13_d "" VALUE 0x008D83D8 Scalar_FLOAT64_IEEE 0 speedgoat_test_SN5659_R2021b_CM_double -1.7E+308 1.7E+308 /end CHARACTERISTIC
/begin CHARACTERISTIC speedgoat_test_SN5659__cal_impl.Decode3_P13_dz "" VALUE 0x008DA4D0 Scalar_FLOAT64_IEEE 0 speedgoat_test_SN5659_R2021b_CM_double -1.7E+308 1.7E+308 /end CHARACTERISTIC
/begin CHARACTERISTIC speedgoat_test_SN5659__cal_impl.Decode3_P13_e "" VALUE 0x008D9E38 Scalar_FLOAT64_IEEE 0 speedgoat_test_SN5659_R2021b_CM_double -1.7E+308 1.7E+308 /end CHARACTERISTIC
/begin CHARACTERISTIC speedgoat_test_SN5659__cal_impl.Decode3_P13_ez "" VALUE 0x008DBF30 Scalar_FLOAT64_IEEE 0 speedgoat_test_SN5659_R2021b_CM_double -1.7E+308 1.7E+308 /end CHARACTERISTIC
/begin CHARACTERISTIC speedgoat_test_SN5659__cal_impl.Decode3_P13_f "" VALUE 0x008DB898 Scalar_FLOAT64_IEEE 0 speedgoat_test_SN5659_R2021b_CM_double -1.7E+308 1.7E+308 /end CHARACTERISTIC
/begin CHARACTERISTIC speedgoat_test_SN5659__cal_impl.Decode3_P13_i "" VALUE 0x008DAB68 Scalar_FLOAT64_IEEE 0 speedgoat_test_SN5659_R2021b_CM_double -1.7E+308 1.7E+308 /end CHARACTERISTIC
/begin CHARACTERISTIC speedgoat_test_SN5659__cal_impl.Decode3_P13_k "" VALUE 0x008DCC60 Scalar_FLOAT64_IEEE 0 speedgoat_test_SN5659_R2021b_CM_double -1.7E+308 1.7E+308 /end CHARACTERISTIC
/begin CHARACTERISTIC speedgoat_test_SN5659__cal_impl.Decode3_P13_l "" VALUE 0x008DB200 Scalar_FLOAT64_IEEE 0 speedgoat_test_SN5659_R2021b_CM_double -1.7E+308 1.7E+308 /end CHARACTERISTIC
/begin CHARACTERISTIC speedgoat_test_SN5659__cal_impl.Decode3_P13_m "" VALUE 0x008D97A0 Scalar_FLOAT64_IEEE 0 speedgoat_test_SN5659_R2021b_CM_double -1.7E+308 1.7E+308 /end CHARACTERISTIC
/begin CHARACTERISTIC speedgoat_test_SN5659__cal_impl.Decode3_P13_my "" VALUE 0x008DC5C8 Scalar_FLOAT64_IEEE 0 speedgoat_test_SN5659_R2021b_CM_double -1.7E+308 1.7E+308 /end CHARACTERISTIC
/begin CHARACTERISTIC speedgoat_test_SN5659__cal_impl.Decode3_P14_c "" VALUE 0x008DC5E0 Scalar_FLOAT64_IEEE 0 speedgoat_test_SN5659_R2021b_CM_double -1.7E+308 1.7E+308 /end CHARACTERISTIC
/begin CHARACTERISTIC speedgoat_test_SN5659__cal_impl.Decode3_P14_f "" VALUE 0x008DA4E8 Scalar_FLOAT64_IEEE 0 speedgoat_test_SN5659_R2021b_CM_double -1.7E+308 1.7E+308 /end CHARACTERISTIC
/begin CHARACTERISTIC speedgoat_test_SN5659__cal_impl.Decode3_P14_fx "" VALUE 0x008DB218 Scalar_FLOAT64_IEEE 0 speedgoat_test_SN5659_R2021b_CM_double -1.7E+308 1.7E+308 /end CHARACTERISTIC
/begin CHARACTERISTIC speedgoat_test_SN5659__cal_impl.Decode3_P14_j "" VALUE 0x008D83F0 Scalar_FLOAT64_IEEE 0 speedgoat_test_SN5659_R2021b_CM_double -1.7E+308 1.7E+308 /end CHARACTERISTIC
/begin CHARACTERISTIC speedgoat_test_SN5659__cal_impl.Decode3_P14_jy "" VALUE 0x008D9E50 Scalar_FLOAT64_IEEE 0 speedgoat_test_SN5659_R2021b_CM_double -1.7E+308 1.7E+308 /end CHARACTERISTIC
/begin CHARACTERISTIC speedgoat_test_SN5659__cal_impl.Decode3_P14_k "" VALUE 0x008DAB80 Scalar_FLOAT64_IEEE 0 speedgoat_test_SN5659_R2021b_CM_double -1.7E+308 1.7E+308 /end CHARACTERISTIC
/begin CHARACTERISTIC speedgoat_test_SN5659__cal_impl.Decode3_P14_l "" VALUE 0x008D97B8 Scalar_FLOAT64_IEEE 0 speedgoat_test_SN5659_R2021b_CM_double -1.7E+308 1.7E+308 /end CHARACTERISTIC
/begin CHARACTERISTIC speedgoat_test_SN5659__cal_impl.Decode3_P14_m "" VALUE 0x008DBF48 Scalar_FLOAT64_IEEE 0 speedgoat_test_SN5659_R2021b_CM_double -1.7E+308 1.7E+308 /end CHARACTERISTIC
/begin CHARACTERISTIC speedgoat_test_SN5659__cal_impl.Decode3_P14_n "" VALUE 0x008DB8B0 Scalar_FLOAT64_IEEE 0 speedgoat_test_SN5659_R2021b_CM_double -1.7E+308 1.7E+308 /end CHARACTERISTIC
/begin CHARACTERISTIC speedgoat_test_SN5659__cal_impl.Decode3_P14_nc "" VALUE 0x008DCC78 Scalar_FLOAT64_IEEE 0 speedgoat_test_SN5659_R2021b_CM_double -1.7E+308 1.7E+308 /end CHARACTERISTIC
/begin CHARACTERISTIC speedgoat_test_SN5659__cal_impl.Decode3_P14_px "" VALUE 0x008D9120 Scalar_FLOAT64_IEEE 0 speedgoat_test_SN5659_R2021b_CM_double -1.7E+308 1.7E+308 /end CHARACTERISTIC
/begin CHARACTERISTIC speedgoat_test_SN5659__cal_impl.Decode3_P15_b "" VALUE 0x008DB8C8 Scalar_FLOAT64_IEEE 0 speedgoat_test_SN5659_R2021b_CM_double -1.7E+308 1.7E+308 /end CHARACTERISTIC
/begin CHARACTERISTIC speedgoat_test_SN5659__cal_impl.Decode3_P15_d "" VALUE 0x008D8408 Scalar_FLOAT64_IEEE 0 speedgoat_test_SN5659_R2021b_CM_double -1.7E+308 1.7E+308 /end CHARACTERISTIC
/begin CHARACTERISTIC speedgoat_test_SN5659__cal_impl.Decode3_P15_e "" VALUE 0x008DA500 Scalar_FLOAT64_IEEE 0 speedgoat_test_SN5659_R2021b_CM_double -1.7E+308 1.7E+308 /end CHARACTERISTIC
/begin CHARACTERISTIC speedgoat_test_SN5659__cal_impl.Decode3_P15_h "" VALUE 0x008DBF60 Scalar_FLOAT64_IEEE 0 speedgoat_test_SN5659_R2021b_CM_double -1.7E+308 1.7E+308 /end CHARACTERISTIC
/begin CHARACTERISTIC speedgoat_test_SN5659__cal_impl.Decode3_P15_j "" VALUE 0x008D9138 Scalar_FLOAT64_IEEE 0 speedgoat_test_SN5659_R2021b_CM_double -1.7E+308 1.7E+308 /end CHARACTERISTIC
/begin CHARACTERISTIC speedgoat_test_SN5659__cal_impl.Decode3_P15_jx "" VALUE 0x008DAB98 Scalar_FLOAT64_IEEE 0 speedgoat_test_SN5659_R2021b_CM_double -1.7E+308 1.7E+308 /end CHARACTERISTIC
/begin CHARACTERISTIC speedgoat_test_SN5659__cal_impl.Decode3_P15_k "" VALUE 0x008DC5F8 Scalar_FLOAT64_IEEE 0 speedgoat_test_SN5659_R2021b_CM_double -1.7E+308 1.7E+308 /end CHARACTERISTIC
/begin CHARACTERISTIC speedgoat_test_SN5659__cal_impl.Decode3_P15_l "" VALUE 0x008D97D0 Scalar_FLOAT64_IEEE 0 speedgoat_test_SN5659_R2021b_CM_double -1.7E+308 1.7E+308 /end CHARACTERISTIC
/begin CHARACTERISTIC speedgoat_test_SN5659__cal_impl.Decode3_P15_l0 "" VALUE 0x008D9E68 Scalar_FLOAT64_IEEE 0 speedgoat_test_SN5659_R2021b_CM_double -1.7E+308 1.7E+308 /end CHARACTERISTIC
/begin CHARACTERISTIC speedgoat_test_SN5659__cal_impl.Decode3_P15_n "" VALUE 0x008DCC90 Scalar_FLOAT64_IEEE 0 speedgoat_test_SN5659_R2021b_CM_double -1.7E+308 1.7E+308 /end CHARACTERISTIC
/begin CHARACTERISTIC speedgoat_test_SN5659__cal_impl.Decode3_P15_p "" VALUE 0x008DB230 Scalar_FLOAT64_IEEE 0 speedgoat_test_SN5659_R2021b_CM_double -1.7E+308 1.7E+308 /end CHARACTERISTIC
/begin CHARACTERISTIC speedgoat_test_SN5659__cal_impl.Decode3_P16_b "" VALUE 0x008D8420 Scalar_FLOAT64_IEEE 0 speedgoat_test_SN5659_R2021b_CM_double -1.7E+308 1.7E+308 /end CHARACTERISTIC
/begin CHARACTERISTIC speedgoat_test_SN5659__cal_impl.Decode3_P16_b1 "" VALUE 0x008D9150 Scalar_FLOAT64_IEEE 0 speedgoat_test_SN5659_R2021b_CM_double -1.7E+308 1.7E+308 /end CHARACTERISTIC
/begin CHARACTERISTIC speedgoat_test_SN5659__cal_impl.Decode3_P16_e "" VALUE 0x008DA518 Scalar_FLOAT64_IEEE 0 speedgoat_test_SN5659_R2021b_CM_double -1.7E+308 1.7E+308 /end CHARACTERISTIC
/begin CHARACTERISTIC speedgoat_test_SN5659__cal_impl.Decode3_P16_f "" VALUE 0x008DABB0 Scalar_FLOAT64_IEEE 0 speedgoat_test_SN5659_R2021b_CM_double -1.7E+308 1.7E+308 /end CHARACTERISTIC
/begin CHARACTERISTIC speedgoat_test_SN5659__cal_impl.Decode3_P16_fl "" VALUE 0x008DB8E0 Scalar_FLOAT64_IEEE 0 speedgoat_test_SN5659_R2021b_CM_double -1.7E+308 1.7E+308 /end CHARACTERISTIC
/begin CHARACTERISTIC speedgoat_test_SN5659__cal_impl.Decode3_P16_g "" VALUE 0x008DBF78 Scalar_FLOAT64_IEEE 0 speedgoat_test_SN5659_R2021b_CM_double -1.7E+308 1.7E+308 /end CHARACTERISTIC
/begin CHARACTERISTIC speedgoat_test_SN5659__cal_impl.Decode3_P16_h "" VALUE 0x008D97E8 Scalar_FLOAT64_IEEE 0 speedgoat_test_SN5659_R2021b_CM_double -1.7E+308 1.7E+308 /end CHARACTERISTIC
/begin CHARACTERISTIC speedgoat_test_SN5659__cal_impl.Decode3_P16_hp "" VALUE 0x008D9E80 Scalar_FLOAT64_IEEE 0 speedgoat_test_SN5659_R2021b_CM_double -1.7E+308 1.7E+308 /end CHARACTERISTIC
/begin CHARACTERISTIC speedgoat_test_SN5659__cal_impl.Decode3_P16_i "" VALUE 0x008DCCA8 Scalar_FLOAT64_IEEE 0 speedgoat_test_SN5659_R2021b_CM_double -1.7E+308 1.7E+308 /end CHARACTERISTIC
/begin CHARACTERISTIC speedgoat_test_SN5659__cal_impl.Decode3_P16_o "" VALUE 0x008DB248 Scalar_FLOAT64_IEEE 0 speedgoat_test_SN5659_R2021b_CM_double -1.7E+308 1.7E+308 /end CHARACTERISTIC
/begin CHARACTERISTIC speedgoat_test_SN5659__cal_impl.Decode3_P16_p "" VALUE 0x008DC610 Scalar_FLOAT64_IEEE 0 speedgoat_test_SN5659_R2021b_CM_double -1.7E+308 1.7E+308 /end CHARACTERISTIC
/begin CHARACTERISTIC speedgoat_test_SN5659__cal_impl.Decode3_P1_a "" VALUE 0x008D82B0 Scalar_FLOAT64_IEEE 0 speedgoat_test_SN5659_R2021b_CM_double -1.7E+308 1.7E+308 /end CHARACTERISTIC
/begin CHARACTERISTIC speedgoat_test_SN5659__cal_impl.Decode3_P1_a1 "" VALUE 0x008D8FE0 Scalar_FLOAT64_IEEE 0 speedgoat_test_SN5659_R2021b_CM_double -1.7E+308 1.7E+308 /end CHARACTERISTIC
/begin CHARACTERISTIC speedgoat_test_SN5659__cal_impl.Decode3_P1_a1u "" VALUE 0x008DA3A8 Scalar_FLOAT64_IEEE 0 speedgoat_test_SN5659_R2021b_CM_double -1.7E+308 1.7E+308 /end CHARACTERISTIC
/begin CHARACTERISTIC speedgoat_test_SN5659__cal_impl.Decode3_P1_b "" VALUE 0x008DB0D8 Scalar_FLOAT64_IEEE 0 speedgoat_test_SN5659_R2021b_CM_double -1.7E+308 1.7E+308 /end CHARACTERISTIC
/begin CHARACTERISTIC speedgoat_test_SN5659__cal_impl.Decode3_P1_cm "" VALUE 0x008D9D10 Scalar_FLOAT64_IEEE 0 speedgoat_test_SN5659_R2021b_CM_double -1.7E+308 1.7E+308 /end CHARACTERISTIC
/begin CHARACTERISTIC speedgoat_test_SN5659__cal_impl.Decode3_P1_e "" VALUE 0x008DAA40 Scalar_FLOAT64_IEEE 0 speedgoat_test_SN5659_R2021b_CM_double -1.7E+308 1.7E+308 /end CHARACTERISTIC
/begin CHARACTERISTIC speedgoat_test_SN5659__cal_impl.Decode3_P1_k "" VALUE 0x008D9678 Scalar_FLOAT64_IEEE 0 speedgoat_test_SN5659_R2021b_CM_double -1.7E+308 1.7E+308 /end CHARACTERISTIC
/begin CHARACTERISTIC speedgoat_test_SN5659__cal_impl.Decode3_P1_kn "" VALUE 0x008DB770 Scalar_FLOAT64_IEEE 0 speedgoat_test_SN5659_R2021b_CM_double -1.7E+308 1.7E+308 /end CHARACTERISTIC
/begin CHARACTERISTIC speedgoat_test_SN5659__cal_impl.Decode3_P1_m "" VALUE 0x008DBE08 Scalar_FLOAT64_IEEE 0 speedgoat_test_SN5659_R2021b_CM_double -1.7E+308 1.7E+308 /end CHARACTERISTIC
/begin CHARACTERISTIC speedgoat_test_SN5659__cal_impl.Decode3_P1_mu "" VALUE 0x008DC4A0 Scalar_FLOAT64_IEEE 0 speedgoat_test_SN5659_R2021b_CM_double -1.7E+308 1.7E+308 /end CHARACTERISTIC
/begin CHARACTERISTIC speedgoat_test_SN5659__cal_impl.Decode3_P1_n "" VALUE 0x008DCB38 Scalar_FLOAT64_IEEE 0 speedgoat_test_SN5659_R2021b_CM_double -1.7E+308 1.7E+308 /end CHARACTERISTIC
/begin CHARACTERISTIC speedgoat_test_SN5659__cal_impl.Decode3_P2_c "" VALUE 0x008DBE20 Scalar_FLOAT64_IEEE 0 speedgoat_test_SN5659_R2021b_CM_double -1.7E+308 1.7E+308 /end CHARACTERISTIC
/begin CHARACTERISTIC speedgoat_test_SN5659__cal_impl.Decode3_P2_h "" VALUE 0x008D9D28 Scalar_FLOAT64_IEEE 0 speedgoat_test_SN5659_R2021b_CM_double -1.7E+308 1.7E+308 /end CHARACTERISTIC
/begin CHARACTERISTIC speedgoat_test_SN5659__cal_impl.Decode3_P2_js "" VALUE 0x008DB788 Scalar_FLOAT64_IEEE 0 speedgoat_test_SN5659_R2021b_CM_double -1.7E+308 1.7E+308 /end CHARACTERISTIC
/begin CHARACTERISTIC speedgoat_test_SN5659__cal_impl.Decode3_P2_l "" VALUE 0x008D82C8 Scalar_FLOAT64_IEEE 0 speedgoat_test_SN5659_R2021b_CM_double -1.7E+308 1.7E+308 /end CHARACTERISTIC
/begin CHARACTERISTIC speedgoat_test_SN5659__cal_impl.Decode3_P2_l2 "" VALUE 0x008DAA58 Scalar_FLOAT64_IEEE 0 speedgoat_test_SN5659_R2021b_CM_double -1.7E+308 1.7E+308 /end CHARACTERISTIC
/begin CHARACTERISTIC speedgoat_test_SN5659__cal_impl.Decode3_P2_ls "" VALUE 0x008DB0F0 Scalar_FLOAT64_IEEE 0 speedgoat_test_SN5659_R2021b_CM_double -1.7E+308 1.7E+308 /end CHARACTERISTIC
/begin CHARACTERISTIC speedgoat_test_SN5659__cal_impl.Decode3_P2_o "" VALUE 0x008D9690 Scalar_FLOAT64_IEEE 0 speedgoat_test_SN5659_R2021b_CM_double -1.7E+308 1.7E+308 /end CHARACTERISTIC
/begin CHARACTERISTIC speedgoat_test_SN5659__cal_impl.Decode3_P2_of "" VALUE 0x008DA3C0 Scalar_FLOAT64_IEEE 0 speedgoat_test_SN5659_R2021b_CM_double -1.7E+308 1.7E+308 /end CHARACTERISTIC
/begin CHARACTERISTIC speedgoat_test_SN5659__cal_impl.Decode3_P2_ow "" VALUE 0x008DC4B8 Scalar_FLOAT64_IEEE 0 speedgoat_test_SN5659_R2021b_CM_double -1.7E+308 1.7E+308 /end CHARACTERISTIC
/begin CHARACTERISTIC speedgoat_test_SN5659__cal_impl.Decode3_P2_p "" VALUE 0x008D8FF8 Scalar_FLOAT64_IEEE 0 speedgoat_test_SN5659_R2021b_CM_double -1.7E+308 1.7E+308 /end CHARACTERISTIC
/begin CHARACTERISTIC speedgoat_test_SN5659__cal_impl.Decode3_P2_pu "" VALUE 0x008DCB50 Scalar_FLOAT64_IEEE 0 speedgoat_test_SN5659_R2021b_CM_double -1.7E+308 1.7E+308 /end CHARACTERISTIC
/begin CHARACTERISTIC speedgoat_test_SN5659__cal_impl.Decode3_P3_b "" VALUE 0x008D9D40 Scalar_FLOAT64_IEEE 0 speedgoat_test_SN5659_R2021b_CM_double -1.7E+308 1.7E+308 /end CHARACTERISTIC
/begin CHARACTERISTIC speedgoat_test_SN5659__cal_impl.Decode3_P3_c "" VALUE 0x008D96A8 Scalar_FLOAT64_IEEE 0 speedgoat_test_SN5659_R2021b_CM_double -1.7E+308 1.7E+308 /end CHARACTERISTIC
/begin CHARACTERISTIC speedgoat_test_SN5659__cal_impl.Decode3_P3_cq "" VALUE 0x008DAA70 Scalar_FLOAT64_IEEE 0 speedgoat_test_SN5659_R2021b_CM_double -1.7E+308 1.7E+308 /end CHARACTERISTIC
/begin CHARACTERISTIC speedgoat_test_SN5659__cal_impl.Decode3_P3_e "" VALUE 0x008DCB68 Scalar_FLOAT64_IEEE 0 speedgoat_test_SN5659_R2021b_CM_double -1.7E+308 1.7E+308 /end CHARACTERISTIC
/begin CHARACTERISTIC speedgoat_test_SN5659__cal_impl.Decode3_P3_h "" VALUE 0x008D9010 Scalar_FLOAT64_IEEE 0 speedgoat_test_SN5659_R2021b_CM_double -1.7E+308 1.7E+308 /end CHARACTERISTIC
/begin CHARACTERISTIC speedgoat_test_SN5659__cal_impl.Decode3_P3_ht "" VALUE 0x008DC4D0 Scalar_FLOAT64_IEEE 0 speedgoat_test_SN5659_R2021b_CM_double -1.7E+308 1.7E+308 /end CHARACTERISTIC
/begin CHARACTERISTIC speedgoat_test_SN5659__cal_impl.Decode3_P3_i "" VALUE 0x008DBE38 Scalar_FLOAT64_IEEE 0 speedgoat_test_SN5659_R2021b_CM_double -1.7E+308 1.7E+308 /end CHARACTERISTIC
/begin CHARACTERISTIC speedgoat_test_SN5659__cal_impl.Decode3_P3_jq "" VALUE 0x008DB7A0 Scalar_FLOAT64_IEEE 0 speedgoat_test_SN5659_R2021b_CM_double -1.7E+308 1.7E+308 /end CHARACTERISTIC
/begin CHARACTERISTIC speedgoat_test_SN5659__cal_impl.Decode3_P3_l "" VALUE 0x008DB108 Scalar_FLOAT64_IEEE 0 speedgoat_test_SN5659_R2021b_CM_double -1.7E+308 1.7E+308 /end CHARACTERISTIC
/begin CHARACTERISTIC speedgoat_test_SN5659__cal_impl.Decode3_P3_p "" VALUE 0x008D82E0 Scalar_FLOAT64_IEEE 0 speedgoat_test_SN5659_R2021b_CM_double -1.7E+308 1.7E+308 /end CHARACTERISTIC
/begin CHARACTERISTIC speedgoat_test_SN5659__cal_impl.Decode3_P3_pi "" VALUE 0x008DA3D8 Scalar_FLOAT64_IEEE 0 speedgoat_test_SN5659_R2021b_CM_double -1.7E+308 1.7E+308 /end CHARACTERISTIC
/begin CHARACTERISTIC speedgoat_test_SN5659__cal_impl.Decode3_P4_a "" VALUE 0x008DA3F0 Scalar_FLOAT64_IEEE 0 speedgoat_test_SN5659_R2021b_CM_double -1.7E+308 1.7E+308 /end CHARACTERISTIC
/begin CHARACTERISTIC speedgoat_test_SN5659__cal_impl.Decode3_P4_d "" VALUE 0x008D9028 Scalar_FLOAT64_IEEE 0 speedgoat_test_SN5659_R2021b_CM_double -1.7E+308 1.7E+308 /end CHARACTERISTIC
/begin CHARACTERISTIC speedgoat_test_SN5659__cal_impl.Decode3_P4_g "" VALUE 0x008DC4E8 Scalar_FLOAT64_IEEE 0 speedgoat_test_SN5659_R2021b_CM_double -1.7E+308 1.7E+308 /end CHARACTERISTIC
/begin CHARACTERISTIC speedgoat_test_SN5659__cal_impl.Decode3_P4_i "" VALUE 0x008D96C0 Scalar_FLOAT64_IEEE 0 speedgoat_test_SN5659_R2021b_CM_double -1.7E+308 1.7E+308 /end CHARACTERISTIC
/begin CHARACTERISTIC speedgoat_test_SN5659__cal_impl.Decode3_P4_j "" VALUE 0x008DAA88 Scalar_FLOAT64_IEEE 0 speedgoat_test_SN5659_R2021b_CM_double -1.7E+308 1.7E+308 /end CHARACTERISTIC
/begin CHARACTERISTIC speedgoat_test_SN5659__cal_impl.Decode3_P4_ja "" VALUE 0x008DB120 Scalar_FLOAT64_IEEE 0 speedgoat_test_SN5659_R2021b_CM_double -1.7E+308 1.7E+308 /end CHARACTERISTIC
/begin CHARACTERISTIC speedgoat_test_SN5659__cal_impl.Decode3_P4_jl "" VALUE 0x008DCB80 Scalar_FLOAT64_IEEE 0 speedgoat_test_SN5659_R2021b_CM_double -1.7E+308 1.7E+308 /end CHARACTERISTIC
/begin CHARACTERISTIC speedgoat_test_SN5659__cal_impl.Decode3_P4_m "" VALUE 0x008D82F8 Scalar_FLOAT64_IEEE 0 speedgoat_test_SN5659_R2021b_CM_double -1.7E+308 1.7E+308 /end CHARACTERISTIC
/begin CHARACTERISTIC speedgoat_test_SN5659__cal_impl.Decode3_P4_m4 "" VALUE 0x008DBE50 Scalar_FLOAT64_IEEE 0 speedgoat_test_SN5659_R2021b_CM_double -1.7E+308 1.7E+308 /end CHARACTERISTIC
/begin CHARACTERISTIC speedgoat_test_SN5659__cal_impl.Decode3_P4_o "" VALUE 0x008D9D58 Scalar_FLOAT64_IEEE 0 speedgoat_test_SN5659_R2021b_CM_double -1.7E+308 1.7E+308 /end CHARACTERISTIC
/begin CHARACTERISTIC speedgoat_test_SN5659__cal_impl.Decode3_P4_o3 "" VALUE 0x008DB7B8 Scalar_FLOAT64_IEEE 0 speedgoat_test_SN5659_R2021b_CM_double -1.7E+308 1.7E+308 /end CHARACTERISTIC
/begin CHARACTERISTIC speedgoat_test_SN5659__cal_impl.Decode3_P5_a "" VALUE 0x008D96D8 Scalar_FLOAT64_IEEE 0 speedgoat_test_SN5659_R2021b_CM_double -1.7E+308 1.7E+308 /end CHARACTERISTIC
/begin CHARACTERISTIC speedgoat_test_SN5659__cal_impl.Decode3_P5_ae "" VALUE 0x008D9D70 Scalar_FLOAT64_IEEE 0 speedgoat_test_SN5659_R2021b_CM_double -1.7E+308 1.7E+308 /end CHARACTERISTIC
/begin CHARACTERISTIC speedgoat_test_SN5659__cal_impl.Decode3_P5_c "" VALUE 0x008D8310 Scalar_FLOAT64_IEEE 0 speedgoat_test_SN5659_R2021b_CM_double -1.7E+308 1.7E+308 /end CHARACTERISTIC
/begin CHARACTERISTIC speedgoat_test_SN5659__cal_impl.Decode3_P5_e "" VALUE 0x008DC500 Scalar_FLOAT64_IEEE 0 speedgoat_test_SN5659_R2021b_CM_double -1.7E+308 1.7E+308 /end CHARACTERISTIC
/begin CHARACTERISTIC speedgoat_test_SN5659__cal_impl.Decode3_P5_f "" VALUE 0x008DB138 Scalar_FLOAT64_IEEE 0 speedgoat_test_SN5659_R2021b_CM_double -1.7E+308 1.7E+308 /end CHARACTERISTIC
/begin CHARACTERISTIC speedgoat_test_SN5659__cal_impl.Decode3_P5_g "" VALUE 0x008DB7D0 Scalar_FLOAT64_IEEE 0 speedgoat_test_SN5659_R2021b_CM_double -1.7E+308 1.7E+308 /end CHARACTERISTIC
/begin CHARACTERISTIC speedgoat_test_SN5659__cal_impl.Decode3_P5_h "" VALUE 0x008DA408 Scalar_FLOAT64_IEEE 0 speedgoat_test_SN5659_R2021b_CM_double -1.7E+308 1.7E+308 /end CHARACTERISTIC
/begin CHARACTERISTIC speedgoat_test_SN5659__cal_impl.Decode3_P5_m "" VALUE 0x008D9040 Scalar_FLOAT64_IEEE 0 speedgoat_test_SN5659_R2021b_CM_double -1.7E+308 1.7E+308 /end CHARACTERISTIC
/begin CHARACTERISTIC speedgoat_test_SN5659__cal_impl.Decode3_P5_n "" VALUE 0x008DAAA0 Scalar_FLOAT64_IEEE 0 speedgoat_test_SN5659_R2021b_CM_double -1.7E+308 1.7E+308 /end CHARACTERISTIC
/begin CHARACTERISTIC speedgoat_test_SN5659__cal_impl.Decode3_P5_nh "" VALUE 0x008DBE68 Scalar_FLOAT64_IEEE 0 speedgoat_test_SN5659_R2021b_CM_double -1.7E+308 1.7E+308 /end CHARACTERISTIC
/begin CHARACTERISTIC speedgoat_test_SN5659__cal_impl.Decode3_P5_o "" VALUE 0x008DCB98 Scalar_FLOAT64_IEEE 0 speedgoat_test_SN5659_R2021b_CM_double -1.7E+308 1.7E+308 /end CHARACTERISTIC
/begin CHARACTERISTIC speedgoat_test_SN5659__cal_impl.Decode3_P6_d "" VALUE 0x008D9D88 Scalar_FLOAT64_IEEE 0 speedgoat_test_SN5659_R2021b_CM_double -1.7E+308 1.7E+308 /end CHARACTERISTIC
/begin CHARACTERISTIC speedgoat_test_SN5659__cal_impl.Decode3_P6_d3 "" VALUE 0x008DB150 Scalar_FLOAT64_IEEE 0 speedgoat_test_SN5659_R2021b_CM_double -1.7E+308 1.7E+308 /end CHARACTERISTIC
/begin CHARACTERISTIC speedgoat_test_SN5659__cal_impl.Decode3_P6_e "" VALUE 0x008DAAB8 Scalar_FLOAT64_IEEE 0 speedgoat_test_SN5659_R2021b_CM_double -1.7E+308 1.7E+308 /end CHARACTERISTIC
/begin CHARACTERISTIC speedgoat_test_SN5659__cal_impl.Decode3_P6_g "" VALUE 0x008DC518 Scalar_FLOAT64_IEEE 0 speedgoat_test_SN5659_R2021b_CM_double -1.7E+308 1.7E+308 /end CHARACTERISTIC
/begin CHARACTERISTIC speedgoat_test_SN5659__cal_impl.Decode3_P6_i "" VALUE 0x008D96F0 Scalar_FLOAT64_IEEE 0 speedgoat_test_SN5659_R2021b_CM_double -1.7E+308 1.7E+308 /end CHARACTERISTIC
/begin CHARACTERISTIC speedgoat_test_SN5659__cal_impl.Decode3_P6_ib "" VALUE 0x008DCBB0 Scalar_FLOAT64_IEEE 0 speedgoat_test_SN5659_R2021b_CM_double -1.7E+308 1.7E+308 /end CHARACTERISTIC
/begin CHARACTERISTIC speedgoat_test_SN5659__cal_impl.Decode3_P6_ih "" VALUE 0x008DB7E8 Scalar_FLOAT64_IEEE 0 speedgoat_test_SN5659_R2021b_CM_double -1.7E+308 1.7E+308 /end CHARACTERISTIC
/begin CHARACTERISTIC speedgoat_test_SN5659__cal_impl.Decode3_P6_k "" VALUE 0x008D8328 Scalar_FLOAT64_IEEE 0 speedgoat_test_SN5659_R2021b_CM_double -1.7E+308 1.7E+308 /end CHARACTERISTIC
/begin CHARACTERISTIC speedgoat_test_SN5659__cal_impl.Decode3_P6_l "" VALUE 0x008DBE80 Scalar_FLOAT64_IEEE 0 speedgoat_test_SN5659_R2021b_CM_double -1.7E+308 1.7E+308 /end CHARACTERISTIC
/begin CHARACTERISTIC speedgoat_test_SN5659__cal_impl.Decode3_P6_o "" VALUE 0x008D9058 Scalar_FLOAT64_IEEE 0 speedgoat_test_SN5659_R2021b_CM_double -1.7E+308 1.7E+308 /end CHARACTERISTIC
/begin CHARACTERISTIC speedgoat_test_SN5659__cal_impl.Decode3_P6_ot "" VALUE 0x008DA420 Scalar_FLOAT64_IEEE 0 speedgoat_test_SN5659_R2021b_CM_double -1.7E+308 1.7E+308 /end CHARACTERISTIC
/begin CHARACTERISTIC speedgoat_test_SN5659__cal_impl.Decode3_P7_b "" VALUE 0x008DAAD0 Scalar_FLOAT64_IEEE 0 speedgoat_test_SN5659_R2021b_CM_double -1.7E+308 1.7E+308 /end CHARACTERISTIC
/begin CHARACTERISTIC speedgoat_test_SN5659__cal_impl.Decode3_P7_bv "" VALUE 0x008DBE98 Scalar_FLOAT64_IEEE 0 speedgoat_test_SN5659_R2021b_CM_double -1.7E+308 1.7E+308 /end CHARACTERISTIC
/begin CHARACTERISTIC speedgoat_test_SN5659__cal_impl.Decode3_P7_c "" VALUE 0x008D9708 Scalar_FLOAT64_IEEE 0 speedgoat_test_SN5659_R2021b_CM_double -1.7E+308 1.7E+308 /end CHARACTERISTIC
/begin CHARACTERISTIC speedgoat_test_SN5659__cal_impl.Decode3_P7_cp "" VALUE 0x008DB800 Scalar_FLOAT64_IEEE 0 speedgoat_test_SN5659_R2021b_CM_double -1.7E+308 1.7E+308 /end CHARACTERISTIC
/begin CHARACTERISTIC speedgoat_test_SN5659__cal_impl.Decode3_P7_e "" VALUE 0x008D9DA0 Scalar_FLOAT64_IEEE 0 speedgoat_test_SN5659_R2021b_CM_double -1.7E+308 1.7E+308 /end CHARACTERISTIC
/begin CHARACTERISTIC speedgoat_test_SN5659__cal_impl.Decode3_P7_f "" VALUE 0x008DA438 Scalar_FLOAT64_IEEE 0 speedgoat_test_SN5659_R2021b_CM_double -1.7E+308 1.7E+308 /end CHARACTERISTIC
/begin CHARACTERISTIC speedgoat_test_SN5659__cal_impl.Decode3_P7_fx "" VALUE 0x008DCBC8 Scalar_FLOAT64_IEEE 0 speedgoat_test_SN5659_R2021b_CM_double -1.7E+308 1.7E+308 /end CHARACTERISTIC
/begin CHARACTERISTIC speedgoat_test_SN5659__cal_impl.Decode3_P7_i "" VALUE 0x008DB168 Scalar_FLOAT64_IEEE 0 speedgoat_test_SN5659_R2021b_CM_double -1.7E+308 1.7E+308 /end CHARACTERISTIC
/begin CHARACTERISTIC speedgoat_test_SN5659__cal_impl.Decode3_P7_k "" VALUE 0x008D8340 Scalar_FLOAT64_IEEE 0 speedgoat_test_SN5659_R2021b_CM_double -1.7E+308 1.7E+308 /end CHARACTERISTIC
/begin CHARACTERISTIC speedgoat_test_SN5659__cal_impl.Decode3_P7_kc "" VALUE 0x008D9070 Scalar_FLOAT64_IEEE 0 speedgoat_test_SN5659_R2021b_CM_double -1.7E+308 1.7E+308 /end CHARACTERISTIC
/begin CHARACTERISTIC speedgoat_test_SN5659__cal_impl.Decode3_P7_m "" VALUE 0x008DC530 Scalar_FLOAT64_IEEE 0 speedgoat_test_SN5659_R2021b_CM_double -1.7E+308 1.7E+308 /end CHARACTERISTIC
/begin CHARACTERISTIC speedgoat_test_SN5659__cal_impl.Decode3_P8_a "" VALUE 0x008DC548 Scalar_FLOAT64_IEEE 0 speedgoat_test_SN5659_R2021b_CM_double -1.7E+308 1.7E+308 /end CHARACTERISTIC
/begin CHARACTERISTIC speedgoat_test_SN5659__cal_impl.Decode3_P8_b "" VALUE 0x008DCBE0 Scalar_FLOAT64_IEEE 0 speedgoat_test_SN5659_R2021b_CM_double -1.7E+308 1.7E+308 /end CHARACTERISTIC
/begin CHARACTERISTIC speedgoat_test_SN5659__cal_impl.Decode3_P8_e "" VALUE 0x008DA450 Scalar_FLOAT64_IEEE 0 speedgoat_test_SN5659_R2021b_CM_double -1.7E+308 1.7E+308 /end CHARACTERISTIC
/begin CHARACTERISTIC speedgoat_test_SN5659__cal_impl.Decode3_P8_g "" VALUE 0x008D8358 Scalar_FLOAT64_IEEE 0 speedgoat_test_SN5659_R2021b_CM_double -1.7E+308 1.7E+308 /end CHARACTERISTIC
/begin CHARACTERISTIC speedgoat_test_SN5659__cal_impl.Decode3_P8_g0 "" VALUE 0x008D9720 Scalar_FLOAT64_IEEE 0 speedgoat_test_SN5659_R2021b_CM_double -1.7E+308 1.7E+308 /end CHARACTERISTIC
/begin CHARACTERISTIC speedgoat_test_SN5659__cal_impl.Decode3_P8_i "" VALUE 0x008D9DB8 Scalar_FLOAT64_IEEE 0 speedgoat_test_SN5659_R2021b_CM_double -1.7E+308 1.7E+308 /end CHARACTERISTIC
/begin CHARACTERISTIC speedgoat_test_SN5659__cal_impl.Decode3_P8_ig "" VALUE 0x008DBEB0 Scalar_FLOAT64_IEEE 0 speedgoat_test_SN5659_R2021b_CM_double -1.7E+308 1.7E+308 /end CHARACTERISTIC
/begin CHARACTERISTIC speedgoat_test_SN5659__cal_impl.Decode3_P8_l "" VALUE 0x008DB818 Scalar_FLOAT64_IEEE 0 speedgoat_test_SN5659_R2021b_CM_double -1.7E+308 1.7E+308 /end CHARACTERISTIC
/begin CHARACTERISTIC speedgoat_test_SN5659__cal_impl.Decode3_P8_m "" VALUE 0x008D9088 Scalar_FLOAT64_IEEE 0 speedgoat_test_SN5659_R2021b_CM_double -1.7E+308 1.7E+308 /end CHARACTERISTIC
/begin CHARACTERISTIC speedgoat_test_SN5659__cal_impl.Decode3_P8_m3 "" VALUE 0x008DB180 Scalar_FLOAT64_IEEE 0 speedgoat_test_SN5659_R2021b_CM_double -1.7E+308 1.7E+308 /end CHARACTERISTIC
/begin CHARACTERISTIC speedgoat_test_SN5659__cal_impl.Decode3_P8_p "" VALUE 0x008DAAE8 Scalar_FLOAT64_IEEE 0 speedgoat_test_SN5659_R2021b_CM_double -1.7E+308 1.7E+308 /end CHARACTERISTIC
/begin CHARACTERISTIC speedgoat_test_SN5659__cal_impl.Decode3_P9_d "" VALUE 0x008D9738 Scalar_FLOAT64_IEEE 0 speedgoat_test_SN5659_R2021b_CM_double -1.7E+308 1.7E+308 /end CHARACTERISTIC
/begin CHARACTERISTIC speedgoat_test_SN5659__cal_impl.Decode3_P9_dw "" VALUE 0x008DC560 Scalar_FLOAT64_IEEE 0 speedgoat_test_SN5659_R2021b_CM_double -1.7E+308 1.7E+308 /end CHARACTERISTIC
/begin CHARACTERISTIC speedgoat_test_SN5659__cal_impl.Decode3_P9_dy "" VALUE 0x008DCBF8 Scalar_FLOAT64_IEEE 0 speedgoat_test_SN5659_R2021b_CM_double -1.7E+308 1.7E+308 /end CHARACTERISTIC
/begin CHARACTERISTIC speedgoat_test_SN5659__cal_impl.Decode3_P9_h "" VALUE 0x008D8370 Scalar_FLOAT64_IEEE 0 speedgoat_test_SN5659_R2021b_CM_double -1.7E+308 1.7E+308 /end CHARACTERISTIC
/begin CHARACTERISTIC speedgoat_test_SN5659__cal_impl.Decode3_P9_h1 "" VALUE 0x008DB198 Scalar_FLOAT64_IEEE 0 speedgoat_test_SN5659_R2021b_CM_double -1.7E+308 1.7E+308 /end CHARACTERISTIC
/begin CHARACTERISTIC speedgoat_test_SN5659__cal_impl.Decode3_P9_hu "" VALUE 0x008DAB00 Scalar_FLOAT64_IEEE 0 speedgoat_test_SN5659_R2021b_CM_double -1.7E+308 1.7E+308 /end CHARACTERISTIC
/begin CHARACTERISTIC speedgoat_test_SN5659__cal_impl.Decode3_P9_hv "" VALUE 0x008DB830 Scalar_FLOAT64_IEEE 0 speedgoat_test_SN5659_R2021b_CM_double -1.7E+308 1.7E+308 /end CHARACTERISTIC
/begin CHARACTERISTIC speedgoat_test_SN5659__cal_impl.Decode3_P9_m "" VALUE 0x008DA468 Scalar_FLOAT64_IEEE 0 speedgoat_test_SN5659_R2021b_CM_double -1.7E+308 1.7E+308 /end CHARACTERISTIC
/begin CHARACTERISTIC speedgoat_test_SN5659__cal_impl.Decode3_P9_m5 "" VALUE 0x008DBEC8 Scalar_FLOAT64_IEEE 0 speedgoat_test_SN5659_R2021b_CM_double -1.7E+308 1.7E+308 /end CHARACTERISTIC
/begin CHARACTERISTIC speedgoat_test_SN5659__cal_impl.Decode3_P9_o "" VALUE 0x008D90A0 Scalar_FLOAT64_IEEE 0 speedgoat_test_SN5659_R2021b_CM_double -1.7E+308 1.7E+308 /end CHARACTERISTIC
/begin CHARACTERISTIC speedgoat_test_SN5659__cal_impl.Decode3_P9_o2 "" VALUE 0x008D9DD0 Scalar_FLOAT64_IEEE 0 speedgoat_test_SN5659_R2021b_CM_double -1.7E+308 1.7E+308 /end CHARACTERISTIC
/begin CHARACTERISTIC speedgoat_test_SN5659__cal_impl.Decode4_P10_a "" VAL_BLK 0x008DB9D0 Scalar_FLOAT64_IEEE 0 speedgoat_test_SN5659_R2021b_CM_double -1.7E+308 1.7E+308 MATRIX_DIM 2 1 /end CHARACTERISTIC
/begin CHARACTERISTIC speedgoat_test_SN5659__cal_impl.Decode4_P10_b "" VAL_BLK 0x008D8510 Scalar_FLOAT64_IEEE 0 speedgoat_test_SN5659_R2021b_CM_double -1.7E+308 1.7E+308 MATRIX_DIM 2 1 /end CHARACTERISTIC
/begin CHARACTERISTIC speedgoat_test_SN5659__cal_impl.Decode4_P10_bm "" VAL_BLK 0x008DA608 Scalar_FLOAT64_IEEE 0 speedgoat_test_SN5659_R2021b_CM_double -1.7E+308 1.7E+308 MATRIX_DIM 2 1 /end CHARACTERISTIC
/begin CHARACTERISTIC speedgoat_test_SN5659__cal_impl.Decode4_P10_bv "" VAL_BLK 0x008DC700 Scalar_FLOAT64_IEEE 0 speedgoat_test_SN5659_R2021b_CM_double -1.7E+308 1.7E+308 MATRIX_DIM 2 1 /end CHARACTERISTIC
/begin CHARACTERISTIC speedgoat_test_SN5659__cal_impl.Decode4_P10_e "" VAL_BLK 0x008DB338 Scalar_FLOAT64_IEEE 0 speedgoat_test_SN5659_R2021b_CM_double -1.7E+308 1.7E+308 MATRIX_DIM 2 1 /end CHARACTERISTIC
/begin CHARACTERISTIC speedgoat_test_SN5659__cal_impl.Decode4_P10_f "" VAL_BLK 0x008D9F70 Scalar_FLOAT64_IEEE 0 speedgoat_test_SN5659_R2021b_CM_double -1.7E+308 1.7E+308 MATRIX_DIM 2 1 /end CHARACTERISTIC
/begin CHARACTERISTIC speedgoat_test_SN5659__cal_impl.Decode4_P10_g "" VAL_BLK 0x008D9240 Scalar_FLOAT64_IEEE 0 speedgoat_test_SN5659_R2021b_CM_double -1.7E+308 1.7E+308 MATRIX_DIM 2 1 /end CHARACTERISTIC
/begin CHARACTERISTIC speedgoat_test_SN5659__cal_impl.Decode4_P10_h "" VAL_BLK 0x008DACA0 Scalar_FLOAT64_IEEE 0 speedgoat_test_SN5659_R2021b_CM_double -1.7E+308 1.7E+308 MATRIX_DIM 2 1 /end CHARACTERISTIC
/begin CHARACTERISTIC speedgoat_test_SN5659__cal_impl.Decode4_P10_m "" VAL_BLK 0x008D98D8 Scalar_FLOAT64_IEEE 0 speedgoat_test_SN5659_R2021b_CM_double -1.7E+308 1.7E+308 MATRIX_DIM 2 1 /end CHARACTERISTIC
/begin CHARACTERISTIC speedgoat_test_SN5659__cal_impl.Decode4_P10_mz "" VAL_BLK 0x008DCD98 Scalar_FLOAT64_IEEE 0 speedgoat_test_SN5659_R2021b_CM_double -1.7E+308 1.7E+308 MATRIX_DIM 2 1 /end CHARACTERISTIC
/begin CHARACTERISTIC speedgoat_test_SN5659__cal_impl.Decode4_P10_o "" VAL_BLK 0x008DC068 Scalar_FLOAT64_IEEE 0 speedgoat_test_SN5659_R2021b_CM_double -1.7E+308 1.7E+308 MATRIX_DIM 2 1 /end CHARACTERISTIC
/begin CHARACTERISTIC speedgoat_test_SN5659__cal_impl.Decode4_P11_a "" VALUE 0x008DC720 Scalar_FLOAT64_IEEE 0 speedgoat_test_SN5659_R2021b_CM_double -1.7E+308 1.7E+308 /end CHARACTERISTIC
/begin CHARACTERISTIC speedgoat_test_SN5659__cal_impl.Decode4_P11_c "" VALUE 0x008DCDB8 Scalar_FLOAT64_IEEE 0 speedgoat_test_SN5659_R2021b_CM_double -1.7E+308 1.7E+308 /end CHARACTERISTIC
/begin CHARACTERISTIC speedgoat_test_SN5659__cal_impl.Decode4_P11_d "" VALUE 0x008D98F8 Scalar_FLOAT64_IEEE 0 speedgoat_test_SN5659_R2021b_CM_double -1.7E+308 1.7E+308 /end CHARACTERISTIC
/begin CHARACTERISTIC speedgoat_test_SN5659__cal_impl.Decode4_P11_gt "" VALUE 0x008DB358 Scalar_FLOAT64_IEEE 0 speedgoat_test_SN5659_R2021b_CM_double -1.7E+308 1.7E+308 /end CHARACTERISTIC
/begin CHARACTERISTIC speedgoat_test_SN5659__cal_impl.Decode4_P11_h "" VALUE 0x008D9260 Scalar_FLOAT64_IEEE 0 speedgoat_test_SN5659_R2021b_CM_double -1.7E+308 1.7E+308 /end CHARACTERISTIC
/begin CHARACTERISTIC speedgoat_test_SN5659__cal_impl.Decode4_P11_hn "" VALUE 0x008DB9F0 Scalar_FLOAT64_IEEE 0 speedgoat_test_SN5659_R2021b_CM_double -1.7E+308 1.7E+308 /end CHARACTERISTIC
/begin CHARACTERISTIC speedgoat_test_SN5659__cal_impl.Decode4_P11_j "" VALUE 0x008DC088 Scalar_FLOAT64_IEEE 0 speedgoat_test_SN5659_R2021b_CM_double -1.7E+308 1.7E+308 /end CHARACTERISTIC
/begin CHARACTERISTIC speedgoat_test_SN5659__cal_impl.Decode4_P11_l "" VALUE 0x008DA628 Scalar_FLOAT64_IEEE 0 speedgoat_test_SN5659_R2021b_CM_double -1.7E+308 1.7E+308 /end CHARACTERISTIC
/begin CHARACTERISTIC speedgoat_test_SN5659__cal_impl.Decode4_P11_m "" VALUE 0x008D8530 Scalar_FLOAT64_IEEE 0 speedgoat_test_SN5659_R2021b_CM_double -1.7E+308 1.7E+308 /end CHARACTERISTIC
/begin CHARACTERISTIC speedgoat_test_SN5659__cal_impl.Decode4_P11_n "" VALUE 0x008DACC0 Scalar_FLOAT64_IEEE 0 speedgoat_test_SN5659_R2021b_CM_double -1.7E+308 1.7E+308 /end CHARACTERISTIC
/begin CHARACTERISTIC speedgoat_test_SN5659__cal_impl.Decode4_P11_p "" VALUE 0x008D9F90 Scalar_FLOAT64_IEEE 0 speedgoat_test_SN5659_R2021b_CM_double -1.7E+308 1.7E+308 /end CHARACTERISTIC
/begin CHARACTERISTIC speedgoat_test_SN5659__cal_impl.Decode4_P12_c "" VALUE 0x008DACD8 Scalar_FLOAT64_IEEE 0 speedgoat_test_SN5659_R2021b_CM_double -1.7E+308 1.7E+308 /end CHARACTERISTIC
/begin CHARACTERISTIC speedgoat_test_SN5659__cal_impl.Decode4_P12_d "" VALUE 0x008D8548 Scalar_FLOAT64_IEEE 0 speedgoat_test_SN5659_R2021b_CM_double -1.7E+308 1.7E+308 /end CHARACTERISTIC
/begin CHARACTERISTIC speedgoat_test_SN5659__cal_impl.Decode4_P12_f "" VALUE 0x008D9278 Scalar_FLOAT64_IEEE 0 speedgoat_test_SN5659_R2021b_CM_double -1.7E+308 1.7E+308 /end CHARACTERISTIC
/begin CHARACTERISTIC speedgoat_test_SN5659__cal_impl.Decode4_P12_ff "" VALUE 0x008DCDD0 Scalar_FLOAT64_IEEE 0 speedgoat_test_SN5659_R2021b_CM_double -1.7E+308 1.7E+308 /end CHARACTERISTIC
/begin CHARACTERISTIC speedgoat_test_SN5659__cal_impl.Decode4_P12_g "" VALUE 0x008D9FA8 Scalar_FLOAT64_IEEE 0 speedgoat_test_SN5659_R2021b_CM_double -1.7E+308 1.7E+308 /end CHARACTERISTIC
/begin CHARACTERISTIC speedgoat_test_SN5659__cal_impl.Decode4_P12_j "" VALUE 0x008DC0A0 Scalar_FLOAT64_IEEE 0 speedgoat_test_SN5659_R2021b_CM_double -1.7E+308 1.7E+308 /end CHARACTERISTIC
/begin CHARACTERISTIC speedgoat_test_SN5659__cal_impl.Decode4_P12_k "" VALUE 0x008D9910 Scalar_FLOAT64_IEEE 0 speedgoat_test_SN5659_R2021b_CM_double -1.7E+308 1.7E+308 /end CHARACTERISTIC
/begin CHARACTERISTIC speedgoat_test_SN5659__cal_impl.Decode4_P12_ko "" VALUE 0x008DBA08 Scalar_FLOAT64_IEEE 0 speedgoat_test_SN5659_R2021b_CM_double -1.7E+308 1.7E+308 /end CHARACTERISTIC
/begin CHARACTERISTIC speedgoat_test_SN5659__cal_impl.Decode4_P12_n "" VALUE 0x008DB370 Scalar_FLOAT64_IEEE 0 speedgoat_test_SN5659_R2021b_CM_double -1.7E+308 1.7E+308 /end CHARACTERISTIC
/begin CHARACTERISTIC speedgoat_test_SN5659__cal_impl.Decode4_P12_nu "" VALUE 0x008DC738 Scalar_FLOAT64_IEEE 0 speedgoat_test_SN5659_R2021b_CM_double -1.7E+308 1.7E+308 /end CHARACTERISTIC
/begin CHARACTERISTIC speedgoat_test_SN5659__cal_impl.Decode4_P12_o "" VALUE 0x008DA640 Scalar_FLOAT64_IEEE 0 speedgoat_test_SN5659_R2021b_CM_double -1.7E+308 1.7E+308 /end CHARACTERISTIC
/begin CHARACTERISTIC speedgoat_test_SN5659__cal_impl.Decode4_P13_a "" VALUE 0x008D9FC0 Scalar_FLOAT64_IEEE 0 speedgoat_test_SN5659_R2021b_CM_double -1.7E+308 1.7E+308 /end CHARACTERISTIC
/begin CHARACTERISTIC speedgoat_test_SN5659__cal_impl.Decode4_P13_aq "" VALUE 0x008DC750 Scalar_FLOAT64_IEEE 0 speedgoat_test_SN5659_R2021b_CM_double -1.7E+308 1.7E+308 /end CHARACTERISTIC
/begin CHARACTERISTIC speedgoat_test_SN5659__cal_impl.Decode4_P13_c "" VALUE 0x008DA658 Scalar_FLOAT64_IEEE 0 speedgoat_test_SN5659_R2021b_CM_double -1.7E+308 1.7E+308 /end CHARACTERISTIC
/begin CHARACTERISTIC speedgoat_test_SN5659__cal_impl.Decode4_P13_ct "" VALUE 0x008DACF0 Scalar_FLOAT64_IEEE 0 speedgoat_test_SN5659_R2021b_CM_double -1.7E+308 1.7E+308 /end CHARACTERISTIC
/begin CHARACTERISTIC speedgoat_test_SN5659__cal_impl.Decode4_P13_f "" VALUE 0x008D9928 Scalar_FLOAT64_IEEE 0 speedgoat_test_SN5659_R2021b_CM_double -1.7E+308 1.7E+308 /end CHARACTERISTIC
/begin CHARACTERISTIC speedgoat_test_SN5659__cal_impl.Decode4_P13_g "" VALUE 0x008D9290 Scalar_FLOAT64_IEEE 0 speedgoat_test_SN5659_R2021b_CM_double -1.7E+308 1.7E+308 /end CHARACTERISTIC
/begin CHARACTERISTIC speedgoat_test_SN5659__cal_impl.Decode4_P13_h "" VALUE 0x008DBA20 Scalar_FLOAT64_IEEE 0 speedgoat_test_SN5659_R2021b_CM_double -1.7E+308 1.7E+308 /end CHARACTERISTIC
/begin CHARACTERISTIC speedgoat_test_SN5659__cal_impl.Decode4_P13_i "" VALUE 0x008DB388 Scalar_FLOAT64_IEEE 0 speedgoat_test_SN5659_R2021b_CM_double -1.7E+308 1.7E+308 /end CHARACTERISTIC
/begin CHARACTERISTIC speedgoat_test_SN5659__cal_impl.Decode4_P13_io "" VALUE 0x008DC0B8 Scalar_FLOAT64_IEEE 0 speedgoat_test_SN5659_R2021b_CM_double -1.7E+308 1.7E+308 /end CHARACTERISTIC
/begin CHARACTERISTIC speedgoat_test_SN5659__cal_impl.Decode4_P13_n "" VALUE 0x008DCDE8 Scalar_FLOAT64_IEEE 0 speedgoat_test_SN5659_R2021b_CM_double -1.7E+308 1.7E+308 /end CHARACTERISTIC
/begin CHARACTERISTIC speedgoat_test_SN5659__cal_impl.Decode4_P13_p "" VALUE 0x008D8560 Scalar_FLOAT64_IEEE 0 speedgoat_test_SN5659_R2021b_CM_double -1.7E+308 1.7E+308 /end CHARACTERISTIC
/begin CHARACTERISTIC speedgoat_test_SN5659__cal_impl.Decode4_P14_a "" VALUE 0x008DB3A0 Scalar_FLOAT64_IEEE 0 speedgoat_test_SN5659_R2021b_CM_double -1.7E+308 1.7E+308 /end CHARACTERISTIC
/begin CHARACTERISTIC speedgoat_test_SN5659__cal_impl.Decode4_P14_aq "" VALUE 0x008DBA38 Scalar_FLOAT64_IEEE 0 speedgoat_test_SN5659_R2021b_CM_double -1.7E+308 1.7E+308 /end CHARACTERISTIC
/begin CHARACTERISTIC speedgoat_test_SN5659__cal_impl.Decode4_P14_d "" VALUE 0x008D9940 Scalar_FLOAT64_IEEE 0 speedgoat_test_SN5659_R2021b_CM_double -1.7E+308 1.7E+308 /end CHARACTERISTIC
/begin CHARACTERISTIC speedgoat_test_SN5659__cal_impl.Decode4_P14_dy "" VALUE 0x008DC768 Scalar_FLOAT64_IEEE 0 speedgoat_test_SN5659_R2021b_CM_double -1.7E+308 1.7E+308 /end CHARACTERISTIC
/begin CHARACTERISTIC speedgoat_test_SN5659__cal_impl.Decode4_P14_f "" VALUE 0x008D92A8 Scalar_FLOAT64_IEEE 0 speedgoat_test_SN5659_R2021b_CM_double -1.7E+308 1.7E+308 /end CHARACTERISTIC
/begin CHARACTERISTIC speedgoat_test_SN5659__cal_impl.Decode4_P14_h "" VALUE 0x008D8578 Scalar_FLOAT64_IEEE 0 speedgoat_test_SN5659_R2021b_CM_double -1.7E+308 1.7E+308 /end CHARACTERISTIC
/begin CHARACTERISTIC speedgoat_test_SN5659__cal_impl.Decode4_P14_j "" VALUE 0x008DAD08 Scalar_FLOAT64_IEEE 0 speedgoat_test_SN5659_R2021b_CM_double -1.7E+308 1.7E+308 /end CHARACTERISTIC
/begin CHARACTERISTIC speedgoat_test_SN5659__cal_impl.Decode4_P14_l "" VALUE 0x008DA670 Scalar_FLOAT64_IEEE 0 speedgoat_test_SN5659_R2021b_CM_double -1.7E+308 1.7E+308 /end CHARACTERISTIC
/begin CHARACTERISTIC speedgoat_test_SN5659__cal_impl.Decode4_P14_l4 "" VALUE 0x008DC0D0 Scalar_FLOAT64_IEEE 0 speedgoat_test_SN5659_R2021b_CM_double -1.7E+308 1.7E+308 /end CHARACTERISTIC
/begin CHARACTERISTIC speedgoat_test_SN5659__cal_impl.Decode4_P14_lo "" VALUE 0x008DCE00 Scalar_FLOAT64_IEEE 0 speedgoat_test_SN5659_R2021b_CM_double -1.7E+308 1.7E+308 /end CHARACTERISTIC
/begin CHARACTERISTIC speedgoat_test_SN5659__cal_impl.Decode4_P14_n "" VALUE 0x008D9FD8 Scalar_FLOAT64_IEEE 0 speedgoat_test_SN5659_R2021b_CM_double -1.7E+308 1.7E+308 /end CHARACTERISTIC
/begin CHARACTERISTIC speedgoat_test_SN5659__cal_impl.Decode4_P15_a "" VALUE 0x008D92C0 Scalar_FLOAT64_IEEE 0 speedgoat_test_SN5659_R2021b_CM_double -1.7E+308 1.7E+308 /end CHARACTERISTIC
/begin CHARACTERISTIC speedgoat_test_SN5659__cal_impl.Decode4_P15_c "" VALUE 0x008D8590 Scalar_FLOAT64_IEEE 0 speedgoat_test_SN5659_R2021b_CM_double -1.7E+308 1.7E+308 /end CHARACTERISTIC
/begin CHARACTERISTIC speedgoat_test_SN5659__cal_impl.Decode4_P15_d "" VALUE 0x008D9FF0 Scalar_FLOAT64_IEEE 0 speedgoat_test_SN5659_R2021b_CM_double -1.7E+308 1.7E+308 /end CHARACTERISTIC
/begin CHARACTERISTIC speedgoat_test_SN5659__cal_impl.Decode4_P15_dv "" VALUE 0x008DC0E8 Scalar_FLOAT64_IEEE 0 speedgoat_test_SN5659_R2021b_CM_double -1.7E+308 1.7E+308 /end CHARACTERISTIC
/begin CHARACTERISTIC speedgoat_test_SN5659__cal_impl.Decode4_P15_dw "" VALUE 0x008DAD20 Scalar_FLOAT64_IEEE 0 speedgoat_test_SN5659_R2021b_CM_double -1.7E+308 1.7E+308 /end CHARACTERISTIC
/begin CHARACTERISTIC speedgoat_test_SN5659__cal_impl.Decode4_P15_f "" VALUE 0x008D9958 Scalar_FLOAT64_IEEE 0 speedgoat_test_SN5659_R2021b_CM_double -1.7E+308 1.7E+308 /end CHARACTERISTIC
/begin CHARACTERISTIC speedgoat_test_SN5659__cal_impl.Decode4_P15_ft "" VALUE 0x008DBA50 Scalar_FLOAT64_IEEE 0 speedgoat_test_SN5659_R2021b_CM_double -1.7E+308 1.7E+308 /end CHARACTERISTIC
/begin CHARACTERISTIC speedgoat_test_SN5659__cal_impl.Decode4_P15_i "" VALUE 0x008DA688 Scalar_FLOAT64_IEEE 0 speedgoat_test_SN5659_R2021b_CM_double -1.7E+308 1.7E+308 /end CHARACTERISTIC
/begin CHARACTERISTIC speedgoat_test_SN5659__cal_impl.Decode4_P15_i0 "" VALUE 0x008DB3B8 Scalar_FLOAT64_IEEE 0 speedgoat_test_SN5659_R2021b_CM_double -1.7E+308 1.7E+308 /end CHARACTERISTIC
/begin CHARACTERISTIC speedgoat_test_SN5659__cal_impl.Decode4_P15_n "" VALUE 0x008DC780 Scalar_FLOAT64_IEEE 0 speedgoat_test_SN5659_R2021b_CM_double -1.7E+308 1.7E+308 /end CHARACTERISTIC
/begin CHARACTERISTIC speedgoat_test_SN5659__cal_impl.Decode4_P15_p "" VALUE 0x008DCE18 Scalar_FLOAT64_IEEE 0 speedgoat_test_SN5659_R2021b_CM_double -1.7E+308 1.7E+308 /end CHARACTERISTIC
/begin CHARACTERISTIC speedgoat_test_SN5659__cal_impl.Decode4_P16_a "" VALUE 0x008DBA68 Scalar_FLOAT64_IEEE 0 speedgoat_test_SN5659_R2021b_CM_double -1.7E+308 1.7E+308 /end CHARACTERISTIC
/begin CHARACTERISTIC speedgoat_test_SN5659__cal_impl.Decode4_P16_c "" VALUE 0x008DA6A0 Scalar_FLOAT64_IEEE 0 speedgoat_test_SN5659_R2021b_CM_double -1.7E+308 1.7E+308 /end CHARACTERISTIC
/begin CHARACTERISTIC speedgoat_test_SN5659__cal_impl.Decode4_P16_d "" VALUE 0x008DA008 Scalar_FLOAT64_IEEE 0 speedgoat_test_SN5659_R2021b_CM_double -1.7E+308 1.7E+308 /end CHARACTERISTIC
/begin CHARACTERISTIC speedgoat_test_SN5659__cal_impl.Decode4_P16_e "" VALUE 0x008D9970 Scalar_FLOAT64_IEEE 0 speedgoat_test_SN5659_R2021b_CM_double -1.7E+308 1.7E+308 /end CHARACTERISTIC
/begin CHARACTERISTIC speedgoat_test_SN5659__cal_impl.Decode4_P16_ec "" VALUE 0x008DCE30 Scalar_FLOAT64_IEEE 0 speedgoat_test_SN5659_R2021b_CM_double -1.7E+308 1.7E+308 /end CHARACTERISTIC
/begin CHARACTERISTIC speedgoat_test_SN5659__cal_impl.Decode4_P16_g "" VALUE 0x008D85A8 Scalar_FLOAT64_IEEE 0 speedgoat_test_SN5659_R2021b_CM_double -1.7E+308 1.7E+308 /end CHARACTERISTIC
/begin CHARACTERISTIC speedgoat_test_SN5659__cal_impl.Decode4_P16_gq "" VALUE 0x008DC798 Scalar_FLOAT64_IEEE 0 speedgoat_test_SN5659_R2021b_CM_double -1.7E+308 1.7E+308 /end CHARACTERISTIC
/begin CHARACTERISTIC speedgoat_test_SN5659__cal_impl.Decode4_P16_j "" VALUE 0x008DC100 Scalar_FLOAT64_IEEE 0 speedgoat_test_SN5659_R2021b_CM_double -1.7E+308 1.7E+308 /end CHARACTERISTIC
/begin CHARACTERISTIC speedgoat_test_SN5659__cal_impl.Decode4_P16_l "" VALUE 0x008DB3D0 Scalar_FLOAT64_IEEE 0 speedgoat_test_SN5659_R2021b_CM_double -1.7E+308 1.7E+308 /end CHARACTERISTIC
/begin CHARACTERISTIC speedgoat_test_SN5659__cal_impl.Decode4_P16_o "" VALUE 0x008DAD38 Scalar_FLOAT64_IEEE 0 speedgoat_test_SN5659_R2021b_CM_double -1.7E+308 1.7E+308 /end CHARACTERISTIC
/begin CHARACTERISTIC speedgoat_test_SN5659__cal_impl.Decode4_P16_p "" VALUE 0x008D92D8 Scalar_FLOAT64_IEEE 0 speedgoat_test_SN5659_R2021b_CM_double -1.7E+308 1.7E+308 /end CHARACTERISTIC
/begin CHARACTERISTIC speedgoat_test_SN5659__cal_impl.Decode4_P1_a "" VALUE 0x008DABC8 Scalar_FLOAT64_IEEE 0 speedgoat_test_SN5659_R2021b_CM_double -1.7E+308 1.7E+308 /end CHARACTERISTIC
/begin CHARACTERISTIC speedgoat_test_SN5659__cal_impl.Decode4_P1_c "" VALUE 0x008D9800 Scalar_FLOAT64_IEEE 0 speedgoat_test_SN5659_R2021b_CM_double -1.7E+308 1.7E+308 /end CHARACTERISTIC
/begin CHARACTERISTIC speedgoat_test_SN5659__cal_impl.Decode4_P1_f "" VALUE 0x008DBF90 Scalar_FLOAT64_IEEE 0 speedgoat_test_SN5659_R2021b_CM_double -1.7E+308 1.7E+308 /end CHARACTERISTIC
/begin CHARACTERISTIC speedgoat_test_SN5659__cal_impl.Decode4_P1_g "" VALUE 0x008D8438 Scalar_FLOAT64_IEEE 0 speedgoat_test_SN5659_R2021b_CM_double -1.7E+308 1.7E+308 /end CHARACTERISTIC
/begin CHARACTERISTIC speedgoat_test_SN5659__cal_impl.Decode4_P1_k "" VALUE 0x008D9E98 Scalar_FLOAT64_IEEE 0 speedgoat_test_SN5659_R2021b_CM_double -1.7E+308 1.7E+308 /end CHARACTERISTIC
/begin CHARACTERISTIC speedgoat_test_SN5659__cal_impl.Decode4_P1_kt "" VALUE 0x008DB260 Scalar_FLOAT64_IEEE 0 speedgoat_test_SN5659_R2021b_CM_double -1.7E+308 1.7E+308 /end CHARACTERISTIC
/begin CHARACTERISTIC speedgoat_test_SN5659__cal_impl.Decode4_P1_m "" VALUE 0x008DCCC0 Scalar_FLOAT64_IEEE 0 speedgoat_test_SN5659_R2021b_CM_double -1.7E+308 1.7E+308 /end CHARACTERISTIC
/begin CHARACTERISTIC speedgoat_test_SN5659__cal_impl.Decode4_P1_n "" VALUE 0x008DB8F8 Scalar_FLOAT64_IEEE 0 speedgoat_test_SN5659_R2021b_CM_double -1.7E+308 1.7E+308 /end CHARACTERISTIC
/begin CHARACTERISTIC speedgoat_test_SN5659__cal_impl.Decode4_P1_p "" VALUE 0x008D9168 Scalar_FLOAT64_IEEE 0 speedgoat_test_SN5659_R2021b_CM_double -1.7E+308 1.7E+308 /end CHARACTERISTIC
/begin CHARACTERISTIC speedgoat_test_SN5659__cal_impl.Decode4_P1_pt "" VALUE 0x008DA530 Scalar_FLOAT64_IEEE 0 speedgoat_test_SN5659_R2021b_CM_double -1.7E+308 1.7E+308 /end CHARACTERISTIC
/begin CHARACTERISTIC speedgoat_test_SN5659__cal_impl.Decode4_P1_px "" VALUE 0x008DC628 Scalar_FLOAT64_IEEE 0 speedgoat_test_SN5659_R2021b_CM_double -1.7E+308 1.7E+308 /end CHARACTERISTIC
/begin CHARACTERISTIC speedgoat_test_SN5659__cal_impl.Decode4_P2_c "" VALUE 0x008DA548 Scalar_FLOAT64_IEEE 0 speedgoat_test_SN5659_R2021b_CM_double -1.7E+308 1.7E+308 /end CHARACTERISTIC
/begin CHARACTERISTIC speedgoat_test_SN5659__cal_impl.Decode4_P2_e "" VALUE 0x008DC640 Scalar_FLOAT64_IEEE 0 speedgoat_test_SN5659_R2021b_CM_double -1.7E+308 1.7E+308 /end CHARACTERISTIC
/begin CHARACTERISTIC speedgoat_test_SN5659__cal_impl.Decode4_P2_h "" VALUE 0x008DCCD8 Scalar_FLOAT64_IEEE 0 speedgoat_test_SN5659_R2021b_CM_double -1.7E+308 1.7E+308 /end CHARACTERISTIC
/begin CHARACTERISTIC speedgoat_test_SN5659__cal_impl.Decode4_P2_j "" VALUE 0x008D9180 Scalar_FLOAT64_IEEE 0 speedgoat_test_SN5659_R2021b_CM_double -1.7E+308 1.7E+308 /end CHARACTERISTIC
/begin CHARACTERISTIC speedgoat_test_SN5659__cal_impl.Decode4_P2_l "" VALUE 0x008D9818 Scalar_FLOAT64_IEEE 0 speedgoat_test_SN5659_R2021b_CM_double -1.7E+308 1.7E+308 /end CHARACTERISTIC
/begin CHARACTERISTIC speedgoat_test_SN5659__cal_impl.Decode4_P2_lo "" VALUE 0x008DB278 Scalar_FLOAT64_IEEE 0 speedgoat_test_SN5659_R2021b_CM_double -1.7E+308 1.7E+308 /end CHARACTERISTIC
/begin CHARACTERISTIC speedgoat_test_SN5659__cal_impl.Decode4_P2_m "" VALUE 0x008DABE0 Scalar_FLOAT64_IEEE 0 speedgoat_test_SN5659_R2021b_CM_double -1.7E+308 1.7E+308 /end CHARACTERISTIC
/begin CHARACTERISTIC speedgoat_test_SN5659__cal_impl.Decode4_P2_n "" VALUE 0x008DB910 Scalar_FLOAT64_IEEE 0 speedgoat_test_SN5659_R2021b_CM_double -1.7E+308 1.7E+308 /end CHARACTERISTIC
/begin CHARACTERISTIC speedgoat_test_SN5659__cal_impl.Decode4_P2_p "" VALUE 0x008D8450 Scalar_FLOAT64_IEEE 0 speedgoat_test_SN5659_R2021b_CM_double -1.7E+308 1.7E+308 /end CHARACTERISTIC
/begin CHARACTERISTIC speedgoat_test_SN5659__cal_impl.Decode4_P2_p0 "" VALUE 0x008D9EB0 Scalar_FLOAT64_IEEE 0 speedgoat_test_SN5659_R2021b_CM_double -1.7E+308 1.7E+308 /end CHARACTERISTIC
/begin CHARACTERISTIC speedgoat_test_SN5659__cal_impl.Decode4_P2_pq "" VALUE 0x008DBFA8 Scalar_FLOAT64_IEEE 0 speedgoat_test_SN5659_R2021b_CM_double -1.7E+308 1.7E+308 /end CHARACTERISTIC
/begin CHARACTERISTIC speedgoat_test_SN5659__cal_impl.Decode4_P3_b "" VALUE 0x008DB290 Scalar_FLOAT64_IEEE 0 speedgoat_test_SN5659_R2021b_CM_double -1.7E+308 1.7E+308 /end CHARACTERISTIC
/begin CHARACTERISTIC speedgoat_test_SN5659__cal_impl.Decode4_P3_c "" VALUE 0x008D8468 Scalar_FLOAT64_IEEE 0 speedgoat_test_SN5659_R2021b_CM_double -1.7E+308 1.7E+308 /end CHARACTERISTIC
/begin CHARACTERISTIC speedgoat_test_SN5659__cal_impl.Decode4_P3_cw "" VALUE 0x008D9EC8 Scalar_FLOAT64_IEEE 0 speedgoat_test_SN5659_R2021b_CM_double -1.7E+308 1.7E+308 /end CHARACTERISTIC
/begin CHARACTERISTIC speedgoat_test_SN5659__cal_impl.Decode4_P3_e "" VALUE 0x008D9830 Scalar_FLOAT64_IEEE 0 speedgoat_test_SN5659_R2021b_CM_double -1.7E+308 1.7E+308 /end CHARACTERISTIC
/begin CHARACTERISTIC speedgoat_test_SN5659__cal_impl.Decode4_P3_g "" VALUE 0x008DC658 Scalar_FLOAT64_IEEE 0 speedgoat_test_SN5659_R2021b_CM_double -1.7E+308 1.7E+308 /end CHARACTERISTIC
/begin CHARACTERISTIC speedgoat_test_SN5659__cal_impl.Decode4_P3_j "" VALUE 0x008DB928 Scalar_FLOAT64_IEEE 0 speedgoat_test_SN5659_R2021b_CM_double -1.7E+308 1.7E+308 /end CHARACTERISTIC
/begin CHARACTERISTIC speedgoat_test_SN5659__cal_impl.Decode4_P3_k "" VALUE 0x008DBFC0 Scalar_FLOAT64_IEEE 0 speedgoat_test_SN5659_R2021b_CM_double -1.7E+308 1.7E+308 /end CHARACTERISTIC
/begin CHARACTERISTIC speedgoat_test_SN5659__cal_impl.Decode4_P3_m "" VALUE 0x008DA560 Scalar_FLOAT64_IEEE 0 speedgoat_test_SN5659_R2021b_CM_double -1.7E+308 1.7E+308 /end CHARACTERISTIC
/begin CHARACTERISTIC speedgoat_test_SN5659__cal_impl.Decode4_P3_mr "" VALUE 0x008DABF8 Scalar_FLOAT64_IEEE 0 speedgoat_test_SN5659_R2021b_CM_double -1.7E+308 1.7E+308 /end CHARACTERISTIC
/begin CHARACTERISTIC speedgoat_test_SN5659__cal_impl.Decode4_P3_n "" VALUE 0x008DCCF0 Scalar_FLOAT64_IEEE 0 speedgoat_test_SN5659_R2021b_CM_double -1.7E+308 1.7E+308 /end CHARACTERISTIC
/begin CHARACTERISTIC speedgoat_test_SN5659__cal_impl.Decode4_P3_p "" VALUE 0x008D9198 Scalar_FLOAT64_IEEE 0 speedgoat_test_SN5659_R2021b_CM_double -1.7E+308 1.7E+308 /end CHARACTERISTIC
/begin CHARACTERISTIC speedgoat_test_SN5659__cal_impl.Decode4_P4_b "" VALUE 0x008DCD08 Scalar_FLOAT64_IEEE 0 speedgoat_test_SN5659_R2021b_CM_double -1.7E+308 1.7E+308 /end CHARACTERISTIC
/begin CHARACTERISTIC speedgoat_test_SN5659__cal_impl.Decode4_P4_e "" VALUE 0x008D8480 Scalar_FLOAT64_IEEE 0 speedgoat_test_SN5659_R2021b_CM_double -1.7E+308 1.7E+308 /end CHARACTERISTIC
/begin CHARACTERISTIC speedgoat_test_SN5659__cal_impl.Decode4_P4_f "" VALUE 0x008DAC10 Scalar_FLOAT64_IEEE 0 speedgoat_test_SN5659_R2021b_CM_double -1.7E+308 1.7E+308 /end CHARACTERISTIC
/begin CHARACTERISTIC speedgoat_test_SN5659__cal_impl.Decode4_P4_ft "" VALUE 0x008DBFD8 Scalar_FLOAT64_IEEE 0 speedgoat_test_SN5659_R2021b_CM_double -1.7E+308 1.7E+308 /end CHARACTERISTIC
/begin CHARACTERISTIC speedgoat_test_SN5659__cal_impl.Decode4_P4_g "" VALUE 0x008DC670 Scalar_FLOAT64_IEEE 0 speedgoat_test_SN5659_R2021b_CM_double -1.7E+308 1.7E+308 /end CHARACTERISTIC
/begin CHARACTERISTIC speedgoat_test_SN5659__cal_impl.Decode4_P4_h "" VALUE 0x008DA578 Scalar_FLOAT64_IEEE 0 speedgoat_test_SN5659_R2021b_CM_double -1.7E+308 1.7E+308 /end CHARACTERISTIC
/begin CHARACTERISTIC speedgoat_test_SN5659__cal_impl.Decode4_P4_hj "" VALUE 0x008DB940 Scalar_FLOAT64_IEEE 0 speedgoat_test_SN5659_R2021b_CM_double -1.7E+308 1.7E+308 /end CHARACTERISTIC
/begin CHARACTERISTIC speedgoat_test_SN5659__cal_impl.Decode4_P4_hz "" VALUE 0x008DB2A8 Scalar_FLOAT64_IEEE 0 speedgoat_test_SN5659_R2021b_CM_double -1.7E+308 1.7E+308 /end CHARACTERISTIC
/begin CHARACTERISTIC speedgoat_test_SN5659__cal_impl.Decode4_P4_i "" VALUE 0x008D9848 Scalar_FLOAT64_IEEE 0 speedgoat_test_SN5659_R2021b_CM_double -1.7E+308 1.7E+308 /end CHARACTERISTIC
/begin CHARACTERISTIC speedgoat_test_SN5659__cal_impl.Decode4_P4_l "" VALUE 0x008D91B0 Scalar_FLOAT64_IEEE 0 speedgoat_test_SN5659_R2021b_CM_double -1.7E+308 1.7E+308 /end CHARACTERISTIC
/begin CHARACTERISTIC speedgoat_test_SN5659__cal_impl.Decode4_P4_p "" VALUE 0x008D9EE0 Scalar_FLOAT64_IEEE 0 speedgoat_test_SN5659_R2021b_CM_double -1.7E+308 1.7E+308 /end CHARACTERISTIC
/begin CHARACTERISTIC speedgoat_test_SN5659__cal_impl.Decode4_P5_a "" VALUE 0x008D9EF8 Scalar_FLOAT64_IEEE 0 speedgoat_test_SN5659_R2021b_CM_double -1.7E+308 1.7E+308 /end CHARACTERISTIC
/begin CHARACTERISTIC speedgoat_test_SN5659__cal_impl.Decode4_P5_c "" VALUE 0x008D91C8 Scalar_FLOAT64_IEEE 0 speedgoat_test_SN5659_R2021b_CM_double -1.7E+308 1.7E+308 /end CHARACTERISTIC
/begin CHARACTERISTIC speedgoat_test_SN5659__cal_impl.Decode4_P5_cm "" VALUE 0x008DC688 Scalar_FLOAT64_IEEE 0 speedgoat_test_SN5659_R2021b_CM_double -1.7E+308 1.7E+308 /end CHARACTERISTIC
/begin CHARACTERISTIC speedgoat_test_SN5659__cal_impl.Decode4_P5_cn "" VALUE 0x008DAC28 Scalar_FLOAT64_IEEE 0 speedgoat_test_SN5659_R2021b_CM_double -1.7E+308 1.7E+308 /end CHARACTERISTIC
/begin CHARACTERISTIC speedgoat_test_SN5659__cal_impl.Decode4_P5_cq "" VALUE 0x008DA590 Scalar_FLOAT64_IEEE 0 speedgoat_test_SN5659_R2021b_CM_double -1.7E+308 1.7E+308 /end CHARACTERISTIC
/begin CHARACTERISTIC speedgoat_test_SN5659__cal_impl.Decode4_P5_d "" VALUE 0x008DBFF0 Scalar_FLOAT64_IEEE 0 speedgoat_test_SN5659_R2021b_CM_double -1.7E+308 1.7E+308 /end CHARACTERISTIC
/begin CHARACTERISTIC speedgoat_test_SN5659__cal_impl.Decode4_P5_e "" VALUE 0x008D9860 Scalar_FLOAT64_IEEE 0 speedgoat_test_SN5659_R2021b_CM_double -1.7E+308 1.7E+308 /end CHARACTERISTIC
/begin CHARACTERISTIC speedgoat_test_SN5659__cal_impl.Decode4_P5_k "" VALUE 0x008DB958 Scalar_FLOAT64_IEEE 0 speedgoat_test_SN5659_R2021b_CM_double -1.7E+308 1.7E+308 /end CHARACTERISTIC
/begin CHARACTERISTIC speedgoat_test_SN5659__cal_impl.Decode4_P5_l "" VALUE 0x008DB2C0 Scalar_FLOAT64_IEEE 0 speedgoat_test_SN5659_R2021b_CM_double -1.7E+308 1.7E+308 /end CHARACTERISTIC
/begin CHARACTERISTIC speedgoat_test_SN5659__cal_impl.Decode4_P5_m "" VALUE 0x008DCD20 Scalar_FLOAT64_IEEE 0 speedgoat_test_SN5659_R2021b_CM_double -1.7E+308 1.7E+308 /end CHARACTERISTIC
/begin CHARACTERISTIC speedgoat_test_SN5659__cal_impl.Decode4_P5_p "" VALUE 0x008D8498 Scalar_FLOAT64_IEEE 0 speedgoat_test_SN5659_R2021b_CM_double -1.7E+308 1.7E+308 /end CHARACTERISTIC
/begin CHARACTERISTIC speedgoat_test_SN5659__cal_impl.Decode4_P6_a "" VALUE 0x008D9F10 Scalar_FLOAT64_IEEE 0 speedgoat_test_SN5659_R2021b_CM_double -1.7E+308 1.7E+308 /end CHARACTERISTIC
/begin CHARACTERISTIC speedgoat_test_SN5659__cal_impl.Decode4_P6_aj "" VALUE 0x008DB970 Scalar_FLOAT64_IEEE 0 speedgoat_test_SN5659_R2021b_CM_double -1.7E+308 1.7E+308 /end CHARACTERISTIC
/begin CHARACTERISTIC speedgoat_test_SN5659__cal_impl.Decode4_P6_aw "" VALUE 0x008DAC40 Scalar_FLOAT64_IEEE 0 speedgoat_test_SN5659_R2021b_CM_double -1.7E+308 1.7E+308 /end CHARACTERISTIC
/begin CHARACTERISTIC speedgoat_test_SN5659__cal_impl.Decode4_P6_awi "" VALUE 0x008DC6A0 Scalar_FLOAT64_IEEE 0 speedgoat_test_SN5659_R2021b_CM_double -1.7E+308 1.7E+308 /end CHARACTERISTIC
/begin CHARACTERISTIC speedgoat_test_SN5659__cal_impl.Decode4_P6_c "" VALUE 0x008D91E0 Scalar_FLOAT64_IEEE 0 speedgoat_test_SN5659_R2021b_CM_double -1.7E+308 1.7E+308 /end CHARACTERISTIC
/begin CHARACTERISTIC speedgoat_test_SN5659__cal_impl.Decode4_P6_d "" VALUE 0x008DCD38 Scalar_FLOAT64_IEEE 0 speedgoat_test_SN5659_R2021b_CM_double -1.7E+308 1.7E+308 /end CHARACTERISTIC
/begin CHARACTERISTIC speedgoat_test_SN5659__cal_impl.Decode4_P6_e "" VALUE 0x008DA5A8 Scalar_FLOAT64_IEEE 0 speedgoat_test_SN5659_R2021b_CM_double -1.7E+308 1.7E+308 /end CHARACTERISTIC
/begin CHARACTERISTIC speedgoat_test_SN5659__cal_impl.Decode4_P6_f "" VALUE 0x008DB2D8 Scalar_FLOAT64_IEEE 0 speedgoat_test_SN5659_R2021b_CM_double -1.7E+308 1.7E+308 /end CHARACTERISTIC
/begin CHARACTERISTIC speedgoat_test_SN5659__cal_impl.Decode4_P6_h "" VALUE 0x008D84B0 Scalar_FLOAT64_IEEE 0 speedgoat_test_SN5659_R2021b_CM_double -1.7E+308 1.7E+308 /end CHARACTERISTIC
/begin CHARACTERISTIC speedgoat_test_SN5659__cal_impl.Decode4_P6_m "" VALUE 0x008DC008 Scalar_FLOAT64_IEEE 0 speedgoat_test_SN5659_R2021b_CM_double -1.7E+308 1.7E+308 /end CHARACTERISTIC
/begin CHARACTERISTIC speedgoat_test_SN5659__cal_impl.Decode4_P6_p "" VALUE 0x008D9878 Scalar_FLOAT64_IEEE 0 speedgoat_test_SN5659_R2021b_CM_double -1.7E+308 1.7E+308 /end CHARACTERISTIC
/begin CHARACTERISTIC speedgoat_test_SN5659__cal_impl.Decode4_P7_a "" VALUE 0x008DCD50 Scalar_FLOAT64_IEEE 0 speedgoat_test_SN5659_R2021b_CM_double -1.7E+308 1.7E+308 /end CHARACTERISTIC
/begin CHARACTERISTIC speedgoat_test_SN5659__cal_impl.Decode4_P7_b "" VALUE 0x008DAC58 Scalar_FLOAT64_IEEE 0 speedgoat_test_SN5659_R2021b_CM_double -1.7E+308 1.7E+308 /end CHARACTERISTIC
/begin CHARACTERISTIC speedgoat_test_SN5659__cal_impl.Decode4_P7_d "" VALUE 0x008DA5C0 Scalar_FLOAT64_IEEE 0 speedgoat_test_SN5659_R2021b_CM_double -1.7E+308 1.7E+308 /end CHARACTERISTIC
/begin CHARACTERISTIC speedgoat_test_SN5659__cal_impl.Decode4_P7_f "" VALUE 0x008D84C8 Scalar_FLOAT64_IEEE 0 speedgoat_test_SN5659_R2021b_CM_double -1.7E+308 1.7E+308 /end CHARACTERISTIC
/begin CHARACTERISTIC speedgoat_test_SN5659__cal_impl.Decode4_P7_fb "" VALUE 0x008DB2F0 Scalar_FLOAT64_IEEE 0 speedgoat_test_SN5659_R2021b_CM_double -1.7E+308 1.7E+308 /end CHARACTERISTIC
/begin CHARACTERISTIC speedgoat_test_SN5659__cal_impl.Decode4_P7_g "" VALUE 0x008D9F28 Scalar_FLOAT64_IEEE 0 speedgoat_test_SN5659_R2021b_CM_double -1.7E+308 1.7E+308 /end CHARACTERISTIC
/begin CHARACTERISTIC speedgoat_test_SN5659__cal_impl.Decode4_P7_h "" VALUE 0x008DB988 Scalar_FLOAT64_IEEE 0 speedgoat_test_SN5659_R2021b_CM_double -1.7E+308 1.7E+308 /end CHARACTERISTIC
/begin CHARACTERISTIC speedgoat_test_SN5659__cal_impl.Decode4_P7_h0 "" VALUE 0x008DC6B8 Scalar_FLOAT64_IEEE 0 speedgoat_test_SN5659_R2021b_CM_double -1.7E+308 1.7E+308 /end CHARACTERISTIC
/begin CHARACTERISTIC speedgoat_test_SN5659__cal_impl.Decode4_P7_nt "" VALUE 0x008D91F8 Scalar_FLOAT64_IEEE 0 speedgoat_test_SN5659_R2021b_CM_double -1.7E+308 1.7E+308 /end CHARACTERISTIC
/begin CHARACTERISTIC speedgoat_test_SN5659__cal_impl.Decode4_P7_nw "" VALUE 0x008DC020 Scalar_FLOAT64_IEEE 0 speedgoat_test_SN5659_R2021b_CM_double -1.7E+308 1.7E+308 /end CHARACTERISTIC
/begin CHARACTERISTIC speedgoat_test_SN5659__cal_impl.Decode4_P7_o "" VALUE 0x008D9890 Scalar_FLOAT64_IEEE 0 speedgoat_test_SN5659_R2021b_CM_double -1.7E+308 1.7E+308 /end CHARACTERISTIC
/begin CHARACTERISTIC speedgoat_test_SN5659__cal_impl.Decode4_P8_b "" VALUE 0x008D84E0 Scalar_FLOAT64_IEEE 0 speedgoat_test_SN5659_R2021b_CM_double -1.7E+308 1.7E+308 /end CHARACTERISTIC
/begin CHARACTERISTIC speedgoat_test_SN5659__cal_impl.Decode4_P8_d "" VALUE 0x008DB308 Scalar_FLOAT64_IEEE 0 speedgoat_test_SN5659_R2021b_CM_double -1.7E+308 1.7E+308 /end CHARACTERISTIC
/begin CHARACTERISTIC speedgoat_test_SN5659__cal_impl.Decode4_P8_e "" VALUE 0x008D98A8 Scalar_FLOAT64_IEEE 0 speedgoat_test_SN5659_R2021b_CM_double -1.7E+308 1.7E+308 /end CHARACTERISTIC
/begin CHARACTERISTIC speedgoat_test_SN5659__cal_impl.Decode4_P8_gh "" VALUE 0x008DA5D8 Scalar_FLOAT64_IEEE 0 speedgoat_test_SN5659_R2021b_CM_double -1.7E+308 1.7E+308 /end CHARACTERISTIC
/begin CHARACTERISTIC speedgoat_test_SN5659__cal_impl.Decode4_P8_i "" VALUE 0x008D9F40 Scalar_FLOAT64_IEEE 0 speedgoat_test_SN5659_R2021b_CM_double -1.7E+308 1.7E+308 /end CHARACTERISTIC
/begin CHARACTERISTIC speedgoat_test_SN5659__cal_impl.Decode4_P8_iy "" VALUE 0x008DB9A0 Scalar_FLOAT64_IEEE 0 speedgoat_test_SN5659_R2021b_CM_double -1.7E+308 1.7E+308 /end CHARACTERISTIC
/begin CHARACTERISTIC speedgoat_test_SN5659__cal_impl.Decode4_P8_j "" VALUE 0x008D9210 Scalar_FLOAT64_IEEE 0 speedgoat_test_SN5659_R2021b_CM_double -1.7E+308 1.7E+308 /end CHARACTERISTIC
/begin CHARACTERISTIC speedgoat_test_SN5659__cal_impl.Decode4_P8_l "" VALUE 0x008DCD68 Scalar_FLOAT64_IEEE 0 speedgoat_test_SN5659_R2021b_CM_double -1.7E+308 1.7E+308 /end CHARACTERISTIC
/begin CHARACTERISTIC speedgoat_test_SN5659__cal_impl.Decode4_P8_m "" VALUE 0x008DAC70 Scalar_FLOAT64_IEEE 0 speedgoat_test_SN5659_R2021b_CM_double -1.7E+308 1.7E+308 /end CHARACTERISTIC
/begin CHARACTERISTIC speedgoat_test_SN5659__cal_impl.Decode4_P8_n "" VALUE 0x008DC038 Scalar_FLOAT64_IEEE 0 speedgoat_test_SN5659_R2021b_CM_double -1.7E+308 1.7E+308 /end CHARACTERISTIC
/begin CHARACTERISTIC speedgoat_test_SN5659__cal_impl.Decode4_P8_p "" VALUE 0x008DC6D0 Scalar_FLOAT64_IEEE 0 speedgoat_test_SN5659_R2021b_CM_double -1.7E+308 1.7E+308 /end CHARACTERISTIC
/begin CHARACTERISTIC speedgoat_test_SN5659__cal_impl.Decode4_P9_a "" VALUE 0x008D84F8 Scalar_FLOAT64_IEEE 0 speedgoat_test_SN5659_R2021b_CM_double -1.7E+308 1.7E+308 /end CHARACTERISTIC
/begin CHARACTERISTIC speedgoat_test_SN5659__cal_impl.Decode4_P9_ay "" VALUE 0x008D98C0 Scalar_FLOAT64_IEEE 0 speedgoat_test_SN5659_R2021b_CM_double -1.7E+308 1.7E+308 /end CHARACTERISTIC
/begin CHARACTERISTIC speedgoat_test_SN5659__cal_impl.Decode4_P9_b "" VALUE 0x008D9228 Scalar_FLOAT64_IEEE 0 speedgoat_test_SN5659_R2021b_CM_double -1.7E+308 1.7E+308 /end CHARACTERISTIC
/begin CHARACTERISTIC speedgoat_test_SN5659__cal_impl.Decode4_P9_bz "" VALUE 0x008DB9B8 Scalar_FLOAT64_IEEE 0 speedgoat_test_SN5659_R2021b_CM_double -1.7E+308 1.7E+308 /end CHARACTERISTIC
/begin CHARACTERISTIC speedgoat_test_SN5659__cal_impl.Decode4_P9_d "" VALUE 0x008D9F58 Scalar_FLOAT64_IEEE 0 speedgoat_test_SN5659_R2021b_CM_double -1.7E+308 1.7E+308 /end CHARACTERISTIC
/begin CHARACTERISTIC speedgoat_test_SN5659__cal_impl.Decode4_P9_dp "" VALUE 0x008DC050 Scalar_FLOAT64_IEEE 0 speedgoat_test_SN5659_R2021b_CM_double -1.7E+308 1.7E+308 /end CHARACTERISTIC
/begin CHARACTERISTIC speedgoat_test_SN5659__cal_impl.Decode4_P9_l "" VALUE 0x008DB320 Scalar_FLOAT64_IEEE 0 speedgoat_test_SN5659_R2021b_CM_double -1.7E+308 1.7E+308 /end CHARACTERISTIC
/begin CHARACTERISTIC speedgoat_test_SN5659__cal_impl.Decode4_P9_n "" VALUE 0x008DA5F0 Scalar_FLOAT64_IEEE 0 speedgoat_test_SN5659_R2021b_CM_double -1.7E+308 1.7E+308 /end CHARACTERISTIC
/begin CHARACTERISTIC speedgoat_test_SN5659__cal_impl.Decode4_P9_o "" VALUE 0x008DAC88 Scalar_FLOAT64_IEEE 0 speedgoat_test_SN5659_R2021b_CM_double -1.7E+308 1.7E+308 /end CHARACTERISTIC
/begin CHARACTERISTIC speedgoat_test_SN5659__cal_impl.Decode4_P9_p "" VALUE 0x008DC6E8 Scalar_FLOAT64_IEEE 0 speedgoat_test_SN5659_R2021b_CM_double -1.7E+308 1.7E+308 /end CHARACTERISTIC
/begin CHARACTERISTIC speedgoat_test_SN5659__cal_impl.Decode4_P9_p0 "" VALUE 0x008DCD80 Scalar_FLOAT64_IEEE 0 speedgoat_test_SN5659_R2021b_CM_double -1.7E+308 1.7E+308 /end CHARACTERISTIC
/begin CHARACTERISTIC speedgoat_test_SN5659__cal_impl.Decode5_P10_k "" VAL_BLK 0x008DA2F8 Scalar_FLOAT64_IEEE 0 speedgoat_test_SN5659_R2021b_CM_double -1.7E+308 1.7E+308 MATRIX_DIM 2 1 /end CHARACTERISTIC
/begin CHARACTERISTIC speedgoat_test_SN5659__cal_impl.Decode5_P10_k2 "" VAL_BLK 0x008DCA88 Scalar_FLOAT64_IEEE 0 speedgoat_test_SN5659_R2021b_CM_double -1.7E+308 1.7E+308 MATRIX_DIM 2 1 /end CHARACTERISTIC
/begin CHARACTERISTIC speedgoat_test_SN5659__cal_impl.Decode5_P11_c "" VALUE 0x008DA318 Scalar_FLOAT64_IEEE 0 speedgoat_test_SN5659_R2021b_CM_double -1.7E+308 1.7E+308 /end CHARACTERISTIC
/begin CHARACTERISTIC speedgoat_test_SN5659__cal_impl.Decode5_P11_i "" VALUE 0x008DCAA8 Scalar_FLOAT64_IEEE 0 speedgoat_test_SN5659_R2021b_CM_double -1.7E+308 1.7E+308 /end CHARACTERISTIC
/begin CHARACTERISTIC speedgoat_test_SN5659__cal_impl.Decode5_P12_e "" VALUE 0x008DA330 Scalar_FLOAT64_IEEE 0 speedgoat_test_SN5659_R2021b_CM_double -1.7E+308 1.7E+308 /end CHARACTERISTIC
/begin CHARACTERISTIC speedgoat_test_SN5659__cal_impl.Decode5_P12_h "" VALUE 0x008DCAC0 Scalar_FLOAT64_IEEE 0 speedgoat_test_SN5659_R2021b_CM_double -1.7E+308 1.7E+308 /end CHARACTERISTIC
/begin CHARACTERISTIC speedgoat_test_SN5659__cal_impl.Decode5_P13_o "" VALUE 0x008DA348 Scalar_FLOAT64_IEEE 0 speedgoat_test_SN5659_R2021b_CM_double -1.7E+308 1.7E+308 /end CHARACTERISTIC
/begin CHARACTERISTIC speedgoat_test_SN5659__cal_impl.Decode5_P13_p "" VALUE 0x008DCAD8 Scalar_FLOAT64_IEEE 0 speedgoat_test_SN5659_R2021b_CM_double -1.7E+308 1.7E+308 /end CHARACTERISTIC
/begin CHARACTERISTIC speedgoat_test_SN5659__cal_impl.Decode5_P14_cm "" VALUE 0x008DCAF0 Scalar_FLOAT64_IEEE 0 speedgoat_test_SN5659_R2021b_CM_double -1.7E+308 1.7E+308 /end CHARACTERISTIC
/begin CHARACTERISTIC speedgoat_test_SN5659__cal_impl.Decode5_P14_g "" VALUE 0x008DA360 Scalar_FLOAT64_IEEE 0 speedgoat_test_SN5659_R2021b_CM_double -1.7E+308 1.7E+308 /end CHARACTERISTIC
/begin CHARACTERISTIC speedgoat_test_SN5659__cal_impl.Decode5_P15_b "" VALUE 0x008DCB08 Scalar_FLOAT64_IEEE 0 speedgoat_test_SN5659_R2021b_CM_double -1.7E+308 1.7E+308 /end CHARACTERISTIC
/begin CHARACTERISTIC speedgoat_test_SN5659__cal_impl.Decode5_P15_o "" VALUE 0x008DA378 Scalar_FLOAT64_IEEE 0 speedgoat_test_SN5659_R2021b_CM_double -1.7E+308 1.7E+308 /end CHARACTERISTIC
/begin CHARACTERISTIC speedgoat_test_SN5659__cal_impl.Decode5_P16_m "" VALUE 0x008DA390 Scalar_FLOAT64_IEEE 0 speedgoat_test_SN5659_R2021b_CM_double -1.7E+308 1.7E+308 /end CHARACTERISTIC
/begin CHARACTERISTIC speedgoat_test_SN5659__cal_impl.Decode5_P16_o "" VALUE 0x008DCB20 Scalar_FLOAT64_IEEE 0 speedgoat_test_SN5659_R2021b_CM_double -1.7E+308 1.7E+308 /end CHARACTERISTIC
/begin CHARACTERISTIC speedgoat_test_SN5659__cal_impl.Decode5_P1_m "" VALUE 0x008DA220 Scalar_FLOAT64_IEEE 0 speedgoat_test_SN5659_R2021b_CM_double -1.7E+308 1.7E+308 /end CHARACTERISTIC
/begin CHARACTERISTIC speedgoat_test_SN5659__cal_impl.Decode5_P1_p "" VALUE 0x008DC9B0 Scalar_FLOAT64_IEEE 0 speedgoat_test_SN5659_R2021b_CM_double -1.7E+308 1.7E+308 /end CHARACTERISTIC
/begin CHARACTERISTIC speedgoat_test_SN5659__cal_impl.Decode5_P2_f "" VALUE 0x008DA238 Scalar_FLOAT64_IEEE 0 speedgoat_test_SN5659_R2021b_CM_double -1.7E+308 1.7E+308 /end CHARACTERISTIC
/begin CHARACTERISTIC speedgoat_test_SN5659__cal_impl.Decode5_P2_f0 "" VALUE 0x008DC9C8 Scalar_FLOAT64_IEEE 0 speedgoat_test_SN5659_R2021b_CM_double -1.7E+308 1.7E+308 /end CHARACTERISTIC
/begin CHARACTERISTIC speedgoat_test_SN5659__cal_impl.Decode5_P3_d "" VALUE 0x008DA250 Scalar_FLOAT64_IEEE 0 speedgoat_test_SN5659_R2021b_CM_double -1.7E+308 1.7E+308 /end CHARACTERISTIC
/begin CHARACTERISTIC speedgoat_test_SN5659__cal_impl.Decode5_P3_o "" VALUE 0x008DC9E0 Scalar_FLOAT64_IEEE 0 speedgoat_test_SN5659_R2021b_CM_double -1.7E+308 1.7E+308 /end CHARACTERISTIC
/begin CHARACTERISTIC speedgoat_test_SN5659__cal_impl.Decode5_P4_f5 "" VALUE 0x008DC9F8 Scalar_FLOAT64_IEEE 0 speedgoat_test_SN5659_R2021b_CM_double -1.7E+308 1.7E+308 /end CHARACTERISTIC
/begin CHARACTERISTIC speedgoat_test_SN5659__cal_impl.Decode5_P4_j "" VALUE 0x008DA268 Scalar_FLOAT64_IEEE 0 speedgoat_test_SN5659_R2021b_CM_double -1.7E+308 1.7E+308 /end CHARACTERISTIC
/begin CHARACTERISTIC speedgoat_test_SN5659__cal_impl.Decode5_P5_d "" VALUE 0x008DCA10 Scalar_FLOAT64_IEEE 0 speedgoat_test_SN5659_R2021b_CM_double -1.7E+308 1.7E+308 /end CHARACTERISTIC
/begin CHARACTERISTIC speedgoat_test_SN5659__cal_impl.Decode5_P5_n "" VALUE 0x008DA280 Scalar_FLOAT64_IEEE 0 speedgoat_test_SN5659_R2021b_CM_double -1.7E+308 1.7E+308 /end CHARACTERISTIC
/begin CHARACTERISTIC speedgoat_test_SN5659__cal_impl.Decode5_P6_b "" VALUE 0x008DA298 Scalar_FLOAT64_IEEE 0 speedgoat_test_SN5659_R2021b_CM_double -1.7E+308 1.7E+308 /end CHARACTERISTIC
/begin CHARACTERISTIC speedgoat_test_SN5659__cal_impl.Decode5_P6_c "" VALUE 0x008DCA28 Scalar_FLOAT64_IEEE 0 speedgoat_test_SN5659_R2021b_CM_double -1.7E+308 1.7E+308 /end CHARACTERISTIC
/begin CHARACTERISTIC speedgoat_test_SN5659__cal_impl.Decode5_P7_j "" VALUE 0x008DA2B0 Scalar_FLOAT64_IEEE 0 speedgoat_test_SN5659_R2021b_CM_double -1.7E+308 1.7E+308 /end CHARACTERISTIC
/begin CHARACTERISTIC speedgoat_test_SN5659__cal_impl.Decode5_P7_m "" VALUE 0x008DCA40 Scalar_FLOAT64_IEEE 0 speedgoat_test_SN5659_R2021b_CM_double -1.7E+308 1.7E+308 /end CHARACTERISTIC
/begin CHARACTERISTIC speedgoat_test_SN5659__cal_impl.Decode5_P8_c "" VALUE 0x008DCA58 Scalar_FLOAT64_IEEE 0 speedgoat_test_SN5659_R2021b_CM_double -1.7E+308 1.7E+308 /end CHARACTERISTIC
/begin CHARACTERISTIC speedgoat_test_SN5659__cal_impl.Decode5_P8_d "" VALUE 0x008DA2C8 Scalar_FLOAT64_IEEE 0 speedgoat_test_SN5659_R2021b_CM_double -1.7E+308 1.7E+308 /end CHARACTERISTIC
/begin CHARACTERISTIC speedgoat_test_SN5659__cal_impl.Decode5_P9_h "" VALUE 0x008DCA70 Scalar_FLOAT64_IEEE 0 speedgoat_test_SN5659_R2021b_CM_double -1.7E+308 1.7E+308 /end CHARACTERISTIC
/begin CHARACTERISTIC speedgoat_test_SN5659__cal_impl.Decode5_P9_i "" VALUE 0x008DA2E0 Scalar_FLOAT64_IEEE 0 speedgoat_test_SN5659_R2021b_CM_double -1.7E+308 1.7E+308 /end CHARACTERISTIC
/begin MEASUREMENT speedgoat_test_SN5659_R2021b_B.Decode1_a "" FLOAT64_IEEE speedgoat_test_SN5659_R2021b_CM_double 0 0 -1.7E+308 1.7E+308 ECU_ADDRESS 0x00946A98 /end MEASUREMENT
/begin MEASUREMENT speedgoat_test_SN5659_R2021b_B.Decode1_al "" FLOAT64_IEEE speedgoat_test_SN5659_R2021b_CM_double 0 0 -1.7E+308 1.7E+308 ECU_ADDRESS 0x009471F8 /end MEASUREMENT
/begin MEASUREMENT speedgoat_test_SN5659_R2021b_B.Decode1_f "" FLOAT64_IEEE speedgoat_test_SN5659_R2021b_CM_double 0 0 -1.7E+308 1.7E+308 ECU_ADDRESS 0x009468C0 /end MEASUREMENT
/begin MEASUREMENT speedgoat_test_SN5659_R2021b_B.Decode1_g "" FLOAT64_IEEE speedgoat_test_SN5659_R2021b_CM_double 0 0 -1.7E+308 1.7E+308 ECU_ADDRESS 0x009466E8 /end MEASUREMENT
/begin MEASUREMENT speedgoat_test_SN5659_R2021b_B.Decode1_i "" FLOAT64_IEEE speedgoat_test_SN5659_R2021b_CM_double 0 0 -1.7E+308 1.7E+308 ECU_ADDRESS 0x00946C70 /end MEASUREMENT
/begin MEASUREMENT speedgoat_test_SN5659_R2021b_B.Decode1_io "" FLOAT64_IEEE speedgoat_test_SN5659_R2021b_CM_double 0 0 -1.7E+308 1.7E+308 ECU_ADDRESS 0x00947780 /end MEASUREMENT
/begin MEASUREMENT speedgoat_test_SN5659_R2021b_B.Decode1_m "" FLOAT64_IEEE speedgoat_test_SN5659_R2021b_CM_double 0 0 -1.7E+308 1.7E+308 ECU_ADDRESS 0x00946338 /end MEASUREMENT
/begin MEASUREMENT speedgoat_test_SN5659_R2021b_B.Decode1_my "" FLOAT64_IEEE speedgoat_test_SN5659_R2021b_CM_double 0 0 -1.7E+308 1.7E+308 ECU_ADDRESS 0x00946E48 /end MEASUREMENT
/begin MEASUREMENT speedgoat_test_SN5659_R2021b_B.Decode1_n "" FLOAT64_IEEE speedgoat_test_SN5659_R2021b_CM_double 0 0 -1.7E+308 1.7E+308 ECU_ADDRESS 0x00947020 /end MEASUREMENT
/begin MEASUREMENT speedgoat_test_SN5659_R2021b_B.Decode1_p "" FLOAT64_IEEE speedgoat_test_SN5659_R2021b_CM_double 0 0 -1.7E+308 1.7E+308 ECU_ADDRESS 0x009473D0 /end MEASUREMENT
/begin MEASUREMENT speedgoat_test_SN5659_R2021b_B.Decode1_pf "" FLOAT64_IEEE speedgoat_test_SN5659_R2021b_CM_double 0 0 -1.7E+308 1.7E+308 ECU_ADDRESS 0x009475A8 /end MEASUREMENT
/begin MEASUREMENT speedgoat_test_SN5659_R2021b_B.Decode2 "" FLOAT64_IEEE speedgoat_test_SN5659_R2021b_CM_double 0 0 -1.7E+308 1.7E+308 ECU_ADDRESS 0x00946340 /end MEASUREMENT
/begin MEASUREMENT speedgoat_test_SN5659_R2021b_B.Decode2_b "" FLOAT64_IEEE speedgoat_test_SN5659_R2021b_CM_double 0 0 -1.7E+308 1.7E+308 ECU_ADDRESS 0x00947028 /end MEASUREMENT
/begin MEASUREMENT speedgoat_test_SN5659_R2021b_B.Decode2_ba "" FLOAT64_IEEE speedgoat_test_SN5659_R2021b_CM_double 0 0 -1.7E+308 1.7E+308 ECU_ADDRESS 0x009473D8 /end MEASUREMENT
/begin MEASUREMENT speedgoat_test_SN5659_R2021b_B.Decode2_i "" FLOAT64_IEEE speedgoat_test_SN5659_R2021b_CM_double 0 0 -1.7E+308 1.7E+308 ECU_ADDRESS 0x00946E50 /end MEASUREMENT
/begin MEASUREMENT speedgoat_test_SN5659_R2021b_B.Decode2_j "" FLOAT64_IEEE speedgoat_test_SN5659_R2021b_CM_double 0 0 -1.7E+308 1.7E+308 ECU_ADDRESS 0x009468C8 /end MEASUREMENT
/begin MEASUREMENT speedgoat_test_SN5659_R2021b_B.Decode2_j2 "" FLOAT64_IEEE speedgoat_test_SN5659_R2021b_CM_double 0 0 -1.7E+308 1.7E+308 ECU_ADDRESS 0x00946AA0 /end MEASUREMENT
/begin MEASUREMENT speedgoat_test_SN5659_R2021b_B.Decode2_k "" FLOAT64_IEEE speedgoat_test_SN5659_R2021b_CM_double 0 0 -1.7E+308 1.7E+308 ECU_ADDRESS 0x009475B0 /end MEASUREMENT
/begin MEASUREMENT speedgoat_test_SN5659_R2021b_B.Decode2_l "" FLOAT64_IEEE speedgoat_test_SN5659_R2021b_CM_double 0 0 -1.7E+308 1.7E+308 ECU_ADDRESS 0x00947200 /end MEASUREMENT
/begin MEASUREMENT speedgoat_test_SN5659_R2021b_B.Decode2_n "" FLOAT64_IEEE speedgoat_test_SN5659_R2021b_CM_double 0 0 -1.7E+308 1.7E+308 ECU_ADDRESS 0x009466F0 /end MEASUREMENT
/begin MEASUREMENT speedgoat_test_SN5659_R2021b_B.Decode3_a "" FLOAT64_IEEE speedgoat_test_SN5659_R2021b_CM_double 0 0 -1.7E+308 1.7E+308 ECU_ADDRESS 0x009473E0 /end MEASUREMENT
/begin MEASUREMENT speedgoat_test_SN5659_R2021b_B.Decode3_b "" FLOAT64_IEEE speedgoat_test_SN5659_R2021b_CM_double 0 0 -1.7E+308 1.7E+308 ECU_ADDRESS 0x009475B8 /end MEASUREMENT
/begin MEASUREMENT speedgoat_test_SN5659_R2021b_B.Decode3_cq "" FLOAT64_IEEE speedgoat_test_SN5659_R2021b_CM_double 0 0 -1.7E+308 1.7E+308 ECU_ADDRESS 0x00947030 /end MEASUREMENT
/begin MEASUREMENT speedgoat_test_SN5659_R2021b_B.Decode3_j "" FLOAT64_IEEE speedgoat_test_SN5659_R2021b_CM_double 0 0 -1.7E+308 1.7E+308 ECU_ADDRESS 0x009466F8 /end MEASUREMENT
/begin MEASUREMENT speedgoat_test_SN5659_R2021b_B.Decode3_k "" FLOAT64_IEEE speedgoat_test_SN5659_R2021b_CM_double 0 0 -1.7E+308 1.7E+308 ECU_ADDRESS 0x009468D0 /end MEASUREMENT
/begin MEASUREMENT speedgoat_test_SN5659_R2021b_B.Decode3_l "" FLOAT64_IEEE speedgoat_test_SN5659_R2021b_CM_double 0 0 -1.7E+308 1.7E+308 ECU_ADDRESS 0x00946348 /end MEASUREMENT
/begin MEASUREMENT speedgoat_test_SN5659_R2021b_B.Decode3_m "" FLOAT64_IEEE speedgoat_test_SN5659_R2021b_CM_double 0 0 -1.7E+308 1.7E+308 ECU_ADDRESS 0x00946AA8 /end MEASUREMENT
/begin MEASUREMENT speedgoat_test_SN5659_R2021b_B.Decode3_n "" FLOAT64_IEEE speedgoat_test_SN5659_R2021b_CM_double 0 0 -1.7E+308 1.7E+308 ECU_ADDRESS 0x00946E58 /end MEASUREMENT
/begin MEASUREMENT speedgoat_test_SN5659_R2021b_B.Decode3_ny "" FLOAT64_IEEE speedgoat_test_SN5659_R2021b_CM_double 0 0 -1.7E+308 1.7E+308 ECU_ADDRESS 0x00947790 /end MEASUREMENT
/begin MEASUREMENT speedgoat_test_SN5659_R2021b_B.Decode3_o "" FLOAT64_IEEE speedgoat_test_SN5659_R2021b_CM_double 0 0 -1.7E+308 1.7E+308 ECU_ADDRESS 0x00946C80 /end MEASUREMENT
/begin MEASUREMENT speedgoat_test_SN5659_R2021b_B.Decode3_ou "" FLOAT64_IEEE speedgoat_test_SN5659_R2021b_CM_double 0 0 -1.7E+308 1.7E+308 ECU_ADDRESS 0x00947208 /end MEASUREMENT
/begin MEASUREMENT speedgoat_test_SN5659_R2021b_B.Decode4_a "" FLOAT64_IEEE speedgoat_test_SN5659_R2021b_CM_double 0 0 -1.7E+308 1.7E+308 ECU_ADDRESS 0x00946AB0 /end MEASUREMENT
/begin MEASUREMENT speedgoat_test_SN5659_R2021b_B.Decode4_b "" FLOAT64_IEEE speedgoat_test_SN5659_R2021b_CM_double 0 0 -1.7E+308 1.7E+308 ECU_ADDRESS 0x00946C88 /end MEASUREMENT
/begin MEASUREMENT speedgoat_test_SN5659_R2021b_B.Decode4_c "" FLOAT64_IEEE speedgoat_test_SN5659_R2021b_CM_double 0 0 -1.7E+308 1.7E+308 ECU_ADDRESS 0x009468D8 /end MEASUREMENT
/begin MEASUREMENT speedgoat_test_SN5659_R2021b_B.Decode4_c1 "" FLOAT64_IEEE speedgoat_test_SN5659_R2021b_CM_double 0 0 -1.7E+308 1.7E+308 ECU_ADDRESS 0x00946E60 /end MEASUREMENT
/begin MEASUREMENT speedgoat_test_SN5659_R2021b_B.Decode4_d "" FLOAT64_IEEE speedgoat_test_SN5659_R2021b_CM_double 0 0 -1.7E+308 1.7E+308 ECU_ADDRESS 0x00946350 /end MEASUREMENT
/begin MEASUREMENT speedgoat_test_SN5659_R2021b_B.Decode4_f "" FLOAT64_IEEE speedgoat_test_SN5659_R2021b_CM_double 0 0 -1.7E+308 1.7E+308 ECU_ADDRESS 0x009473E8 /end MEASUREMENT
/begin MEASUREMENT speedgoat_test_SN5659_R2021b_B.Decode4_ff "" FLOAT64_IEEE speedgoat_test_SN5659_R2021b_CM_double 0 0 -1.7E+308 1.7E+308 ECU_ADDRESS 0x009475C0 /end MEASUREMENT
/begin MEASUREMENT speedgoat_test_SN5659_R2021b_B.Decode4_h "" FLOAT64_IEEE speedgoat_test_SN5659_R2021b_CM_double 0 0 -1.7E+308 1.7E+308 ECU_ADDRESS 0x00946700 /end MEASUREMENT
/begin MEASUREMENT speedgoat_test_SN5659_R2021b_B.Decode4_j "" FLOAT64_IEEE speedgoat_test_SN5659_R2021b_CM_double 0 0 -1.7E+308 1.7E+308 ECU_ADDRESS 0x00947798 /end MEASUREMENT
/begin MEASUREMENT speedgoat_test_SN5659_R2021b_B.Decode4_oi "" FLOAT64_IEEE speedgoat_test_SN5659_R2021b_CM_double 0 0 -1.7E+308 1.7E+308 ECU_ADDRESS 0x00947038 /end MEASUREMENT
/begin MEASUREMENT speedgoat_test_SN5659_R2021b_B.Decode4_p "" FLOAT64_IEEE speedgoat_test_SN5659_R2021b_CM_double 0 0 -1.7E+308 1.7E+308 ECU_ADDRESS 0x00947210 /end MEASUREMENT
/begin MEASUREMENT speedgoat_test_SN5659_R2021b_B.Decode5_b "" FLOAT64_IEEE speedgoat_test_SN5659_R2021b_CM_double 0 0 -1.7E+308 1.7E+308 ECU_ADDRESS 0x00947788 /end MEASUREMENT
/begin MEASUREMENT speedgoat_test_SN5659_R2021b_B.Decode5_i "" FLOAT64_IEEE speedgoat_test_SN5659_R2021b_CM_double 0 0 -1.7E+308 1.7E+308 ECU_ADDRESS 0x00946C78 /end MEASUREMENT
/begin COMPU_METHOD speedgoat_test_SN5659_R2021b_CM_double "" IDENTICAL "%15.10" "" /end COMPU_METHOD
/begin RECORD_LAYOUT Scalar_FLOAT64_IEEE FNC_VALUES 1 FLOAT64_IEEE COLUMN_DIR DIRECT /end RECORD_LAYOUT
/begin GROUP speedgoat_test_SN5659_R2021b_IO682_Decode_Channel_10 "speedgoat_test_SN5659_R2021b/IO682/Decode Channel 10"
 /begin REF_CHARACTERISTIC speedgoat_test_SN5659__cal_impl.Decode1_P10_h speedgoat_test_SN5659__cal_impl.Decode1_P11_p speedgoat_test_SN5659__cal_impl.Decode1_P12_h speedgoat_test_SN5659__cal_impl.Decode1_P13_l speedgoat_test_SN5659__cal_impl.Decode1_P14_g speedgoat_test_SN5659__cal_impl.Decode1_P15_g speedgoat_test_SN5659__cal_impl.Decode1_P16_e speedgoat_test_SN5659__cal_impl.Decode1_P1_n speedgoat_test_SN5659__cal_impl.Decode1_P2_o speedgoat_test_SN5659__cal_impl.Decode1_P3_o speedgoat_test_SN5659__cal_impl.Decode1_P4_l speedgoat_test_SN5659__cal_impl.Decode1_P5_k speedgoat_test_SN5659__cal_impl.Decode1_P6_d speedgoat_test_SN5659__cal_impl.Decode1_P7_a speedgoat_test_SN5659__cal_impl.Decode1_P8_g speedgoat_test_SN5659__cal_impl.Decode1_P9_o speedgoat_test_SN5659__cal_impl.Decode2_P10_h speedgoat_test_SN5659__cal_impl.Decode2_P11_j speedgoat_test_SN5659__cal_impl.Decode2_P12_g speedgoat_test_SN5659__cal_impl.Decode2_P13_i speedgoat_test_SN5659__cal_impl.Decode2_P14_e speedgoat_test_SN5659__cal_impl.Decode2_P15_a speedgoat_test_SN5659__cal_impl.Decode2_P16_c speedgoat_test_SN5659__cal_impl.Decode2_P1_d speedgoat_test_SN5659__cal_impl.Decode2_P2_m speedgoat_test_SN5659__cal_impl.Decode2_P3_a speedgoat_test_SN5659__cal_impl.Decode2_P4_g speedgoat_test_SN5659__cal_impl.Decode2_P5_g speedgoat_test_SN5659__cal_impl.Decode2_P6_l speedgoat_test_SN5659__cal_impl.Decode2_P7_g speedgoat_test_SN5659__cal_impl.Decode2_P8_l speedgoat_test_SN5659__cal_impl.Decode2_P9_l speedgoat_test_SN5659__cal_impl.Decode3_P10_l speedgoat_test_SN5659__cal_impl.Decode3_P11_i speedgoat_test_SN5659__cal_impl.Decode3_P12_a speedgoat_test_SN5659__cal_impl.Decode3_P13_b speedgoat_test_SN5659__cal_impl.Decode3_P14_px speedgoat_test_SN5659__cal_impl.Decode3_P15_j speedgoat_test_SN5659__cal_impl.Decode3_P16_b1 speedgoat_test_SN5659__cal_impl.Decode3_P1_a1 speedgoat_test_SN5659__cal_impl.Decode3_P2_p speedgoat_test_SN5659__cal_impl.Decode3_P3_h speedgoat_test_SN5659__cal_impl.Decode3_P4_d speedgoat_test_SN5659__cal_impl.Decode3_P5_m speedgoat_test_SN5659__cal_impl.Decode3_P6_o speedgoat_test_SN5659__cal_impl.Decode3_P7_kc speedgoat_test_SN5659__cal_impl.Decode3_P8_m speedgoat_test_SN5659__cal_impl.Decode3_P9_o speedgoat_test_SN5659__cal_impl.Decode4_P10_g speedgoat_test_SN5659__cal_impl.Decode4_P11_h speedgoat_test_SN5659__cal_impl.Decode4_P12_f speedgoat_test_SN5659__cal_impl.Decode4_P13_g speedgoat_test_SN5659__cal_impl.Decode4_P14_f speedgoat_test_SN5659__cal_impl.Decode4_P15_a speedgoat_test_SN5659__cal_impl.Decode4_P16_p speedgoat_test_SN5659__cal_impl.Decode4_P1_p speedgoat_test_SN5659__cal_impl.Decode4_P2_j speedgoat_test_SN5659__cal_impl.Decode4_P3_p speedgoat_test_SN5659__cal_impl.Decode4_P4_l speedgoat_test_SN5659__cal_impl.Decode4_P5_c speedgoat_test_SN5659__cal_impl.Decode4_P6_c speedgoat_test_SN5659__cal_impl.Decode4_P7_nt speedgoat_test_SN5659__cal_impl.Decode4_P8_j speedgoat_test_SN5659__cal_impl.Decode4_P9_b /end REF_CHARACTERISTIC
 /begin REF_MEASUREMENT speedgoat_test_SN5659_R2021b_B.Decode1_g speedgoat_test_SN5659_R2021b_B.Decode2_n speedgoat_test_SN5659_R2021b_B.Decode3_j speedgoat_test_SN5659_R2021b_B.Decode4_h /end REF_MEASUREMENT
/end GROUP
/begin GROUP speedgoat_test_SN5659_R2021b_IO682_Decode_Channel_11 "speedgoat_test_SN5659_R2021b/IO682/Decode Channel 11"
 /begin REF_CHARACTERISTIC speedgoat_test_SN5659__cal_impl.Decode1_P10_lm speedgoat_test_SN5659__cal_impl.Decode1_P11_f speedgoat_test_SN5659__cal_impl.Decode1_P12_pv speedgoat_test_SN5659__cal_impl.Decode1_P13_fg speedgoat_test_SN5659__cal_impl.Decode1_P14_gk speedgoat_test_SN5659__cal_impl.Decode1_P15_a speedgoat_test_SN5659__cal_impl.Decode1_P16_n speedgoat_test_SN5659__cal_impl.Decode1_P1_ng speedgoat_test_SN5659__cal_impl.Decode1_P2_k speedgoat_test_SN5659__cal_impl.Decode1_P3_f speedgoat_test_SN5659__cal_impl.Decode1_P4_c speedgoat_test_SN5659__cal_impl.Decode1_P5_fb speedgoat_test_SN5659__cal_impl.Decode1_P6_b speedgoat_test_SN5659__cal_impl.Decode1_P7_m speedgoat_test_SN5659__cal_impl.Decode1_P8_e speedgoat_test_SN5659__cal_impl.Decode1_P9_b speedgoat_test_SN5659__cal_impl.Decode2_P10_c speedgoat_test_SN5659__cal_impl.Decode2_P11_f speedgoat_test_SN5659__cal_impl.Decode2_P12_f speedgoat_test_SN5659__cal_impl.Decode2_P13_k speedgoat_test_SN5659__cal_impl.Decode2_P14_m speedgoat_test_SN5659__cal_impl.Decode2_P15_c speedgoat_test_SN5659__cal_impl.Decode2_P16_m speedgoat_test_SN5659__cal_impl.Decode2_P1_g speedgoat_test_SN5659__cal_impl.Decode2_P2_e speedgoat_test_SN5659__cal_impl.Decode2_P3_e speedgoat_test_SN5659__cal_impl.Decode2_P4_l speedgoat_test_SN5659__cal_impl.Decode2_P5_f speedgoat_test_SN5659__cal_impl.Decode2_P6_o speedgoat_test_SN5659__cal_impl.Decode2_P7_m speedgoat_test_SN5659__cal_impl.Decode2_P8_f speedgoat_test_SN5659__cal_impl.Decode2_P9_p speedgoat_test_SN5659__cal_impl.Decode3_P10_f speedgoat_test_SN5659__cal_impl.Decode3_P11_h speedgoat_test_SN5659__cal_impl.Decode3_P12_k speedgoat_test_SN5659__cal_impl.Decode3_P13_m speedgoat_test_SN5659__cal_impl.Decode3_P14_l speedgoat_test_SN5659__cal_impl.Decode3_P15_l speedgoat_test_SN5659__cal_impl.Decode3_P16_h speedgoat_test_SN5659__cal_impl.Decode3_P1_k speedgoat_test_SN5659__cal_impl.Decode3_P2_o speedgoat_test_SN5659__cal_impl.Decode3_P3_c speedgoat_test_SN5659__cal_impl.Decode3_P4_i speedgoat_test_SN5659__cal_impl.Decode3_P5_a speedgoat_test_SN5659__cal_impl.Decode3_P6_i speedgoat_test_SN5659__cal_impl.Decode3_P7_c speedgoat_test_SN5659__cal_impl.Decode3_P8_g0 speedgoat_test_SN5659__cal_impl.Decode3_P9_d speedgoat_test_SN5659__cal_impl.Decode4_P10_m speedgoat_test_SN5659__cal_impl.Decode4_P11_d speedgoat_test_SN5659__cal_impl.Decode4_P12_k speedgoat_test_SN5659__cal_impl.Decode4_P13_f speedgoat_test_SN5659__cal_impl.Decode4_P14_d speedgoat_test_SN5659__cal_impl.Decode4_P15_f speedgoat_test_SN5659__cal_impl.Decode4_P16_e speedgoat_test_SN5659__cal_impl.Decode4_P1_c speedgoat_test_SN5659__cal_impl.Decode4_P2_l speedgoat_test_SN5659__cal_impl.Decode4_P3_e speedgoat_test_SN5659__cal_impl.Decode4_P4_i speedgoat_test_SN5659__cal_impl.Decode4_P5_e speedgoat_test_SN5659__cal_impl.Decode4_P6_p speedgoat_test_SN5659__cal_impl.Decode4_P7_o speedgoat_test_SN5659__cal_impl.Decode4_P8_e speedgoat_test_SN5659__cal_impl.Decode4_P9_ay /end REF_CHARACTERISTIC
 /begin REF_MEASUREMENT speedgoat_test_SN5659_R2021b_B.Decode1_f speedgoat_test_SN5659_R2021b_B.Decode2_j speedgoat_test_SN5659_R2021b_B.Decode3_k speedgoat_test_SN5659_R2021b_B.Decode4_c /end REF_MEASUREMENT
/end GROUP
/begin GROUP speedgoat_test_SN5659_R2021b_IO682_Decode_Channel_12 "speedgoat_test_SN5659_R2021b/IO682/Decode Channel 12"
 /begin REF_CHARACTERISTIC speedgoat_test_SN5659__cal_impl.Decode1_P10_k1 speedgoat_test_SN5659__cal_impl.Decode1_P11_i speedgoat_test_SN5659__cal_impl.Decode1_P12_j speedgoat_test_SN5659__cal_impl.Decode1_P13_aa speedgoat_test_SN5659__cal_impl.Decode1_P14_d speedgoat_test_SN5659__cal_impl.Decode1_P15_h speedgoat_test_SN5659__cal_impl.Decode1_P16_m speedgoat_test_SN5659__cal_impl.Decode1_P1_e speedgoat_test_SN5659__cal_impl.Decode1_P2_ov speedgoat_test_SN5659__cal_impl.Decode1_P3_p speedgoat_test_SN5659__cal_impl.Decode1_P4_ls speedgoat_test_SN5659__cal_impl.Decode1_P5_m speedgoat_test_SN5659__cal_impl.Decode1_P6_n speedgoat_test_SN5659__cal_impl.Decode1_P7_d speedgoat_test_SN5659__cal_impl.Decode1_P8_p speedgoat_test_SN5659__cal_impl.Decode1_P9_g speedgoat_test_SN5659__cal_impl.Decode2_P10_j speedgoat_test_SN5659__cal_impl.Decode2_P11_m speedgoat_test_SN5659__cal_impl.Decode2_P12_k speedgoat_test_SN5659__cal_impl.Decode2_P13_j speedgoat_test_SN5659__cal_impl.Decode2_P14_o speedgoat_test_SN5659__cal_impl.Decode2_P15_g speedgoat_test_SN5659__cal_impl.Decode2_P16_cj speedgoat_test_SN5659__cal_impl.Decode2_P1_e speedgoat_test_SN5659__cal_impl.Decode2_P2_j speedgoat_test_SN5659__cal_impl.Decode2_P3_k speedgoat_test_SN5659__cal_impl.Decode2_P4_c speedgoat_test_SN5659__cal_impl.Decode2_P5_c speedgoat_test_SN5659__cal_impl.Decode2_P6_p speedgoat_test_SN5659__cal_impl.Decode2_P7_o speedgoat_test_SN5659__cal_impl.Decode2_P8_b speedgoat_test_SN5659__cal_impl.Decode2_P9_g speedgoat_test_SN5659__cal_impl.Decode3_P10_o speedgoat_test_SN5659__cal_impl.Decode3_P11_k speedgoat_test_SN5659__cal_impl.Decode3_P12_ku speedgoat_test_SN5659__cal_impl.Decode3_P13_e speedgoat_test_SN5659__cal_impl.Decode3_P14_jy speedgoat_test_SN5659__cal_impl.Decode3_P15_l0 speedgoat_test_SN5659__cal_impl.Decode3_P16_hp speedgoat_test_SN5659__cal_impl.Decode3_P1_cm speedgoat_test_SN5659__cal_impl.Decode3_P2_h speedgoat_test_SN5659__cal_impl.Decode3_P3_b speedgoat_test_SN5659__cal_impl.Decode3_P4_o speedgoat_test_SN5659__cal_impl.Decode3_P5_ae speedgoat_test_SN5659__cal_impl.Decode3_P6_d speedgoat_test_SN5659__cal_impl.Decode3_P7_e speedgoat_test_SN5659__cal_impl.Decode3_P8_i speedgoat_test_SN5659__cal_impl.Decode3_P9_o2 speedgoat_test_SN5659__cal_impl.Decode4_P10_f speedgoat_test_SN5659__cal_impl.Decode4_P11_p speedgoat_test_SN5659__cal_impl.Decode4_P12_g speedgoat_test_SN5659__cal_impl.Decode4_P13_a speedgoat_test_SN5659__cal_impl.Decode4_P14_n speedgoat_test_SN5659__cal_impl.Decode4_P15_d speedgoat_test_SN5659__cal_impl.Decode4_P16_d speedgoat_test_SN5659__cal_impl.Decode4_P1_k speedgoat_test_SN5659__cal_impl.Decode4_P2_p0 speedgoat_test_SN5659__cal_impl.Decode4_P3_cw speedgoat_test_SN5659__cal_impl.Decode4_P4_p speedgoat_test_SN5659__cal_impl.Decode4_P5_a speedgoat_test_SN5659__cal_impl.Decode4_P6_a speedgoat_test_SN5659__cal_impl.Decode4_P7_g speedgoat_test_SN5659__cal_impl.Decode4_P8_i speedgoat_test_SN5659__cal_impl.Decode4_P9_d /end REF_CHARACTERISTIC
 /begin REF_MEASUREMENT speedgoat_test_SN5659_R2021b_B.Decode1_a speedgoat_test_SN5659_R2021b_B.Decode2_j2 speedgoat_test_SN5659_R2021b_B.Decode3_m speedgoat_test_SN5659_R2021b_B.Decode4_a /end REF_MEASUREMENT
/end GROUP
/begin GROUP speedgoat_test_SN5659_R2021b_IO682_Decode_Channel_13 "speedgoat_test_SN5659_R2021b/IO682/Decode Channel 13"
 /begin REF_CHARACTERISTIC speedgoat_test_SN5659__cal_impl.Decode1_P10_lb speedgoat_test_SN5659__cal_impl.Decode1_P11_m speedgoat_test_SN5659__cal_impl.Decode1_P12_b speedgoat_test_SN5659__cal_impl.Decode1_P13_lz speedgoat_test_SN5659__cal_impl.Decode1_P14_k speedgoat_test_SN5659__cal_impl.Decode1_P15_h1 speedgoat_test_SN5659__cal_impl.Decode1_P16_f speedgoat_test_SN5659__cal_impl.Decode1_P1_e3 speedgoat_test_SN5659__cal_impl.Decode1_P2_e speedgoat_test_SN5659__cal_impl.Decode1_P3_j speedgoat_test_SN5659__cal_impl.Decode1_P4_i speedgoat_test_SN5659__cal_impl.Decode1_P5_o speedgoat_test_SN5659__cal_impl.Decode1_P6_p speedgoat_test_SN5659__cal_impl.Decode1_P7_dn speedgoat_test_SN5659__cal_impl.Decode1_P8_lr speedgoat_test_SN5659__cal_impl.Decode1_P9_i speedgoat_test_SN5659__cal_impl.Decode3_P10_b speedgoat_test_SN5659__cal_impl.Decode3_P11_a speedgoat_test_SN5659__cal_impl.Decode3_P12_pk speedgoat_test_SN5659__cal_impl.Decode3_P13_dz speedgoat_test_SN5659__cal_impl.Decode3_P14_f speedgoat_test_SN5659__cal_impl.Decode3_P15_e speedgoat_test_SN5659__cal_impl.Decode3_P16_e speedgoat_test_SN5659__cal_impl.Decode3_P1_a1u speedgoat_test_SN5659__cal_impl.Decode3_P2_of speedgoat_test_SN5659__cal_impl.Decode3_P3_pi speedgoat_test_SN5659__cal_impl.Decode3_P4_a speedgoat_test_SN5659__cal_impl.Decode3_P5_h speedgoat_test_SN5659__cal_impl.Decode3_P6_ot speedgoat_test_SN5659__cal_impl.Decode3_P7_f speedgoat_test_SN5659__cal_impl.Decode3_P8_e speedgoat_test_SN5659__cal_impl.Decode3_P9_m speedgoat_test_SN5659__cal_impl.Decode4_P10_bm speedgoat_test_SN5659__cal_impl.Decode4_P11_l speedgoat_test_SN5659__cal_impl.Decode4_P12_o speedgoat_test_SN5659__cal_impl.Decode4_P13_c speedgoat_test_SN5659__cal_impl.Decode4_P14_l speedgoat_test_SN5659__cal_impl.Decode4_P15_i speedgoat_test_SN5659__cal_impl.Decode4_P16_c speedgoat_test_SN5659__cal_impl.Decode4_P1_pt speedgoat_test_SN5659__cal_impl.Decode4_P2_c speedgoat_test_SN5659__cal_impl.Decode4_P3_m speedgoat_test_SN5659__cal_impl.Decode4_P4_h speedgoat_test_SN5659__cal_impl.Decode4_P5_cq speedgoat_test_SN5659__cal_impl.Decode4_P6_e speedgoat_test_SN5659__cal_impl.Decode4_P7_d speedgoat_test_SN5659__cal_impl.Decode4_P8_gh speedgoat_test_SN5659__cal_impl.Decode4_P9_n speedgoat_test_SN5659__cal_impl.Decode5_P10_k speedgoat_test_SN5659__cal_impl.Decode5_P11_c speedgoat_test_SN5659__cal_impl.Decode5_P12_e speedgoat_test_SN5659__cal_impl.Decode5_P13_o speedgoat_test_SN5659__cal_impl.Decode5_P14_g speedgoat_test_SN5659__cal_impl.Decode5_P15_o speedgoat_test_SN5659__cal_impl.Decode5_P16_m speedgoat_test_SN5659__cal_impl.Decode5_P1_m speedgoat_test_SN5659__cal_impl.Decode5_P2_f speedgoat_test_SN5659__cal_impl.Decode5_P3_d speedgoat_test_SN5659__cal_impl.Decode5_P4_j speedgoat_test_SN5659__cal_impl.Decode5_P5_n speedgoat_test_SN5659__cal_impl.Decode5_P6_b speedgoat_test_SN5659__cal_impl.Decode5_P7_j speedgoat_test_SN5659__cal_impl.Decode5_P8_d speedgoat_test_SN5659__cal_impl.Decode5_P9_i /end REF_CHARACTERISTIC
 /begin REF_MEASUREMENT speedgoat_test_SN5659_R2021b_B.Decode1_i speedgoat_test_SN5659_R2021b_B.Decode3_o speedgoat_test_SN5659_R2021b_B.Decode4_b speedgoat_test_SN5659_R2021b_B.Decode5_i /end REF_MEASUREMENT
/end GROUP
/begin GROUP speedgoat_test_SN5659_R2021b_IO682_Decode_Channel_14 "speedgoat_test_SN5659_R2021b/IO682/Decode Channel 14"
 /begin REF_CHARACTERISTIC speedgoat_test_SN5659__cal_impl.Decode1_P10_a speedgoat_test_SN5659__cal_impl.Decode1_P11_g speedgoat_test_SN5659__cal_impl.Decode1_P12_d speedgoat_test_SN5659__cal_impl.Decode1_P13_c speedgoat_test_SN5659__cal_impl.Decode1_P14_gc speedgoat_test_SN5659__cal_impl.Decode1_P15_j speedgoat_test_SN5659__cal_impl.Decode1_P16_jd speedgoat_test_SN5659__cal_impl.Decode1_P1_d speedgoat_test_SN5659__cal_impl.Decode1_P2_en speedgoat_test_SN5659__cal_impl.Decode1_P3_c speedgoat_test_SN5659__cal_impl.Decode1_P4_m speedgoat_test_SN5659__cal_impl.Decode1_P5_c speedgoat_test_SN5659__cal_impl.Decode1_P6_i speedgoat_test_SN5659__cal_impl.Decode1_P7_o speedgoat_test_SN5659__cal_impl.Decode1_P8_i speedgoat_test_SN5659__cal_impl.Decode1_P9_l speedgoat_test_SN5659__cal_impl.Decode2_P10_n speedgoat_test_SN5659__cal_impl.Decode2_P11_k speedgoat_test_SN5659__cal_impl.Decode2_P12_i speedgoat_test_SN5659__cal_impl.Decode2_P13_e speedgoat_test_SN5659__cal_impl.Decode2_P14_b speedgoat_test_SN5659__cal_impl.Decode2_P15_n speedgoat_test_SN5659__cal_impl.Decode2_P16_n speedgoat_test_SN5659__cal_impl.Decode2_P1_h speedgoat_test_SN5659__cal_impl.Decode2_P2_h speedgoat_test_SN5659__cal_impl.Decode2_P3_d speedgoat_test_SN5659__cal_impl.Decode2_P4_f speedgoat_test_SN5659__cal_impl.Decode2_P5_gd speedgoat_test_SN5659__cal_impl.Decode2_P6_oa speedgoat_test_SN5659__cal_impl.Decode2_P7_j speedgoat_test_SN5659__cal_impl.Decode2_P8_h speedgoat_test_SN5659__cal_impl.Decode2_P9_pb speedgoat_test_SN5659__cal_impl.Decode3_P10_c speedgoat_test_SN5659__cal_impl.Decode3_P11_d speedgoat_test_SN5659__cal_impl.Decode3_P12_b speedgoat_test_SN5659__cal_impl.Decode3_P13_i speedgoat_test_SN5659__cal_impl.Decode3_P14_k speedgoat_test_SN5659__cal_impl.Decode3_P15_jx speedgoat_test_SN5659__cal_impl.Decode3_P16_f speedgoat_test_SN5659__cal_impl.Decode3_P1_e speedgoat_test_SN5659__cal_impl.Decode3_P2_l2 speedgoat_test_SN5659__cal_impl.Decode3_P3_cq speedgoat_test_SN5659__cal_impl.Decode3_P4_j speedgoat_test_SN5659__cal_impl.Decode3_P5_n speedgoat_test_SN5659__cal_impl.Decode3_P6_e speedgoat_test_SN5659__cal_impl.Decode3_P7_b speedgoat_test_SN5659__cal_impl.Decode3_P8_p speedgoat_test_SN5659__cal_impl.Decode3_P9_hu speedgoat_test_SN5659__cal_impl.Decode4_P10_h speedgoat_test_SN5659__cal_impl.Decode4_P11_n speedgoat_test_SN5659__cal_impl.Decode4_P12_c speedgoat_test_SN5659__cal_impl.Decode4_P13_ct speedgoat_test_SN5659__cal_impl.Decode4_P14_j speedgoat_test_SN5659__cal_impl.Decode4_P15_dw speedgoat_test_SN5659__cal_impl.Decode4_P16_o speedgoat_test_SN5659__cal_impl.Decode4_P1_a speedgoat_test_SN5659__cal_impl.Decode4_P2_m speedgoat_test_SN5659__cal_impl.Decode4_P3_mr speedgoat_test_SN5659__cal_impl.Decode4_P4_f speedgoat_test_SN5659__cal_impl.Decode4_P5_cn speedgoat_test_SN5659__cal_impl.Decode4_P6_aw speedgoat_test_SN5659__cal_impl.Decode4_P7_b speedgoat_test_SN5659__cal_impl.Decode4_P8_m speedgoat_test_SN5659__cal_impl.Decode4_P9_o /end REF_CHARACTERISTIC
 /begin REF_MEASUREMENT speedgoat_test_SN5659_R2021b_B.Decode1_my speedgoat_test_SN5659_R2021b_B.Decode2_i speedgoat_test_SN5659_R2021b_B.Decode3_n speedgoat_test_SN5659_R2021b_B.Decode4_c1 /end REF_MEASUREMENT
/end GROUP
/begin GROUP speedgoat_test_SN5659_R2021b_IO682_Decode_Channel_15 "speedgoat_test_SN5659_R2021b/IO682/Decode Channel 15"
 /begin REF_CHARACTERISTIC speedgoat_test_SN5659__cal_impl.Decode1_P10_lbu speedgoat_test_SN5659__cal_impl.Decode1_P11_fz speedgoat_test_SN5659__cal_impl.Decode1_P12_k speedgoat_test_SN5659__cal_impl.Decode1_P13_d speedgoat_test_SN5659__cal_impl.Decode1_P14_i speedgoat_test_SN5659__cal_impl.Decode1_P15_n speedgoat_test_SN5659__cal_impl.Decode1_P16_js speedgoat_test_SN5659__cal_impl.Decode1_P1_l speedgoat_test_SN5659__cal_impl.Decode1_P2_f speedgoat_test_SN5659__cal_impl.Decode1_P3_j5 speedgoat_test_SN5659__cal_impl.Decode1_P4_cf speedgoat_test_SN5659__cal_impl.Decode1_P5_a speedgoat_test_SN5659__cal_impl.Decode1_P6_fp speedgoat_test_SN5659__cal_impl.Decode1_P7_b speedgoat_test_SN5659__cal_impl.Decode1_P8_pw speedgoat_test_SN5659__cal_impl.Decode1_P9_d speedgoat_test_SN5659__cal_impl.Decode2_P10_b speedgoat_test_SN5659__cal_impl.Decode2_P11_b speedgoat_test_SN5659__cal_impl.Decode2_P12_l speedgoat_test_SN5659__cal_impl.Decode2_P13_f speedgoat_test_SN5659__cal_impl.Decode2_P14_mb speedgoat_test_SN5659__cal_impl.Decode2_P15_j speedgoat_test_SN5659__cal_impl.Decode2_P16_j speedgoat_test_SN5659__cal_impl.Decode2_P1_o speedgoat_test_SN5659__cal_impl.Decode2_P2_ex speedgoat_test_SN5659__cal_impl.Decode2_P3_g speedgoat_test_SN5659__cal_impl.Decode2_P4_j speedgoat_test_SN5659__cal_impl.Decode2_P5_e speedgoat_test_SN5659__cal_impl.Decode2_P6_pp speedgoat_test_SN5659__cal_impl.Decode2_P7_mb speedgoat_test_SN5659__cal_impl.Decode2_P8_c speedgoat_test_SN5659__cal_impl.Decode2_P9_n speedgoat_test_SN5659__cal_impl.Decode3_P10_n speedgoat_test_SN5659__cal_impl.Decode3_P11_k1 speedgoat_test_SN5659__cal_impl.Decode3_P12_l speedgoat_test_SN5659__cal_impl.Decode3_P13_l speedgoat_test_SN5659__cal_impl.Decode3_P14_fx speedgoat_test_SN5659__cal_impl.Decode3_P15_p speedgoat_test_SN5659__cal_impl.Decode3_P16_o speedgoat_test_SN5659__cal_impl.Decode3_P1_b speedgoat_test_SN5659__cal_impl.Decode3_P2_ls speedgoat_test_SN5659__cal_impl.Decode3_P3_l speedgoat_test_SN5659__cal_impl.Decode3_P4_ja speedgoat_test_SN5659__cal_impl.Decode3_P5_f speedgoat_test_SN5659__cal_impl.Decode3_P6_d3 speedgoat_test_SN5659__cal_impl.Decode3_P7_i speedgoat_test_SN5659__cal_impl.Decode3_P8_m3 speedgoat_test_SN5659__cal_impl.Decode3_P9_h1 speedgoat_test_SN5659__cal_impl.Decode4_P10_e speedgoat_test_SN5659__cal_impl.Decode4_P11_gt speedgoat_test_SN5659__cal_impl.Decode4_P12_n speedgoat_test_SN5659__cal_impl.Decode4_P13_i speedgoat_test_SN5659__cal_impl.Decode4_P14_a speedgoat_test_SN5659__cal_impl.Decode4_P15_i0 speedgoat_test_SN5659__cal_impl.Decode4_P16_l speedgoat_test_SN5659__cal_impl.Decode4_P1_kt speedgoat_test_SN5659__cal_impl.Decode4_P2_lo speedgoat_test_SN5659__cal_impl.Decode4_P3_b speedgoat_test_SN5659__cal_impl.Decode4_P4_hz speedgoat_test_SN5659__cal_impl.Decode4_P5_l speedgoat_test_SN5659__cal_impl.Decode4_P6_f speedgoat_test_SN5659__cal_impl.Decode4_P7_fb speedgoat_test_SN5659__cal_impl.Decode4_P8_d speedgoat_test_SN5659__cal_impl.Decode4_P9_l /end REF_CHARACTERISTIC
 /begin REF_MEASUREMENT speedgoat_test_SN5659_R2021b_B.Decode1_n speedgoat_test_SN5659_R2021b_B.Decode2_b speedgoat_test_SN5659_R2021b_B.Decode3_cq speedgoat_test_SN5659_R2021b_B.Decode4_oi /end REF_MEASUREMENT
/end GROUP
/begin GROUP speedgoat_test_SN5659_R2021b_IO682_Decode_Channel_16 "speedgoat_test_SN5659_R2021b/IO682/Decode Channel 16"
 /begin REF_CHARACTERISTIC speedgoat_test_SN5659__cal_impl.Decode1_P10_e speedgoat_test_SN5659__cal_impl.Decode1_P11_a speedgoat_test_SN5659__cal_impl.Decode1_P12_a speedgoat_test_SN5659__cal_impl.Decode1_P13_k speedgoat_test_SN5659__cal_impl.Decode1_P14_o4 speedgoat_test_SN5659__cal_impl.Decode1_P15_be speedgoat_test_SN5659__cal_impl.Decode1_P16_ey speedgoat_test_SN5659__cal_impl.Decode1_P1_i speedgoat_test_SN5659__cal_impl.Decode1_P2_j speedgoat_test_SN5659__cal_impl.Decode1_P3_f2 speedgoat_test_SN5659__cal_impl.Decode1_P4_p speedgoat_test_SN5659__cal_impl.Decode1_P5_nq speedgoat_test_SN5659__cal_impl.Decode1_P6_ba speedgoat_test_SN5659__cal_impl.Decode1_P7_hm speedgoat_test_SN5659__cal_impl.Decode1_P8_gl speedgoat_test_SN5659__cal_impl.Decode1_P9_dd speedgoat_test_SN5659__cal_impl.Decode2_P10_js speedgoat_test_SN5659__cal_impl.Decode2_P11_jv speedgoat_test_SN5659__cal_impl.Decode2_P12_p speedgoat_test_SN5659__cal_impl.Decode2_P13_iy speedgoat_test_SN5659__cal_impl.Decode2_P14_f speedgoat_test_SN5659__cal_impl.Decode2_P15_cj speedgoat_test_SN5659__cal_impl.Decode2_P16_i speedgoat_test_SN5659__cal_impl.Decode2_P1_c speedgoat_test_SN5659__cal_impl.Decode2_P2_k speedgoat_test_SN5659__cal_impl.Decode2_P3_b speedgoat_test_SN5659__cal_impl.Decode2_P4_o speedgoat_test_SN5659__cal_impl.Decode2_P5_j speedgoat_test_SN5659__cal_impl.Decode2_P6_h speedgoat_test_SN5659__cal_impl.Decode2_P7_jq speedgoat_test_SN5659__cal_impl.Decode2_P8_j speedgoat_test_SN5659__cal_impl.Decode2_P9_c speedgoat_test_SN5659__cal_impl.Decode3_P10_m speedgoat_test_SN5659__cal_impl.Decode3_P11_bu speedgoat_test_SN5659__cal_impl.Decode3_P12_f speedgoat_test_SN5659__cal_impl.Decode3_P13_f speedgoat_test_SN5659__cal_impl.Decode3_P14_n speedgoat_test_SN5659__cal_impl.Decode3_P15_b speedgoat_test_SN5659__cal_impl.Decode3_P16_fl speedgoat_test_SN5659__cal_impl.Decode3_P1_kn speedgoat_test_SN5659__cal_impl.Decode3_P2_js speedgoat_test_SN5659__cal_impl.Decode3_P3_jq speedgoat_test_SN5659__cal_impl.Decode3_P4_o3 speedgoat_test_SN5659__cal_impl.Decode3_P5_g speedgoat_test_SN5659__cal_impl.Decode3_P6_ih speedgoat_test_SN5659__cal_impl.Decode3_P7_cp speedgoat_test_SN5659__cal_impl.Decode3_P8_l speedgoat_test_SN5659__cal_impl.Decode3_P9_hv speedgoat_test_SN5659__cal_impl.Decode4_P10_a speedgoat_test_SN5659__cal_impl.Decode4_P11_hn speedgoat_test_SN5659__cal_impl.Decode4_P12_ko speedgoat_test_SN5659__cal_impl.Decode4_P13_h speedgoat_test_SN5659__cal_impl.Decode4_P14_aq speedgoat_test_SN5659__cal_impl.Decode4_P15_ft speedgoat_test_SN5659__cal_impl.Decode4_P16_a speedgoat_test_SN5659__cal_impl.Decode4_P1_n speedgoat_test_SN5659__cal_impl.Decode4_P2_n speedgoat_test_SN5659__cal_impl.Decode4_P3_j speedgoat_test_SN5659__cal_impl.Decode4_P4_hj speedgoat_test_SN5659__cal_impl.Decode4_P5_k speedgoat_test_SN5659__cal_impl.Decode4_P6_aj speedgoat_test_SN5659__cal_impl.Decode4_P7_h speedgoat_test_SN5659__cal_impl.Decode4_P8_iy speedgoat_test_SN5659__cal_impl.Decode4_P9_bz /end REF_CHARACTERISTIC
 /begin REF_MEASUREMENT speedgoat_test_SN5659_R2021b_B.Decode1_al speedgoat_test_SN5659_R2021b_B.Decode2_l speedgoat_test_SN5659_R2021b_B.Decode3_ou speedgoat_test_SN5659_R2021b_B.Decode4_p /end REF_MEASUREMENT
/end GROUP
/begin GROUP speedgoat_test_SN5659_R2021b_IO682_Decode_Channel_2 "speedgoat_test_SN5659_R2021b/IO682/Decode Channel 2"
 /begin REF_CHARACTERISTIC speedgoat_test_SN5659__cal_impl.Decode1_P10_k speedgoat_test_SN5659__cal_impl.Decode1_P11_e speedgoat_test_SN5659__cal_impl.Decode1_P12_p speedgoat_test_SN5659__cal_impl.Decode1_P13_a speedgoat_test_SN5659__cal_impl.Decode1_P14_o speedgoat_test_SN5659__cal_impl.Decode1_P15_l speedgoat_test_SN5659__cal_impl.Decode1_P16_j speedgoat_test_SN5659__cal_impl.Decode1_P1_c speedgoat_test_SN5659__cal_impl.Decode1_P2_g speedgoat_test_SN5659__cal_impl.Decode1_P3_b speedgoat_test_SN5659__cal_impl.Decode1_P4_b speedgoat_test_SN5659__cal_impl.Decode1_P5_f speedgoat_test_SN5659__cal_impl.Decode1_P6_f speedgoat_test_SN5659__cal_impl.Decode1_P7_h speedgoat_test_SN5659__cal_impl.Decode1_P8_c speedgoat_test_SN5659__cal_impl.Decode1_P9_p speedgoat_test_SN5659__cal_impl.Decode2_P1 speedgoat_test_SN5659__cal_impl.Decode2_P10 speedgoat_test_SN5659__cal_impl.Decode2_P11 speedgoat_test_SN5659__cal_impl.Decode2_P12 speedgoat_test_SN5659__cal_impl.Decode2_P13 speedgoat_test_SN5659__cal_impl.Decode2_P14 speedgoat_test_SN5659__cal_impl.Decode2_P15 speedgoat_test_SN5659__cal_impl.Decode2_P16 speedgoat_test_SN5659__cal_impl.Decode2_P2 speedgoat_test_SN5659__cal_impl.Decode2_P3 speedgoat_test_SN5659__cal_impl.Decode2_P4 speedgoat_test_SN5659__cal_impl.Decode2_P5 speedgoat_test_SN5659__cal_impl.Decode2_P6 speedgoat_test_SN5659__cal_impl.Decode2_P7 speedgoat_test_SN5659__cal_impl.Decode2_P8 speedgoat_test_SN5659__cal_impl.Decode2_P9 speedgoat_test_SN5659__cal_impl.Decode3_P10_a speedgoat_test_SN5659__cal_impl.Decode3_P11_b speedgoat_test_SN5659__cal_impl.Decode3_P12_p speedgoat_test_SN5659__cal_impl.Decode3_P13_d speedgoat_test_SN5659__cal_impl.Decode3_P14_j speedgoat_test_SN5659__cal_impl.Decode3_P15_d speedgoat_test_SN5659__cal_impl.Decode3_P16_b speedgoat_test_SN5659__cal_impl.Decode3_P1_a speedgoat_test_SN5659__cal_impl.Decode3_P2_l speedgoat_test_SN5659__cal_impl.Decode3_P3_p speedgoat_test_SN5659__cal_impl.Decode3_P4_m speedgoat_test_SN5659__cal_impl.Decode3_P5_c speedgoat_test_SN5659__cal_impl.Decode3_P6_k speedgoat_test_SN5659__cal_impl.Decode3_P7_k speedgoat_test_SN5659__cal_impl.Decode3_P8_g speedgoat_test_SN5659__cal_impl.Decode3_P9_h speedgoat_test_SN5659__cal_impl.Decode4_P10_b speedgoat_test_SN5659__cal_impl.Decode4_P11_m speedgoat_test_SN5659__cal_impl.Decode4_P12_d speedgoat_test_SN5659__cal_impl.Decode4_P13_p speedgoat_test_SN5659__cal_impl.Decode4_P14_h speedgoat_test_SN5659__cal_impl.Decode4_P15_c speedgoat_test_SN5659__cal_impl.Decode4_P16_g speedgoat_test_SN5659__cal_impl.Decode4_P1_g speedgoat_test_SN5659__cal_impl.Decode4_P2_p speedgoat_test_SN5659__cal_impl.Decode4_P3_c speedgoat_test_SN5659__cal_impl.Decode4_P4_e speedgoat_test_SN5659__cal_impl.Decode4_P5_p speedgoat_test_SN5659__cal_impl.Decode4_P6_h speedgoat_test_SN5659__cal_impl.Decode4_P7_f speedgoat_test_SN5659__cal_impl.Decode4_P8_b speedgoat_test_SN5659__cal_impl.Decode4_P9_a /end REF_CHARACTERISTIC
 /begin REF_MEASUREMENT speedgoat_test_SN5659_R2021b_B.Decode1_m speedgoat_test_SN5659_R2021b_B.Decode2 speedgoat_test_SN5659_R2021b_B.Decode3_l speedgoat_test_SN5659_R2021b_B.Decode4_d /end REF_MEASUREMENT
/end GROUP
/begin GROUP speedgoat_test_SN5659_R2021b_IO682_Decode_Channel_3 "speedgoat_test_SN5659_R2021b/IO682/Decode Channel 3"
 /begin REF_CHARACTERISTIC speedgoat_test_SN5659__cal_impl.Decode1_P10_aa speedgoat_test_SN5659__cal_impl.Decode1_P11_ei speedgoat_test_SN5659__cal_impl.Decode1_P12_jm speedgoat_test_SN5659__cal_impl.Decode1_P13_e speedgoat_test_SN5659__cal_impl.Decode1_P14_id speedgoat_test_SN5659__cal_impl.Decode1_P15_l0 speedgoat_test_SN5659__cal_impl.Decode1_P16_g speedgoat_test_SN5659__cal_impl.Decode1_P1_p speedgoat_test_SN5659__cal_impl.Decode1_P2_d speedgoat_test_SN5659__cal_impl.Decode1_P3_n speedgoat_test_SN5659__cal_impl.Decode1_P4_pr speedgoat_test_SN5659__cal_impl.Decode1_P5_p speedgoat_test_SN5659__cal_impl.Decode1_P6_o speedgoat_test_SN5659__cal_impl.Decode1_P7_bo speedgoat_test_SN5659__cal_impl.Decode1_P8_ga speedgoat_test_SN5659__cal_impl.Decode1_P9_c speedgoat_test_SN5659__cal_impl.Decode2_P10_bf speedgoat_test_SN5659__cal_impl.Decode2_P11_ff speedgoat_test_SN5659__cal_impl.Decode2_P12_b speedgoat_test_SN5659__cal_impl.Decode2_P13_c speedgoat_test_SN5659__cal_impl.Decode2_P14_f2 speedgoat_test_SN5659__cal_impl.Decode2_P15_go speedgoat_test_SN5659__cal_impl.Decode2_P16_cw speedgoat_test_SN5659__cal_impl.Decode2_P1_i speedgoat_test_SN5659__cal_impl.Decode2_P2_ef speedgoat_test_SN5659__cal_impl.Decode2_P3_c speedgoat_test_SN5659__cal_impl.Decode2_P4_e speedgoat_test_SN5659__cal_impl.Decode2_P5_l speedgoat_test_SN5659__cal_impl.Decode2_P6_n speedgoat_test_SN5659__cal_impl.Decode2_P7_ja speedgoat_test_SN5659__cal_impl.Decode2_P8_g speedgoat_test_SN5659__cal_impl.Decode2_P9_e speedgoat_test_SN5659__cal_impl.Decode3_P10_i speedgoat_test_SN5659__cal_impl.Decode3_P11_m speedgoat_test_SN5659__cal_impl.Decode3_P12_ls speedgoat_test_SN5659__cal_impl.Decode3_P13_ez speedgoat_test_SN5659__cal_impl.Decode3_P14_m speedgoat_test_SN5659__cal_impl.Decode3_P15_h speedgoat_test_SN5659__cal_impl.Decode3_P16_g speedgoat_test_SN5659__cal_impl.Decode3_P1_m speedgoat_test_SN5659__cal_impl.Decode3_P2_c speedgoat_test_SN5659__cal_impl.Decode3_P3_i speedgoat_test_SN5659__cal_impl.Decode3_P4_m4 speedgoat_test_SN5659__cal_impl.Decode3_P5_nh speedgoat_test_SN5659__cal_impl.Decode3_P6_l speedgoat_test_SN5659__cal_impl.Decode3_P7_bv speedgoat_test_SN5659__cal_impl.Decode3_P8_ig speedgoat_test_SN5659__cal_impl.Decode3_P9_m5 speedgoat_test_SN5659__cal_impl.Decode4_P10_o speedgoat_test_SN5659__cal_impl.Decode4_P11_j speedgoat_test_SN5659__cal_impl.Decode4_P12_j speedgoat_test_SN5659__cal_impl.Decode4_P13_io speedgoat_test_SN5659__cal_impl.Decode4_P14_l4 speedgoat_test_SN5659__cal_impl.Decode4_P15_dv speedgoat_test_SN5659__cal_impl.Decode4_P16_j speedgoat_test_SN5659__cal_impl.Decode4_P1_f speedgoat_test_SN5659__cal_impl.Decode4_P2_pq speedgoat_test_SN5659__cal_impl.Decode4_P3_k speedgoat_test_SN5659__cal_impl.Decode4_P4_ft speedgoat_test_SN5659__cal_impl.Decode4_P5_d speedgoat_test_SN5659__cal_impl.Decode4_P6_m speedgoat_test_SN5659__cal_impl.Decode4_P7_nw speedgoat_test_SN5659__cal_impl.Decode4_P8_n speedgoat_test_SN5659__cal_impl.Decode4_P9_dp /end REF_CHARACTERISTIC
 /begin REF_MEASUREMENT speedgoat_test_SN5659_R2021b_B.Decode1_p speedgoat_test_SN5659_R2021b_B.Decode2_ba speedgoat_test_SN5659_R2021b_B.Decode3_a speedgoat_test_SN5659_R2021b_B.Decode4_f /end REF_MEASUREMENT
/end GROUP
/begin GROUP speedgoat_test_SN5659_R2021b_IO682_Decode_Channel_4 "speedgoat_test_SN5659_R2021b/IO682/Decode Channel 4"
 /begin REF_CHARACTERISTIC speedgoat_test_SN5659__cal_impl.Decode1_P10_d speedgoat_test_SN5659__cal_impl.Decode1_P11_c speedgoat_test_SN5659__cal_impl.Decode1_P12_po speedgoat_test_SN5659__cal_impl.Decode1_P13_p speedgoat_test_SN5659__cal_impl.Decode1_P14_da speedgoat_test_SN5659__cal_impl.Decode1_P15_gw speedgoat_test_SN5659__cal_impl.Decode1_P16_be speedgoat_test_SN5659__cal_impl.Decode1_P1_k speedgoat_test_SN5659__cal_impl.Decode1_P2_e1 speedgoat_test_SN5659__cal_impl.Decode1_P3_ng speedgoat_test_SN5659__cal_impl.Decode1_P4_h speedgoat_test_SN5659__cal_impl.Decode1_P5_d speedgoat_test_SN5659__cal_impl.Decode1_P6_pa speedgoat_test_SN5659__cal_impl.Decode1_P7_l speedgoat_test_SN5659__cal_impl.Decode1_P8_o speedgoat_test_SN5659__cal_impl.Decode1_P9_a speedgoat_test_SN5659__cal_impl.Decode2_P10_f speedgoat_test_SN5659__cal_impl.Decode2_P11_fz speedgoat_test_SN5659__cal_impl.Decode2_P12_bf speedgoat_test_SN5659__cal_impl.Decode2_P13_m speedgoat_test_SN5659__cal_impl.Decode2_P14_j speedgoat_test_SN5659__cal_impl.Decode2_P15_jl speedgoat_test_SN5659__cal_impl.Decode2_P16_f speedgoat_test_SN5659__cal_impl.Decode2_P1_p speedgoat_test_SN5659__cal_impl.Decode2_P2_kc speedgoat_test_SN5659__cal_impl.Decode2_P3_i speedgoat_test_SN5659__cal_impl.Decode2_P4_b speedgoat_test_SN5659__cal_impl.Decode2_P5_d speedgoat_test_SN5659__cal_impl.Decode2_P6_m speedgoat_test_SN5659__cal_impl.Decode2_P7_h speedgoat_test_SN5659__cal_impl.Decode2_P8_bd speedgoat_test_SN5659__cal_impl.Decode2_P9_lp speedgoat_test_SN5659__cal_impl.Decode3_P10_oo speedgoat_test_SN5659__cal_impl.Decode3_P11_mj speedgoat_test_SN5659__cal_impl.Decode3_P12_kuc speedgoat_test_SN5659__cal_impl.Decode3_P13_my speedgoat_test_SN5659__cal_impl.Decode3_P14_c speedgoat_test_SN5659__cal_impl.Decode3_P15_k speedgoat_test_SN5659__cal_impl.Decode3_P16_p speedgoat_test_SN5659__cal_impl.Decode3_P1_mu speedgoat_test_SN5659__cal_impl.Decode3_P2_ow speedgoat_test_SN5659__cal_impl.Decode3_P3_ht speedgoat_test_SN5659__cal_impl.Decode3_P4_g speedgoat_test_SN5659__cal_impl.Decode3_P5_e speedgoat_test_SN5659__cal_impl.Decode3_P6_g speedgoat_test_SN5659__cal_impl.Decode3_P7_m speedgoat_test_SN5659__cal_impl.Decode3_P8_a speedgoat_test_SN5659__cal_impl.Decode3_P9_dw speedgoat_test_SN5659__cal_impl.Decode4_P10_bv speedgoat_test_SN5659__cal_impl.Decode4_P11_a speedgoat_test_SN5659__cal_impl.Decode4_P12_nu speedgoat_test_SN5659__cal_impl.Decode4_P13_aq speedgoat_test_SN5659__cal_impl.Decode4_P14_dy speedgoat_test_SN5659__cal_impl.Decode4_P15_n speedgoat_test_SN5659__cal_impl.Decode4_P16_gq speedgoat_test_SN5659__cal_impl.Decode4_P1_px speedgoat_test_SN5659__cal_impl.Decode4_P2_e speedgoat_test_SN5659__cal_impl.Decode4_P3_g speedgoat_test_SN5659__cal_impl.Decode4_P4_g speedgoat_test_SN5659__cal_impl.Decode4_P5_cm speedgoat_test_SN5659__cal_impl.Decode4_P6_awi speedgoat_test_SN5659__cal_impl.Decode4_P7_h0 speedgoat_test_SN5659__cal_impl.Decode4_P8_p speedgoat_test_SN5659__cal_impl.Decode4_P9_p /end REF_CHARACTERISTIC
 /begin REF_MEASUREMENT speedgoat_test_SN5659_R2021b_B.Decode1_pf speedgoat_test_SN5659_R2021b_B.Decode2_k speedgoat_test_SN5659_R2021b_B.Decode3_b speedgoat_test_SN5659_R2021b_B.Decode4_ff /end REF_MEASUREMENT
/end GROUP
/begin GROUP speedgoat_test_SN5659_R2021b_IO682_Decode_Channel_5 "speedgoat_test_SN5659_R2021b/IO682/Decode Channel 5"
 /begin REF_CHARACTERISTIC speedgoat_test_SN5659__cal_impl.Decode1_P10_j speedgoat_test_SN5659__cal_impl.Decode1_P11_ee speedgoat_test_SN5659__cal_impl.Decode1_P12_d5 speedgoat_test_SN5659__cal_impl.Decode1_P13_ad speedgoat_test_SN5659__cal_impl.Decode1_P14_j speedgoat_test_SN5659__cal_impl.Decode1_P15_au speedgoat_test_SN5659__cal_impl.Decode1_P16_l speedgoat_test_SN5659__cal_impl.Decode1_P1_h speedgoat_test_SN5659__cal_impl.Decode1_P2_c speedgoat_test_SN5659__cal_impl.Decode1_P3_d speedgoat_test_SN5659__cal_impl.Decode1_P4_me speedgoat_test_SN5659__cal_impl.Decode1_P5_d5 speedgoat_test_SN5659__cal_impl.Decode1_P6_i3 speedgoat_test_SN5659__cal_impl.Decode1_P7_d3 speedgoat_test_SN5659__cal_impl.Decode1_P8_c5 speedgoat_test_SN5659__cal_impl.Decode1_P9_pu speedgoat_test_SN5659__cal_impl.Decode3_P10_k5 speedgoat_test_SN5659__cal_impl.Decode3_P11_bg speedgoat_test_SN5659__cal_impl.Decode3_P12_pa speedgoat_test_SN5659__cal_impl.Decode3_P13_k speedgoat_test_SN5659__cal_impl.Decode3_P14_nc speedgoat_test_SN5659__cal_impl.Decode3_P15_n speedgoat_test_SN5659__cal_impl.Decode3_P16_i speedgoat_test_SN5659__cal_impl.Decode3_P1_n speedgoat_test_SN5659__cal_impl.Decode3_P2_pu speedgoat_test_SN5659__cal_impl.Decode3_P3_e speedgoat_test_SN5659__cal_impl.Decode3_P4_jl speedgoat_test_SN5659__cal_impl.Decode3_P5_o speedgoat_test_SN5659__cal_impl.Decode3_P6_ib speedgoat_test_SN5659__cal_impl.Decode3_P7_fx speedgoat_test_SN5659__cal_impl.Decode3_P8_b speedgoat_test_SN5659__cal_impl.Decode3_P9_dy speedgoat_test_SN5659__cal_impl.Decode4_P10_mz speedgoat_test_SN5659__cal_impl.Decode4_P11_c speedgoat_test_SN5659__cal_impl.Decode4_P12_ff speedgoat_test_SN5659__cal_impl.Decode4_P13_n speedgoat_test_SN5659__cal_impl.Decode4_P14_lo speedgoat_test_SN5659__cal_impl.Decode4_P15_p speedgoat_test_SN5659__cal_impl.Decode4_P16_ec speedgoat_test_SN5659__cal_impl.Decode4_P1_m speedgoat_test_SN5659__cal_impl.Decode4_P2_h speedgoat_test_SN5659__cal_impl.Decode4_P3_n speedgoat_test_SN5659__cal_impl.Decode4_P4_b speedgoat_test_SN5659__cal_impl.Decode4_P5_m speedgoat_test_SN5659__cal_impl.Decode4_P6_d speedgoat_test_SN5659__cal_impl.Decode4_P7_a speedgoat_test_SN5659__cal_impl.Decode4_P8_l speedgoat_test_SN5659__cal_impl.Decode4_P9_p0 speedgoat_test_SN5659__cal_impl.Decode5_P10_k2 speedgoat_test_SN5659__cal_impl.Decode5_P11_i speedgoat_test_SN5659__cal_impl.Decode5_P12_h speedgoat_test_SN5659__cal_impl.Decode5_P13_p speedgoat_test_SN5659__cal_impl.Decode5_P14_cm speedgoat_test_SN5659__cal_impl.Decode5_P15_b speedgoat_test_SN5659__cal_impl.Decode5_P16_o speedgoat_test_SN5659__cal_impl.Decode5_P1_p speedgoat_test_SN5659__cal_impl.Decode5_P2_f0 speedgoat_test_SN5659__cal_impl.Decode5_P3_o speedgoat_test_SN5659__cal_impl.Decode5_P4_f5 speedgoat_test_SN5659__cal_impl.Decode5_P5_d speedgoat_test_SN5659__cal_impl.Decode5_P6_c speedgoat_test_SN5659__cal_impl.Decode5_P7_m speedgoat_test_SN5659__cal_impl.Decode5_P8_c speedgoat_test_SN5659__cal_impl.Decode5_P9_h /end REF_CHARACTERISTIC
 /begin REF_MEASUREMENT speedgoat_test_SN5659_R2021b_B.Decode1_io speedgoat_test_SN5659_R2021b_B.Decode3_ny speedgoat_test_SN5659_R2021b_B.Decode4_j speedgoat_test_SN5659_R2021b_B.Decode5_b /end REF_MEASUREMENT
/end GROUP
/end MODULE
/end PROJECT
