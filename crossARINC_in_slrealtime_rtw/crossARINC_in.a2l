/******************************************************************************
* ASAP2 file: crossARINC_in.a2l
* Code generation for model "crossARINC_in".
* Model version : 1.26
* Simulink Coder version : 10.4 R2021b
* C source code generated on : Tue May 17 12:21:50 2022
* Target selection: slrealtime.tlc
* Embedded hardware selection: Intel->x86-64 (Linux 64)
* Code generation objectives: Unspecified
* Validation result: Not run
* (add additional file header information here)
******************************************************************************/ ASAP2_VERSION 1 71
/begin PROJECT ProjectName "Project Comment Goes Here"
/begin HEADER "Header Comments go here" /end HEADER
/begin MODULE ModuleName "Module Comment Goes Here"
/begin IF_DATA XCP
 /begin PROTOCOL_LAYER 0x0100 0x03E8 0x00C8 0x0000 0x0000 0x0000 0x0000 0x0000 0xFC 0x0578 BYTE_ORDER_MSB_LAST ADDRESS_GRANULARITY_BYTE OPTIONAL_CMD ALLOC_ODT_ENTRY OPTIONAL_CMD ALLOC_ODT OPTIONAL_CMD ALLOC_DAQ OPTIONAL_CMD FREE_DAQ OPTIONAL_CMD GET_DAQ_RESOLUTION_INFO OPTIONAL_CMD GET_DAQ_PROCESSOR_INFO OPTIONAL_CMD START_STOP_SYNCH OPTIONAL_CMD START_STOP_DAQ_LIST OPTIONAL_CMD SET_DAQ_LIST_MODE OPTIONAL_CMD WRITE_DAQ OPTIONAL_CMD SET_DAQ_PTR OPTIONAL_CMD GET_CAL_PAGE OPTIONAL_CMD SET_CAL_PAGE OPTIONAL_CMD COPY_CAL_PAGE OPTIONAL_CMD SHORT_DOWNLOAD OPTIONAL_CMD DOWNLOAD_MAX OPTIONAL_CMD DOWNLOAD OPTIONAL_CMD SHORT_UPLOAD OPTIONAL_CMD UPLOAD OPTIONAL_CMD SET_MTA /end PROTOCOL_LAYER
 /begin DAQ DYNAMIC 0x0000 0x0080 0x00 OPTIMISATION_TYPE_DEFAULT ADDRESS_EXTENSION_FREE IDENTIFICATION_FIELD_TYPE_RELATIVE_WORD_ALIGNED GRANULARITY_ODT_ENTRY_SIZE_DAQ_BYTE 0xFF OVERLOAD_INDICATION_PID PRESCALER_SUPPORTED /begin STIM GRANULARITY_ODT_ENTRY_SIZE_STIM_BYTE 0xFF /end STIM /begin TIMESTAMP_SUPPORTED 0x0001 SIZE_DWORD UNIT_1US TIMESTAMP_FIXED /end TIMESTAMP_SUPPORTED /begin EVENT "8 ms" "8 ms" 0x0000 DAQ 0xFF 0x08 0x06 0x00 /end EVENT /end DAQ
 /begin XCP_ON_UDP_IP 0x0100 0x15B3 ADDRESS "192.168.7.2" /end XCP_ON_UDP_IP
/end IF_DATA
/begin MOD_PAR "MOD PAR Comment Goes Here"
 /begin MEMORY_SEGMENT crossARINC_in_cal_impl "crossARINC_in_cal_impl" DATA FLASH INTERN 0x0080B020 0x1FA0 -1 -1 -1 -1 -1
  /begin IF_DATA XCP
   /begin SEGMENT 0x00 0x02 0x00 0x00 0x00
    /begin PAGE 0x00 ECU_ACCESS_DONT_CARE XCP_READ_ACCESS_DONT_CARE XCP_WRITE_ACCESS_NOT_ALLOWED /end PAGE
    /begin PAGE 0x01 ECU_ACCESS_DONT_CARE XCP_READ_ACCESS_DONT_CARE XCP_WRITE_ACCESS_DONT_CARE /end PAGE
   /end SEGMENT
  /end IF_DATA
 /end MEMORY_SEGMENT
/end MOD_PAR
/begin MOD_COMMON "Mod Common Comment Here" BYTE_ORDER MSB_LAST ALIGNMENT_BYTE 1 ALIGNMENT_WORD 2 ALIGNMENT_LONG 4 ALIGNMENT_FLOAT32_IEEE 4 ALIGNMENT_FLOAT64_IEEE 8 ALIGNMENT_INT64 8 /end MOD_COMMON
/begin CHARACTERISTIC crossARINC_in_cal_impl.CCCodeBlock1_P1 "" VALUE 0x0080C980 Scalar_FLOAT64_IEEE 0 crossARINC_in_CM_double -1.7E+308 1.7E+308 /end CHARACTERISTIC
/begin CHARACTERISTIC crossARINC_in_cal_impl.CCCodeBlock1_P2 "" VALUE 0x0080C988 Scalar_FLOAT64_IEEE 0 crossARINC_in_CM_double -1.7E+308 1.7E+308 /end CHARACTERISTIC
/begin CHARACTERISTIC crossARINC_in_cal_impl.CCCodeBlock1_P3 "" VALUE 0x0080CFBC Scalar_BOOLEAN 0 crossARINC_in_CM_logical 0 1 /end CHARACTERISTIC
/begin CHARACTERISTIC crossARINC_in_cal_impl.CCCodeBlock1_P4 "" VALUE 0x0080CFBD Scalar_BOOLEAN 0 crossARINC_in_CM_logical 0 1 /end CHARACTERISTIC
/begin CHARACTERISTIC crossARINC_in_cal_impl.CCCodeBlock1_P5 "" VALUE 0x0080CFB0 Scalar_ULONG 0 crossARINC_in_CM_uint32 0 2147483646 /end CHARACTERISTIC
/begin CHARACTERISTIC crossARINC_in_cal_impl.CCCodeBlock2_P1 "" VALUE 0x0080CE18 Scalar_FLOAT64_IEEE 0 crossARINC_in_CM_double -1.7E+308 1.7E+308 /end CHARACTERISTIC
/begin CHARACTERISTIC crossARINC_in_cal_impl.CCCodeBlock2_P2 "" VALUE 0x0080CE20 Scalar_FLOAT64_IEEE 0 crossARINC_in_CM_double -1.7E+308 1.7E+308 /end CHARACTERISTIC
/begin CHARACTERISTIC crossARINC_in_cal_impl.CCCodeBlock2_P3 "" VALUE 0x0080CFBE Scalar_BOOLEAN 0 crossARINC_in_CM_logical 0 1 /end CHARACTERISTIC
/begin CHARACTERISTIC crossARINC_in_cal_impl.CCCodeBlock2_P4 "" VALUE 0x0080CFBF Scalar_BOOLEAN 0 crossARINC_in_CM_logical 0 1 /end CHARACTERISTIC
/begin CHARACTERISTIC crossARINC_in_cal_impl.CCCodeBlock2_P5 "" VALUE 0x0080CFB4 Scalar_ULONG 0 crossARINC_in_CM_uint32 0 2147483646 /end CHARACTERISTIC
/begin CHARACTERISTIC crossARINC_in_cal_impl.CCCodeBlock3_P1 "" VALUE 0x0080BEE8 Scalar_FLOAT64_IEEE 0 crossARINC_in_CM_double -1.7E+308 1.7E+308 /end CHARACTERISTIC
/begin CHARACTERISTIC crossARINC_in_cal_impl.CCCodeBlock3_P2 "" VALUE 0x0080BEF0 Scalar_FLOAT64_IEEE 0 crossARINC_in_CM_double -1.7E+308 1.7E+308 /end CHARACTERISTIC
/begin CHARACTERISTIC crossARINC_in_cal_impl.CCCodeBlock3_P3 "" VALUE 0x0080CFBA Scalar_BOOLEAN 0 crossARINC_in_CM_logical 0 1 /end CHARACTERISTIC
/begin CHARACTERISTIC crossARINC_in_cal_impl.CCCodeBlock3_P4 "" VALUE 0x0080CFBB Scalar_BOOLEAN 0 crossARINC_in_CM_logical 0 1 /end CHARACTERISTIC
/begin CHARACTERISTIC crossARINC_in_cal_impl.CCCodeBlock3_P5 "" VALUE 0x0080CFAC Scalar_ULONG 0 crossARINC_in_CM_uint32 0 2147483646 /end CHARACTERISTIC
/begin CHARACTERISTIC crossARINC_in_cal_impl.CCCodeBlock_P1 "" VALUE 0x0080B758 Scalar_FLOAT64_IEEE 0 crossARINC_in_CM_double -1.7E+308 1.7E+308 /end CHARACTERISTIC
/begin CHARACTERISTIC crossARINC_in_cal_impl.CCCodeBlock_P2 "" VALUE 0x0080B760 Scalar_FLOAT64_IEEE 0 crossARINC_in_CM_double -1.7E+308 1.7E+308 /end CHARACTERISTIC
/begin CHARACTERISTIC crossARINC_in_cal_impl.CCCodeBlock_P3 "" VALUE 0x0080CFB8 Scalar_BOOLEAN 0 crossARINC_in_CM_logical 0 1 /end CHARACTERISTIC
/begin CHARACTERISTIC crossARINC_in_cal_impl.CCCodeBlock_P4 "" VALUE 0x0080CFB9 Scalar_BOOLEAN 0 crossARINC_in_CM_logical 0 1 /end CHARACTERISTIC
/begin CHARACTERISTIC crossARINC_in_cal_impl.CCCodeBlock_P5 "" VALUE 0x0080CFA8 Scalar_ULONG 0 crossARINC_in_CM_uint32 0 2147483646 /end CHARACTERISTIC
/begin CHARACTERISTIC crossARINC_in_cal_impl.Constant_Value "" VALUE 0x0080B020 Scalar_FLOAT64_IEEE 0 crossARINC_in_CM_double -1.7E+308 1.7E+308 /end CHARACTERISTIC
/begin CHARACTERISTIC crossARINC_in_cal_impl.Decode10_P1 "" VALUE 0x0080CE38 Scalar_FLOAT64_IEEE 0 crossARINC_in_CM_double -1.7E+308 1.7E+308 /end CHARACTERISTIC
/begin CHARACTERISTIC crossARINC_in_cal_impl.Decode10_P10 "" VALUE 0x0080CF10 Scalar_FLOAT64_IEEE 0 crossARINC_in_CM_double -1.7E+308 1.7E+308 /end CHARACTERISTIC
/begin CHARACTERISTIC crossARINC_in_cal_impl.Decode10_P11 "" VALUE 0x0080CF28 Scalar_FLOAT64_IEEE 0 crossARINC_in_CM_double -1.7E+308 1.7E+308 /end CHARACTERISTIC
/begin CHARACTERISTIC crossARINC_in_cal_impl.Decode10_P12 "" VALUE 0x0080CF40 Scalar_FLOAT64_IEEE 0 crossARINC_in_CM_double -1.7E+308 1.7E+308 /end CHARACTERISTIC
/begin CHARACTERISTIC crossARINC_in_cal_impl.Decode10_P13 "" VALUE 0x0080CF58 Scalar_FLOAT64_IEEE 0 crossARINC_in_CM_double -1.7E+308 1.7E+308 /end CHARACTERISTIC
/begin CHARACTERISTIC crossARINC_in_cal_impl.Decode10_P14 "" VALUE 0x0080CF70 Scalar_FLOAT64_IEEE 0 crossARINC_in_CM_double -1.7E+308 1.7E+308 /end CHARACTERISTIC
/begin CHARACTERISTIC crossARINC_in_cal_impl.Decode10_P15 "" VALUE 0x0080CF88 Scalar_FLOAT64_IEEE 0 crossARINC_in_CM_double -1.7E+308 1.7E+308 /end CHARACTERISTIC
/begin CHARACTERISTIC crossARINC_in_cal_impl.Decode10_P16 "" VALUE 0x0080CFA0 Scalar_FLOAT64_IEEE 0 crossARINC_in_CM_double -1.7E+308 1.7E+308 /end CHARACTERISTIC
/begin CHARACTERISTIC crossARINC_in_cal_impl.Decode10_P2 "" VALUE 0x0080CE50 Scalar_FLOAT64_IEEE 0 crossARINC_in_CM_double -1.7E+308 1.7E+308 /end CHARACTERISTIC
/begin CHARACTERISTIC crossARINC_in_cal_impl.Decode10_P3 "" VALUE 0x0080CE68 Scalar_FLOAT64_IEEE 0 crossARINC_in_CM_double -1.7E+308 1.7E+308 /end CHARACTERISTIC
/begin CHARACTERISTIC crossARINC_in_cal_impl.Decode10_P4 "" VALUE 0x0080CE80 Scalar_FLOAT64_IEEE 0 crossARINC_in_CM_double -1.7E+308 1.7E+308 /end CHARACTERISTIC
/begin CHARACTERISTIC crossARINC_in_cal_impl.Decode10_P5 "" VALUE 0x0080CE98 Scalar_FLOAT64_IEEE 0 crossARINC_in_CM_double -1.7E+308 1.7E+308 /end CHARACTERISTIC
/begin CHARACTERISTIC crossARINC_in_cal_impl.Decode10_P6 "" VALUE 0x0080CEB0 Scalar_FLOAT64_IEEE 0 crossARINC_in_CM_double -1.7E+308 1.7E+308 /end CHARACTERISTIC
/begin CHARACTERISTIC crossARINC_in_cal_impl.Decode10_P7 "" VALUE 0x0080CEC8 Scalar_FLOAT64_IEEE 0 crossARINC_in_CM_double -1.7E+308 1.7E+308 /end CHARACTERISTIC
/begin CHARACTERISTIC crossARINC_in_cal_impl.Decode10_P8 "" VALUE 0x0080CEE0 Scalar_FLOAT64_IEEE 0 crossARINC_in_CM_double -1.7E+308 1.7E+308 /end CHARACTERISTIC
/begin CHARACTERISTIC crossARINC_in_cal_impl.Decode10_P9 "" VALUE 0x0080CEF8 Scalar_FLOAT64_IEEE 0 crossARINC_in_CM_double -1.7E+308 1.7E+308 /end CHARACTERISTIC
/begin CHARACTERISTIC crossARINC_in_cal_impl.Decode11_P1 "" VALUE 0x0080B8F8 Scalar_FLOAT64_IEEE 0 crossARINC_in_CM_double -1.7E+308 1.7E+308 /end CHARACTERISTIC
/begin CHARACTERISTIC crossARINC_in_cal_impl.Decode11_P10 "" VALUE 0x0080B9D0 Scalar_FLOAT64_IEEE 0 crossARINC_in_CM_double -1.7E+308 1.7E+308 /end CHARACTERISTIC
/begin CHARACTERISTIC crossARINC_in_cal_impl.Decode11_P11 "" VALUE 0x0080B9E8 Scalar_FLOAT64_IEEE 0 crossARINC_in_CM_double -1.7E+308 1.7E+308 /end CHARACTERISTIC
/begin CHARACTERISTIC crossARINC_in_cal_impl.Decode11_P12 "" VALUE 0x0080BA00 Scalar_FLOAT64_IEEE 0 crossARINC_in_CM_double -1.7E+308 1.7E+308 /end CHARACTERISTIC
/begin CHARACTERISTIC crossARINC_in_cal_impl.Decode11_P13 "" VALUE 0x0080BA18 Scalar_FLOAT64_IEEE 0 crossARINC_in_CM_double -1.7E+308 1.7E+308 /end CHARACTERISTIC
/begin CHARACTERISTIC crossARINC_in_cal_impl.Decode11_P14 "" VALUE 0x0080BA30 Scalar_FLOAT64_IEEE 0 crossARINC_in_CM_double -1.7E+308 1.7E+308 /end CHARACTERISTIC
/begin CHARACTERISTIC crossARINC_in_cal_impl.Decode11_P15 "" VALUE 0x0080BA48 Scalar_FLOAT64_IEEE 0 crossARINC_in_CM_double -1.7E+308 1.7E+308 /end CHARACTERISTIC
/begin CHARACTERISTIC crossARINC_in_cal_impl.Decode11_P16 "" VALUE 0x0080BA60 Scalar_FLOAT64_IEEE 0 crossARINC_in_CM_double -1.7E+308 1.7E+308 /end CHARACTERISTIC
/begin CHARACTERISTIC crossARINC_in_cal_impl.Decode11_P2 "" VALUE 0x0080B910 Scalar_FLOAT64_IEEE 0 crossARINC_in_CM_double -1.7E+308 1.7E+308 /end CHARACTERISTIC
/begin CHARACTERISTIC crossARINC_in_cal_impl.Decode11_P3 "" VALUE 0x0080B928 Scalar_FLOAT64_IEEE 0 crossARINC_in_CM_double -1.7E+308 1.7E+308 /end CHARACTERISTIC
/begin CHARACTERISTIC crossARINC_in_cal_impl.Decode11_P4 "" VALUE 0x0080B940 Scalar_FLOAT64_IEEE 0 crossARINC_in_CM_double -1.7E+308 1.7E+308 /end CHARACTERISTIC
/begin CHARACTERISTIC crossARINC_in_cal_impl.Decode11_P5 "" VALUE 0x0080B958 Scalar_FLOAT64_IEEE 0 crossARINC_in_CM_double -1.7E+308 1.7E+308 /end CHARACTERISTIC
/begin CHARACTERISTIC crossARINC_in_cal_impl.Decode11_P6 "" VALUE 0x0080B970 Scalar_FLOAT64_IEEE 0 crossARINC_in_CM_double -1.7E+308 1.7E+308 /end CHARACTERISTIC
/begin CHARACTERISTIC crossARINC_in_cal_impl.Decode11_P7 "" VALUE 0x0080B988 Scalar_FLOAT64_IEEE 0 crossARINC_in_CM_double -1.7E+308 1.7E+308 /end CHARACTERISTIC
/begin CHARACTERISTIC crossARINC_in_cal_impl.Decode11_P8 "" VALUE 0x0080B9A0 Scalar_FLOAT64_IEEE 0 crossARINC_in_CM_double -1.7E+308 1.7E+308 /end CHARACTERISTIC
/begin CHARACTERISTIC crossARINC_in_cal_impl.Decode11_P9 "" VALUE 0x0080B9B8 Scalar_FLOAT64_IEEE 0 crossARINC_in_CM_double -1.7E+308 1.7E+308 /end CHARACTERISTIC
/begin CHARACTERISTIC crossARINC_in_cal_impl.Decode12_P1 "" VALUE 0x0080BA78 Scalar_FLOAT64_IEEE 0 crossARINC_in_CM_double -1.7E+308 1.7E+308 /end CHARACTERISTIC
/begin CHARACTERISTIC crossARINC_in_cal_impl.Decode12_P10 "" VALUE 0x0080BB50 Scalar_FLOAT64_IEEE 0 crossARINC_in_CM_double -1.7E+308 1.7E+308 /end CHARACTERISTIC
/begin CHARACTERISTIC crossARINC_in_cal_impl.Decode12_P11 "" VALUE 0x0080BB68 Scalar_FLOAT64_IEEE 0 crossARINC_in_CM_double -1.7E+308 1.7E+308 /end CHARACTERISTIC
/begin CHARACTERISTIC crossARINC_in_cal_impl.Decode12_P12 "" VALUE 0x0080BB80 Scalar_FLOAT64_IEEE 0 crossARINC_in_CM_double -1.7E+308 1.7E+308 /end CHARACTERISTIC
/begin CHARACTERISTIC crossARINC_in_cal_impl.Decode12_P13 "" VALUE 0x0080BB98 Scalar_FLOAT64_IEEE 0 crossARINC_in_CM_double -1.7E+308 1.7E+308 /end CHARACTERISTIC
/begin CHARACTERISTIC crossARINC_in_cal_impl.Decode12_P14 "" VALUE 0x0080BBB0 Scalar_FLOAT64_IEEE 0 crossARINC_in_CM_double -1.7E+308 1.7E+308 /end CHARACTERISTIC
/begin CHARACTERISTIC crossARINC_in_cal_impl.Decode12_P15 "" VALUE 0x0080BBC8 Scalar_FLOAT64_IEEE 0 crossARINC_in_CM_double -1.7E+308 1.7E+308 /end CHARACTERISTIC
/begin CHARACTERISTIC crossARINC_in_cal_impl.Decode12_P16 "" VALUE 0x0080BBE0 Scalar_FLOAT64_IEEE 0 crossARINC_in_CM_double -1.7E+308 1.7E+308 /end CHARACTERISTIC
/begin CHARACTERISTIC crossARINC_in_cal_impl.Decode12_P2 "" VALUE 0x0080BA90 Scalar_FLOAT64_IEEE 0 crossARINC_in_CM_double -1.7E+308 1.7E+308 /end CHARACTERISTIC
/begin CHARACTERISTIC crossARINC_in_cal_impl.Decode12_P3 "" VALUE 0x0080BAA8 Scalar_FLOAT64_IEEE 0 crossARINC_in_CM_double -1.7E+308 1.7E+308 /end CHARACTERISTIC
/begin CHARACTERISTIC crossARINC_in_cal_impl.Decode12_P4 "" VALUE 0x0080BAC0 Scalar_FLOAT64_IEEE 0 crossARINC_in_CM_double -1.7E+308 1.7E+308 /end CHARACTERISTIC
/begin CHARACTERISTIC crossARINC_in_cal_impl.Decode12_P5 "" VALUE 0x0080BAD8 Scalar_FLOAT64_IEEE 0 crossARINC_in_CM_double -1.7E+308 1.7E+308 /end CHARACTERISTIC
/begin CHARACTERISTIC crossARINC_in_cal_impl.Decode12_P6 "" VALUE 0x0080BAF0 Scalar_FLOAT64_IEEE 0 crossARINC_in_CM_double -1.7E+308 1.7E+308 /end CHARACTERISTIC
/begin CHARACTERISTIC crossARINC_in_cal_impl.Decode12_P7 "" VALUE 0x0080BB08 Scalar_FLOAT64_IEEE 0 crossARINC_in_CM_double -1.7E+308 1.7E+308 /end CHARACTERISTIC
/begin CHARACTERISTIC crossARINC_in_cal_impl.Decode12_P8 "" VALUE 0x0080BB20 Scalar_FLOAT64_IEEE 0 crossARINC_in_CM_double -1.7E+308 1.7E+308 /end CHARACTERISTIC
/begin CHARACTERISTIC crossARINC_in_cal_impl.Decode12_P9 "" VALUE 0x0080BB38 Scalar_FLOAT64_IEEE 0 crossARINC_in_CM_double -1.7E+308 1.7E+308 /end CHARACTERISTIC
/begin CHARACTERISTIC crossARINC_in_cal_impl.Decode13_P1 "" VALUE 0x0080BBF8 Scalar_FLOAT64_IEEE 0 crossARINC_in_CM_double -1.7E+308 1.7E+308 /end CHARACTERISTIC
/begin CHARACTERISTIC crossARINC_in_cal_impl.Decode13_P10 "" VALUE 0x0080BCD0 Scalar_FLOAT64_IEEE 0 crossARINC_in_CM_double -1.7E+308 1.7E+308 /end CHARACTERISTIC
/begin CHARACTERISTIC crossARINC_in_cal_impl.Decode13_P11 "" VALUE 0x0080BCE8 Scalar_FLOAT64_IEEE 0 crossARINC_in_CM_double -1.7E+308 1.7E+308 /end CHARACTERISTIC
/begin CHARACTERISTIC crossARINC_in_cal_impl.Decode13_P12 "" VALUE 0x0080BD00 Scalar_FLOAT64_IEEE 0 crossARINC_in_CM_double -1.7E+308 1.7E+308 /end CHARACTERISTIC
/begin CHARACTERISTIC crossARINC_in_cal_impl.Decode13_P13 "" VALUE 0x0080BD18 Scalar_FLOAT64_IEEE 0 crossARINC_in_CM_double -1.7E+308 1.7E+308 /end CHARACTERISTIC
/begin CHARACTERISTIC crossARINC_in_cal_impl.Decode13_P14 "" VALUE 0x0080BD30 Scalar_FLOAT64_IEEE 0 crossARINC_in_CM_double -1.7E+308 1.7E+308 /end CHARACTERISTIC
/begin CHARACTERISTIC crossARINC_in_cal_impl.Decode13_P15 "" VALUE 0x0080BD48 Scalar_FLOAT64_IEEE 0 crossARINC_in_CM_double -1.7E+308 1.7E+308 /end CHARACTERISTIC
/begin CHARACTERISTIC crossARINC_in_cal_impl.Decode13_P16 "" VALUE 0x0080BD60 Scalar_FLOAT64_IEEE 0 crossARINC_in_CM_double -1.7E+308 1.7E+308 /end CHARACTERISTIC
/begin CHARACTERISTIC crossARINC_in_cal_impl.Decode13_P2 "" VALUE 0x0080BC10 Scalar_FLOAT64_IEEE 0 crossARINC_in_CM_double -1.7E+308 1.7E+308 /end CHARACTERISTIC
/begin CHARACTERISTIC crossARINC_in_cal_impl.Decode13_P3 "" VALUE 0x0080BC28 Scalar_FLOAT64_IEEE 0 crossARINC_in_CM_double -1.7E+308 1.7E+308 /end CHARACTERISTIC
/begin CHARACTERISTIC crossARINC_in_cal_impl.Decode13_P4 "" VALUE 0x0080BC40 Scalar_FLOAT64_IEEE 0 crossARINC_in_CM_double -1.7E+308 1.7E+308 /end CHARACTERISTIC
/begin CHARACTERISTIC crossARINC_in_cal_impl.Decode13_P5 "" VALUE 0x0080BC58 Scalar_FLOAT64_IEEE 0 crossARINC_in_CM_double -1.7E+308 1.7E+308 /end CHARACTERISTIC
/begin CHARACTERISTIC crossARINC_in_cal_impl.Decode13_P6 "" VALUE 0x0080BC70 Scalar_FLOAT64_IEEE 0 crossARINC_in_CM_double -1.7E+308 1.7E+308 /end CHARACTERISTIC
/begin CHARACTERISTIC crossARINC_in_cal_impl.Decode13_P7 "" VALUE 0x0080BC88 Scalar_FLOAT64_IEEE 0 crossARINC_in_CM_double -1.7E+308 1.7E+308 /end CHARACTERISTIC
/begin CHARACTERISTIC crossARINC_in_cal_impl.Decode13_P8 "" VALUE 0x0080BCA0 Scalar_FLOAT64_IEEE 0 crossARINC_in_CM_double -1.7E+308 1.7E+308 /end CHARACTERISTIC
/begin CHARACTERISTIC crossARINC_in_cal_impl.Decode13_P9 "" VALUE 0x0080BCB8 Scalar_FLOAT64_IEEE 0 crossARINC_in_CM_double -1.7E+308 1.7E+308 /end CHARACTERISTIC
/begin CHARACTERISTIC crossARINC_in_cal_impl.Decode14_P1 "" VALUE 0x0080BD78 Scalar_FLOAT64_IEEE 0 crossARINC_in_CM_double -1.7E+308 1.7E+308 /end CHARACTERISTIC
/begin CHARACTERISTIC crossARINC_in_cal_impl.Decode14_P10 "" VALUE 0x0080BE50 Scalar_FLOAT64_IEEE 0 crossARINC_in_CM_double -1.7E+308 1.7E+308 /end CHARACTERISTIC
/begin CHARACTERISTIC crossARINC_in_cal_impl.Decode14_P11 "" VALUE 0x0080BE68 Scalar_FLOAT64_IEEE 0 crossARINC_in_CM_double -1.7E+308 1.7E+308 /end CHARACTERISTIC
/begin CHARACTERISTIC crossARINC_in_cal_impl.Decode14_P12 "" VALUE 0x0080BE80 Scalar_FLOAT64_IEEE 0 crossARINC_in_CM_double -1.7E+308 1.7E+308 /end CHARACTERISTIC
/begin CHARACTERISTIC crossARINC_in_cal_impl.Decode14_P13 "" VALUE 0x0080BE98 Scalar_FLOAT64_IEEE 0 crossARINC_in_CM_double -1.7E+308 1.7E+308 /end CHARACTERISTIC
/begin CHARACTERISTIC crossARINC_in_cal_impl.Decode14_P14 "" VALUE 0x0080BEB0 Scalar_FLOAT64_IEEE 0 crossARINC_in_CM_double -1.7E+308 1.7E+308 /end CHARACTERISTIC
/begin CHARACTERISTIC crossARINC_in_cal_impl.Decode14_P15 "" VALUE 0x0080BEC8 Scalar_FLOAT64_IEEE 0 crossARINC_in_CM_double -1.7E+308 1.7E+308 /end CHARACTERISTIC
/begin CHARACTERISTIC crossARINC_in_cal_impl.Decode14_P16 "" VALUE 0x0080BEE0 Scalar_FLOAT64_IEEE 0 crossARINC_in_CM_double -1.7E+308 1.7E+308 /end CHARACTERISTIC
/begin CHARACTERISTIC crossARINC_in_cal_impl.Decode14_P2 "" VALUE 0x0080BD90 Scalar_FLOAT64_IEEE 0 crossARINC_in_CM_double -1.7E+308 1.7E+308 /end CHARACTERISTIC
/begin CHARACTERISTIC crossARINC_in_cal_impl.Decode14_P3 "" VALUE 0x0080BDA8 Scalar_FLOAT64_IEEE 0 crossARINC_in_CM_double -1.7E+308 1.7E+308 /end CHARACTERISTIC
/begin CHARACTERISTIC crossARINC_in_cal_impl.Decode14_P4 "" VALUE 0x0080BDC0 Scalar_FLOAT64_IEEE 0 crossARINC_in_CM_double -1.7E+308 1.7E+308 /end CHARACTERISTIC
/begin CHARACTERISTIC crossARINC_in_cal_impl.Decode14_P5 "" VALUE 0x0080BDD8 Scalar_FLOAT64_IEEE 0 crossARINC_in_CM_double -1.7E+308 1.7E+308 /end CHARACTERISTIC
/begin CHARACTERISTIC crossARINC_in_cal_impl.Decode14_P6 "" VALUE 0x0080BDF0 Scalar_FLOAT64_IEEE 0 crossARINC_in_CM_double -1.7E+308 1.7E+308 /end CHARACTERISTIC
/begin CHARACTERISTIC crossARINC_in_cal_impl.Decode14_P7 "" VALUE 0x0080BE08 Scalar_FLOAT64_IEEE 0 crossARINC_in_CM_double -1.7E+308 1.7E+308 /end CHARACTERISTIC
/begin CHARACTERISTIC crossARINC_in_cal_impl.Decode14_P8 "" VALUE 0x0080BE20 Scalar_FLOAT64_IEEE 0 crossARINC_in_CM_double -1.7E+308 1.7E+308 /end CHARACTERISTIC
/begin CHARACTERISTIC crossARINC_in_cal_impl.Decode14_P9 "" VALUE 0x0080BE38 Scalar_FLOAT64_IEEE 0 crossARINC_in_CM_double -1.7E+308 1.7E+308 /end CHARACTERISTIC
/begin CHARACTERISTIC crossARINC_in_cal_impl.Decode15_P1 "" VALUE 0x0080BF08 Scalar_FLOAT64_IEEE 0 crossARINC_in_CM_double -1.7E+308 1.7E+308 /end CHARACTERISTIC
/begin CHARACTERISTIC crossARINC_in_cal_impl.Decode15_P10 "" VALUE 0x0080BFE0 Scalar_FLOAT64_IEEE 0 crossARINC_in_CM_double -1.7E+308 1.7E+308 /end CHARACTERISTIC
/begin CHARACTERISTIC crossARINC_in_cal_impl.Decode15_P11 "" VALUE 0x0080BFF8 Scalar_FLOAT64_IEEE 0 crossARINC_in_CM_double -1.7E+308 1.7E+308 /end CHARACTERISTIC
/begin CHARACTERISTIC crossARINC_in_cal_impl.Decode15_P12 "" VALUE 0x0080C010 Scalar_FLOAT64_IEEE 0 crossARINC_in_CM_double -1.7E+308 1.7E+308 /end CHARACTERISTIC
/begin CHARACTERISTIC crossARINC_in_cal_impl.Decode15_P13 "" VALUE 0x0080C028 Scalar_FLOAT64_IEEE 0 crossARINC_in_CM_double -1.7E+308 1.7E+308 /end CHARACTERISTIC
/begin CHARACTERISTIC crossARINC_in_cal_impl.Decode15_P14 "" VALUE 0x0080C040 Scalar_FLOAT64_IEEE 0 crossARINC_in_CM_double -1.7E+308 1.7E+308 /end CHARACTERISTIC
/begin CHARACTERISTIC crossARINC_in_cal_impl.Decode15_P15 "" VALUE 0x0080C058 Scalar_FLOAT64_IEEE 0 crossARINC_in_CM_double -1.7E+308 1.7E+308 /end CHARACTERISTIC
/begin CHARACTERISTIC crossARINC_in_cal_impl.Decode15_P16 "" VALUE 0x0080C070 Scalar_FLOAT64_IEEE 0 crossARINC_in_CM_double -1.7E+308 1.7E+308 /end CHARACTERISTIC
/begin CHARACTERISTIC crossARINC_in_cal_impl.Decode15_P2 "" VALUE 0x0080BF20 Scalar_FLOAT64_IEEE 0 crossARINC_in_CM_double -1.7E+308 1.7E+308 /end CHARACTERISTIC
/begin CHARACTERISTIC crossARINC_in_cal_impl.Decode15_P3 "" VALUE 0x0080BF38 Scalar_FLOAT64_IEEE 0 crossARINC_in_CM_double -1.7E+308 1.7E+308 /end CHARACTERISTIC
/begin CHARACTERISTIC crossARINC_in_cal_impl.Decode15_P4 "" VALUE 0x0080BF50 Scalar_FLOAT64_IEEE 0 crossARINC_in_CM_double -1.7E+308 1.7E+308 /end CHARACTERISTIC
/begin CHARACTERISTIC crossARINC_in_cal_impl.Decode15_P5 "" VALUE 0x0080BF68 Scalar_FLOAT64_IEEE 0 crossARINC_in_CM_double -1.7E+308 1.7E+308 /end CHARACTERISTIC
/begin CHARACTERISTIC crossARINC_in_cal_impl.Decode15_P6 "" VALUE 0x0080BF80 Scalar_FLOAT64_IEEE 0 crossARINC_in_CM_double -1.7E+308 1.7E+308 /end CHARACTERISTIC
/begin CHARACTERISTIC crossARINC_in_cal_impl.Decode15_P7 "" VALUE 0x0080BF98 Scalar_FLOAT64_IEEE 0 crossARINC_in_CM_double -1.7E+308 1.7E+308 /end CHARACTERISTIC
/begin CHARACTERISTIC crossARINC_in_cal_impl.Decode15_P8 "" VALUE 0x0080BFB0 Scalar_FLOAT64_IEEE 0 crossARINC_in_CM_double -1.7E+308 1.7E+308 /end CHARACTERISTIC
/begin CHARACTERISTIC crossARINC_in_cal_impl.Decode15_P9 "" VALUE 0x0080BFC8 Scalar_FLOAT64_IEEE 0 crossARINC_in_CM_double -1.7E+308 1.7E+308 /end CHARACTERISTIC
/begin CHARACTERISTIC crossARINC_in_cal_impl.Decode16_P1 "" VALUE 0x0080C088 Scalar_FLOAT64_IEEE 0 crossARINC_in_CM_double -1.7E+308 1.7E+308 /end CHARACTERISTIC
/begin CHARACTERISTIC crossARINC_in_cal_impl.Decode16_P10 "" VALUE 0x0080C160 Scalar_FLOAT64_IEEE 0 crossARINC_in_CM_double -1.7E+308 1.7E+308 /end CHARACTERISTIC
/begin CHARACTERISTIC crossARINC_in_cal_impl.Decode16_P11 "" VALUE 0x0080C178 Scalar_FLOAT64_IEEE 0 crossARINC_in_CM_double -1.7E+308 1.7E+308 /end CHARACTERISTIC
/begin CHARACTERISTIC crossARINC_in_cal_impl.Decode16_P12 "" VALUE 0x0080C190 Scalar_FLOAT64_IEEE 0 crossARINC_in_CM_double -1.7E+308 1.7E+308 /end CHARACTERISTIC
/begin CHARACTERISTIC crossARINC_in_cal_impl.Decode16_P13 "" VALUE 0x0080C1A8 Scalar_FLOAT64_IEEE 0 crossARINC_in_CM_double -1.7E+308 1.7E+308 /end CHARACTERISTIC
/begin CHARACTERISTIC crossARINC_in_cal_impl.Decode16_P14 "" VALUE 0x0080C1C0 Scalar_FLOAT64_IEEE 0 crossARINC_in_CM_double -1.7E+308 1.7E+308 /end CHARACTERISTIC
/begin CHARACTERISTIC crossARINC_in_cal_impl.Decode16_P15 "" VALUE 0x0080C1D8 Scalar_FLOAT64_IEEE 0 crossARINC_in_CM_double -1.7E+308 1.7E+308 /end CHARACTERISTIC
/begin CHARACTERISTIC crossARINC_in_cal_impl.Decode16_P16 "" VALUE 0x0080C1F0 Scalar_FLOAT64_IEEE 0 crossARINC_in_CM_double -1.7E+308 1.7E+308 /end CHARACTERISTIC
/begin CHARACTERISTIC crossARINC_in_cal_impl.Decode16_P2 "" VALUE 0x0080C0A0 Scalar_FLOAT64_IEEE 0 crossARINC_in_CM_double -1.7E+308 1.7E+308 /end CHARACTERISTIC
/begin CHARACTERISTIC crossARINC_in_cal_impl.Decode16_P3 "" VALUE 0x0080C0B8 Scalar_FLOAT64_IEEE 0 crossARINC_in_CM_double -1.7E+308 1.7E+308 /end CHARACTERISTIC
/begin CHARACTERISTIC crossARINC_in_cal_impl.Decode16_P4 "" VALUE 0x0080C0D0 Scalar_FLOAT64_IEEE 0 crossARINC_in_CM_double -1.7E+308 1.7E+308 /end CHARACTERISTIC
/begin CHARACTERISTIC crossARINC_in_cal_impl.Decode16_P5 "" VALUE 0x0080C0E8 Scalar_FLOAT64_IEEE 0 crossARINC_in_CM_double -1.7E+308 1.7E+308 /end CHARACTERISTIC
/begin CHARACTERISTIC crossARINC_in_cal_impl.Decode16_P6 "" VALUE 0x0080C100 Scalar_FLOAT64_IEEE 0 crossARINC_in_CM_double -1.7E+308 1.7E+308 /end CHARACTERISTIC
/begin CHARACTERISTIC crossARINC_in_cal_impl.Decode16_P7 "" VALUE 0x0080C118 Scalar_FLOAT64_IEEE 0 crossARINC_in_CM_double -1.7E+308 1.7E+308 /end CHARACTERISTIC
/begin CHARACTERISTIC crossARINC_in_cal_impl.Decode16_P8 "" VALUE 0x0080C130 Scalar_FLOAT64_IEEE 0 crossARINC_in_CM_double -1.7E+308 1.7E+308 /end CHARACTERISTIC
/begin CHARACTERISTIC crossARINC_in_cal_impl.Decode16_P9 "" VALUE 0x0080C148 Scalar_FLOAT64_IEEE 0 crossARINC_in_CM_double -1.7E+308 1.7E+308 /end CHARACTERISTIC
/begin CHARACTERISTIC crossARINC_in_cal_impl.Decode17_P1 "" VALUE 0x0080C208 Scalar_FLOAT64_IEEE 0 crossARINC_in_CM_double -1.7E+308 1.7E+308 /end CHARACTERISTIC
/begin CHARACTERISTIC crossARINC_in_cal_impl.Decode17_P10 "" VALUE 0x0080C2E0 Scalar_FLOAT64_IEEE 0 crossARINC_in_CM_double -1.7E+308 1.7E+308 /end CHARACTERISTIC
/begin CHARACTERISTIC crossARINC_in_cal_impl.Decode17_P11 "" VALUE 0x0080C2F8 Scalar_FLOAT64_IEEE 0 crossARINC_in_CM_double -1.7E+308 1.7E+308 /end CHARACTERISTIC
/begin CHARACTERISTIC crossARINC_in_cal_impl.Decode17_P12 "" VALUE 0x0080C310 Scalar_FLOAT64_IEEE 0 crossARINC_in_CM_double -1.7E+308 1.7E+308 /end CHARACTERISTIC
/begin CHARACTERISTIC crossARINC_in_cal_impl.Decode17_P13 "" VALUE 0x0080C328 Scalar_FLOAT64_IEEE 0 crossARINC_in_CM_double -1.7E+308 1.7E+308 /end CHARACTERISTIC
/begin CHARACTERISTIC crossARINC_in_cal_impl.Decode17_P14 "" VALUE 0x0080C340 Scalar_FLOAT64_IEEE 0 crossARINC_in_CM_double -1.7E+308 1.7E+308 /end CHARACTERISTIC
/begin CHARACTERISTIC crossARINC_in_cal_impl.Decode17_P15 "" VALUE 0x0080C358 Scalar_FLOAT64_IEEE 0 crossARINC_in_CM_double -1.7E+308 1.7E+308 /end CHARACTERISTIC
/begin CHARACTERISTIC crossARINC_in_cal_impl.Decode17_P16 "" VALUE 0x0080C370 Scalar_FLOAT64_IEEE 0 crossARINC_in_CM_double -1.7E+308 1.7E+308 /end CHARACTERISTIC
/begin CHARACTERISTIC crossARINC_in_cal_impl.Decode17_P2 "" VALUE 0x0080C220 Scalar_FLOAT64_IEEE 0 crossARINC_in_CM_double -1.7E+308 1.7E+308 /end CHARACTERISTIC
/begin CHARACTERISTIC crossARINC_in_cal_impl.Decode17_P3 "" VALUE 0x0080C238 Scalar_FLOAT64_IEEE 0 crossARINC_in_CM_double -1.7E+308 1.7E+308 /end CHARACTERISTIC
/begin CHARACTERISTIC crossARINC_in_cal_impl.Decode17_P4 "" VALUE 0x0080C250 Scalar_FLOAT64_IEEE 0 crossARINC_in_CM_double -1.7E+308 1.7E+308 /end CHARACTERISTIC
/begin CHARACTERISTIC crossARINC_in_cal_impl.Decode17_P5 "" VALUE 0x0080C268 Scalar_FLOAT64_IEEE 0 crossARINC_in_CM_double -1.7E+308 1.7E+308 /end CHARACTERISTIC
/begin CHARACTERISTIC crossARINC_in_cal_impl.Decode17_P6 "" VALUE 0x0080C280 Scalar_FLOAT64_IEEE 0 crossARINC_in_CM_double -1.7E+308 1.7E+308 /end CHARACTERISTIC
/begin CHARACTERISTIC crossARINC_in_cal_impl.Decode17_P7 "" VALUE 0x0080C298 Scalar_FLOAT64_IEEE 0 crossARINC_in_CM_double -1.7E+308 1.7E+308 /end CHARACTERISTIC
/begin CHARACTERISTIC crossARINC_in_cal_impl.Decode17_P8 "" VALUE 0x0080C2B0 Scalar_FLOAT64_IEEE 0 crossARINC_in_CM_double -1.7E+308 1.7E+308 /end CHARACTERISTIC
/begin CHARACTERISTIC crossARINC_in_cal_impl.Decode17_P9 "" VALUE 0x0080C2C8 Scalar_FLOAT64_IEEE 0 crossARINC_in_CM_double -1.7E+308 1.7E+308 /end CHARACTERISTIC
/begin CHARACTERISTIC crossARINC_in_cal_impl.Decode1_P1 "" VALUE 0x0080B5E0 Scalar_FLOAT64_IEEE 0 crossARINC_in_CM_double -1.7E+308 1.7E+308 /end CHARACTERISTIC
/begin CHARACTERISTIC crossARINC_in_cal_impl.Decode1_P10 "" VAL_BLK 0x0080B6B8 Scalar_FLOAT64_IEEE 0 crossARINC_in_CM_double -1.7E+308 1.7E+308 MATRIX_DIM 2 1 /end CHARACTERISTIC
/begin CHARACTERISTIC crossARINC_in_cal_impl.Decode1_P11 "" VALUE 0x0080B6D8 Scalar_FLOAT64_IEEE 0 crossARINC_in_CM_double -1.7E+308 1.7E+308 /end CHARACTERISTIC
/begin CHARACTERISTIC crossARINC_in_cal_impl.Decode1_P12 "" VALUE 0x0080B6F0 Scalar_FLOAT64_IEEE 0 crossARINC_in_CM_double -1.7E+308 1.7E+308 /end CHARACTERISTIC
/begin CHARACTERISTIC crossARINC_in_cal_impl.Decode1_P13 "" VALUE 0x0080B708 Scalar_FLOAT64_IEEE 0 crossARINC_in_CM_double -1.7E+308 1.7E+308 /end CHARACTERISTIC
/begin CHARACTERISTIC crossARINC_in_cal_impl.Decode1_P14 "" VALUE 0x0080B720 Scalar_FLOAT64_IEEE 0 crossARINC_in_CM_double -1.7E+308 1.7E+308 /end CHARACTERISTIC
/begin CHARACTERISTIC crossARINC_in_cal_impl.Decode1_P15 "" VALUE 0x0080B738 Scalar_FLOAT64_IEEE 0 crossARINC_in_CM_double -1.7E+308 1.7E+308 /end CHARACTERISTIC
/begin CHARACTERISTIC crossARINC_in_cal_impl.Decode1_P16 "" VALUE 0x0080B750 Scalar_FLOAT64_IEEE 0 crossARINC_in_CM_double -1.7E+308 1.7E+308 /end CHARACTERISTIC
/begin CHARACTERISTIC crossARINC_in_cal_impl.Decode1_P2 "" VALUE 0x0080B5F8 Scalar_FLOAT64_IEEE 0 crossARINC_in_CM_double -1.7E+308 1.7E+308 /end CHARACTERISTIC
/begin CHARACTERISTIC crossARINC_in_cal_impl.Decode1_P3 "" VALUE 0x0080B610 Scalar_FLOAT64_IEEE 0 crossARINC_in_CM_double -1.7E+308 1.7E+308 /end CHARACTERISTIC
/begin CHARACTERISTIC crossARINC_in_cal_impl.Decode1_P4 "" VALUE 0x0080B628 Scalar_FLOAT64_IEEE 0 crossARINC_in_CM_double -1.7E+308 1.7E+308 /end CHARACTERISTIC
/begin CHARACTERISTIC crossARINC_in_cal_impl.Decode1_P5 "" VALUE 0x0080B640 Scalar_FLOAT64_IEEE 0 crossARINC_in_CM_double -1.7E+308 1.7E+308 /end CHARACTERISTIC
/begin CHARACTERISTIC crossARINC_in_cal_impl.Decode1_P6 "" VALUE 0x0080B658 Scalar_FLOAT64_IEEE 0 crossARINC_in_CM_double -1.7E+308 1.7E+308 /end CHARACTERISTIC
/begin CHARACTERISTIC crossARINC_in_cal_impl.Decode1_P7 "" VALUE 0x0080B670 Scalar_FLOAT64_IEEE 0 crossARINC_in_CM_double -1.7E+308 1.7E+308 /end CHARACTERISTIC
/begin CHARACTERISTIC crossARINC_in_cal_impl.Decode1_P8 "" VALUE 0x0080B688 Scalar_FLOAT64_IEEE 0 crossARINC_in_CM_double -1.7E+308 1.7E+308 /end CHARACTERISTIC
/begin CHARACTERISTIC crossARINC_in_cal_impl.Decode1_P9 "" VALUE 0x0080B6A0 Scalar_FLOAT64_IEEE 0 crossARINC_in_CM_double -1.7E+308 1.7E+308 /end CHARACTERISTIC
/begin CHARACTERISTIC crossARINC_in_cal_impl.Decode2_P1 "" VALUE 0x0080C388 Scalar_FLOAT64_IEEE 0 crossARINC_in_CM_double -1.7E+308 1.7E+308 /end CHARACTERISTIC
/begin CHARACTERISTIC crossARINC_in_cal_impl.Decode2_P10 "" VALUE 0x0080C460 Scalar_FLOAT64_IEEE 0 crossARINC_in_CM_double -1.7E+308 1.7E+308 /end CHARACTERISTIC
/begin CHARACTERISTIC crossARINC_in_cal_impl.Decode2_P11 "" VALUE 0x0080C478 Scalar_FLOAT64_IEEE 0 crossARINC_in_CM_double -1.7E+308 1.7E+308 /end CHARACTERISTIC
/begin CHARACTERISTIC crossARINC_in_cal_impl.Decode2_P12 "" VALUE 0x0080C490 Scalar_FLOAT64_IEEE 0 crossARINC_in_CM_double -1.7E+308 1.7E+308 /end CHARACTERISTIC
/begin CHARACTERISTIC crossARINC_in_cal_impl.Decode2_P13 "" VALUE 0x0080C4A8 Scalar_FLOAT64_IEEE 0 crossARINC_in_CM_double -1.7E+308 1.7E+308 /end CHARACTERISTIC
/begin CHARACTERISTIC crossARINC_in_cal_impl.Decode2_P14 "" VALUE 0x0080C4C0 Scalar_FLOAT64_IEEE 0 crossARINC_in_CM_double -1.7E+308 1.7E+308 /end CHARACTERISTIC
/begin CHARACTERISTIC crossARINC_in_cal_impl.Decode2_P15 "" VALUE 0x0080C4D8 Scalar_FLOAT64_IEEE 0 crossARINC_in_CM_double -1.7E+308 1.7E+308 /end CHARACTERISTIC
/begin CHARACTERISTIC crossARINC_in_cal_impl.Decode2_P16 "" VALUE 0x0080C4F0 Scalar_FLOAT64_IEEE 0 crossARINC_in_CM_double -1.7E+308 1.7E+308 /end CHARACTERISTIC
/begin CHARACTERISTIC crossARINC_in_cal_impl.Decode2_P2 "" VALUE 0x0080C3A0 Scalar_FLOAT64_IEEE 0 crossARINC_in_CM_double -1.7E+308 1.7E+308 /end CHARACTERISTIC
/begin CHARACTERISTIC crossARINC_in_cal_impl.Decode2_P3 "" VALUE 0x0080C3B8 Scalar_FLOAT64_IEEE 0 crossARINC_in_CM_double -1.7E+308 1.7E+308 /end CHARACTERISTIC
/begin CHARACTERISTIC crossARINC_in_cal_impl.Decode2_P4 "" VALUE 0x0080C3D0 Scalar_FLOAT64_IEEE 0 crossARINC_in_CM_double -1.7E+308 1.7E+308 /end CHARACTERISTIC
/begin CHARACTERISTIC crossARINC_in_cal_impl.Decode2_P5 "" VALUE 0x0080C3E8 Scalar_FLOAT64_IEEE 0 crossARINC_in_CM_double -1.7E+308 1.7E+308 /end CHARACTERISTIC
/begin CHARACTERISTIC crossARINC_in_cal_impl.Decode2_P6 "" VALUE 0x0080C400 Scalar_FLOAT64_IEEE 0 crossARINC_in_CM_double -1.7E+308 1.7E+308 /end CHARACTERISTIC
/begin CHARACTERISTIC crossARINC_in_cal_impl.Decode2_P7 "" VALUE 0x0080C418 Scalar_FLOAT64_IEEE 0 crossARINC_in_CM_double -1.7E+308 1.7E+308 /end CHARACTERISTIC
/begin CHARACTERISTIC crossARINC_in_cal_impl.Decode2_P8 "" VALUE 0x0080C430 Scalar_FLOAT64_IEEE 0 crossARINC_in_CM_double -1.7E+308 1.7E+308 /end CHARACTERISTIC
/begin CHARACTERISTIC crossARINC_in_cal_impl.Decode2_P9 "" VALUE 0x0080C448 Scalar_FLOAT64_IEEE 0 crossARINC_in_CM_double -1.7E+308 1.7E+308 /end CHARACTERISTIC
/begin CHARACTERISTIC crossARINC_in_cal_impl.Decode3_P1 "" VALUE 0x0080C688 Scalar_FLOAT64_IEEE 0 crossARINC_in_CM_double -1.7E+308 1.7E+308 /end CHARACTERISTIC
/begin CHARACTERISTIC crossARINC_in_cal_impl.Decode3_P10 "" VALUE 0x0080C760 Scalar_FLOAT64_IEEE 0 crossARINC_in_CM_double -1.7E+308 1.7E+308 /end CHARACTERISTIC
/begin CHARACTERISTIC crossARINC_in_cal_impl.Decode3_P11 "" VALUE 0x0080C778 Scalar_FLOAT64_IEEE 0 crossARINC_in_CM_double -1.7E+308 1.7E+308 /end CHARACTERISTIC
/begin CHARACTERISTIC crossARINC_in_cal_impl.Decode3_P12 "" VALUE 0x0080C790 Scalar_FLOAT64_IEEE 0 crossARINC_in_CM_double -1.7E+308 1.7E+308 /end CHARACTERISTIC
/begin CHARACTERISTIC crossARINC_in_cal_impl.Decode3_P13 "" VALUE 0x0080C7A8 Scalar_FLOAT64_IEEE 0 crossARINC_in_CM_double -1.7E+308 1.7E+308 /end CHARACTERISTIC
/begin CHARACTERISTIC crossARINC_in_cal_impl.Decode3_P14 "" VALUE 0x0080C7C0 Scalar_FLOAT64_IEEE 0 crossARINC_in_CM_double -1.7E+308 1.7E+308 /end CHARACTERISTIC
/begin CHARACTERISTIC crossARINC_in_cal_impl.Decode3_P15 "" VALUE 0x0080C7D8 Scalar_FLOAT64_IEEE 0 crossARINC_in_CM_double -1.7E+308 1.7E+308 /end CHARACTERISTIC
/begin CHARACTERISTIC crossARINC_in_cal_impl.Decode3_P16 "" VALUE 0x0080C7F0 Scalar_FLOAT64_IEEE 0 crossARINC_in_CM_double -1.7E+308 1.7E+308 /end CHARACTERISTIC
/begin CHARACTERISTIC crossARINC_in_cal_impl.Decode3_P2 "" VALUE 0x0080C6A0 Scalar_FLOAT64_IEEE 0 crossARINC_in_CM_double -1.7E+308 1.7E+308 /end CHARACTERISTIC
/begin CHARACTERISTIC crossARINC_in_cal_impl.Decode3_P3 "" VALUE 0x0080C6B8 Scalar_FLOAT64_IEEE 0 crossARINC_in_CM_double -1.7E+308 1.7E+308 /end CHARACTERISTIC
/begin CHARACTERISTIC crossARINC_in_cal_impl.Decode3_P4 "" VALUE 0x0080C6D0 Scalar_FLOAT64_IEEE 0 crossARINC_in_CM_double -1.7E+308 1.7E+308 /end CHARACTERISTIC
/begin CHARACTERISTIC crossARINC_in_cal_impl.Decode3_P5 "" VALUE 0x0080C6E8 Scalar_FLOAT64_IEEE 0 crossARINC_in_CM_double -1.7E+308 1.7E+308 /end CHARACTERISTIC
/begin CHARACTERISTIC crossARINC_in_cal_impl.Decode3_P6 "" VALUE 0x0080C700 Scalar_FLOAT64_IEEE 0 crossARINC_in_CM_double -1.7E+308 1.7E+308 /end CHARACTERISTIC
/begin CHARACTERISTIC crossARINC_in_cal_impl.Decode3_P7 "" VALUE 0x0080C718 Scalar_FLOAT64_IEEE 0 crossARINC_in_CM_double -1.7E+308 1.7E+308 /end CHARACTERISTIC
/begin CHARACTERISTIC crossARINC_in_cal_impl.Decode3_P8 "" VALUE 0x0080C730 Scalar_FLOAT64_IEEE 0 crossARINC_in_CM_double -1.7E+308 1.7E+308 /end CHARACTERISTIC
/begin CHARACTERISTIC crossARINC_in_cal_impl.Decode3_P9 "" VALUE 0x0080C748 Scalar_FLOAT64_IEEE 0 crossARINC_in_CM_double -1.7E+308 1.7E+308 /end CHARACTERISTIC
/begin CHARACTERISTIC crossARINC_in_cal_impl.Decode4_P1 "" VALUE 0x0080C808 Scalar_FLOAT64_IEEE 0 crossARINC_in_CM_double -1.7E+308 1.7E+308 /end CHARACTERISTIC
/begin CHARACTERISTIC crossARINC_in_cal_impl.Decode4_P10 "" VAL_BLK 0x0080C8E0 Scalar_FLOAT64_IEEE 0 crossARINC_in_CM_double -1.7E+308 1.7E+308 MATRIX_DIM 2 1 /end CHARACTERISTIC
/begin CHARACTERISTIC crossARINC_in_cal_impl.Decode4_P11 "" VALUE 0x0080C900 Scalar_FLOAT64_IEEE 0 crossARINC_in_CM_double -1.7E+308 1.7E+308 /end CHARACTERISTIC
/begin CHARACTERISTIC crossARINC_in_cal_impl.Decode4_P12 "" VALUE 0x0080C918 Scalar_FLOAT64_IEEE 0 crossARINC_in_CM_double -1.7E+308 1.7E+308 /end CHARACTERISTIC
/begin CHARACTERISTIC crossARINC_in_cal_impl.Decode4_P13 "" VALUE 0x0080C930 Scalar_FLOAT64_IEEE 0 crossARINC_in_CM_double -1.7E+308 1.7E+308 /end CHARACTERISTIC
/begin CHARACTERISTIC crossARINC_in_cal_impl.Decode4_P14 "" VALUE 0x0080C948 Scalar_FLOAT64_IEEE 0 crossARINC_in_CM_double -1.7E+308 1.7E+308 /end CHARACTERISTIC
/begin CHARACTERISTIC crossARINC_in_cal_impl.Decode4_P15 "" VALUE 0x0080C960 Scalar_FLOAT64_IEEE 0 crossARINC_in_CM_double -1.7E+308 1.7E+308 /end CHARACTERISTIC
/begin CHARACTERISTIC crossARINC_in_cal_impl.Decode4_P16 "" VALUE 0x0080C978 Scalar_FLOAT64_IEEE 0 crossARINC_in_CM_double -1.7E+308 1.7E+308 /end CHARACTERISTIC
/begin CHARACTERISTIC crossARINC_in_cal_impl.Decode4_P2 "" VALUE 0x0080C820 Scalar_FLOAT64_IEEE 0 crossARINC_in_CM_double -1.7E+308 1.7E+308 /end CHARACTERISTIC
/begin CHARACTERISTIC crossARINC_in_cal_impl.Decode4_P3 "" VALUE 0x0080C838 Scalar_FLOAT64_IEEE 0 crossARINC_in_CM_double -1.7E+308 1.7E+308 /end CHARACTERISTIC
/begin CHARACTERISTIC crossARINC_in_cal_impl.Decode4_P4 "" VALUE 0x0080C850 Scalar_FLOAT64_IEEE 0 crossARINC_in_CM_double -1.7E+308 1.7E+308 /end CHARACTERISTIC
/begin CHARACTERISTIC crossARINC_in_cal_impl.Decode4_P5 "" VALUE 0x0080C868 Scalar_FLOAT64_IEEE 0 crossARINC_in_CM_double -1.7E+308 1.7E+308 /end CHARACTERISTIC
/begin CHARACTERISTIC crossARINC_in_cal_impl.Decode4_P6 "" VALUE 0x0080C880 Scalar_FLOAT64_IEEE 0 crossARINC_in_CM_double -1.7E+308 1.7E+308 /end CHARACTERISTIC
/begin CHARACTERISTIC crossARINC_in_cal_impl.Decode4_P7 "" VALUE 0x0080C898 Scalar_FLOAT64_IEEE 0 crossARINC_in_CM_double -1.7E+308 1.7E+308 /end CHARACTERISTIC
/begin CHARACTERISTIC crossARINC_in_cal_impl.Decode4_P8 "" VALUE 0x0080C8B0 Scalar_FLOAT64_IEEE 0 crossARINC_in_CM_double -1.7E+308 1.7E+308 /end CHARACTERISTIC
/begin CHARACTERISTIC crossARINC_in_cal_impl.Decode4_P9 "" VALUE 0x0080C8C8 Scalar_FLOAT64_IEEE 0 crossARINC_in_CM_double -1.7E+308 1.7E+308 /end CHARACTERISTIC
/begin CHARACTERISTIC crossARINC_in_cal_impl.Decode5_P1 "" VALUE 0x0080B778 Scalar_FLOAT64_IEEE 0 crossARINC_in_CM_double -1.7E+308 1.7E+308 /end CHARACTERISTIC
/begin CHARACTERISTIC crossARINC_in_cal_impl.Decode5_P10 "" VALUE 0x0080B850 Scalar_FLOAT64_IEEE 0 crossARINC_in_CM_double -1.7E+308 1.7E+308 /end CHARACTERISTIC
/begin CHARACTERISTIC crossARINC_in_cal_impl.Decode5_P11 "" VALUE 0x0080B868 Scalar_FLOAT64_IEEE 0 crossARINC_in_CM_double -1.7E+308 1.7E+308 /end CHARACTERISTIC
/begin CHARACTERISTIC crossARINC_in_cal_impl.Decode5_P12 "" VALUE 0x0080B880 Scalar_FLOAT64_IEEE 0 crossARINC_in_CM_double -1.7E+308 1.7E+308 /end CHARACTERISTIC
/begin CHARACTERISTIC crossARINC_in_cal_impl.Decode5_P13 "" VALUE 0x0080B898 Scalar_FLOAT64_IEEE 0 crossARINC_in_CM_double -1.7E+308 1.7E+308 /end CHARACTERISTIC
/begin CHARACTERISTIC crossARINC_in_cal_impl.Decode5_P14 "" VALUE 0x0080B8B0 Scalar_FLOAT64_IEEE 0 crossARINC_in_CM_double -1.7E+308 1.7E+308 /end CHARACTERISTIC
/begin CHARACTERISTIC crossARINC_in_cal_impl.Decode5_P15 "" VALUE 0x0080B8C8 Scalar_FLOAT64_IEEE 0 crossARINC_in_CM_double -1.7E+308 1.7E+308 /end CHARACTERISTIC
/begin CHARACTERISTIC crossARINC_in_cal_impl.Decode5_P16 "" VALUE 0x0080B8E0 Scalar_FLOAT64_IEEE 0 crossARINC_in_CM_double -1.7E+308 1.7E+308 /end CHARACTERISTIC
/begin CHARACTERISTIC crossARINC_in_cal_impl.Decode5_P2 "" VALUE 0x0080B790 Scalar_FLOAT64_IEEE 0 crossARINC_in_CM_double -1.7E+308 1.7E+308 /end CHARACTERISTIC
/begin CHARACTERISTIC crossARINC_in_cal_impl.Decode5_P3 "" VALUE 0x0080B7A8 Scalar_FLOAT64_IEEE 0 crossARINC_in_CM_double -1.7E+308 1.7E+308 /end CHARACTERISTIC
/begin CHARACTERISTIC crossARINC_in_cal_impl.Decode5_P4 "" VALUE 0x0080B7C0 Scalar_FLOAT64_IEEE 0 crossARINC_in_CM_double -1.7E+308 1.7E+308 /end CHARACTERISTIC
/begin CHARACTERISTIC crossARINC_in_cal_impl.Decode5_P5 "" VALUE 0x0080B7D8 Scalar_FLOAT64_IEEE 0 crossARINC_in_CM_double -1.7E+308 1.7E+308 /end CHARACTERISTIC
/begin CHARACTERISTIC crossARINC_in_cal_impl.Decode5_P6 "" VALUE 0x0080B7F0 Scalar_FLOAT64_IEEE 0 crossARINC_in_CM_double -1.7E+308 1.7E+308 /end CHARACTERISTIC
/begin CHARACTERISTIC crossARINC_in_cal_impl.Decode5_P7 "" VALUE 0x0080B808 Scalar_FLOAT64_IEEE 0 crossARINC_in_CM_double -1.7E+308 1.7E+308 /end CHARACTERISTIC
/begin CHARACTERISTIC crossARINC_in_cal_impl.Decode5_P8 "" VALUE 0x0080B820 Scalar_FLOAT64_IEEE 0 crossARINC_in_CM_double -1.7E+308 1.7E+308 /end CHARACTERISTIC
/begin CHARACTERISTIC crossARINC_in_cal_impl.Decode5_P9 "" VALUE 0x0080B838 Scalar_FLOAT64_IEEE 0 crossARINC_in_CM_double -1.7E+308 1.7E+308 /end CHARACTERISTIC
/begin CHARACTERISTIC crossARINC_in_cal_impl.Decode6_P1 "" VALUE 0x0080C508 Scalar_FLOAT64_IEEE 0 crossARINC_in_CM_double -1.7E+308 1.7E+308 /end CHARACTERISTIC
/begin CHARACTERISTIC crossARINC_in_cal_impl.Decode6_P10 "" VALUE 0x0080C5E0 Scalar_FLOAT64_IEEE 0 crossARINC_in_CM_double -1.7E+308 1.7E+308 /end CHARACTERISTIC
/begin CHARACTERISTIC crossARINC_in_cal_impl.Decode6_P11 "" VALUE 0x0080C5F8 Scalar_FLOAT64_IEEE 0 crossARINC_in_CM_double -1.7E+308 1.7E+308 /end CHARACTERISTIC
/begin CHARACTERISTIC crossARINC_in_cal_impl.Decode6_P12 "" VALUE 0x0080C610 Scalar_FLOAT64_IEEE 0 crossARINC_in_CM_double -1.7E+308 1.7E+308 /end CHARACTERISTIC
/begin CHARACTERISTIC crossARINC_in_cal_impl.Decode6_P13 "" VALUE 0x0080C628 Scalar_FLOAT64_IEEE 0 crossARINC_in_CM_double -1.7E+308 1.7E+308 /end CHARACTERISTIC
/begin CHARACTERISTIC crossARINC_in_cal_impl.Decode6_P14 "" VALUE 0x0080C640 Scalar_FLOAT64_IEEE 0 crossARINC_in_CM_double -1.7E+308 1.7E+308 /end CHARACTERISTIC
/begin CHARACTERISTIC crossARINC_in_cal_impl.Decode6_P15 "" VALUE 0x0080C658 Scalar_FLOAT64_IEEE 0 crossARINC_in_CM_double -1.7E+308 1.7E+308 /end CHARACTERISTIC
/begin CHARACTERISTIC crossARINC_in_cal_impl.Decode6_P16 "" VALUE 0x0080C670 Scalar_FLOAT64_IEEE 0 crossARINC_in_CM_double -1.7E+308 1.7E+308 /end CHARACTERISTIC
/begin CHARACTERISTIC crossARINC_in_cal_impl.Decode6_P2 "" VALUE 0x0080C520 Scalar_FLOAT64_IEEE 0 crossARINC_in_CM_double -1.7E+308 1.7E+308 /end CHARACTERISTIC
/begin CHARACTERISTIC crossARINC_in_cal_impl.Decode6_P3 "" VALUE 0x0080C538 Scalar_FLOAT64_IEEE 0 crossARINC_in_CM_double -1.7E+308 1.7E+308 /end CHARACTERISTIC
/begin CHARACTERISTIC crossARINC_in_cal_impl.Decode6_P4 "" VALUE 0x0080C550 Scalar_FLOAT64_IEEE 0 crossARINC_in_CM_double -1.7E+308 1.7E+308 /end CHARACTERISTIC
/begin CHARACTERISTIC crossARINC_in_cal_impl.Decode6_P5 "" VALUE 0x0080C568 Scalar_FLOAT64_IEEE 0 crossARINC_in_CM_double -1.7E+308 1.7E+308 /end CHARACTERISTIC
/begin CHARACTERISTIC crossARINC_in_cal_impl.Decode6_P6 "" VALUE 0x0080C580 Scalar_FLOAT64_IEEE 0 crossARINC_in_CM_double -1.7E+308 1.7E+308 /end CHARACTERISTIC
/begin CHARACTERISTIC crossARINC_in_cal_impl.Decode6_P7 "" VALUE 0x0080C598 Scalar_FLOAT64_IEEE 0 crossARINC_in_CM_double -1.7E+308 1.7E+308 /end CHARACTERISTIC
/begin CHARACTERISTIC crossARINC_in_cal_impl.Decode6_P8 "" VALUE 0x0080C5B0 Scalar_FLOAT64_IEEE 0 crossARINC_in_CM_double -1.7E+308 1.7E+308 /end CHARACTERISTIC
/begin CHARACTERISTIC crossARINC_in_cal_impl.Decode6_P9 "" VALUE 0x0080C5C8 Scalar_FLOAT64_IEEE 0 crossARINC_in_CM_double -1.7E+308 1.7E+308 /end CHARACTERISTIC
/begin CHARACTERISTIC crossARINC_in_cal_impl.Decode7_P1 "" VALUE 0x0080C9A0 Scalar_FLOAT64_IEEE 0 crossARINC_in_CM_double -1.7E+308 1.7E+308 /end CHARACTERISTIC
/begin CHARACTERISTIC crossARINC_in_cal_impl.Decode7_P10 "" VAL_BLK 0x0080CA78 Scalar_FLOAT64_IEEE 0 crossARINC_in_CM_double -1.7E+308 1.7E+308 MATRIX_DIM 2 1 /end CHARACTERISTIC
/begin CHARACTERISTIC crossARINC_in_cal_impl.Decode7_P11 "" VALUE 0x0080CA98 Scalar_FLOAT64_IEEE 0 crossARINC_in_CM_double -1.7E+308 1.7E+308 /end CHARACTERISTIC
/begin CHARACTERISTIC crossARINC_in_cal_impl.Decode7_P12 "" VALUE 0x0080CAB0 Scalar_FLOAT64_IEEE 0 crossARINC_in_CM_double -1.7E+308 1.7E+308 /end CHARACTERISTIC
/begin CHARACTERISTIC crossARINC_in_cal_impl.Decode7_P13 "" VALUE 0x0080CAC8 Scalar_FLOAT64_IEEE 0 crossARINC_in_CM_double -1.7E+308 1.7E+308 /end CHARACTERISTIC
/begin CHARACTERISTIC crossARINC_in_cal_impl.Decode7_P14 "" VALUE 0x0080CAE0 Scalar_FLOAT64_IEEE 0 crossARINC_in_CM_double -1.7E+308 1.7E+308 /end CHARACTERISTIC
/begin CHARACTERISTIC crossARINC_in_cal_impl.Decode7_P15 "" VALUE 0x0080CAF8 Scalar_FLOAT64_IEEE 0 crossARINC_in_CM_double -1.7E+308 1.7E+308 /end CHARACTERISTIC
/begin CHARACTERISTIC crossARINC_in_cal_impl.Decode7_P16 "" VALUE 0x0080CB10 Scalar_FLOAT64_IEEE 0 crossARINC_in_CM_double -1.7E+308 1.7E+308 /end CHARACTERISTIC
/begin CHARACTERISTIC crossARINC_in_cal_impl.Decode7_P2 "" VALUE 0x0080C9B8 Scalar_FLOAT64_IEEE 0 crossARINC_in_CM_double -1.7E+308 1.7E+308 /end CHARACTERISTIC
/begin CHARACTERISTIC crossARINC_in_cal_impl.Decode7_P3 "" VALUE 0x0080C9D0 Scalar_FLOAT64_IEEE 0 crossARINC_in_CM_double -1.7E+308 1.7E+308 /end CHARACTERISTIC
/begin CHARACTERISTIC crossARINC_in_cal_impl.Decode7_P4 "" VALUE 0x0080C9E8 Scalar_FLOAT64_IEEE 0 crossARINC_in_CM_double -1.7E+308 1.7E+308 /end CHARACTERISTIC
/begin CHARACTERISTIC crossARINC_in_cal_impl.Decode7_P5 "" VALUE 0x0080CA00 Scalar_FLOAT64_IEEE 0 crossARINC_in_CM_double -1.7E+308 1.7E+308 /end CHARACTERISTIC
/begin CHARACTERISTIC crossARINC_in_cal_impl.Decode7_P6 "" VALUE 0x0080CA18 Scalar_FLOAT64_IEEE 0 crossARINC_in_CM_double -1.7E+308 1.7E+308 /end CHARACTERISTIC
/begin CHARACTERISTIC crossARINC_in_cal_impl.Decode7_P7 "" VALUE 0x0080CA30 Scalar_FLOAT64_IEEE 0 crossARINC_in_CM_double -1.7E+308 1.7E+308 /end CHARACTERISTIC
/begin CHARACTERISTIC crossARINC_in_cal_impl.Decode7_P8 "" VALUE 0x0080CA48 Scalar_FLOAT64_IEEE 0 crossARINC_in_CM_double -1.7E+308 1.7E+308 /end CHARACTERISTIC
/begin CHARACTERISTIC crossARINC_in_cal_impl.Decode7_P9 "" VALUE 0x0080CA60 Scalar_FLOAT64_IEEE 0 crossARINC_in_CM_double -1.7E+308 1.7E+308 /end CHARACTERISTIC
/begin CHARACTERISTIC crossARINC_in_cal_impl.Decode8_P1 "" VALUE 0x0080CB28 Scalar_FLOAT64_IEEE 0 crossARINC_in_CM_double -1.7E+308 1.7E+308 /end CHARACTERISTIC
/begin CHARACTERISTIC crossARINC_in_cal_impl.Decode8_P10 "" VALUE 0x0080CC00 Scalar_FLOAT64_IEEE 0 crossARINC_in_CM_double -1.7E+308 1.7E+308 /end CHARACTERISTIC
/begin CHARACTERISTIC crossARINC_in_cal_impl.Decode8_P11 "" VALUE 0x0080CC18 Scalar_FLOAT64_IEEE 0 crossARINC_in_CM_double -1.7E+308 1.7E+308 /end CHARACTERISTIC
/begin CHARACTERISTIC crossARINC_in_cal_impl.Decode8_P12 "" VALUE 0x0080CC30 Scalar_FLOAT64_IEEE 0 crossARINC_in_CM_double -1.7E+308 1.7E+308 /end CHARACTERISTIC
/begin CHARACTERISTIC crossARINC_in_cal_impl.Decode8_P13 "" VALUE 0x0080CC48 Scalar_FLOAT64_IEEE 0 crossARINC_in_CM_double -1.7E+308 1.7E+308 /end CHARACTERISTIC
/begin CHARACTERISTIC crossARINC_in_cal_impl.Decode8_P14 "" VALUE 0x0080CC60 Scalar_FLOAT64_IEEE 0 crossARINC_in_CM_double -1.7E+308 1.7E+308 /end CHARACTERISTIC
/begin CHARACTERISTIC crossARINC_in_cal_impl.Decode8_P15 "" VALUE 0x0080CC78 Scalar_FLOAT64_IEEE 0 crossARINC_in_CM_double -1.7E+308 1.7E+308 /end CHARACTERISTIC
/begin CHARACTERISTIC crossARINC_in_cal_impl.Decode8_P16 "" VALUE 0x0080CC90 Scalar_FLOAT64_IEEE 0 crossARINC_in_CM_double -1.7E+308 1.7E+308 /end CHARACTERISTIC
/begin CHARACTERISTIC crossARINC_in_cal_impl.Decode8_P2 "" VALUE 0x0080CB40 Scalar_FLOAT64_IEEE 0 crossARINC_in_CM_double -1.7E+308 1.7E+308 /end CHARACTERISTIC
/begin CHARACTERISTIC crossARINC_in_cal_impl.Decode8_P3 "" VALUE 0x0080CB58 Scalar_FLOAT64_IEEE 0 crossARINC_in_CM_double -1.7E+308 1.7E+308 /end CHARACTERISTIC
/begin CHARACTERISTIC crossARINC_in_cal_impl.Decode8_P4 "" VALUE 0x0080CB70 Scalar_FLOAT64_IEEE 0 crossARINC_in_CM_double -1.7E+308 1.7E+308 /end CHARACTERISTIC
/begin CHARACTERISTIC crossARINC_in_cal_impl.Decode8_P5 "" VALUE 0x0080CB88 Scalar_FLOAT64_IEEE 0 crossARINC_in_CM_double -1.7E+308 1.7E+308 /end CHARACTERISTIC
/begin CHARACTERISTIC crossARINC_in_cal_impl.Decode8_P6 "" VALUE 0x0080CBA0 Scalar_FLOAT64_IEEE 0 crossARINC_in_CM_double -1.7E+308 1.7E+308 /end CHARACTERISTIC
/begin CHARACTERISTIC crossARINC_in_cal_impl.Decode8_P7 "" VALUE 0x0080CBB8 Scalar_FLOAT64_IEEE 0 crossARINC_in_CM_double -1.7E+308 1.7E+308 /end CHARACTERISTIC
/begin CHARACTERISTIC crossARINC_in_cal_impl.Decode8_P8 "" VALUE 0x0080CBD0 Scalar_FLOAT64_IEEE 0 crossARINC_in_CM_double -1.7E+308 1.7E+308 /end CHARACTERISTIC
/begin CHARACTERISTIC crossARINC_in_cal_impl.Decode8_P9 "" VALUE 0x0080CBE8 Scalar_FLOAT64_IEEE 0 crossARINC_in_CM_double -1.7E+308 1.7E+308 /end CHARACTERISTIC
/begin CHARACTERISTIC crossARINC_in_cal_impl.Decode9_P1 "" VALUE 0x0080CCA8 Scalar_FLOAT64_IEEE 0 crossARINC_in_CM_double -1.7E+308 1.7E+308 /end CHARACTERISTIC
/begin CHARACTERISTIC crossARINC_in_cal_impl.Decode9_P10 "" VALUE 0x0080CD80 Scalar_FLOAT64_IEEE 0 crossARINC_in_CM_double -1.7E+308 1.7E+308 /end CHARACTERISTIC
/begin CHARACTERISTIC crossARINC_in_cal_impl.Decode9_P11 "" VALUE 0x0080CD98 Scalar_FLOAT64_IEEE 0 crossARINC_in_CM_double -1.7E+308 1.7E+308 /end CHARACTERISTIC
/begin CHARACTERISTIC crossARINC_in_cal_impl.Decode9_P12 "" VALUE 0x0080CDB0 Scalar_FLOAT64_IEEE 0 crossARINC_in_CM_double -1.7E+308 1.7E+308 /end CHARACTERISTIC
/begin CHARACTERISTIC crossARINC_in_cal_impl.Decode9_P13 "" VALUE 0x0080CDC8 Scalar_FLOAT64_IEEE 0 crossARINC_in_CM_double -1.7E+308 1.7E+308 /end CHARACTERISTIC
/begin CHARACTERISTIC crossARINC_in_cal_impl.Decode9_P14 "" VALUE 0x0080CDE0 Scalar_FLOAT64_IEEE 0 crossARINC_in_CM_double -1.7E+308 1.7E+308 /end CHARACTERISTIC
/begin CHARACTERISTIC crossARINC_in_cal_impl.Decode9_P15 "" VALUE 0x0080CDF8 Scalar_FLOAT64_IEEE 0 crossARINC_in_CM_double -1.7E+308 1.7E+308 /end CHARACTERISTIC
/begin CHARACTERISTIC crossARINC_in_cal_impl.Decode9_P16 "" VALUE 0x0080CE10 Scalar_FLOAT64_IEEE 0 crossARINC_in_CM_double -1.7E+308 1.7E+308 /end CHARACTERISTIC
/begin CHARACTERISTIC crossARINC_in_cal_impl.Decode9_P2 "" VALUE 0x0080CCC0 Scalar_FLOAT64_IEEE 0 crossARINC_in_CM_double -1.7E+308 1.7E+308 /end CHARACTERISTIC
/begin CHARACTERISTIC crossARINC_in_cal_impl.Decode9_P3 "" VALUE 0x0080CCD8 Scalar_FLOAT64_IEEE 0 crossARINC_in_CM_double -1.7E+308 1.7E+308 /end CHARACTERISTIC
/begin CHARACTERISTIC crossARINC_in_cal_impl.Decode9_P4 "" VALUE 0x0080CCF0 Scalar_FLOAT64_IEEE 0 crossARINC_in_CM_double -1.7E+308 1.7E+308 /end CHARACTERISTIC
/begin CHARACTERISTIC crossARINC_in_cal_impl.Decode9_P5 "" VALUE 0x0080CD08 Scalar_FLOAT64_IEEE 0 crossARINC_in_CM_double -1.7E+308 1.7E+308 /end CHARACTERISTIC
/begin CHARACTERISTIC crossARINC_in_cal_impl.Decode9_P6 "" VALUE 0x0080CD20 Scalar_FLOAT64_IEEE 0 crossARINC_in_CM_double -1.7E+308 1.7E+308 /end CHARACTERISTIC
/begin CHARACTERISTIC crossARINC_in_cal_impl.Decode9_P7 "" VALUE 0x0080CD38 Scalar_FLOAT64_IEEE 0 crossARINC_in_CM_double -1.7E+308 1.7E+308 /end CHARACTERISTIC
/begin CHARACTERISTIC crossARINC_in_cal_impl.Decode9_P8 "" VALUE 0x0080CD50 Scalar_FLOAT64_IEEE 0 crossARINC_in_CM_double -1.7E+308 1.7E+308 /end CHARACTERISTIC
/begin CHARACTERISTIC crossARINC_in_cal_impl.Decode9_P9 "" VALUE 0x0080CD68 Scalar_FLOAT64_IEEE 0 crossARINC_in_CM_double -1.7E+308 1.7E+308 /end CHARACTERISTIC
/begin CHARACTERISTIC crossARINC_in_cal_impl.Receivev2_P1 "" VALUE 0x0080B568 Scalar_FLOAT64_IEEE 0 crossARINC_in_CM_double -1.7E+308 1.7E+308 /end CHARACTERISTIC
/begin CHARACTERISTIC crossARINC_in_cal_impl.Receivev2_P2 "" VALUE 0x0080B580 Scalar_FLOAT64_IEEE 0 crossARINC_in_CM_double -1.7E+308 1.7E+308 /end CHARACTERISTIC
/begin CHARACTERISTIC crossARINC_in_cal_impl.Receivev2_P3 "" VALUE 0x0080B598 Scalar_FLOAT64_IEEE 0 crossARINC_in_CM_double -1.7E+308 1.7E+308 /end CHARACTERISTIC
/begin CHARACTERISTIC crossARINC_in_cal_impl.Receivev2_P4 "" VALUE 0x0080B5B0 Scalar_FLOAT64_IEEE 0 crossARINC_in_CM_double -1.7E+308 1.7E+308 /end CHARACTERISTIC
/begin CHARACTERISTIC crossARINC_in_cal_impl.Receivev2_P5 "" VALUE 0x0080B5C8 Scalar_FLOAT64_IEEE 0 crossARINC_in_CM_double -1.7E+308 1.7E+308 /end CHARACTERISTIC
/begin CHARACTERISTIC crossARINC_in_cal_impl.Setupv2_P1 "" VALUE 0x0080B038 Scalar_FLOAT64_IEEE 0 crossARINC_in_CM_double -1.7E+308 1.7E+308 /end CHARACTERISTIC
/begin CHARACTERISTIC crossARINC_in_cal_impl.Setupv2_P2 "" VALUE 0x0080B050 Scalar_FLOAT64_IEEE 0 crossARINC_in_CM_double -1.7E+308 1.7E+308 /end CHARACTERISTIC
/begin CHARACTERISTIC crossARINC_in_cal_impl.Setupv2_P3 "" VALUE 0x0080B068 Scalar_FLOAT64_IEEE 0 crossARINC_in_CM_double -1.7E+308 1.7E+308 /end CHARACTERISTIC
/begin CHARACTERISTIC crossARINC_in_cal_impl.Setupv2_P4 "" VALUE 0x0080B080 Scalar_FLOAT64_IEEE 0 crossARINC_in_CM_double -1.7E+308 1.7E+308 /end CHARACTERISTIC
/begin CHARACTERISTIC crossARINC_in_cal_impl.Setupv2_P5 "" VALUE 0x0080B098 Scalar_FLOAT64_IEEE 0 crossARINC_in_CM_double -1.7E+308 1.7E+308 /end CHARACTERISTIC
/begin CHARACTERISTIC crossARINC_in_cal_impl.Setupv2_P6 "" VALUE 0x0080B0B0 Scalar_FLOAT64_IEEE 0 crossARINC_in_CM_double -1.7E+308 1.7E+308 /end CHARACTERISTIC
/begin CHARACTERISTIC crossARINC_in_cal_impl.Setupv2_P7 "" VAL_BLK 0x0080B0C8 Scalar_FLOAT64_IEEE 0 crossARINC_in_CM_double -1.7E+308 1.7E+308 MATRIX_DIM 5 16 /end CHARACTERISTIC
/begin CHARACTERISTIC crossARINC_in_cal_impl.Setupv2_P8 "" VAL_BLK 0x0080B358 Scalar_FLOAT64_IEEE 0 crossARINC_in_CM_double -1.7E+308 1.7E+308 MATRIX_DIM 4 16 /end CHARACTERISTIC
/begin MEASUREMENT crossARINC_in_B.ACE9C_ACE8x_DELTA_P_C "" FLOAT32_IEEE crossARINC_in_CM_single 0 0 -3.4E+38 3.4E+38 ECU_ADDRESS 0x00817438 /end MEASUREMENT
/begin MEASUREMENT crossARINC_in_B.ACE9C_ACE8x_DELTA_P_FAILURE "" UBYTE crossARINC_in_CM_logical 0 0 0 1 ECU_ADDRESS 0x0081744E /end MEASUREMENT
/begin MEASUREMENT crossARINC_in_B.ACE9C_ACE8x_GEARING_APPLIED "" FLOAT32_IEEE crossARINC_in_CM_single 0 0 -3.4E+38 3.4E+38 ECU_ADDRESS 0x00817434 /end MEASUREMENT
/begin MEASUREMENT crossARINC_in_B.ACE9C_ACE8x_GEARING_APP_F_C "" UBYTE crossARINC_in_CM_logical 0 0 0 1 ECU_ADDRESS 0x00817448 /end MEASUREMENT
/begin MEASUREMENT crossARINC_in_B.ACE9C_ACE8x_INC_DEMAND_FAIL "" UBYTE crossARINC_in_CM_logical 0 0 0 1 ECU_ADDRESS 0x0081745A /end MEASUREMENT
/begin MEASUREMENT crossARINC_in_B.ACE9C_ACE8x_MODE_C "" UBYTE crossARINC_in_CM_uint8 0 0 0 255 ECU_ADDRESS 0x00817446 /end MEASUREMENT
/begin MEASUREMENT crossARINC_in_B.ACE9C_ACE8x_PPROG "" UBYTE crossARINC_in_CM_uint8 0 0 0 255 ECU_ADDRESS 0x00817445 /end MEASUREMENT
/begin MEASUREMENT crossARINC_in_B.ACE9C_ACE8x_PPROG_FAILURE "" UBYTE crossARINC_in_CM_logical 0 0 0 1 ECU_ADDRESS 0x00817454 /end MEASUREMENT
/begin MEASUREMENT crossARINC_in_B.ACE9C_ACE8x_RAM_POS_C "" FLOAT32_IEEE crossARINC_in_CM_single 0 0 -3.4E+38 3.4E+38 ECU_ADDRESS 0x0081743C /end MEASUREMENT
/begin MEASUREMENT crossARINC_in_B.ACE9C_ACE8x_RAM_POS_C_FAILURE "" UBYTE crossARINC_in_CM_logical 0 0 0 1 ECU_ADDRESS 0x00817456 /end MEASUREMENT
/begin MEASUREMENT crossARINC_in_B.ACE9C_ACE8x_ROLL_POS_C "" FLOAT32_IEEE crossARINC_in_CM_single 0 0 -3.4E+38 3.4E+38 ECU_ADDRESS 0x00817440 /end MEASUREMENT
/begin MEASUREMENT crossARINC_in_B.ACE9C_ACE8x_ROLL_POS_C_FAILURE "" UBYTE crossARINC_in_CM_logical 0 0 0 1 ECU_ADDRESS 0x00817458 /end MEASUREMENT
/begin MEASUREMENT crossARINC_in_B.ACE9C_ACE8x_SPD_C "" UBYTE crossARINC_in_CM_uint8 0 0 0 255 ECU_ADDRESS 0x00817444 /end MEASUREMENT
/begin MEASUREMENT crossARINC_in_B.ACE9C_ACE8x_SPD_C_FAILURE "" UBYTE crossARINC_in_CM_logical 0 0 0 1 ECU_ADDRESS 0x0081744C /end MEASUREMENT
/begin MEASUREMENT crossARINC_in_B.ACE9C_ACE8x_TBI_FLAG_APP "" UBYTE crossARINC_in_CM_logical 0 0 0 1 ECU_ADDRESS 0x0081744A /end MEASUREMENT
/begin MEASUREMENT crossARINC_in_B.ACE9C_ACE8x_WOW1_C "" UBYTE crossARINC_in_CM_logical 0 0 0 1 ECU_ADDRESS 0x00817450 /end MEASUREMENT
/begin MEASUREMENT crossARINC_in_B.ACE9C_ACE8x_WOW2_C "" UBYTE crossARINC_in_CM_logical 0 0 0 1 ECU_ADDRESS 0x00817452 /end MEASUREMENT
/begin MEASUREMENT crossARINC_in_B.CCCodeBlock "" FLOAT64_IEEE crossARINC_in_CM_double 0 0 -1.7E+308 1.7E+308 ECU_ADDRESS 0x008173F8 /end MEASUREMENT
/begin MEASUREMENT crossARINC_in_B.CCCodeBlock1 "" FLOAT64_IEEE crossARINC_in_CM_double 0 0 -1.7E+308 1.7E+308 ECU_ADDRESS 0x00817408 /end MEASUREMENT
/begin MEASUREMENT crossARINC_in_B.CCCodeBlock2 "" FLOAT64_IEEE crossARINC_in_CM_double 0 0 -1.7E+308 1.7E+308 ECU_ADDRESS 0x00817410 /end MEASUREMENT
/begin MEASUREMENT crossARINC_in_B.CCCodeBlock3 "" FLOAT64_IEEE crossARINC_in_CM_double 0 0 -1.7E+308 1.7E+308 ECU_ADDRESS 0x00817400 /end MEASUREMENT
/begin MEASUREMENT crossARINC_in_B.Compare "" UBYTE crossARINC_in_CM_logical 0 0 0 1 ECU_ADDRESS 0x0081745B /end MEASUREMENT
/begin MEASUREMENT crossARINC_in_B.Decode1 "" ULONG crossARINC_in_CM_uint32 0 0 0 2147483646 ECU_ADDRESS 0x00817418 /end MEASUREMENT
/begin MEASUREMENT crossARINC_in_B.Decode10 "" UBYTE crossARINC_in_CM_logical 0 0 0 1 ECU_ADDRESS 0x00817459 /end MEASUREMENT
/begin MEASUREMENT crossARINC_in_B.Decode11 "" UBYTE crossARINC_in_CM_logical 0 0 0 1 ECU_ADDRESS 0x00817449 /end MEASUREMENT
/begin MEASUREMENT crossARINC_in_B.Decode12 "" UBYTE crossARINC_in_CM_logical 0 0 0 1 ECU_ADDRESS 0x0081744B /end MEASUREMENT
/begin MEASUREMENT crossARINC_in_B.Decode13 "" UBYTE crossARINC_in_CM_logical 0 0 0 1 ECU_ADDRESS 0x0081744D /end MEASUREMENT
/begin MEASUREMENT crossARINC_in_B.Decode14 "" ULONG crossARINC_in_CM_uint32 0 0 0 2147483646 ECU_ADDRESS 0x0081741C /end MEASUREMENT
/begin MEASUREMENT crossARINC_in_B.Decode15 "" UBYTE crossARINC_in_CM_logical 0 0 0 1 ECU_ADDRESS 0x0081744F /end MEASUREMENT
/begin MEASUREMENT crossARINC_in_B.Decode16 "" UBYTE crossARINC_in_CM_logical 0 0 0 1 ECU_ADDRESS 0x00817451 /end MEASUREMENT
/begin MEASUREMENT crossARINC_in_B.Decode17 "" ULONG crossARINC_in_CM_uint32 0 0 0 2147483646 ECU_ADDRESS 0x00817420 /end MEASUREMENT
/begin MEASUREMENT crossARINC_in_B.Decode2 "" ULONG crossARINC_in_CM_uint32 0 0 0 2147483646 ECU_ADDRESS 0x00817424 /end MEASUREMENT
/begin MEASUREMENT crossARINC_in_B.Decode3 "" UBYTE crossARINC_in_CM_logical 0 0 0 1 ECU_ADDRESS 0x00817455 /end MEASUREMENT
/begin MEASUREMENT crossARINC_in_B.Decode4 "" ULONG crossARINC_in_CM_uint32 0 0 0 2147483646 ECU_ADDRESS 0x00817428 /end MEASUREMENT
/begin MEASUREMENT crossARINC_in_B.Decode5 "" UBYTE crossARINC_in_CM_logical 0 0 0 1 ECU_ADDRESS 0x00817447 /end MEASUREMENT
/begin MEASUREMENT crossARINC_in_B.Decode6 "" UBYTE crossARINC_in_CM_logical 0 0 0 1 ECU_ADDRESS 0x00817453 /end MEASUREMENT
/begin MEASUREMENT crossARINC_in_B.Decode7 "" ULONG crossARINC_in_CM_uint32 0 0 0 2147483646 ECU_ADDRESS 0x0081742C /end MEASUREMENT
/begin MEASUREMENT crossARINC_in_B.Decode8 "" UBYTE crossARINC_in_CM_logical 0 0 0 1 ECU_ADDRESS 0x00817457 /end MEASUREMENT
/begin MEASUREMENT crossARINC_in_B.Decode9 "" ULONG crossARINC_in_CM_uint32 0 0 0 2147483646 ECU_ADDRESS 0x00817430 /end MEASUREMENT
/begin MEASUREMENT crossARINC_in_B.Receivev2 "" FLOAT64_IEEE crossARINC_in_CM_double 0 0 -1.7E+308 1.7E+308 LAYOUT COLUMN_DIR MATRIX_DIM 11 ECU_ADDRESS 0x008173A0 /end MEASUREMENT
/begin COMPU_METHOD crossARINC_in_CM_double "" IDENTICAL "%15.10" "" /end COMPU_METHOD
/begin COMPU_METHOD crossARINC_in_CM_logical "" IDENTICAL "%1.0" "" /end COMPU_METHOD
/begin COMPU_METHOD crossARINC_in_CM_single "" IDENTICAL "%8.6" "" /end COMPU_METHOD
/begin COMPU_METHOD crossARINC_in_CM_uint32 "" IDENTICAL "%10.0" "" /end COMPU_METHOD
/begin COMPU_METHOD crossARINC_in_CM_uint8 "" IDENTICAL "%3.0" "" /end COMPU_METHOD
/begin RECORD_LAYOUT Scalar_BOOLEAN FNC_VALUES 1 UBYTE COLUMN_DIR DIRECT /end RECORD_LAYOUT
/begin RECORD_LAYOUT Scalar_FLOAT32_IEEE FNC_VALUES 1 FLOAT32_IEEE COLUMN_DIR DIRECT /end RECORD_LAYOUT
/begin RECORD_LAYOUT Scalar_FLOAT64_IEEE FNC_VALUES 1 FLOAT64_IEEE COLUMN_DIR DIRECT /end RECORD_LAYOUT
/begin RECORD_LAYOUT Scalar_UBYTE FNC_VALUES 1 UBYTE COLUMN_DIR DIRECT /end RECORD_LAYOUT
/begin RECORD_LAYOUT Scalar_ULONG FNC_VALUES 1 ULONG COLUMN_DIR DIRECT /end RECORD_LAYOUT
/begin GROUP crossARINC_in "crossARINC_in" ROOT /begin SUB_GROUP crossARINC_in_Decode_Channel_1 /end SUB_GROUP
 /begin REF_CHARACTERISTIC crossARINC_in_cal_impl.Receivev2_P1 crossARINC_in_cal_impl.Receivev2_P2 crossARINC_in_cal_impl.Receivev2_P3 crossARINC_in_cal_impl.Receivev2_P4 crossARINC_in_cal_impl.Receivev2_P5 crossARINC_in_cal_impl.Setupv2_P1 crossARINC_in_cal_impl.Setupv2_P2 crossARINC_in_cal_impl.Setupv2_P3 crossARINC_in_cal_impl.Setupv2_P4 crossARINC_in_cal_impl.Setupv2_P5 crossARINC_in_cal_impl.Setupv2_P6 crossARINC_in_cal_impl.Setupv2_P7 crossARINC_in_cal_impl.Setupv2_P8 /end REF_CHARACTERISTIC
 /begin REF_MEASUREMENT crossARINC_in_B.Receivev2 crossARINC_in_DW.Receivev2_PWORK crossARINC_in_DW.Setupv2_PWORK /end REF_MEASUREMENT
/end GROUP
/begin GROUP crossARINC_in_Decode_Channel_1 "crossARINC_in/Decode Channel 1" /begin SUB_GROUP crossARINC_in_Decode_Channel_1_Compare_To_Zero /end SUB_GROUP
 /begin REF_CHARACTERISTIC crossARINC_in_cal_impl.CCCodeBlock1_P1 crossARINC_in_cal_impl.CCCodeBlock1_P2 crossARINC_in_cal_impl.CCCodeBlock1_P3 crossARINC_in_cal_impl.CCCodeBlock1_P4 crossARINC_in_cal_impl.CCCodeBlock1_P5 crossARINC_in_cal_impl.CCCodeBlock2_P1 crossARINC_in_cal_impl.CCCodeBlock2_P2 crossARINC_in_cal_impl.CCCodeBlock2_P3 crossARINC_in_cal_impl.CCCodeBlock2_P4 crossARINC_in_cal_impl.CCCodeBlock2_P5 crossARINC_in_cal_impl.CCCodeBlock3_P1 crossARINC_in_cal_impl.CCCodeBlock3_P2 crossARINC_in_cal_impl.CCCodeBlock3_P3 crossARINC_in_cal_impl.CCCodeBlock3_P4 crossARINC_in_cal_impl.CCCodeBlock3_P5 crossARINC_in_cal_impl.CCCodeBlock_P1 crossARINC_in_cal_impl.CCCodeBlock_P2 crossARINC_in_cal_impl.CCCodeBlock_P3 crossARINC_in_cal_impl.CCCodeBlock_P4 crossARINC_in_cal_impl.CCCodeBlock_P5 crossARINC_in_cal_impl.Decode10_P1 crossARINC_in_cal_impl.Decode10_P10 crossARINC_in_cal_impl.Decode10_P11 crossARINC_in_cal_impl.Decode10_P12 crossARINC_in_cal_impl.Decode10_P13 crossARINC_in_cal_impl.Decode10_P14 crossARINC_in_cal_impl.Decode10_P15 crossARINC_in_cal_impl.Decode10_P16 crossARINC_in_cal_impl.Decode10_P2 crossARINC_in_cal_impl.Decode10_P3 crossARINC_in_cal_impl.Decode10_P4 crossARINC_in_cal_impl.Decode10_P5 crossARINC_in_cal_impl.Decode10_P6 crossARINC_in_cal_impl.Decode10_P7 crossARINC_in_cal_impl.Decode10_P8 crossARINC_in_cal_impl.Decode10_P9 crossARINC_in_cal_impl.Decode11_P1 crossARINC_in_cal_impl.Decode11_P10 crossARINC_in_cal_impl.Decode11_P11 crossARINC_in_cal_impl.Decode11_P12 crossARINC_in_cal_impl.Decode11_P13 crossARINC_in_cal_impl.Decode11_P14 crossARINC_in_cal_impl.Decode11_P15 crossARINC_in_cal_impl.Decode11_P16 crossARINC_in_cal_impl.Decode11_P2 crossARINC_in_cal_impl.Decode11_P3 crossARINC_in_cal_impl.Decode11_P4 crossARINC_in_cal_impl.Decode11_P5 crossARINC_in_cal_impl.Decode11_P6 crossARINC_in_cal_impl.Decode11_P7 crossARINC_in_cal_impl.Decode11_P8 crossARINC_in_cal_impl.Decode11_P9 crossARINC_in_cal_impl.Decode12_P1 crossARINC_in_cal_impl.Decode12_P10 crossARINC_in_cal_impl.Decode12_P11 crossARINC_in_cal_impl.Decode12_P12 crossARINC_in_cal_impl.Decode12_P13 crossARINC_in_cal_impl.Decode12_P14 crossARINC_in_cal_impl.Decode12_P15 crossARINC_in_cal_impl.Decode12_P16 crossARINC_in_cal_impl.Decode12_P2 crossARINC_in_cal_impl.Decode12_P3 crossARINC_in_cal_impl.Decode12_P4 crossARINC_in_cal_impl.Decode12_P5 crossARINC_in_cal_impl.Decode12_P6 crossARINC_in_cal_impl.Decode12_P7 crossARINC_in_cal_impl.Decode12_P8 crossARINC_in_cal_impl.Decode12_P9 crossARINC_in_cal_impl.Decode13_P1 crossARINC_in_cal_impl.Decode13_P10 crossARINC_in_cal_impl.Decode13_P11 crossARINC_in_cal_impl.Decode13_P12 crossARINC_in_cal_impl.Decode13_P13 crossARINC_in_cal_impl.Decode13_P14 crossARINC_in_cal_impl.Decode13_P15 crossARINC_in_cal_impl.Decode13_P16 crossARINC_in_cal_impl.Decode13_P2 crossARINC_in_cal_impl.Decode13_P3 crossARINC_in_cal_impl.Decode13_P4 crossARINC_in_cal_impl.Decode13_P5 crossARINC_in_cal_impl.Decode13_P6 crossARINC_in_cal_impl.Decode13_P7 crossARINC_in_cal_impl.Decode13_P8 crossARINC_in_cal_impl.Decode13_P9 crossARINC_in_cal_impl.Decode14_P1 crossARINC_in_cal_impl.Decode14_P10 crossARINC_in_cal_impl.Decode14_P11 crossARINC_in_cal_impl.Decode14_P12 crossARINC_in_cal_impl.Decode14_P13 crossARINC_in_cal_impl.Decode14_P14 crossARINC_in_cal_impl.Decode14_P15 crossARINC_in_cal_impl.Decode14_P16 crossARINC_in_cal_impl.Decode14_P2 crossARINC_in_cal_impl.Decode14_P3 crossARINC_in_cal_impl.Decode14_P4 crossARINC_in_cal_impl.Decode14_P5 crossARINC_in_cal_impl.Decode14_P6 crossARINC_in_cal_impl.Decode14_P7 crossARINC_in_cal_impl.Decode14_P8 crossARINC_in_cal_impl.Decode14_P9 crossARINC_in_cal_impl.Decode15_P1 crossARINC_in_cal_impl.Decode15_P10 crossARINC_in_cal_impl.Decode15_P11 crossARINC_in_cal_impl.Decode15_P12 crossARINC_in_cal_impl.Decode15_P13 crossARINC_in_cal_impl.Decode15_P14 crossARINC_in_cal_impl.Decode15_P15 crossARINC_in_cal_impl.Decode15_P16 crossARINC_in_cal_impl.Decode15_P2 crossARINC_in_cal_impl.Decode15_P3 crossARINC_in_cal_impl.Decode15_P4 crossARINC_in_cal_impl.Decode15_P5 crossARINC_in_cal_impl.Decode15_P6 crossARINC_in_cal_impl.Decode15_P7 crossARINC_in_cal_impl.Decode15_P8 crossARINC_in_cal_impl.Decode15_P9 crossARINC_in_cal_impl.Decode16_P1 crossARINC_in_cal_impl.Decode16_P10 crossARINC_in_cal_impl.Decode16_P11 crossARINC_in_cal_impl.Decode16_P12 crossARINC_in_cal_impl.Decode16_P13 crossARINC_in_cal_impl.Decode16_P14 crossARINC_in_cal_impl.Decode16_P15 crossARINC_in_cal_impl.Decode16_P16 crossARINC_in_cal_impl.Decode16_P2 crossARINC_in_cal_impl.Decode16_P3 crossARINC_in_cal_impl.Decode16_P4 crossARINC_in_cal_impl.Decode16_P5 crossARINC_in_cal_impl.Decode16_P6 crossARINC_in_cal_impl.Decode16_P7 crossARINC_in_cal_impl.Decode16_P8 crossARINC_in_cal_impl.Decode16_P9 crossARINC_in_cal_impl.Decode17_P1 crossARINC_in_cal_impl.Decode17_P10 crossARINC_in_cal_impl.Decode17_P11 crossARINC_in_cal_impl.Decode17_P12 crossARINC_in_cal_impl.Decode17_P13 crossARINC_in_cal_impl.Decode17_P14 crossARINC_in_cal_impl.Decode17_P15 crossARINC_in_cal_impl.Decode17_P16 crossARINC_in_cal_impl.Decode17_P2 crossARINC_in_cal_impl.Decode17_P3 crossARINC_in_cal_impl.Decode17_P4 crossARINC_in_cal_impl.Decode17_P5 crossARINC_in_cal_impl.Decode17_P6 crossARINC_in_cal_impl.Decode17_P7 crossARINC_in_cal_impl.Decode17_P8 crossARINC_in_cal_impl.Decode17_P9 crossARINC_in_cal_impl.Decode1_P1 crossARINC_in_cal_impl.Decode1_P10 crossARINC_in_cal_impl.Decode1_P11 crossARINC_in_cal_impl.Decode1_P12 crossARINC_in_cal_impl.Decode1_P13 crossARINC_in_cal_impl.Decode1_P14 crossARINC_in_cal_impl.Decode1_P15 crossARINC_in_cal_impl.Decode1_P16 crossARINC_in_cal_impl.Decode1_P2 crossARINC_in_cal_impl.Decode1_P3 crossARINC_in_cal_impl.Decode1_P4 crossARINC_in_cal_impl.Decode1_P5 crossARINC_in_cal_impl.Decode1_P6 crossARINC_in_cal_impl.Decode1_P7 crossARINC_in_cal_impl.Decode1_P8 crossARINC_in_cal_impl.Decode1_P9 crossARINC_in_cal_impl.Decode2_P1 crossARINC_in_cal_impl.Decode2_P10 crossARINC_in_cal_impl.Decode2_P11 crossARINC_in_cal_impl.Decode2_P12 crossARINC_in_cal_impl.Decode2_P13 crossARINC_in_cal_impl.Decode2_P14 crossARINC_in_cal_impl.Decode2_P15 crossARINC_in_cal_impl.Decode2_P16 crossARINC_in_cal_impl.Decode2_P2 crossARINC_in_cal_impl.Decode2_P3 crossARINC_in_cal_impl.Decode2_P4 crossARINC_in_cal_impl.Decode2_P5 crossARINC_in_cal_impl.Decode2_P6 crossARINC_in_cal_impl.Decode2_P7 crossARINC_in_cal_impl.Decode2_P8 crossARINC_in_cal_impl.Decode2_P9 crossARINC_in_cal_impl.Decode3_P1 crossARINC_in_cal_impl.Decode3_P10 crossARINC_in_cal_impl.Decode3_P11 crossARINC_in_cal_impl.Decode3_P12 crossARINC_in_cal_impl.Decode3_P13 crossARINC_in_cal_impl.Decode3_P14 crossARINC_in_cal_impl.Decode3_P15 crossARINC_in_cal_impl.Decode3_P16 crossARINC_in_cal_impl.Decode3_P2 crossARINC_in_cal_impl.Decode3_P3 crossARINC_in_cal_impl.Decode3_P4 crossARINC_in_cal_impl.Decode3_P5 crossARINC_in_cal_impl.Decode3_P6 crossARINC_in_cal_impl.Decode3_P7 crossARINC_in_cal_impl.Decode3_P8 crossARINC_in_cal_impl.Decode3_P9 crossARINC_in_cal_impl.Decode4_P1 crossARINC_in_cal_impl.Decode4_P10 crossARINC_in_cal_impl.Decode4_P11 crossARINC_in_cal_impl.Decode4_P12 crossARINC_in_cal_impl.Decode4_P13 crossARINC_in_cal_impl.Decode4_P14 crossARINC_in_cal_impl.Decode4_P15 crossARINC_in_cal_impl.Decode4_P16 crossARINC_in_cal_impl.Decode4_P2 crossARINC_in_cal_impl.Decode4_P3 crossARINC_in_cal_impl.Decode4_P4 crossARINC_in_cal_impl.Decode4_P5 crossARINC_in_cal_impl.Decode4_P6 crossARINC_in_cal_impl.Decode4_P7 crossARINC_in_cal_impl.Decode4_P8 crossARINC_in_cal_impl.Decode4_P9 crossARINC_in_cal_impl.Decode5_P1 crossARINC_in_cal_impl.Decode5_P10 crossARINC_in_cal_impl.Decode5_P11 crossARINC_in_cal_impl.Decode5_P12 crossARINC_in_cal_impl.Decode5_P13 crossARINC_in_cal_impl.Decode5_P14 crossARINC_in_cal_impl.Decode5_P15 crossARINC_in_cal_impl.Decode5_P16 crossARINC_in_cal_impl.Decode5_P2 crossARINC_in_cal_impl.Decode5_P3 crossARINC_in_cal_impl.Decode5_P4 crossARINC_in_cal_impl.Decode5_P5 crossARINC_in_cal_impl.Decode5_P6 crossARINC_in_cal_impl.Decode5_P7 crossARINC_in_cal_impl.Decode5_P8 crossARINC_in_cal_impl.Decode5_P9 crossARINC_in_cal_impl.Decode6_P1 crossARINC_in_cal_impl.Decode6_P10 crossARINC_in_cal_impl.Decode6_P11 crossARINC_in_cal_impl.Decode6_P12 crossARINC_in_cal_impl.Decode6_P13 crossARINC_in_cal_impl.Decode6_P14 crossARINC_in_cal_impl.Decode6_P15 crossARINC_in_cal_impl.Decode6_P16 crossARINC_in_cal_impl.Decode6_P2 crossARINC_in_cal_impl.Decode6_P3 crossARINC_in_cal_impl.Decode6_P4 crossARINC_in_cal_impl.Decode6_P5 crossARINC_in_cal_impl.Decode6_P6 crossARINC_in_cal_impl.Decode6_P7 crossARINC_in_cal_impl.Decode6_P8 crossARINC_in_cal_impl.Decode6_P9 crossARINC_in_cal_impl.Decode7_P1 crossARINC_in_cal_impl.Decode7_P10 crossARINC_in_cal_impl.Decode7_P11 crossARINC_in_cal_impl.Decode7_P12 crossARINC_in_cal_impl.Decode7_P13 crossARINC_in_cal_impl.Decode7_P14 crossARINC_in_cal_impl.Decode7_P15 crossARINC_in_cal_impl.Decode7_P16 crossARINC_in_cal_impl.Decode7_P2 crossARINC_in_cal_impl.Decode7_P3 crossARINC_in_cal_impl.Decode7_P4 crossARINC_in_cal_impl.Decode7_P5 crossARINC_in_cal_impl.Decode7_P6 crossARINC_in_cal_impl.Decode7_P7 crossARINC_in_cal_impl.Decode7_P8 crossARINC_in_cal_impl.Decode7_P9 crossARINC_in_cal_impl.Decode8_P1 crossARINC_in_cal_impl.Decode8_P10 crossARINC_in_cal_impl.Decode8_P11 crossARINC_in_cal_impl.Decode8_P12 crossARINC_in_cal_impl.Decode8_P13 crossARINC_in_cal_impl.Decode8_P14 crossARINC_in_cal_impl.Decode8_P15 crossARINC_in_cal_impl.Decode8_P16 crossARINC_in_cal_impl.Decode8_P2 crossARINC_in_cal_impl.Decode8_P3 crossARINC_in_cal_impl.Decode8_P4 crossARINC_in_cal_impl.Decode8_P5 crossARINC_in_cal_impl.Decode8_P6 crossARINC_in_cal_impl.Decode8_P7 crossARINC_in_cal_impl.Decode8_P8 crossARINC_in_cal_impl.Decode8_P9 crossARINC_in_cal_impl.Decode9_P1 crossARINC_in_cal_impl.Decode9_P10 crossARINC_in_cal_impl.Decode9_P11 crossARINC_in_cal_impl.Decode9_P12 crossARINC_in_cal_impl.Decode9_P13 crossARINC_in_cal_impl.Decode9_P14 crossARINC_in_cal_impl.Decode9_P15 crossARINC_in_cal_impl.Decode9_P16 crossARINC_in_cal_impl.Decode9_P2 crossARINC_in_cal_impl.Decode9_P3 crossARINC_in_cal_impl.Decode9_P4 crossARINC_in_cal_impl.Decode9_P5 crossARINC_in_cal_impl.Decode9_P6 crossARINC_in_cal_impl.Decode9_P7 crossARINC_in_cal_impl.Decode9_P8 crossARINC_in_cal_impl.Decode9_P9 /end REF_CHARACTERISTIC
 /begin REF_MEASUREMENT crossARINC_in_B.ACE9C_ACE8x_DELTA_P_C crossARINC_in_B.ACE9C_ACE8x_DELTA_P_FAILURE crossARINC_in_B.ACE9C_ACE8x_GEARING_APPLIED crossARINC_in_B.ACE9C_ACE8x_GEARING_APP_F_C crossARINC_in_B.ACE9C_ACE8x_INC_DEMAND_FAIL crossARINC_in_B.ACE9C_ACE8x_MODE_C crossARINC_in_B.ACE9C_ACE8x_PPROG crossARINC_in_B.ACE9C_ACE8x_PPROG_FAILURE crossARINC_in_B.ACE9C_ACE8x_RAM_POS_C crossARINC_in_B.ACE9C_ACE8x_RAM_POS_C_FAILURE crossARINC_in_B.ACE9C_ACE8x_ROLL_POS_C crossARINC_in_B.ACE9C_ACE8x_ROLL_POS_C_FAILURE crossARINC_in_B.ACE9C_ACE8x_SPD_C crossARINC_in_B.ACE9C_ACE8x_SPD_C_FAILURE crossARINC_in_B.ACE9C_ACE8x_TBI_FLAG_APP crossARINC_in_B.ACE9C_ACE8x_WOW1_C crossARINC_in_B.ACE9C_ACE8x_WOW2_C crossARINC_in_B.CCCodeBlock crossARINC_in_B.CCCodeBlock1 crossARINC_in_B.CCCodeBlock2 crossARINC_in_B.CCCodeBlock3 crossARINC_in_B.Decode1 crossARINC_in_B.Decode10 crossARINC_in_B.Decode11 crossARINC_in_B.Decode12 crossARINC_in_B.Decode13 crossARINC_in_B.Decode14 crossARINC_in_B.Decode15 crossARINC_in_B.Decode16 crossARINC_in_B.Decode17 crossARINC_in_B.Decode2 crossARINC_in_B.Decode3 crossARINC_in_B.Decode4 crossARINC_in_B.Decode5 crossARINC_in_B.Decode6 crossARINC_in_B.Decode7 crossARINC_in_B.Decode8 crossARINC_in_B.Decode9 crossARINC_in_B.Receivev2 /end REF_MEASUREMENT
/end GROUP
/begin GROUP crossARINC_in_Decode_Channel_1_Compare_To_Zero "crossARINC_in/Decode Channel 1/Compare
To Zero" /begin REF_CHARACTERISTIC crossARINC_in_cal_impl.Constant_Value /end REF_CHARACTERISTIC /begin REF_MEASUREMENT crossARINC_in_B.Compare crossARINC_in_B.Receivev2 /end REF_MEASUREMENT /end GROUP
/end MODULE
/end PROJECT
