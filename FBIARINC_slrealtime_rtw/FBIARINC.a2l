/******************************************************************************
* ASAP2 file: FBIARINC.a2l
* Code generation for model "FBIARINC".
* Model version : 1.34
* Simulink Coder version : 10.4 R2021b
* C source code generated on : Tue May 17 11:17:16 2022
* Target selection: slrealtime.tlc
* Embedded hardware selection: Intel->x86-64 (Linux 64)
* Code generation objectives: Unspecified
* Validation result: Not run
* (add additional file header information here)
******************************************************************************/ ASAP2_VERSION 1 71
/begin PROJECT ProjectName "Project Comment Goes Here"
/begin HEADER "Header Comments go here" /end HEADER
/begin MODULE ModuleName "Module Comment Goes Here"
/begin IF_DATA XCP
 /begin PROTOCOL_LAYER 0x0100 0x03E8 0x00C8 0x0000 0x0000 0x0000 0x0000 0x0000 0xFC 0x0578 BYTE_ORDER_MSB_LAST ADDRESS_GRANULARITY_BYTE OPTIONAL_CMD ALLOC_ODT_ENTRY OPTIONAL_CMD ALLOC_ODT OPTIONAL_CMD ALLOC_DAQ OPTIONAL_CMD FREE_DAQ OPTIONAL_CMD GET_DAQ_RESOLUTION_INFO OPTIONAL_CMD GET_DAQ_PROCESSOR_INFO OPTIONAL_CMD START_STOP_SYNCH OPTIONAL_CMD START_STOP_DAQ_LIST OPTIONAL_CMD SET_DAQ_LIST_MODE OPTIONAL_CMD WRITE_DAQ OPTIONAL_CMD SET_DAQ_PTR OPTIONAL_CMD GET_CAL_PAGE OPTIONAL_CMD SET_CAL_PAGE OPTIONAL_CMD COPY_CAL_PAGE OPTIONAL_CMD SHORT_DOWNLOAD OPTIONAL_CMD DOWNLOAD_MAX OPTIONAL_CMD DOWNLOAD OPTIONAL_CMD SHORT_UPLOAD OPTIONAL_CMD UPLOAD OPTIONAL_CMD SET_MTA /end PROTOCOL_LAYER
 /begin DAQ DYNAMIC 0x0000 0x0080 0x00 OPTIMISATION_TYPE_DEFAULT ADDRESS_EXTENSION_FREE IDENTIFICATION_FIELD_TYPE_RELATIVE_WORD_ALIGNED GRANULARITY_ODT_ENTRY_SIZE_DAQ_BYTE 0xFF OVERLOAD_INDICATION_PID PRESCALER_SUPPORTED /begin STIM GRANULARITY_ODT_ENTRY_SIZE_STIM_BYTE 0xFF /end STIM /begin TIMESTAMP_SUPPORTED 0x0001 SIZE_DWORD UNIT_1US TIMESTAMP_FIXED /end TIMESTAMP_SUPPORTED /begin EVENT "8 ms" "8 ms" 0x0000 DAQ 0xFF 0x08 0x06 0x00 /end EVENT /end DAQ
 /begin XCP_ON_UDP_IP 0x0100 0x15B3 ADDRESS "192.168.7.2" /end XCP_ON_UDP_IP
/end IF_DATA
/begin MOD_PAR "MOD PAR Comment Goes Here"
 /begin MEMORY_SEGMENT FBIARINC_cal_impl "FBIARINC_cal_impl" DATA FLASH INTERN 0x00808020 0xEF0 -1 -1 -1 -1 -1
  /begin IF_DATA XCP
   /begin SEGMENT 0x00 0x02 0x00 0x00 0x00
    /begin PAGE 0x00 ECU_ACCESS_DONT_CARE XCP_READ_ACCESS_DONT_CARE XCP_WRITE_ACCESS_NOT_ALLOWED /end PAGE
    /begin PAGE 0x01 ECU_ACCESS_DONT_CARE XCP_READ_ACCESS_DONT_CARE XCP_WRITE_ACCESS_DONT_CARE /end PAGE
   /end SEGMENT
  /end IF_DATA
 /end MEMORY_SEGMENT
/end MOD_PAR
/begin MOD_COMMON "Mod Common Comment Here" BYTE_ORDER MSB_LAST ALIGNMENT_BYTE 1 ALIGNMENT_WORD 2 ALIGNMENT_LONG 4 ALIGNMENT_FLOAT32_IEEE 4 ALIGNMENT_FLOAT64_IEEE 8 ALIGNMENT_INT64 8 /end MOD_COMMON
/begin CHARACTERISTIC FBIARINC_cal_impl.CCCodeBlock1_P1 "" VALUE 0x00808EF0 Scalar_FLOAT64_IEEE 0 FBIARINC_CM_double -1.7E+308 1.7E+308 /end CHARACTERISTIC
/begin CHARACTERISTIC FBIARINC_cal_impl.CCCodeBlock1_P2 "" VALUE 0x00808EF8 Scalar_FLOAT64_IEEE 0 FBIARINC_CM_double -1.7E+308 1.7E+308 /end CHARACTERISTIC
/begin CHARACTERISTIC FBIARINC_cal_impl.CCCodeBlock1_P3 "" VALUE 0x00808F0A Scalar_BOOLEAN 0 FBIARINC_CM_logical 0 1 /end CHARACTERISTIC
/begin CHARACTERISTIC FBIARINC_cal_impl.CCCodeBlock1_P4 "" VALUE 0x00808F0B Scalar_BOOLEAN 0 FBIARINC_CM_logical 0 1 /end CHARACTERISTIC
/begin CHARACTERISTIC FBIARINC_cal_impl.CCCodeBlock1_P5 "" VALUE 0x00808F04 Scalar_ULONG 0 FBIARINC_CM_uint32 0 2147483646 /end CHARACTERISTIC
/begin CHARACTERISTIC FBIARINC_cal_impl.CCCodeBlock4_P1 "" VALUE 0x008088E0 Scalar_FLOAT64_IEEE 0 FBIARINC_CM_double -1.7E+308 1.7E+308 /end CHARACTERISTIC
/begin CHARACTERISTIC FBIARINC_cal_impl.CCCodeBlock4_P2 "" VALUE 0x008088E8 Scalar_FLOAT64_IEEE 0 FBIARINC_CM_double -1.7E+308 1.7E+308 /end CHARACTERISTIC
/begin CHARACTERISTIC FBIARINC_cal_impl.CCCodeBlock4_P3 "" VALUE 0x00808F08 Scalar_BOOLEAN 0 FBIARINC_CM_logical 0 1 /end CHARACTERISTIC
/begin CHARACTERISTIC FBIARINC_cal_impl.CCCodeBlock4_P4 "" VALUE 0x00808F09 Scalar_BOOLEAN 0 FBIARINC_CM_logical 0 1 /end CHARACTERISTIC
/begin CHARACTERISTIC FBIARINC_cal_impl.CCCodeBlock4_P5 "" VALUE 0x00808F00 Scalar_ULONG 0 FBIARINC_CM_uint32 0 2147483646 /end CHARACTERISTIC
/begin CHARACTERISTIC FBIARINC_cal_impl.Constant_Value.FBI_ACT "" VALUE 0x00808027 Scalar_BOOLEAN 0 FBIARINC_CM_logical 0 1 /end CHARACTERISTIC
/begin CHARACTERISTIC FBIARINC_cal_impl.Constant_Value.FBI_AMP "" VALUE 0x00808020 Scalar_FLOAT32_IEEE 0 FBIARINC_CM_single -3.4E+38 3.4E+38 /end CHARACTERISTIC
/begin CHARACTERISTIC FBIARINC_cal_impl.Constant_Value.FBI_COMMAND "" VALUE 0x00808028 Scalar_FLOAT32_IEEE 0 FBIARINC_CM_single -3.4E+38 3.4E+38 /end CHARACTERISTIC
/begin CHARACTERISTIC FBIARINC_cal_impl.Constant_Value.FBI_CONFIG "" VALUE 0x00808026 Scalar_UBYTE 0 FBIARINC_CM_uint8 0 255 /end CHARACTERISTIC
/begin CHARACTERISTIC FBIARINC_cal_impl.Constant_Value.FBI_ID_TEST "" VALUE 0x00808025 Scalar_UBYTE 0 FBIARINC_CM_uint8 0 255 /end CHARACTERISTIC
/begin CHARACTERISTIC FBIARINC_cal_impl.Constant_Value.FBI_TIME_LIMIT "" VALUE 0x00808024 Scalar_UBYTE 0 FBIARINC_CM_uint8 0 255 /end CHARACTERISTIC
/begin CHARACTERISTIC FBIARINC_cal_impl.Constant_Value_g "" VALUE 0x00808030 Scalar_FLOAT64_IEEE 0 FBIARINC_CM_double -1.7E+308 1.7E+308 /end CHARACTERISTIC
/begin CHARACTERISTIC FBIARINC_cal_impl.Decode1_P1 "" VALUE 0x008085F0 Scalar_FLOAT64_IEEE 0 FBIARINC_CM_double -1.7E+308 1.7E+308 /end CHARACTERISTIC
/begin CHARACTERISTIC FBIARINC_cal_impl.Decode1_P10 "" VALUE 0x008086C8 Scalar_FLOAT64_IEEE 0 FBIARINC_CM_double -1.7E+308 1.7E+308 /end CHARACTERISTIC
/begin CHARACTERISTIC FBIARINC_cal_impl.Decode1_P11 "" VALUE 0x008086E0 Scalar_FLOAT64_IEEE 0 FBIARINC_CM_double -1.7E+308 1.7E+308 /end CHARACTERISTIC
/begin CHARACTERISTIC FBIARINC_cal_impl.Decode1_P12 "" VALUE 0x008086F8 Scalar_FLOAT64_IEEE 0 FBIARINC_CM_double -1.7E+308 1.7E+308 /end CHARACTERISTIC
/begin CHARACTERISTIC FBIARINC_cal_impl.Decode1_P13 "" VALUE 0x00808710 Scalar_FLOAT64_IEEE 0 FBIARINC_CM_double -1.7E+308 1.7E+308 /end CHARACTERISTIC
/begin CHARACTERISTIC FBIARINC_cal_impl.Decode1_P14 "" VALUE 0x00808728 Scalar_FLOAT64_IEEE 0 FBIARINC_CM_double -1.7E+308 1.7E+308 /end CHARACTERISTIC
/begin CHARACTERISTIC FBIARINC_cal_impl.Decode1_P15 "" VALUE 0x00808740 Scalar_FLOAT64_IEEE 0 FBIARINC_CM_double -1.7E+308 1.7E+308 /end CHARACTERISTIC
/begin CHARACTERISTIC FBIARINC_cal_impl.Decode1_P16 "" VALUE 0x00808758 Scalar_FLOAT64_IEEE 0 FBIARINC_CM_double -1.7E+308 1.7E+308 /end CHARACTERISTIC
/begin CHARACTERISTIC FBIARINC_cal_impl.Decode1_P2 "" VALUE 0x00808608 Scalar_FLOAT64_IEEE 0 FBIARINC_CM_double -1.7E+308 1.7E+308 /end CHARACTERISTIC
/begin CHARACTERISTIC FBIARINC_cal_impl.Decode1_P3 "" VALUE 0x00808620 Scalar_FLOAT64_IEEE 0 FBIARINC_CM_double -1.7E+308 1.7E+308 /end CHARACTERISTIC
/begin CHARACTERISTIC FBIARINC_cal_impl.Decode1_P4 "" VALUE 0x00808638 Scalar_FLOAT64_IEEE 0 FBIARINC_CM_double -1.7E+308 1.7E+308 /end CHARACTERISTIC
/begin CHARACTERISTIC FBIARINC_cal_impl.Decode1_P5 "" VALUE 0x00808650 Scalar_FLOAT64_IEEE 0 FBIARINC_CM_double -1.7E+308 1.7E+308 /end CHARACTERISTIC
/begin CHARACTERISTIC FBIARINC_cal_impl.Decode1_P6 "" VALUE 0x00808668 Scalar_FLOAT64_IEEE 0 FBIARINC_CM_double -1.7E+308 1.7E+308 /end CHARACTERISTIC
/begin CHARACTERISTIC FBIARINC_cal_impl.Decode1_P7 "" VALUE 0x00808680 Scalar_FLOAT64_IEEE 0 FBIARINC_CM_double -1.7E+308 1.7E+308 /end CHARACTERISTIC
/begin CHARACTERISTIC FBIARINC_cal_impl.Decode1_P8 "" VALUE 0x00808698 Scalar_FLOAT64_IEEE 0 FBIARINC_CM_double -1.7E+308 1.7E+308 /end CHARACTERISTIC
/begin CHARACTERISTIC FBIARINC_cal_impl.Decode1_P9 "" VALUE 0x008086B0 Scalar_FLOAT64_IEEE 0 FBIARINC_CM_double -1.7E+308 1.7E+308 /end CHARACTERISTIC
/begin CHARACTERISTIC FBIARINC_cal_impl.Decode2_P1 "" VALUE 0x00808900 Scalar_FLOAT64_IEEE 0 FBIARINC_CM_double -1.7E+308 1.7E+308 /end CHARACTERISTIC
/begin CHARACTERISTIC FBIARINC_cal_impl.Decode2_P10 "" VALUE 0x008089D8 Scalar_FLOAT64_IEEE 0 FBIARINC_CM_double -1.7E+308 1.7E+308 /end CHARACTERISTIC
/begin CHARACTERISTIC FBIARINC_cal_impl.Decode2_P11 "" VALUE 0x008089F0 Scalar_FLOAT64_IEEE 0 FBIARINC_CM_double -1.7E+308 1.7E+308 /end CHARACTERISTIC
/begin CHARACTERISTIC FBIARINC_cal_impl.Decode2_P12 "" VALUE 0x00808A08 Scalar_FLOAT64_IEEE 0 FBIARINC_CM_double -1.7E+308 1.7E+308 /end CHARACTERISTIC
/begin CHARACTERISTIC FBIARINC_cal_impl.Decode2_P13 "" VALUE 0x00808A20 Scalar_FLOAT64_IEEE 0 FBIARINC_CM_double -1.7E+308 1.7E+308 /end CHARACTERISTIC
/begin CHARACTERISTIC FBIARINC_cal_impl.Decode2_P14 "" VALUE 0x00808A38 Scalar_FLOAT64_IEEE 0 FBIARINC_CM_double -1.7E+308 1.7E+308 /end CHARACTERISTIC
/begin CHARACTERISTIC FBIARINC_cal_impl.Decode2_P15 "" VALUE 0x00808A50 Scalar_FLOAT64_IEEE 0 FBIARINC_CM_double -1.7E+308 1.7E+308 /end CHARACTERISTIC
/begin CHARACTERISTIC FBIARINC_cal_impl.Decode2_P16 "" VALUE 0x00808A68 Scalar_FLOAT64_IEEE 0 FBIARINC_CM_double -1.7E+308 1.7E+308 /end CHARACTERISTIC
/begin CHARACTERISTIC FBIARINC_cal_impl.Decode2_P2 "" VALUE 0x00808918 Scalar_FLOAT64_IEEE 0 FBIARINC_CM_double -1.7E+308 1.7E+308 /end CHARACTERISTIC
/begin CHARACTERISTIC FBIARINC_cal_impl.Decode2_P3 "" VALUE 0x00808930 Scalar_FLOAT64_IEEE 0 FBIARINC_CM_double -1.7E+308 1.7E+308 /end CHARACTERISTIC
/begin CHARACTERISTIC FBIARINC_cal_impl.Decode2_P4 "" VALUE 0x00808948 Scalar_FLOAT64_IEEE 0 FBIARINC_CM_double -1.7E+308 1.7E+308 /end CHARACTERISTIC
/begin CHARACTERISTIC FBIARINC_cal_impl.Decode2_P5 "" VALUE 0x00808960 Scalar_FLOAT64_IEEE 0 FBIARINC_CM_double -1.7E+308 1.7E+308 /end CHARACTERISTIC
/begin CHARACTERISTIC FBIARINC_cal_impl.Decode2_P6 "" VALUE 0x00808978 Scalar_FLOAT64_IEEE 0 FBIARINC_CM_double -1.7E+308 1.7E+308 /end CHARACTERISTIC
/begin CHARACTERISTIC FBIARINC_cal_impl.Decode2_P7 "" VALUE 0x00808990 Scalar_FLOAT64_IEEE 0 FBIARINC_CM_double -1.7E+308 1.7E+308 /end CHARACTERISTIC
/begin CHARACTERISTIC FBIARINC_cal_impl.Decode2_P8 "" VALUE 0x008089A8 Scalar_FLOAT64_IEEE 0 FBIARINC_CM_double -1.7E+308 1.7E+308 /end CHARACTERISTIC
/begin CHARACTERISTIC FBIARINC_cal_impl.Decode2_P9 "" VALUE 0x008089C0 Scalar_FLOAT64_IEEE 0 FBIARINC_CM_double -1.7E+308 1.7E+308 /end CHARACTERISTIC
/begin CHARACTERISTIC FBIARINC_cal_impl.Decode3_P1 "" VALUE 0x00808C00 Scalar_FLOAT64_IEEE 0 FBIARINC_CM_double -1.7E+308 1.7E+308 /end CHARACTERISTIC
/begin CHARACTERISTIC FBIARINC_cal_impl.Decode3_P10 "" VALUE 0x00808CD8 Scalar_FLOAT64_IEEE 0 FBIARINC_CM_double -1.7E+308 1.7E+308 /end CHARACTERISTIC
/begin CHARACTERISTIC FBIARINC_cal_impl.Decode3_P11 "" VALUE 0x00808CF0 Scalar_FLOAT64_IEEE 0 FBIARINC_CM_double -1.7E+308 1.7E+308 /end CHARACTERISTIC
/begin CHARACTERISTIC FBIARINC_cal_impl.Decode3_P12 "" VALUE 0x00808D08 Scalar_FLOAT64_IEEE 0 FBIARINC_CM_double -1.7E+308 1.7E+308 /end CHARACTERISTIC
/begin CHARACTERISTIC FBIARINC_cal_impl.Decode3_P13 "" VALUE 0x00808D20 Scalar_FLOAT64_IEEE 0 FBIARINC_CM_double -1.7E+308 1.7E+308 /end CHARACTERISTIC
/begin CHARACTERISTIC FBIARINC_cal_impl.Decode3_P14 "" VALUE 0x00808D38 Scalar_FLOAT64_IEEE 0 FBIARINC_CM_double -1.7E+308 1.7E+308 /end CHARACTERISTIC
/begin CHARACTERISTIC FBIARINC_cal_impl.Decode3_P15 "" VALUE 0x00808D50 Scalar_FLOAT64_IEEE 0 FBIARINC_CM_double -1.7E+308 1.7E+308 /end CHARACTERISTIC
/begin CHARACTERISTIC FBIARINC_cal_impl.Decode3_P16 "" VALUE 0x00808D68 Scalar_FLOAT64_IEEE 0 FBIARINC_CM_double -1.7E+308 1.7E+308 /end CHARACTERISTIC
/begin CHARACTERISTIC FBIARINC_cal_impl.Decode3_P2 "" VALUE 0x00808C18 Scalar_FLOAT64_IEEE 0 FBIARINC_CM_double -1.7E+308 1.7E+308 /end CHARACTERISTIC
/begin CHARACTERISTIC FBIARINC_cal_impl.Decode3_P3 "" VALUE 0x00808C30 Scalar_FLOAT64_IEEE 0 FBIARINC_CM_double -1.7E+308 1.7E+308 /end CHARACTERISTIC
/begin CHARACTERISTIC FBIARINC_cal_impl.Decode3_P4 "" VALUE 0x00808C48 Scalar_FLOAT64_IEEE 0 FBIARINC_CM_double -1.7E+308 1.7E+308 /end CHARACTERISTIC
/begin CHARACTERISTIC FBIARINC_cal_impl.Decode3_P5 "" VALUE 0x00808C60 Scalar_FLOAT64_IEEE 0 FBIARINC_CM_double -1.7E+308 1.7E+308 /end CHARACTERISTIC
/begin CHARACTERISTIC FBIARINC_cal_impl.Decode3_P6 "" VALUE 0x00808C78 Scalar_FLOAT64_IEEE 0 FBIARINC_CM_double -1.7E+308 1.7E+308 /end CHARACTERISTIC
/begin CHARACTERISTIC FBIARINC_cal_impl.Decode3_P7 "" VALUE 0x00808C90 Scalar_FLOAT64_IEEE 0 FBIARINC_CM_double -1.7E+308 1.7E+308 /end CHARACTERISTIC
/begin CHARACTERISTIC FBIARINC_cal_impl.Decode3_P8 "" VALUE 0x00808CA8 Scalar_FLOAT64_IEEE 0 FBIARINC_CM_double -1.7E+308 1.7E+308 /end CHARACTERISTIC
/begin CHARACTERISTIC FBIARINC_cal_impl.Decode3_P9 "" VALUE 0x00808CC0 Scalar_FLOAT64_IEEE 0 FBIARINC_CM_double -1.7E+308 1.7E+308 /end CHARACTERISTIC
/begin CHARACTERISTIC FBIARINC_cal_impl.Decode4_P1 "" VALUE 0x00808D80 Scalar_FLOAT64_IEEE 0 FBIARINC_CM_double -1.7E+308 1.7E+308 /end CHARACTERISTIC
/begin CHARACTERISTIC FBIARINC_cal_impl.Decode4_P10 "" VALUE 0x00808E58 Scalar_FLOAT64_IEEE 0 FBIARINC_CM_double -1.7E+308 1.7E+308 /end CHARACTERISTIC
/begin CHARACTERISTIC FBIARINC_cal_impl.Decode4_P11 "" VALUE 0x00808E70 Scalar_FLOAT64_IEEE 0 FBIARINC_CM_double -1.7E+308 1.7E+308 /end CHARACTERISTIC
/begin CHARACTERISTIC FBIARINC_cal_impl.Decode4_P12 "" VALUE 0x00808E88 Scalar_FLOAT64_IEEE 0 FBIARINC_CM_double -1.7E+308 1.7E+308 /end CHARACTERISTIC
/begin CHARACTERISTIC FBIARINC_cal_impl.Decode4_P13 "" VALUE 0x00808EA0 Scalar_FLOAT64_IEEE 0 FBIARINC_CM_double -1.7E+308 1.7E+308 /end CHARACTERISTIC
/begin CHARACTERISTIC FBIARINC_cal_impl.Decode4_P14 "" VALUE 0x00808EB8 Scalar_FLOAT64_IEEE 0 FBIARINC_CM_double -1.7E+308 1.7E+308 /end CHARACTERISTIC
/begin CHARACTERISTIC FBIARINC_cal_impl.Decode4_P15 "" VALUE 0x00808ED0 Scalar_FLOAT64_IEEE 0 FBIARINC_CM_double -1.7E+308 1.7E+308 /end CHARACTERISTIC
/begin CHARACTERISTIC FBIARINC_cal_impl.Decode4_P16 "" VALUE 0x00808EE8 Scalar_FLOAT64_IEEE 0 FBIARINC_CM_double -1.7E+308 1.7E+308 /end CHARACTERISTIC
/begin CHARACTERISTIC FBIARINC_cal_impl.Decode4_P2 "" VALUE 0x00808D98 Scalar_FLOAT64_IEEE 0 FBIARINC_CM_double -1.7E+308 1.7E+308 /end CHARACTERISTIC
/begin CHARACTERISTIC FBIARINC_cal_impl.Decode4_P3 "" VALUE 0x00808DB0 Scalar_FLOAT64_IEEE 0 FBIARINC_CM_double -1.7E+308 1.7E+308 /end CHARACTERISTIC
/begin CHARACTERISTIC FBIARINC_cal_impl.Decode4_P4 "" VALUE 0x00808DC8 Scalar_FLOAT64_IEEE 0 FBIARINC_CM_double -1.7E+308 1.7E+308 /end CHARACTERISTIC
/begin CHARACTERISTIC FBIARINC_cal_impl.Decode4_P5 "" VALUE 0x00808DE0 Scalar_FLOAT64_IEEE 0 FBIARINC_CM_double -1.7E+308 1.7E+308 /end CHARACTERISTIC
/begin CHARACTERISTIC FBIARINC_cal_impl.Decode4_P6 "" VALUE 0x00808DF8 Scalar_FLOAT64_IEEE 0 FBIARINC_CM_double -1.7E+308 1.7E+308 /end CHARACTERISTIC
/begin CHARACTERISTIC FBIARINC_cal_impl.Decode4_P7 "" VALUE 0x00808E10 Scalar_FLOAT64_IEEE 0 FBIARINC_CM_double -1.7E+308 1.7E+308 /end CHARACTERISTIC
/begin CHARACTERISTIC FBIARINC_cal_impl.Decode4_P8 "" VALUE 0x00808E28 Scalar_FLOAT64_IEEE 0 FBIARINC_CM_double -1.7E+308 1.7E+308 /end CHARACTERISTIC
/begin CHARACTERISTIC FBIARINC_cal_impl.Decode4_P9 "" VALUE 0x00808E40 Scalar_FLOAT64_IEEE 0 FBIARINC_CM_double -1.7E+308 1.7E+308 /end CHARACTERISTIC
/begin CHARACTERISTIC FBIARINC_cal_impl.Decode5_P1 "" VALUE 0x00808770 Scalar_FLOAT64_IEEE 0 FBIARINC_CM_double -1.7E+308 1.7E+308 /end CHARACTERISTIC
/begin CHARACTERISTIC FBIARINC_cal_impl.Decode5_P10 "" VALUE 0x00808848 Scalar_FLOAT64_IEEE 0 FBIARINC_CM_double -1.7E+308 1.7E+308 /end CHARACTERISTIC
/begin CHARACTERISTIC FBIARINC_cal_impl.Decode5_P11 "" VALUE 0x00808860 Scalar_FLOAT64_IEEE 0 FBIARINC_CM_double -1.7E+308 1.7E+308 /end CHARACTERISTIC
/begin CHARACTERISTIC FBIARINC_cal_impl.Decode5_P12 "" VALUE 0x00808878 Scalar_FLOAT64_IEEE 0 FBIARINC_CM_double -1.7E+308 1.7E+308 /end CHARACTERISTIC
/begin CHARACTERISTIC FBIARINC_cal_impl.Decode5_P13 "" VALUE 0x00808890 Scalar_FLOAT64_IEEE 0 FBIARINC_CM_double -1.7E+308 1.7E+308 /end CHARACTERISTIC
/begin CHARACTERISTIC FBIARINC_cal_impl.Decode5_P14 "" VALUE 0x008088A8 Scalar_FLOAT64_IEEE 0 FBIARINC_CM_double -1.7E+308 1.7E+308 /end CHARACTERISTIC
/begin CHARACTERISTIC FBIARINC_cal_impl.Decode5_P15 "" VALUE 0x008088C0 Scalar_FLOAT64_IEEE 0 FBIARINC_CM_double -1.7E+308 1.7E+308 /end CHARACTERISTIC
/begin CHARACTERISTIC FBIARINC_cal_impl.Decode5_P16 "" VALUE 0x008088D8 Scalar_FLOAT64_IEEE 0 FBIARINC_CM_double -1.7E+308 1.7E+308 /end CHARACTERISTIC
/begin CHARACTERISTIC FBIARINC_cal_impl.Decode5_P2 "" VALUE 0x00808788 Scalar_FLOAT64_IEEE 0 FBIARINC_CM_double -1.7E+308 1.7E+308 /end CHARACTERISTIC
/begin CHARACTERISTIC FBIARINC_cal_impl.Decode5_P3 "" VALUE 0x008087A0 Scalar_FLOAT64_IEEE 0 FBIARINC_CM_double -1.7E+308 1.7E+308 /end CHARACTERISTIC
/begin CHARACTERISTIC FBIARINC_cal_impl.Decode5_P4 "" VALUE 0x008087B8 Scalar_FLOAT64_IEEE 0 FBIARINC_CM_double -1.7E+308 1.7E+308 /end CHARACTERISTIC
/begin CHARACTERISTIC FBIARINC_cal_impl.Decode5_P5 "" VALUE 0x008087D0 Scalar_FLOAT64_IEEE 0 FBIARINC_CM_double -1.7E+308 1.7E+308 /end CHARACTERISTIC
/begin CHARACTERISTIC FBIARINC_cal_impl.Decode5_P6 "" VALUE 0x008087E8 Scalar_FLOAT64_IEEE 0 FBIARINC_CM_double -1.7E+308 1.7E+308 /end CHARACTERISTIC
/begin CHARACTERISTIC FBIARINC_cal_impl.Decode5_P7 "" VALUE 0x00808800 Scalar_FLOAT64_IEEE 0 FBIARINC_CM_double -1.7E+308 1.7E+308 /end CHARACTERISTIC
/begin CHARACTERISTIC FBIARINC_cal_impl.Decode5_P8 "" VALUE 0x00808818 Scalar_FLOAT64_IEEE 0 FBIARINC_CM_double -1.7E+308 1.7E+308 /end CHARACTERISTIC
/begin CHARACTERISTIC FBIARINC_cal_impl.Decode5_P9 "" VALUE 0x00808830 Scalar_FLOAT64_IEEE 0 FBIARINC_CM_double -1.7E+308 1.7E+308 /end CHARACTERISTIC
/begin CHARACTERISTIC FBIARINC_cal_impl.Decode6_P1 "" VALUE 0x00808A80 Scalar_FLOAT64_IEEE 0 FBIARINC_CM_double -1.7E+308 1.7E+308 /end CHARACTERISTIC
/begin CHARACTERISTIC FBIARINC_cal_impl.Decode6_P10 "" VALUE 0x00808B58 Scalar_FLOAT64_IEEE 0 FBIARINC_CM_double -1.7E+308 1.7E+308 /end CHARACTERISTIC
/begin CHARACTERISTIC FBIARINC_cal_impl.Decode6_P11 "" VALUE 0x00808B70 Scalar_FLOAT64_IEEE 0 FBIARINC_CM_double -1.7E+308 1.7E+308 /end CHARACTERISTIC
/begin CHARACTERISTIC FBIARINC_cal_impl.Decode6_P12 "" VALUE 0x00808B88 Scalar_FLOAT64_IEEE 0 FBIARINC_CM_double -1.7E+308 1.7E+308 /end CHARACTERISTIC
/begin CHARACTERISTIC FBIARINC_cal_impl.Decode6_P13 "" VALUE 0x00808BA0 Scalar_FLOAT64_IEEE 0 FBIARINC_CM_double -1.7E+308 1.7E+308 /end CHARACTERISTIC
/begin CHARACTERISTIC FBIARINC_cal_impl.Decode6_P14 "" VALUE 0x00808BB8 Scalar_FLOAT64_IEEE 0 FBIARINC_CM_double -1.7E+308 1.7E+308 /end CHARACTERISTIC
/begin CHARACTERISTIC FBIARINC_cal_impl.Decode6_P15 "" VALUE 0x00808BD0 Scalar_FLOAT64_IEEE 0 FBIARINC_CM_double -1.7E+308 1.7E+308 /end CHARACTERISTIC
/begin CHARACTERISTIC FBIARINC_cal_impl.Decode6_P16 "" VALUE 0x00808BE8 Scalar_FLOAT64_IEEE 0 FBIARINC_CM_double -1.7E+308 1.7E+308 /end CHARACTERISTIC
/begin CHARACTERISTIC FBIARINC_cal_impl.Decode6_P2 "" VALUE 0x00808A98 Scalar_FLOAT64_IEEE 0 FBIARINC_CM_double -1.7E+308 1.7E+308 /end CHARACTERISTIC
/begin CHARACTERISTIC FBIARINC_cal_impl.Decode6_P3 "" VALUE 0x00808AB0 Scalar_FLOAT64_IEEE 0 FBIARINC_CM_double -1.7E+308 1.7E+308 /end CHARACTERISTIC
/begin CHARACTERISTIC FBIARINC_cal_impl.Decode6_P4 "" VALUE 0x00808AC8 Scalar_FLOAT64_IEEE 0 FBIARINC_CM_double -1.7E+308 1.7E+308 /end CHARACTERISTIC
/begin CHARACTERISTIC FBIARINC_cal_impl.Decode6_P5 "" VALUE 0x00808AE0 Scalar_FLOAT64_IEEE 0 FBIARINC_CM_double -1.7E+308 1.7E+308 /end CHARACTERISTIC
/begin CHARACTERISTIC FBIARINC_cal_impl.Decode6_P6 "" VALUE 0x00808AF8 Scalar_FLOAT64_IEEE 0 FBIARINC_CM_double -1.7E+308 1.7E+308 /end CHARACTERISTIC
/begin CHARACTERISTIC FBIARINC_cal_impl.Decode6_P7 "" VALUE 0x00808B10 Scalar_FLOAT64_IEEE 0 FBIARINC_CM_double -1.7E+308 1.7E+308 /end CHARACTERISTIC
/begin CHARACTERISTIC FBIARINC_cal_impl.Decode6_P8 "" VALUE 0x00808B28 Scalar_FLOAT64_IEEE 0 FBIARINC_CM_double -1.7E+308 1.7E+308 /end CHARACTERISTIC
/begin CHARACTERISTIC FBIARINC_cal_impl.Decode6_P9 "" VALUE 0x00808B40 Scalar_FLOAT64_IEEE 0 FBIARINC_CM_double -1.7E+308 1.7E+308 /end CHARACTERISTIC
/begin CHARACTERISTIC FBIARINC_cal_impl.Receivev2_P1 "" VALUE 0x00808578 Scalar_FLOAT64_IEEE 0 FBIARINC_CM_double -1.7E+308 1.7E+308 /end CHARACTERISTIC
/begin CHARACTERISTIC FBIARINC_cal_impl.Receivev2_P2 "" VALUE 0x00808590 Scalar_FLOAT64_IEEE 0 FBIARINC_CM_double -1.7E+308 1.7E+308 /end CHARACTERISTIC
/begin CHARACTERISTIC FBIARINC_cal_impl.Receivev2_P3 "" VALUE 0x008085A8 Scalar_FLOAT64_IEEE 0 FBIARINC_CM_double -1.7E+308 1.7E+308 /end CHARACTERISTIC
/begin CHARACTERISTIC FBIARINC_cal_impl.Receivev2_P4 "" VALUE 0x008085C0 Scalar_FLOAT64_IEEE 0 FBIARINC_CM_double -1.7E+308 1.7E+308 /end CHARACTERISTIC
/begin CHARACTERISTIC FBIARINC_cal_impl.Receivev2_P5 "" VALUE 0x008085D8 Scalar_FLOAT64_IEEE 0 FBIARINC_CM_double -1.7E+308 1.7E+308 /end CHARACTERISTIC
/begin CHARACTERISTIC FBIARINC_cal_impl.Setupv2_P1 "" VALUE 0x00808048 Scalar_FLOAT64_IEEE 0 FBIARINC_CM_double -1.7E+308 1.7E+308 /end CHARACTERISTIC
/begin CHARACTERISTIC FBIARINC_cal_impl.Setupv2_P2 "" VALUE 0x00808060 Scalar_FLOAT64_IEEE 0 FBIARINC_CM_double -1.7E+308 1.7E+308 /end CHARACTERISTIC
/begin CHARACTERISTIC FBIARINC_cal_impl.Setupv2_P3 "" VALUE 0x00808078 Scalar_FLOAT64_IEEE 0 FBIARINC_CM_double -1.7E+308 1.7E+308 /end CHARACTERISTIC
/begin CHARACTERISTIC FBIARINC_cal_impl.Setupv2_P4 "" VALUE 0x00808090 Scalar_FLOAT64_IEEE 0 FBIARINC_CM_double -1.7E+308 1.7E+308 /end CHARACTERISTIC
/begin CHARACTERISTIC FBIARINC_cal_impl.Setupv2_P5 "" VALUE 0x008080A8 Scalar_FLOAT64_IEEE 0 FBIARINC_CM_double -1.7E+308 1.7E+308 /end CHARACTERISTIC
/begin CHARACTERISTIC FBIARINC_cal_impl.Setupv2_P6 "" VALUE 0x008080C0 Scalar_FLOAT64_IEEE 0 FBIARINC_CM_double -1.7E+308 1.7E+308 /end CHARACTERISTIC
/begin CHARACTERISTIC FBIARINC_cal_impl.Setupv2_P7 "" VAL_BLK 0x008080D8 Scalar_FLOAT64_IEEE 0 FBIARINC_CM_double -1.7E+308 1.7E+308 MATRIX_DIM 5 16 /end CHARACTERISTIC
/begin CHARACTERISTIC FBIARINC_cal_impl.Setupv2_P8 "" VAL_BLK 0x00808368 Scalar_FLOAT64_IEEE 0 FBIARINC_CM_double -1.7E+308 1.7E+308 MATRIX_DIM 4 16 /end CHARACTERISTIC
/begin MEASUREMENT FBIARINC_B.BusAssignment.FBI_ACT "" UBYTE FBIARINC_CM_logical 0 0 0 1 ECU_ADDRESS 0x0080D727 /end MEASUREMENT
/begin MEASUREMENT FBIARINC_B.BusAssignment.FBI_AMP "" FLOAT32_IEEE FBIARINC_CM_single 0 0 -3.4E+38 3.4E+38 ECU_ADDRESS 0x0080D720 /end MEASUREMENT
/begin MEASUREMENT FBIARINC_B.BusAssignment.FBI_COMMAND "" FLOAT32_IEEE FBIARINC_CM_single 0 0 -3.4E+38 3.4E+38 ECU_ADDRESS 0x0080D728 /end MEASUREMENT
/begin MEASUREMENT FBIARINC_B.BusAssignment.FBI_CONFIG "" UBYTE FBIARINC_CM_uint8 0 0 0 255 ECU_ADDRESS 0x0080D726 /end MEASUREMENT
/begin MEASUREMENT FBIARINC_B.BusAssignment.FBI_ID_TEST "" UBYTE FBIARINC_CM_uint8 0 0 0 255 ECU_ADDRESS 0x0080D725 /end MEASUREMENT
/begin MEASUREMENT FBIARINC_B.BusAssignment.FBI_TIME_LIMIT "" UBYTE FBIARINC_CM_uint8 0 0 0 255 ECU_ADDRESS 0x0080D724 /end MEASUREMENT
/begin MEASUREMENT FBIARINC_B.CCCodeBlock1 "" FLOAT64_IEEE FBIARINC_CM_double 0 0 -1.7E+308 1.7E+308 ECU_ADDRESS 0x0080D790 /end MEASUREMENT
/begin MEASUREMENT FBIARINC_B.CCCodeBlock4 "" FLOAT64_IEEE FBIARINC_CM_double 0 0 -1.7E+308 1.7E+308 ECU_ADDRESS 0x0080D788 /end MEASUREMENT
/begin MEASUREMENT FBIARINC_B.Cast1 "" FLOAT32_IEEE FBIARINC_CM_single 0 0 -3.4E+38 3.4E+38 ECU_ADDRESS 0x0080D7AC /end MEASUREMENT
/begin MEASUREMENT FBIARINC_B.Cast2 "" FLOAT32_IEEE FBIARINC_CM_single 0 0 -3.4E+38 3.4E+38 ECU_ADDRESS 0x0080D7B0 /end MEASUREMENT
/begin MEASUREMENT FBIARINC_B.Cast3 "" UBYTE FBIARINC_CM_uint8 0 0 0 255 ECU_ADDRESS 0x0080D7BC /end MEASUREMENT
/begin MEASUREMENT FBIARINC_B.Cast4 "" UBYTE FBIARINC_CM_uint8 0 0 0 255 ECU_ADDRESS 0x0080D7BD /end MEASUREMENT
/begin MEASUREMENT FBIARINC_B.Cast5 "" UBYTE FBIARINC_CM_uint8 0 0 0 255 ECU_ADDRESS 0x0080D7BE /end MEASUREMENT
/begin MEASUREMENT FBIARINC_B.Cast6 "" UBYTE FBIARINC_CM_logical 0 0 0 1 ECU_ADDRESS 0x0080D7C3 /end MEASUREMENT
/begin MEASUREMENT FBIARINC_B.Compare "" UBYTE FBIARINC_CM_logical 0 0 0 1 ECU_ADDRESS 0x0080D7C5 /end MEASUREMENT
/begin MEASUREMENT FBIARINC_B.Decode1 "" UBYTE FBIARINC_CM_logical 0 0 0 1 ECU_ADDRESS 0x0080D7C2 /end MEASUREMENT
/begin MEASUREMENT FBIARINC_B.Decode2 "" ULONG FBIARINC_CM_uint32 0 0 0 2147483646 ECU_ADDRESS 0x0080D79C /end MEASUREMENT
/begin MEASUREMENT FBIARINC_B.Decode3 "" ULONG FBIARINC_CM_uint32 0 0 0 2147483646 ECU_ADDRESS 0x0080D7A4 /end MEASUREMENT
/begin MEASUREMENT FBIARINC_B.Decode4 "" ULONG FBIARINC_CM_uint32 0 0 0 2147483646 ECU_ADDRESS 0x0080D7A8 /end MEASUREMENT
/begin MEASUREMENT FBIARINC_B.Decode5 "" ULONG FBIARINC_CM_uint32 0 0 0 2147483646 ECU_ADDRESS 0x0080D798 /end MEASUREMENT
/begin MEASUREMENT FBIARINC_B.Decode6 "" ULONG FBIARINC_CM_uint32 0 0 0 2147483646 ECU_ADDRESS 0x0080D7A0 /end MEASUREMENT
/begin MEASUREMENT FBIARINC_B.FBI_ACT "" UBYTE FBIARINC_CM_logical 0 0 0 1 ECU_ADDRESS 0x0080D7C4 /end MEASUREMENT
/begin MEASUREMENT FBIARINC_B.FBI_AMP "" FLOAT32_IEEE FBIARINC_CM_single 0 0 -3.4E+38 3.4E+38 ECU_ADDRESS 0x0080D7B4 /end MEASUREMENT
/begin MEASUREMENT FBIARINC_B.FBI_COMMAND "" FLOAT32_IEEE FBIARINC_CM_single 0 0 -3.4E+38 3.4E+38 ECU_ADDRESS 0x0080D7B8 /end MEASUREMENT
/begin MEASUREMENT FBIARINC_B.FBI_CONFIG "" UBYTE FBIARINC_CM_uint8 0 0 0 255 ECU_ADDRESS 0x0080D7C1 /end MEASUREMENT
/begin MEASUREMENT FBIARINC_B.FBI_ID_TEST "" UBYTE FBIARINC_CM_uint8 0 0 0 255 ECU_ADDRESS 0x0080D7C0 /end MEASUREMENT
/begin MEASUREMENT FBIARINC_B.FBI_TIME_LIMIT "" UBYTE FBIARINC_CM_uint8 0 0 0 255 ECU_ADDRESS 0x0080D7BF /end MEASUREMENT
/begin MEASUREMENT FBIARINC_B.Receivev2 "" FLOAT64_IEEE FBIARINC_CM_double 0 0 -1.7E+308 1.7E+308 LAYOUT COLUMN_DIR MATRIX_DIM 11 ECU_ADDRESS 0x0080D730 /end MEASUREMENT
/begin COMPU_METHOD FBIARINC_CM_double "" IDENTICAL "%15.10" "" /end COMPU_METHOD
/begin COMPU_METHOD FBIARINC_CM_logical "" IDENTICAL "%1.0" "" /end COMPU_METHOD
/begin COMPU_METHOD FBIARINC_CM_single "" IDENTICAL "%8.6" "" /end COMPU_METHOD
/begin COMPU_METHOD FBIARINC_CM_uint32 "" IDENTICAL "%10.0" "" /end COMPU_METHOD
/begin COMPU_METHOD FBIARINC_CM_uint8 "" IDENTICAL "%3.0" "" /end COMPU_METHOD
/begin RECORD_LAYOUT Scalar_BOOLEAN FNC_VALUES 1 UBYTE COLUMN_DIR DIRECT /end RECORD_LAYOUT
/begin RECORD_LAYOUT Scalar_FLOAT32_IEEE FNC_VALUES 1 FLOAT32_IEEE COLUMN_DIR DIRECT /end RECORD_LAYOUT
/begin RECORD_LAYOUT Scalar_FLOAT64_IEEE FNC_VALUES 1 FLOAT64_IEEE COLUMN_DIR DIRECT /end RECORD_LAYOUT
/begin RECORD_LAYOUT Scalar_UBYTE FNC_VALUES 1 UBYTE COLUMN_DIR DIRECT /end RECORD_LAYOUT
/begin RECORD_LAYOUT Scalar_ULONG FNC_VALUES 1 ULONG COLUMN_DIR DIRECT /end RECORD_LAYOUT
/begin GROUP FBIARINC "FBIARINC" ROOT
 /begin SUB_GROUP FBIARINC_cal_impl.Constant_Value FBIARINC_B.BusAssignment FBIARINC_Decode_Channel_1 /end SUB_GROUP
 /begin REF_CHARACTERISTIC FBIARINC_cal_impl.Receivev2_P1 FBIARINC_cal_impl.Receivev2_P2 FBIARINC_cal_impl.Receivev2_P3 FBIARINC_cal_impl.Receivev2_P4 FBIARINC_cal_impl.Receivev2_P5 FBIARINC_cal_impl.Setupv2_P1 FBIARINC_cal_impl.Setupv2_P2 FBIARINC_cal_impl.Setupv2_P3 FBIARINC_cal_impl.Setupv2_P4 FBIARINC_cal_impl.Setupv2_P5 FBIARINC_cal_impl.Setupv2_P6 FBIARINC_cal_impl.Setupv2_P7 FBIARINC_cal_impl.Setupv2_P8 /end REF_CHARACTERISTIC
 /begin REF_MEASUREMENT FBIARINC_B.FBI_ACT FBIARINC_B.FBI_AMP FBIARINC_B.FBI_COMMAND FBIARINC_B.FBI_CONFIG FBIARINC_B.FBI_ID_TEST FBIARINC_B.FBI_TIME_LIMIT FBIARINC_B.Receivev2 FBIARINC_DW.Receivev2_PWORK FBIARINC_DW.Setupv2_PWORK /end REF_MEASUREMENT
/end GROUP
/begin GROUP FBIARINC_B.BusAssignment ""
 /begin REF_MEASUREMENT FBIARINC_B.BusAssignment.FBI_AMP FBIARINC_B.BusAssignment.FBI_TIME_LIMIT FBIARINC_B.BusAssignment.FBI_ID_TEST FBIARINC_B.BusAssignment.FBI_CONFIG FBIARINC_B.BusAssignment.FBI_ACT FBIARINC_B.BusAssignment.FBI_COMMAND /end REF_MEASUREMENT
/end GROUP
/begin GROUP FBIARINC_Decode_Channel_1 "FBIARINC/Decode Channel 1" /begin SUB_GROUP FBIARINC_Decode_Channel_1_Compare_To_Zero /end SUB_GROUP
 /begin REF_CHARACTERISTIC FBIARINC_cal_impl.CCCodeBlock1_P1 FBIARINC_cal_impl.CCCodeBlock1_P2 FBIARINC_cal_impl.CCCodeBlock1_P3 FBIARINC_cal_impl.CCCodeBlock1_P4 FBIARINC_cal_impl.CCCodeBlock1_P5 FBIARINC_cal_impl.CCCodeBlock4_P1 FBIARINC_cal_impl.CCCodeBlock4_P2 FBIARINC_cal_impl.CCCodeBlock4_P3 FBIARINC_cal_impl.CCCodeBlock4_P4 FBIARINC_cal_impl.CCCodeBlock4_P5 FBIARINC_cal_impl.Decode1_P1 FBIARINC_cal_impl.Decode1_P10 FBIARINC_cal_impl.Decode1_P11 FBIARINC_cal_impl.Decode1_P12 FBIARINC_cal_impl.Decode1_P13 FBIARINC_cal_impl.Decode1_P14 FBIARINC_cal_impl.Decode1_P15 FBIARINC_cal_impl.Decode1_P16 FBIARINC_cal_impl.Decode1_P2 FBIARINC_cal_impl.Decode1_P3 FBIARINC_cal_impl.Decode1_P4 FBIARINC_cal_impl.Decode1_P5 FBIARINC_cal_impl.Decode1_P6 FBIARINC_cal_impl.Decode1_P7 FBIARINC_cal_impl.Decode1_P8 FBIARINC_cal_impl.Decode1_P9 FBIARINC_cal_impl.Decode2_P1 FBIARINC_cal_impl.Decode2_P10 FBIARINC_cal_impl.Decode2_P11 FBIARINC_cal_impl.Decode2_P12 FBIARINC_cal_impl.Decode2_P13 FBIARINC_cal_impl.Decode2_P14 FBIARINC_cal_impl.Decode2_P15 FBIARINC_cal_impl.Decode2_P16 FBIARINC_cal_impl.Decode2_P2 FBIARINC_cal_impl.Decode2_P3 FBIARINC_cal_impl.Decode2_P4 FBIARINC_cal_impl.Decode2_P5 FBIARINC_cal_impl.Decode2_P6 FBIARINC_cal_impl.Decode2_P7 FBIARINC_cal_impl.Decode2_P8 FBIARINC_cal_impl.Decode2_P9 FBIARINC_cal_impl.Decode3_P1 FBIARINC_cal_impl.Decode3_P10 FBIARINC_cal_impl.Decode3_P11 FBIARINC_cal_impl.Decode3_P12 FBIARINC_cal_impl.Decode3_P13 FBIARINC_cal_impl.Decode3_P14 FBIARINC_cal_impl.Decode3_P15 FBIARINC_cal_impl.Decode3_P16 FBIARINC_cal_impl.Decode3_P2 FBIARINC_cal_impl.Decode3_P3 FBIARINC_cal_impl.Decode3_P4 FBIARINC_cal_impl.Decode3_P5 FBIARINC_cal_impl.Decode3_P6 FBIARINC_cal_impl.Decode3_P7 FBIARINC_cal_impl.Decode3_P8 FBIARINC_cal_impl.Decode3_P9 FBIARINC_cal_impl.Decode4_P1 FBIARINC_cal_impl.Decode4_P10 FBIARINC_cal_impl.Decode4_P11 FBIARINC_cal_impl.Decode4_P12 FBIARINC_cal_impl.Decode4_P13 FBIARINC_cal_impl.Decode4_P14 FBIARINC_cal_impl.Decode4_P15 FBIARINC_cal_impl.Decode4_P16 FBIARINC_cal_impl.Decode4_P2 FBIARINC_cal_impl.Decode4_P3 FBIARINC_cal_impl.Decode4_P4 FBIARINC_cal_impl.Decode4_P5 FBIARINC_cal_impl.Decode4_P6 FBIARINC_cal_impl.Decode4_P7 FBIARINC_cal_impl.Decode4_P8 FBIARINC_cal_impl.Decode4_P9 FBIARINC_cal_impl.Decode5_P1 FBIARINC_cal_impl.Decode5_P10 FBIARINC_cal_impl.Decode5_P11 FBIARINC_cal_impl.Decode5_P12 FBIARINC_cal_impl.Decode5_P13 FBIARINC_cal_impl.Decode5_P14 FBIARINC_cal_impl.Decode5_P15 FBIARINC_cal_impl.Decode5_P16 FBIARINC_cal_impl.Decode5_P2 FBIARINC_cal_impl.Decode5_P3 FBIARINC_cal_impl.Decode5_P4 FBIARINC_cal_impl.Decode5_P5 FBIARINC_cal_impl.Decode5_P6 FBIARINC_cal_impl.Decode5_P7 FBIARINC_cal_impl.Decode5_P8 FBIARINC_cal_impl.Decode5_P9 FBIARINC_cal_impl.Decode6_P1 FBIARINC_cal_impl.Decode6_P10 FBIARINC_cal_impl.Decode6_P11 FBIARINC_cal_impl.Decode6_P12 FBIARINC_cal_impl.Decode6_P13 FBIARINC_cal_impl.Decode6_P14 FBIARINC_cal_impl.Decode6_P15 FBIARINC_cal_impl.Decode6_P16 FBIARINC_cal_impl.Decode6_P2 FBIARINC_cal_impl.Decode6_P3 FBIARINC_cal_impl.Decode6_P4 FBIARINC_cal_impl.Decode6_P5 FBIARINC_cal_impl.Decode6_P6 FBIARINC_cal_impl.Decode6_P7 FBIARINC_cal_impl.Decode6_P8 FBIARINC_cal_impl.Decode6_P9 /end REF_CHARACTERISTIC
 /begin REF_MEASUREMENT FBIARINC_B.CCCodeBlock1 FBIARINC_B.CCCodeBlock4 FBIARINC_B.Cast1 FBIARINC_B.Cast2 FBIARINC_B.Cast3 FBIARINC_B.Cast4 FBIARINC_B.Cast5 FBIARINC_B.Cast6 FBIARINC_B.Decode1 FBIARINC_B.Decode2 FBIARINC_B.Decode3 FBIARINC_B.Decode4 FBIARINC_B.Decode5 FBIARINC_B.Decode6 FBIARINC_B.Receivev2 /end REF_MEASUREMENT
/end GROUP
/begin GROUP FBIARINC_Decode_Channel_1_Compare_To_Zero "FBIARINC/Decode Channel 1/Compare
To Zero" /begin REF_CHARACTERISTIC FBIARINC_cal_impl.Constant_Value_g /end REF_CHARACTERISTIC /begin REF_MEASUREMENT FBIARINC_B.Compare FBIARINC_B.Receivev2 /end REF_MEASUREMENT /end GROUP
/begin GROUP FBIARINC_cal_impl.Constant_Value ""
 /begin REF_CHARACTERISTIC FBIARINC_cal_impl.Constant_Value.FBI_AMP FBIARINC_cal_impl.Constant_Value.FBI_TIME_LIMIT FBIARINC_cal_impl.Constant_Value.FBI_ID_TEST FBIARINC_cal_impl.Constant_Value.FBI_CONFIG FBIARINC_cal_impl.Constant_Value.FBI_ACT FBIARINC_cal_impl.Constant_Value.FBI_COMMAND /end REF_CHARACTERISTIC
/end GROUP
/end MODULE
/end PROJECT
