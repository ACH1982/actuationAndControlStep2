/******************************************************************************
* ASAP2 file: FCC1ARINC.a2l
* Code generation for model "FCC1ARINC".
* Model version : 1.39
* Simulink Coder version : 10.4 R2021b
* C source code generated on : Tue May 17 11:46:36 2022
* Target selection: slrealtime.tlc
* Embedded hardware selection: Intel->x86-64 (Linux 64)
* Code generation objectives: Unspecified
* Validation result: Not run
* (add additional file header information here)
******************************************************************************/ ASAP2_VERSION 1 71
/begin PROJECT ProjectName "Project Comment Goes Here"
/begin HEADER "Header Comments go here" /end HEADER
/begin MODULE ModuleName "Module Comment Goes Here"
/begin IF_DATA XCP
 /begin PROTOCOL_LAYER 0x0100 0x03E8 0x00C8 0x0000 0x0000 0x0000 0x0000 0x0000 0xFC 0x0578 BYTE_ORDER_MSB_LAST ADDRESS_GRANULARITY_BYTE OPTIONAL_CMD ALLOC_ODT_ENTRY OPTIONAL_CMD ALLOC_ODT OPTIONAL_CMD ALLOC_DAQ OPTIONAL_CMD FREE_DAQ OPTIONAL_CMD GET_DAQ_RESOLUTION_INFO OPTIONAL_CMD GET_DAQ_PROCESSOR_INFO OPTIONAL_CMD START_STOP_SYNCH OPTIONAL_CMD START_STOP_DAQ_LIST OPTIONAL_CMD SET_DAQ_LIST_MODE OPTIONAL_CMD WRITE_DAQ OPTIONAL_CMD SET_DAQ_PTR OPTIONAL_CMD GET_CAL_PAGE OPTIONAL_CMD SET_CAL_PAGE OPTIONAL_CMD COPY_CAL_PAGE OPTIONAL_CMD SHORT_DOWNLOAD OPTIONAL_CMD DOWNLOAD_MAX OPTIONAL_CMD DOWNLOAD OPTIONAL_CMD SHORT_UPLOAD OPTIONAL_CMD UPLOAD OPTIONAL_CMD SET_MTA /end PROTOCOL_LAYER
 /begin DAQ DYNAMIC 0x0000 0x0080 0x00 OPTIMISATION_TYPE_DEFAULT ADDRESS_EXTENSION_FREE IDENTIFICATION_FIELD_TYPE_RELATIVE_WORD_ALIGNED GRANULARITY_ODT_ENTRY_SIZE_DAQ_BYTE 0xFF OVERLOAD_INDICATION_PID PRESCALER_SUPPORTED /begin STIM GRANULARITY_ODT_ENTRY_SIZE_STIM_BYTE 0xFF /end STIM /begin TIMESTAMP_SUPPORTED 0x0001 SIZE_DWORD UNIT_1US TIMESTAMP_FIXED /end TIMESTAMP_SUPPORTED /begin EVENT "8 ms" "8 ms" 0x0000 DAQ 0xFF 0x08 0x06 0x00 /end EVENT /end DAQ
 /begin XCP_ON_UDP_IP 0x0100 0x15B3 ADDRESS "192.168.7.2" /end XCP_ON_UDP_IP
/end IF_DATA
/begin MOD_PAR "MOD PAR Comment Goes Here"
 /begin MEMORY_SEGMENT FCC1ARINC_cal_impl "FCC1ARINC_cal_impl" DATA FLASH INTERN 0x0080A020 0x1878 -1 -1 -1 -1 -1
  /begin IF_DATA XCP
   /begin SEGMENT 0x00 0x02 0x00 0x00 0x00
    /begin PAGE 0x00 ECU_ACCESS_DONT_CARE XCP_READ_ACCESS_DONT_CARE XCP_WRITE_ACCESS_NOT_ALLOWED /end PAGE
    /begin PAGE 0x01 ECU_ACCESS_DONT_CARE XCP_READ_ACCESS_DONT_CARE XCP_WRITE_ACCESS_DONT_CARE /end PAGE
   /end SEGMENT
  /end IF_DATA
 /end MEMORY_SEGMENT
/end MOD_PAR
/begin MOD_COMMON "Mod Common Comment Here" BYTE_ORDER MSB_LAST ALIGNMENT_BYTE 1 ALIGNMENT_WORD 2 ALIGNMENT_LONG 4 ALIGNMENT_FLOAT32_IEEE 4 ALIGNMENT_FLOAT64_IEEE 8 ALIGNMENT_INT64 8 /end MOD_COMMON
/begin CHARACTERISTIC FCC1ARINC_cal_impl.CCCodeBlock1_P1 "" VALUE 0x0080B538 Scalar_FLOAT64_IEEE 0 FCC1ARINC_CM_double -1.7E+308 1.7E+308 /end CHARACTERISTIC
/begin CHARACTERISTIC FCC1ARINC_cal_impl.CCCodeBlock1_P2 "" VALUE 0x0080B540 Scalar_FLOAT64_IEEE 0 FCC1ARINC_CM_double -1.7E+308 1.7E+308 /end CHARACTERISTIC
/begin CHARACTERISTIC FCC1ARINC_cal_impl.CCCodeBlock1_P3 "" VALUE 0x0080B88C Scalar_BOOLEAN 0 FCC1ARINC_CM_logical 0 1 /end CHARACTERISTIC
/begin CHARACTERISTIC FCC1ARINC_cal_impl.CCCodeBlock1_P4 "" VALUE 0x0080B88D Scalar_BOOLEAN 0 FCC1ARINC_CM_logical 0 1 /end CHARACTERISTIC
/begin CHARACTERISTIC FCC1ARINC_cal_impl.CCCodeBlock1_P5 "" VALUE 0x0080B878 Scalar_ULONG 0 FCC1ARINC_CM_uint32 0 2147483646 /end CHARACTERISTIC
/begin CHARACTERISTIC FCC1ARINC_cal_impl.CCCodeBlock2_P1 "" VALUE 0x0080B3A8 Scalar_FLOAT64_IEEE 0 FCC1ARINC_CM_double -1.7E+308 1.7E+308 /end CHARACTERISTIC
/begin CHARACTERISTIC FCC1ARINC_cal_impl.CCCodeBlock2_P2 "" VALUE 0x0080B3B0 Scalar_FLOAT64_IEEE 0 FCC1ARINC_CM_double -1.7E+308 1.7E+308 /end CHARACTERISTIC
/begin CHARACTERISTIC FCC1ARINC_cal_impl.CCCodeBlock2_P3 "" VALUE 0x0080B88A Scalar_BOOLEAN 0 FCC1ARINC_CM_logical 0 1 /end CHARACTERISTIC
/begin CHARACTERISTIC FCC1ARINC_cal_impl.CCCodeBlock2_P4 "" VALUE 0x0080B88B Scalar_BOOLEAN 0 FCC1ARINC_CM_logical 0 1 /end CHARACTERISTIC
/begin CHARACTERISTIC FCC1ARINC_cal_impl.CCCodeBlock2_P5 "" VALUE 0x0080B874 Scalar_ULONG 0 FCC1ARINC_CM_uint32 0 2147483646 /end CHARACTERISTIC
/begin CHARACTERISTIC FCC1ARINC_cal_impl.CCCodeBlock4_P1 "" VALUE 0x0080A908 Scalar_FLOAT64_IEEE 0 FCC1ARINC_CM_double -1.7E+308 1.7E+308 /end CHARACTERISTIC
/begin CHARACTERISTIC FCC1ARINC_cal_impl.CCCodeBlock4_P2 "" VALUE 0x0080A910 Scalar_FLOAT64_IEEE 0 FCC1ARINC_CM_double -1.7E+308 1.7E+308 /end CHARACTERISTIC
/begin CHARACTERISTIC FCC1ARINC_cal_impl.CCCodeBlock4_P3 "" VALUE 0x0080B886 Scalar_BOOLEAN 0 FCC1ARINC_CM_logical 0 1 /end CHARACTERISTIC
/begin CHARACTERISTIC FCC1ARINC_cal_impl.CCCodeBlock4_P4 "" VALUE 0x0080B887 Scalar_BOOLEAN 0 FCC1ARINC_CM_logical 0 1 /end CHARACTERISTIC
/begin CHARACTERISTIC FCC1ARINC_cal_impl.CCCodeBlock4_P5 "" VALUE 0x0080B86C Scalar_ULONG 0 FCC1ARINC_CM_uint32 0 2147483646 /end CHARACTERISTIC
/begin CHARACTERISTIC FCC1ARINC_cal_impl.CCCodeBlock5_P1 "" VALUE 0x0080AA98 Scalar_FLOAT64_IEEE 0 FCC1ARINC_CM_double -1.7E+308 1.7E+308 /end CHARACTERISTIC
/begin CHARACTERISTIC FCC1ARINC_cal_impl.CCCodeBlock5_P2 "" VALUE 0x0080AAA0 Scalar_FLOAT64_IEEE 0 FCC1ARINC_CM_double -1.7E+308 1.7E+308 /end CHARACTERISTIC
/begin CHARACTERISTIC FCC1ARINC_cal_impl.CCCodeBlock5_P3 "" VALUE 0x0080B888 Scalar_BOOLEAN 0 FCC1ARINC_CM_logical 0 1 /end CHARACTERISTIC
/begin CHARACTERISTIC FCC1ARINC_cal_impl.CCCodeBlock5_P4 "" VALUE 0x0080B889 Scalar_BOOLEAN 0 FCC1ARINC_CM_logical 0 1 /end CHARACTERISTIC
/begin CHARACTERISTIC FCC1ARINC_cal_impl.CCCodeBlock5_P5 "" VALUE 0x0080B870 Scalar_ULONG 0 FCC1ARINC_CM_uint32 0 2147483646 /end CHARACTERISTIC
/begin CHARACTERISTIC FCC1ARINC_cal_impl.CCCodeBlock6_P1 "" VALUE 0x0080B6C8 Scalar_FLOAT64_IEEE 0 FCC1ARINC_CM_double -1.7E+308 1.7E+308 /end CHARACTERISTIC
/begin CHARACTERISTIC FCC1ARINC_cal_impl.CCCodeBlock6_P2 "" VALUE 0x0080B6D0 Scalar_FLOAT64_IEEE 0 FCC1ARINC_CM_double -1.7E+308 1.7E+308 /end CHARACTERISTIC
/begin CHARACTERISTIC FCC1ARINC_cal_impl.CCCodeBlock6_P3 "" VALUE 0x0080B88E Scalar_BOOLEAN 0 FCC1ARINC_CM_logical 0 1 /end CHARACTERISTIC
/begin CHARACTERISTIC FCC1ARINC_cal_impl.CCCodeBlock6_P4 "" VALUE 0x0080B88F Scalar_BOOLEAN 0 FCC1ARINC_CM_logical 0 1 /end CHARACTERISTIC
/begin CHARACTERISTIC FCC1ARINC_cal_impl.CCCodeBlock6_P5 "" VALUE 0x0080B87C Scalar_ULONG 0 FCC1ARINC_CM_uint32 0 2147483646 /end CHARACTERISTIC
/begin CHARACTERISTIC FCC1ARINC_cal_impl.CCCodeBlock7_P1 "" VALUE 0x0080B858 Scalar_FLOAT64_IEEE 0 FCC1ARINC_CM_double -1.7E+308 1.7E+308 /end CHARACTERISTIC
/begin CHARACTERISTIC FCC1ARINC_cal_impl.CCCodeBlock7_P2 "" VALUE 0x0080B860 Scalar_FLOAT64_IEEE 0 FCC1ARINC_CM_double -1.7E+308 1.7E+308 /end CHARACTERISTIC
/begin CHARACTERISTIC FCC1ARINC_cal_impl.CCCodeBlock7_P3 "" VALUE 0x0080B890 Scalar_BOOLEAN 0 FCC1ARINC_CM_logical 0 1 /end CHARACTERISTIC
/begin CHARACTERISTIC FCC1ARINC_cal_impl.CCCodeBlock7_P4 "" VALUE 0x0080B891 Scalar_BOOLEAN 0 FCC1ARINC_CM_logical 0 1 /end CHARACTERISTIC
/begin CHARACTERISTIC FCC1ARINC_cal_impl.CCCodeBlock7_P5 "" VALUE 0x0080B880 Scalar_ULONG 0 FCC1ARINC_CM_uint32 0 2147483646 /end CHARACTERISTIC
/begin CHARACTERISTIC FCC1ARINC_cal_impl.CCCodeBlock_P1 "" VALUE 0x0080A778 Scalar_FLOAT64_IEEE 0 FCC1ARINC_CM_double -1.7E+308 1.7E+308 /end CHARACTERISTIC
/begin CHARACTERISTIC FCC1ARINC_cal_impl.CCCodeBlock_P2 "" VALUE 0x0080A780 Scalar_FLOAT64_IEEE 0 FCC1ARINC_CM_double -1.7E+308 1.7E+308 /end CHARACTERISTIC
/begin CHARACTERISTIC FCC1ARINC_cal_impl.CCCodeBlock_P3 "" VALUE 0x0080B884 Scalar_BOOLEAN 0 FCC1ARINC_CM_logical 0 1 /end CHARACTERISTIC
/begin CHARACTERISTIC FCC1ARINC_cal_impl.CCCodeBlock_P4 "" VALUE 0x0080B885 Scalar_BOOLEAN 0 FCC1ARINC_CM_logical 0 1 /end CHARACTERISTIC
/begin CHARACTERISTIC FCC1ARINC_cal_impl.CCCodeBlock_P5 "" VALUE 0x0080B868 Scalar_ULONG 0 FCC1ARINC_CM_uint32 0 2147483646 /end CHARACTERISTIC
/begin CHARACTERISTIC FCC1ARINC_cal_impl.Constant_Value.FCC1_ACExxxA_GEARING_ROLL "" VALUE 0x0080A020 Scalar_FLOAT32_IEEE 0 FCC1ARINC_CM_single -3.4E+38 3.4E+38 /end CHARACTERISTIC
/begin CHARACTERISTIC FCC1ARINC_cal_impl.Constant_Value.FCC1_ACExxxA_GEARING_ROLL_FAIL "" VALUE 0x0080A024 Scalar_BOOLEAN 0 FCC1ARINC_CM_logical 0 1 /end CHARACTERISTIC
/begin CHARACTERISTIC FCC1ARINC_cal_impl.Constant_Value.FCC1_ACExxxA_ROLL_INCREMENTAL_DEM_FAIL "" VALUE 0x0080A025 Scalar_BOOLEAN 0 FCC1ARINC_CM_logical 0 1 /end CHARACTERISTIC
/begin CHARACTERISTIC FCC1ARINC_cal_impl.Constant_Value.FCC1_ACExxxA_ROLL_INCREMENTAL_DEM_LH "" VALUE 0x0080A030 Scalar_FLOAT32_IEEE 0 FCC1ARINC_CM_single -3.4E+38 3.4E+38 /end CHARACTERISTIC
/begin CHARACTERISTIC FCC1ARINC_cal_impl.Constant_Value.FCC1_ACExxxA_ROLL_INCREMENTAL_DEM_RH "" VALUE 0x0080A040 Scalar_FLOAT32_IEEE 0 FCC1ARINC_CM_single -3.4E+38 3.4E+38 /end CHARACTERISTIC
/begin CHARACTERISTIC FCC1ARINC_cal_impl.Constant_Value.FCC1_ACExxxA_SUR_POS_1_AIL "" VALUE 0x0080A03C Scalar_FLOAT32_IEEE 0 FCC1ARINC_CM_single -3.4E+38 3.4E+38 /end CHARACTERISTIC
/begin CHARACTERISTIC FCC1ARINC_cal_impl.Constant_Value.FCC1_ACExxxA_SUR_POS_1_AIL_FAIL "" VALUE 0x0080A028 Scalar_BOOLEAN 0 FCC1ARINC_CM_logical 0 1 /end CHARACTERISTIC
/begin CHARACTERISTIC FCC1ARINC_cal_impl.Constant_Value.FCC1_ACExxxA_TBI_FAIL "" VALUE 0x0080A026 Scalar_BOOLEAN 0 FCC1ARINC_CM_logical 0 1 /end CHARACTERISTIC
/begin CHARACTERISTIC FCC1ARINC_cal_impl.Constant_Value.FCC1_ACExxxA_TBI_LH "" VALUE 0x0080A02C Scalar_FLOAT32_IEEE 0 FCC1ARINC_CM_single -3.4E+38 3.4E+38 /end CHARACTERISTIC
/begin CHARACTERISTIC FCC1ARINC_cal_impl.Constant_Value.FCC1_ACExxxA_TBI_RH "" VALUE 0x0080A034 Scalar_FLOAT32_IEEE 0 FCC1ARINC_CM_single -3.4E+38 3.4E+38 /end CHARACTERISTIC
/begin CHARACTERISTIC FCC1ARINC_cal_impl.Constant_Value.FCC1_ACExxxA_WHEEL_POS_1 "" VALUE 0x0080A038 Scalar_FLOAT32_IEEE 0 FCC1ARINC_CM_single -3.4E+38 3.4E+38 /end CHARACTERISTIC
/begin CHARACTERISTIC FCC1ARINC_cal_impl.Constant_Value.FCC1_ACExxxA_WHEEL_POS_1_FAIL "" VALUE 0x0080A027 Scalar_BOOLEAN 0 FCC1ARINC_CM_logical 0 1 /end CHARACTERISTIC
/begin CHARACTERISTIC FCC1ARINC_cal_impl.Decode10_P1 "" VALUE 0x0080B3C8 Scalar_FLOAT64_IEEE 0 FCC1ARINC_CM_double -1.7E+308 1.7E+308 /end CHARACTERISTIC
/begin CHARACTERISTIC FCC1ARINC_cal_impl.Decode10_P10 "" VALUE 0x0080B4A0 Scalar_FLOAT64_IEEE 0 FCC1ARINC_CM_double -1.7E+308 1.7E+308 /end CHARACTERISTIC
/begin CHARACTERISTIC FCC1ARINC_cal_impl.Decode10_P11 "" VALUE 0x0080B4B8 Scalar_FLOAT64_IEEE 0 FCC1ARINC_CM_double -1.7E+308 1.7E+308 /end CHARACTERISTIC
/begin CHARACTERISTIC FCC1ARINC_cal_impl.Decode10_P12 "" VALUE 0x0080B4D0 Scalar_FLOAT64_IEEE 0 FCC1ARINC_CM_double -1.7E+308 1.7E+308 /end CHARACTERISTIC
/begin CHARACTERISTIC FCC1ARINC_cal_impl.Decode10_P13 "" VALUE 0x0080B4E8 Scalar_FLOAT64_IEEE 0 FCC1ARINC_CM_double -1.7E+308 1.7E+308 /end CHARACTERISTIC
/begin CHARACTERISTIC FCC1ARINC_cal_impl.Decode10_P14 "" VALUE 0x0080B500 Scalar_FLOAT64_IEEE 0 FCC1ARINC_CM_double -1.7E+308 1.7E+308 /end CHARACTERISTIC
/begin CHARACTERISTIC FCC1ARINC_cal_impl.Decode10_P15 "" VALUE 0x0080B518 Scalar_FLOAT64_IEEE 0 FCC1ARINC_CM_double -1.7E+308 1.7E+308 /end CHARACTERISTIC
/begin CHARACTERISTIC FCC1ARINC_cal_impl.Decode10_P16 "" VALUE 0x0080B530 Scalar_FLOAT64_IEEE 0 FCC1ARINC_CM_double -1.7E+308 1.7E+308 /end CHARACTERISTIC
/begin CHARACTERISTIC FCC1ARINC_cal_impl.Decode10_P2 "" VALUE 0x0080B3E0 Scalar_FLOAT64_IEEE 0 FCC1ARINC_CM_double -1.7E+308 1.7E+308 /end CHARACTERISTIC
/begin CHARACTERISTIC FCC1ARINC_cal_impl.Decode10_P3 "" VALUE 0x0080B3F8 Scalar_FLOAT64_IEEE 0 FCC1ARINC_CM_double -1.7E+308 1.7E+308 /end CHARACTERISTIC
/begin CHARACTERISTIC FCC1ARINC_cal_impl.Decode10_P4 "" VALUE 0x0080B410 Scalar_FLOAT64_IEEE 0 FCC1ARINC_CM_double -1.7E+308 1.7E+308 /end CHARACTERISTIC
/begin CHARACTERISTIC FCC1ARINC_cal_impl.Decode10_P5 "" VALUE 0x0080B428 Scalar_FLOAT64_IEEE 0 FCC1ARINC_CM_double -1.7E+308 1.7E+308 /end CHARACTERISTIC
/begin CHARACTERISTIC FCC1ARINC_cal_impl.Decode10_P6 "" VALUE 0x0080B440 Scalar_FLOAT64_IEEE 0 FCC1ARINC_CM_double -1.7E+308 1.7E+308 /end CHARACTERISTIC
/begin CHARACTERISTIC FCC1ARINC_cal_impl.Decode10_P7 "" VALUE 0x0080B458 Scalar_FLOAT64_IEEE 0 FCC1ARINC_CM_double -1.7E+308 1.7E+308 /end CHARACTERISTIC
/begin CHARACTERISTIC FCC1ARINC_cal_impl.Decode10_P8 "" VALUE 0x0080B470 Scalar_FLOAT64_IEEE 0 FCC1ARINC_CM_double -1.7E+308 1.7E+308 /end CHARACTERISTIC
/begin CHARACTERISTIC FCC1ARINC_cal_impl.Decode10_P9 "" VALUE 0x0080B488 Scalar_FLOAT64_IEEE 0 FCC1ARINC_CM_double -1.7E+308 1.7E+308 /end CHARACTERISTIC
/begin CHARACTERISTIC FCC1ARINC_cal_impl.Decode11_P1 "" VALUE 0x0080B558 Scalar_FLOAT64_IEEE 0 FCC1ARINC_CM_double -1.7E+308 1.7E+308 /end CHARACTERISTIC
/begin CHARACTERISTIC FCC1ARINC_cal_impl.Decode11_P10 "" VALUE 0x0080B630 Scalar_FLOAT64_IEEE 0 FCC1ARINC_CM_double -1.7E+308 1.7E+308 /end CHARACTERISTIC
/begin CHARACTERISTIC FCC1ARINC_cal_impl.Decode11_P11 "" VALUE 0x0080B648 Scalar_FLOAT64_IEEE 0 FCC1ARINC_CM_double -1.7E+308 1.7E+308 /end CHARACTERISTIC
/begin CHARACTERISTIC FCC1ARINC_cal_impl.Decode11_P12 "" VALUE 0x0080B660 Scalar_FLOAT64_IEEE 0 FCC1ARINC_CM_double -1.7E+308 1.7E+308 /end CHARACTERISTIC
/begin CHARACTERISTIC FCC1ARINC_cal_impl.Decode11_P13 "" VALUE 0x0080B678 Scalar_FLOAT64_IEEE 0 FCC1ARINC_CM_double -1.7E+308 1.7E+308 /end CHARACTERISTIC
/begin CHARACTERISTIC FCC1ARINC_cal_impl.Decode11_P14 "" VALUE 0x0080B690 Scalar_FLOAT64_IEEE 0 FCC1ARINC_CM_double -1.7E+308 1.7E+308 /end CHARACTERISTIC
/begin CHARACTERISTIC FCC1ARINC_cal_impl.Decode11_P15 "" VALUE 0x0080B6A8 Scalar_FLOAT64_IEEE 0 FCC1ARINC_CM_double -1.7E+308 1.7E+308 /end CHARACTERISTIC
/begin CHARACTERISTIC FCC1ARINC_cal_impl.Decode11_P16 "" VALUE 0x0080B6C0 Scalar_FLOAT64_IEEE 0 FCC1ARINC_CM_double -1.7E+308 1.7E+308 /end CHARACTERISTIC
/begin CHARACTERISTIC FCC1ARINC_cal_impl.Decode11_P2 "" VALUE 0x0080B570 Scalar_FLOAT64_IEEE 0 FCC1ARINC_CM_double -1.7E+308 1.7E+308 /end CHARACTERISTIC
/begin CHARACTERISTIC FCC1ARINC_cal_impl.Decode11_P3 "" VALUE 0x0080B588 Scalar_FLOAT64_IEEE 0 FCC1ARINC_CM_double -1.7E+308 1.7E+308 /end CHARACTERISTIC
/begin CHARACTERISTIC FCC1ARINC_cal_impl.Decode11_P4 "" VALUE 0x0080B5A0 Scalar_FLOAT64_IEEE 0 FCC1ARINC_CM_double -1.7E+308 1.7E+308 /end CHARACTERISTIC
/begin CHARACTERISTIC FCC1ARINC_cal_impl.Decode11_P5 "" VALUE 0x0080B5B8 Scalar_FLOAT64_IEEE 0 FCC1ARINC_CM_double -1.7E+308 1.7E+308 /end CHARACTERISTIC
/begin CHARACTERISTIC FCC1ARINC_cal_impl.Decode11_P6 "" VALUE 0x0080B5D0 Scalar_FLOAT64_IEEE 0 FCC1ARINC_CM_double -1.7E+308 1.7E+308 /end CHARACTERISTIC
/begin CHARACTERISTIC FCC1ARINC_cal_impl.Decode11_P7 "" VALUE 0x0080B5E8 Scalar_FLOAT64_IEEE 0 FCC1ARINC_CM_double -1.7E+308 1.7E+308 /end CHARACTERISTIC
/begin CHARACTERISTIC FCC1ARINC_cal_impl.Decode11_P8 "" VALUE 0x0080B600 Scalar_FLOAT64_IEEE 0 FCC1ARINC_CM_double -1.7E+308 1.7E+308 /end CHARACTERISTIC
/begin CHARACTERISTIC FCC1ARINC_cal_impl.Decode11_P9 "" VALUE 0x0080B618 Scalar_FLOAT64_IEEE 0 FCC1ARINC_CM_double -1.7E+308 1.7E+308 /end CHARACTERISTIC
/begin CHARACTERISTIC FCC1ARINC_cal_impl.Decode12_P1 "" VALUE 0x0080B6E8 Scalar_FLOAT64_IEEE 0 FCC1ARINC_CM_double -1.7E+308 1.7E+308 /end CHARACTERISTIC
/begin CHARACTERISTIC FCC1ARINC_cal_impl.Decode12_P10 "" VALUE 0x0080B7C0 Scalar_FLOAT64_IEEE 0 FCC1ARINC_CM_double -1.7E+308 1.7E+308 /end CHARACTERISTIC
/begin CHARACTERISTIC FCC1ARINC_cal_impl.Decode12_P11 "" VALUE 0x0080B7D8 Scalar_FLOAT64_IEEE 0 FCC1ARINC_CM_double -1.7E+308 1.7E+308 /end CHARACTERISTIC
/begin CHARACTERISTIC FCC1ARINC_cal_impl.Decode12_P12 "" VALUE 0x0080B7F0 Scalar_FLOAT64_IEEE 0 FCC1ARINC_CM_double -1.7E+308 1.7E+308 /end CHARACTERISTIC
/begin CHARACTERISTIC FCC1ARINC_cal_impl.Decode12_P13 "" VALUE 0x0080B808 Scalar_FLOAT64_IEEE 0 FCC1ARINC_CM_double -1.7E+308 1.7E+308 /end CHARACTERISTIC
/begin CHARACTERISTIC FCC1ARINC_cal_impl.Decode12_P14 "" VALUE 0x0080B820 Scalar_FLOAT64_IEEE 0 FCC1ARINC_CM_double -1.7E+308 1.7E+308 /end CHARACTERISTIC
/begin CHARACTERISTIC FCC1ARINC_cal_impl.Decode12_P15 "" VALUE 0x0080B838 Scalar_FLOAT64_IEEE 0 FCC1ARINC_CM_double -1.7E+308 1.7E+308 /end CHARACTERISTIC
/begin CHARACTERISTIC FCC1ARINC_cal_impl.Decode12_P16 "" VALUE 0x0080B850 Scalar_FLOAT64_IEEE 0 FCC1ARINC_CM_double -1.7E+308 1.7E+308 /end CHARACTERISTIC
/begin CHARACTERISTIC FCC1ARINC_cal_impl.Decode12_P2 "" VALUE 0x0080B700 Scalar_FLOAT64_IEEE 0 FCC1ARINC_CM_double -1.7E+308 1.7E+308 /end CHARACTERISTIC
/begin CHARACTERISTIC FCC1ARINC_cal_impl.Decode12_P3 "" VALUE 0x0080B718 Scalar_FLOAT64_IEEE 0 FCC1ARINC_CM_double -1.7E+308 1.7E+308 /end CHARACTERISTIC
/begin CHARACTERISTIC FCC1ARINC_cal_impl.Decode12_P4 "" VALUE 0x0080B730 Scalar_FLOAT64_IEEE 0 FCC1ARINC_CM_double -1.7E+308 1.7E+308 /end CHARACTERISTIC
/begin CHARACTERISTIC FCC1ARINC_cal_impl.Decode12_P5 "" VALUE 0x0080B748 Scalar_FLOAT64_IEEE 0 FCC1ARINC_CM_double -1.7E+308 1.7E+308 /end CHARACTERISTIC
/begin CHARACTERISTIC FCC1ARINC_cal_impl.Decode12_P6 "" VALUE 0x0080B760 Scalar_FLOAT64_IEEE 0 FCC1ARINC_CM_double -1.7E+308 1.7E+308 /end CHARACTERISTIC
/begin CHARACTERISTIC FCC1ARINC_cal_impl.Decode12_P7 "" VALUE 0x0080B778 Scalar_FLOAT64_IEEE 0 FCC1ARINC_CM_double -1.7E+308 1.7E+308 /end CHARACTERISTIC
/begin CHARACTERISTIC FCC1ARINC_cal_impl.Decode12_P8 "" VALUE 0x0080B790 Scalar_FLOAT64_IEEE 0 FCC1ARINC_CM_double -1.7E+308 1.7E+308 /end CHARACTERISTIC
/begin CHARACTERISTIC FCC1ARINC_cal_impl.Decode12_P9 "" VALUE 0x0080B7A8 Scalar_FLOAT64_IEEE 0 FCC1ARINC_CM_double -1.7E+308 1.7E+308 /end CHARACTERISTIC
/begin CHARACTERISTIC FCC1ARINC_cal_impl.Decode1_P1 "" VALUE 0x0080A600 Scalar_FLOAT64_IEEE 0 FCC1ARINC_CM_double -1.7E+308 1.7E+308 /end CHARACTERISTIC
/begin CHARACTERISTIC FCC1ARINC_cal_impl.Decode1_P10 "" VAL_BLK 0x0080A6D8 Scalar_FLOAT64_IEEE 0 FCC1ARINC_CM_double -1.7E+308 1.7E+308 MATRIX_DIM 2 1 /end CHARACTERISTIC
/begin CHARACTERISTIC FCC1ARINC_cal_impl.Decode1_P11 "" VALUE 0x0080A6F8 Scalar_FLOAT64_IEEE 0 FCC1ARINC_CM_double -1.7E+308 1.7E+308 /end CHARACTERISTIC
/begin CHARACTERISTIC FCC1ARINC_cal_impl.Decode1_P12 "" VALUE 0x0080A710 Scalar_FLOAT64_IEEE 0 FCC1ARINC_CM_double -1.7E+308 1.7E+308 /end CHARACTERISTIC
/begin CHARACTERISTIC FCC1ARINC_cal_impl.Decode1_P13 "" VALUE 0x0080A728 Scalar_FLOAT64_IEEE 0 FCC1ARINC_CM_double -1.7E+308 1.7E+308 /end CHARACTERISTIC
/begin CHARACTERISTIC FCC1ARINC_cal_impl.Decode1_P14 "" VALUE 0x0080A740 Scalar_FLOAT64_IEEE 0 FCC1ARINC_CM_double -1.7E+308 1.7E+308 /end CHARACTERISTIC
/begin CHARACTERISTIC FCC1ARINC_cal_impl.Decode1_P15 "" VALUE 0x0080A758 Scalar_FLOAT64_IEEE 0 FCC1ARINC_CM_double -1.7E+308 1.7E+308 /end CHARACTERISTIC
/begin CHARACTERISTIC FCC1ARINC_cal_impl.Decode1_P16 "" VALUE 0x0080A770 Scalar_FLOAT64_IEEE 0 FCC1ARINC_CM_double -1.7E+308 1.7E+308 /end CHARACTERISTIC
/begin CHARACTERISTIC FCC1ARINC_cal_impl.Decode1_P2 "" VALUE 0x0080A618 Scalar_FLOAT64_IEEE 0 FCC1ARINC_CM_double -1.7E+308 1.7E+308 /end CHARACTERISTIC
/begin CHARACTERISTIC FCC1ARINC_cal_impl.Decode1_P3 "" VALUE 0x0080A630 Scalar_FLOAT64_IEEE 0 FCC1ARINC_CM_double -1.7E+308 1.7E+308 /end CHARACTERISTIC
/begin CHARACTERISTIC FCC1ARINC_cal_impl.Decode1_P4 "" VALUE 0x0080A648 Scalar_FLOAT64_IEEE 0 FCC1ARINC_CM_double -1.7E+308 1.7E+308 /end CHARACTERISTIC
/begin CHARACTERISTIC FCC1ARINC_cal_impl.Decode1_P5 "" VALUE 0x0080A660 Scalar_FLOAT64_IEEE 0 FCC1ARINC_CM_double -1.7E+308 1.7E+308 /end CHARACTERISTIC
/begin CHARACTERISTIC FCC1ARINC_cal_impl.Decode1_P6 "" VALUE 0x0080A678 Scalar_FLOAT64_IEEE 0 FCC1ARINC_CM_double -1.7E+308 1.7E+308 /end CHARACTERISTIC
/begin CHARACTERISTIC FCC1ARINC_cal_impl.Decode1_P7 "" VALUE 0x0080A690 Scalar_FLOAT64_IEEE 0 FCC1ARINC_CM_double -1.7E+308 1.7E+308 /end CHARACTERISTIC
/begin CHARACTERISTIC FCC1ARINC_cal_impl.Decode1_P8 "" VALUE 0x0080A6A8 Scalar_FLOAT64_IEEE 0 FCC1ARINC_CM_double -1.7E+308 1.7E+308 /end CHARACTERISTIC
/begin CHARACTERISTIC FCC1ARINC_cal_impl.Decode1_P9 "" VALUE 0x0080A6C0 Scalar_FLOAT64_IEEE 0 FCC1ARINC_CM_double -1.7E+308 1.7E+308 /end CHARACTERISTIC
/begin CHARACTERISTIC FCC1ARINC_cal_impl.Decode2_P1 "" VALUE 0x0080A928 Scalar_FLOAT64_IEEE 0 FCC1ARINC_CM_double -1.7E+308 1.7E+308 /end CHARACTERISTIC
/begin CHARACTERISTIC FCC1ARINC_cal_impl.Decode2_P10 "" VALUE 0x0080AA00 Scalar_FLOAT64_IEEE 0 FCC1ARINC_CM_double -1.7E+308 1.7E+308 /end CHARACTERISTIC
/begin CHARACTERISTIC FCC1ARINC_cal_impl.Decode2_P11 "" VALUE 0x0080AA18 Scalar_FLOAT64_IEEE 0 FCC1ARINC_CM_double -1.7E+308 1.7E+308 /end CHARACTERISTIC
/begin CHARACTERISTIC FCC1ARINC_cal_impl.Decode2_P12 "" VALUE 0x0080AA30 Scalar_FLOAT64_IEEE 0 FCC1ARINC_CM_double -1.7E+308 1.7E+308 /end CHARACTERISTIC
/begin CHARACTERISTIC FCC1ARINC_cal_impl.Decode2_P13 "" VALUE 0x0080AA48 Scalar_FLOAT64_IEEE 0 FCC1ARINC_CM_double -1.7E+308 1.7E+308 /end CHARACTERISTIC
/begin CHARACTERISTIC FCC1ARINC_cal_impl.Decode2_P14 "" VALUE 0x0080AA60 Scalar_FLOAT64_IEEE 0 FCC1ARINC_CM_double -1.7E+308 1.7E+308 /end CHARACTERISTIC
/begin CHARACTERISTIC FCC1ARINC_cal_impl.Decode2_P15 "" VALUE 0x0080AA78 Scalar_FLOAT64_IEEE 0 FCC1ARINC_CM_double -1.7E+308 1.7E+308 /end CHARACTERISTIC
/begin CHARACTERISTIC FCC1ARINC_cal_impl.Decode2_P16 "" VALUE 0x0080AA90 Scalar_FLOAT64_IEEE 0 FCC1ARINC_CM_double -1.7E+308 1.7E+308 /end CHARACTERISTIC
/begin CHARACTERISTIC FCC1ARINC_cal_impl.Decode2_P2 "" VALUE 0x0080A940 Scalar_FLOAT64_IEEE 0 FCC1ARINC_CM_double -1.7E+308 1.7E+308 /end CHARACTERISTIC
/begin CHARACTERISTIC FCC1ARINC_cal_impl.Decode2_P3 "" VALUE 0x0080A958 Scalar_FLOAT64_IEEE 0 FCC1ARINC_CM_double -1.7E+308 1.7E+308 /end CHARACTERISTIC
/begin CHARACTERISTIC FCC1ARINC_cal_impl.Decode2_P4 "" VALUE 0x0080A970 Scalar_FLOAT64_IEEE 0 FCC1ARINC_CM_double -1.7E+308 1.7E+308 /end CHARACTERISTIC
/begin CHARACTERISTIC FCC1ARINC_cal_impl.Decode2_P5 "" VALUE 0x0080A988 Scalar_FLOAT64_IEEE 0 FCC1ARINC_CM_double -1.7E+308 1.7E+308 /end CHARACTERISTIC
/begin CHARACTERISTIC FCC1ARINC_cal_impl.Decode2_P6 "" VALUE 0x0080A9A0 Scalar_FLOAT64_IEEE 0 FCC1ARINC_CM_double -1.7E+308 1.7E+308 /end CHARACTERISTIC
/begin CHARACTERISTIC FCC1ARINC_cal_impl.Decode2_P7 "" VALUE 0x0080A9B8 Scalar_FLOAT64_IEEE 0 FCC1ARINC_CM_double -1.7E+308 1.7E+308 /end CHARACTERISTIC
/begin CHARACTERISTIC FCC1ARINC_cal_impl.Decode2_P8 "" VALUE 0x0080A9D0 Scalar_FLOAT64_IEEE 0 FCC1ARINC_CM_double -1.7E+308 1.7E+308 /end CHARACTERISTIC
/begin CHARACTERISTIC FCC1ARINC_cal_impl.Decode2_P9 "" VALUE 0x0080A9E8 Scalar_FLOAT64_IEEE 0 FCC1ARINC_CM_double -1.7E+308 1.7E+308 /end CHARACTERISTIC
/begin CHARACTERISTIC FCC1ARINC_cal_impl.Decode3_P1 "" VALUE 0x0080AC38 Scalar_FLOAT64_IEEE 0 FCC1ARINC_CM_double -1.7E+308 1.7E+308 /end CHARACTERISTIC
/begin CHARACTERISTIC FCC1ARINC_cal_impl.Decode3_P10 "" VALUE 0x0080AD10 Scalar_FLOAT64_IEEE 0 FCC1ARINC_CM_double -1.7E+308 1.7E+308 /end CHARACTERISTIC
/begin CHARACTERISTIC FCC1ARINC_cal_impl.Decode3_P11 "" VALUE 0x0080AD28 Scalar_FLOAT64_IEEE 0 FCC1ARINC_CM_double -1.7E+308 1.7E+308 /end CHARACTERISTIC
/begin CHARACTERISTIC FCC1ARINC_cal_impl.Decode3_P12 "" VALUE 0x0080AD40 Scalar_FLOAT64_IEEE 0 FCC1ARINC_CM_double -1.7E+308 1.7E+308 /end CHARACTERISTIC
/begin CHARACTERISTIC FCC1ARINC_cal_impl.Decode3_P13 "" VALUE 0x0080AD58 Scalar_FLOAT64_IEEE 0 FCC1ARINC_CM_double -1.7E+308 1.7E+308 /end CHARACTERISTIC
/begin CHARACTERISTIC FCC1ARINC_cal_impl.Decode3_P14 "" VALUE 0x0080AD70 Scalar_FLOAT64_IEEE 0 FCC1ARINC_CM_double -1.7E+308 1.7E+308 /end CHARACTERISTIC
/begin CHARACTERISTIC FCC1ARINC_cal_impl.Decode3_P15 "" VALUE 0x0080AD88 Scalar_FLOAT64_IEEE 0 FCC1ARINC_CM_double -1.7E+308 1.7E+308 /end CHARACTERISTIC
/begin CHARACTERISTIC FCC1ARINC_cal_impl.Decode3_P16 "" VALUE 0x0080ADA0 Scalar_FLOAT64_IEEE 0 FCC1ARINC_CM_double -1.7E+308 1.7E+308 /end CHARACTERISTIC
/begin CHARACTERISTIC FCC1ARINC_cal_impl.Decode3_P2 "" VALUE 0x0080AC50 Scalar_FLOAT64_IEEE 0 FCC1ARINC_CM_double -1.7E+308 1.7E+308 /end CHARACTERISTIC
/begin CHARACTERISTIC FCC1ARINC_cal_impl.Decode3_P3 "" VALUE 0x0080AC68 Scalar_FLOAT64_IEEE 0 FCC1ARINC_CM_double -1.7E+308 1.7E+308 /end CHARACTERISTIC
/begin CHARACTERISTIC FCC1ARINC_cal_impl.Decode3_P4 "" VALUE 0x0080AC80 Scalar_FLOAT64_IEEE 0 FCC1ARINC_CM_double -1.7E+308 1.7E+308 /end CHARACTERISTIC
/begin CHARACTERISTIC FCC1ARINC_cal_impl.Decode3_P5 "" VALUE 0x0080AC98 Scalar_FLOAT64_IEEE 0 FCC1ARINC_CM_double -1.7E+308 1.7E+308 /end CHARACTERISTIC
/begin CHARACTERISTIC FCC1ARINC_cal_impl.Decode3_P6 "" VALUE 0x0080ACB0 Scalar_FLOAT64_IEEE 0 FCC1ARINC_CM_double -1.7E+308 1.7E+308 /end CHARACTERISTIC
/begin CHARACTERISTIC FCC1ARINC_cal_impl.Decode3_P7 "" VALUE 0x0080ACC8 Scalar_FLOAT64_IEEE 0 FCC1ARINC_CM_double -1.7E+308 1.7E+308 /end CHARACTERISTIC
/begin CHARACTERISTIC FCC1ARINC_cal_impl.Decode3_P8 "" VALUE 0x0080ACE0 Scalar_FLOAT64_IEEE 0 FCC1ARINC_CM_double -1.7E+308 1.7E+308 /end CHARACTERISTIC
/begin CHARACTERISTIC FCC1ARINC_cal_impl.Decode3_P9 "" VALUE 0x0080ACF8 Scalar_FLOAT64_IEEE 0 FCC1ARINC_CM_double -1.7E+308 1.7E+308 /end CHARACTERISTIC
/begin CHARACTERISTIC FCC1ARINC_cal_impl.Decode4_P1 "" VALUE 0x0080ADB8 Scalar_FLOAT64_IEEE 0 FCC1ARINC_CM_double -1.7E+308 1.7E+308 /end CHARACTERISTIC
/begin CHARACTERISTIC FCC1ARINC_cal_impl.Decode4_P10 "" VALUE 0x0080AE90 Scalar_FLOAT64_IEEE 0 FCC1ARINC_CM_double -1.7E+308 1.7E+308 /end CHARACTERISTIC
/begin CHARACTERISTIC FCC1ARINC_cal_impl.Decode4_P11 "" VALUE 0x0080AEA8 Scalar_FLOAT64_IEEE 0 FCC1ARINC_CM_double -1.7E+308 1.7E+308 /end CHARACTERISTIC
/begin CHARACTERISTIC FCC1ARINC_cal_impl.Decode4_P12 "" VALUE 0x0080AEC0 Scalar_FLOAT64_IEEE 0 FCC1ARINC_CM_double -1.7E+308 1.7E+308 /end CHARACTERISTIC
/begin CHARACTERISTIC FCC1ARINC_cal_impl.Decode4_P13 "" VALUE 0x0080AED8 Scalar_FLOAT64_IEEE 0 FCC1ARINC_CM_double -1.7E+308 1.7E+308 /end CHARACTERISTIC
/begin CHARACTERISTIC FCC1ARINC_cal_impl.Decode4_P14 "" VALUE 0x0080AEF0 Scalar_FLOAT64_IEEE 0 FCC1ARINC_CM_double -1.7E+308 1.7E+308 /end CHARACTERISTIC
/begin CHARACTERISTIC FCC1ARINC_cal_impl.Decode4_P15 "" VALUE 0x0080AF08 Scalar_FLOAT64_IEEE 0 FCC1ARINC_CM_double -1.7E+308 1.7E+308 /end CHARACTERISTIC
/begin CHARACTERISTIC FCC1ARINC_cal_impl.Decode4_P16 "" VALUE 0x0080AF20 Scalar_FLOAT64_IEEE 0 FCC1ARINC_CM_double -1.7E+308 1.7E+308 /end CHARACTERISTIC
/begin CHARACTERISTIC FCC1ARINC_cal_impl.Decode4_P2 "" VALUE 0x0080ADD0 Scalar_FLOAT64_IEEE 0 FCC1ARINC_CM_double -1.7E+308 1.7E+308 /end CHARACTERISTIC
/begin CHARACTERISTIC FCC1ARINC_cal_impl.Decode4_P3 "" VALUE 0x0080ADE8 Scalar_FLOAT64_IEEE 0 FCC1ARINC_CM_double -1.7E+308 1.7E+308 /end CHARACTERISTIC
/begin CHARACTERISTIC FCC1ARINC_cal_impl.Decode4_P4 "" VALUE 0x0080AE00 Scalar_FLOAT64_IEEE 0 FCC1ARINC_CM_double -1.7E+308 1.7E+308 /end CHARACTERISTIC
/begin CHARACTERISTIC FCC1ARINC_cal_impl.Decode4_P5 "" VALUE 0x0080AE18 Scalar_FLOAT64_IEEE 0 FCC1ARINC_CM_double -1.7E+308 1.7E+308 /end CHARACTERISTIC
/begin CHARACTERISTIC FCC1ARINC_cal_impl.Decode4_P6 "" VALUE 0x0080AE30 Scalar_FLOAT64_IEEE 0 FCC1ARINC_CM_double -1.7E+308 1.7E+308 /end CHARACTERISTIC
/begin CHARACTERISTIC FCC1ARINC_cal_impl.Decode4_P7 "" VALUE 0x0080AE48 Scalar_FLOAT64_IEEE 0 FCC1ARINC_CM_double -1.7E+308 1.7E+308 /end CHARACTERISTIC
/begin CHARACTERISTIC FCC1ARINC_cal_impl.Decode4_P8 "" VALUE 0x0080AE60 Scalar_FLOAT64_IEEE 0 FCC1ARINC_CM_double -1.7E+308 1.7E+308 /end CHARACTERISTIC
/begin CHARACTERISTIC FCC1ARINC_cal_impl.Decode4_P9 "" VALUE 0x0080AE78 Scalar_FLOAT64_IEEE 0 FCC1ARINC_CM_double -1.7E+308 1.7E+308 /end CHARACTERISTIC
/begin CHARACTERISTIC FCC1ARINC_cal_impl.Decode5_P1 "" VALUE 0x0080A798 Scalar_FLOAT64_IEEE 0 FCC1ARINC_CM_double -1.7E+308 1.7E+308 /end CHARACTERISTIC
/begin CHARACTERISTIC FCC1ARINC_cal_impl.Decode5_P10 "" VALUE 0x0080A870 Scalar_FLOAT64_IEEE 0 FCC1ARINC_CM_double -1.7E+308 1.7E+308 /end CHARACTERISTIC
/begin CHARACTERISTIC FCC1ARINC_cal_impl.Decode5_P11 "" VALUE 0x0080A888 Scalar_FLOAT64_IEEE 0 FCC1ARINC_CM_double -1.7E+308 1.7E+308 /end CHARACTERISTIC
/begin CHARACTERISTIC FCC1ARINC_cal_impl.Decode5_P12 "" VALUE 0x0080A8A0 Scalar_FLOAT64_IEEE 0 FCC1ARINC_CM_double -1.7E+308 1.7E+308 /end CHARACTERISTIC
/begin CHARACTERISTIC FCC1ARINC_cal_impl.Decode5_P13 "" VALUE 0x0080A8B8 Scalar_FLOAT64_IEEE 0 FCC1ARINC_CM_double -1.7E+308 1.7E+308 /end CHARACTERISTIC
/begin CHARACTERISTIC FCC1ARINC_cal_impl.Decode5_P14 "" VALUE 0x0080A8D0 Scalar_FLOAT64_IEEE 0 FCC1ARINC_CM_double -1.7E+308 1.7E+308 /end CHARACTERISTIC
/begin CHARACTERISTIC FCC1ARINC_cal_impl.Decode5_P15 "" VALUE 0x0080A8E8 Scalar_FLOAT64_IEEE 0 FCC1ARINC_CM_double -1.7E+308 1.7E+308 /end CHARACTERISTIC
/begin CHARACTERISTIC FCC1ARINC_cal_impl.Decode5_P16 "" VALUE 0x0080A900 Scalar_FLOAT64_IEEE 0 FCC1ARINC_CM_double -1.7E+308 1.7E+308 /end CHARACTERISTIC
/begin CHARACTERISTIC FCC1ARINC_cal_impl.Decode5_P2 "" VALUE 0x0080A7B0 Scalar_FLOAT64_IEEE 0 FCC1ARINC_CM_double -1.7E+308 1.7E+308 /end CHARACTERISTIC
/begin CHARACTERISTIC FCC1ARINC_cal_impl.Decode5_P3 "" VALUE 0x0080A7C8 Scalar_FLOAT64_IEEE 0 FCC1ARINC_CM_double -1.7E+308 1.7E+308 /end CHARACTERISTIC
/begin CHARACTERISTIC FCC1ARINC_cal_impl.Decode5_P4 "" VALUE 0x0080A7E0 Scalar_FLOAT64_IEEE 0 FCC1ARINC_CM_double -1.7E+308 1.7E+308 /end CHARACTERISTIC
/begin CHARACTERISTIC FCC1ARINC_cal_impl.Decode5_P5 "" VALUE 0x0080A7F8 Scalar_FLOAT64_IEEE 0 FCC1ARINC_CM_double -1.7E+308 1.7E+308 /end CHARACTERISTIC
/begin CHARACTERISTIC FCC1ARINC_cal_impl.Decode5_P6 "" VALUE 0x0080A810 Scalar_FLOAT64_IEEE 0 FCC1ARINC_CM_double -1.7E+308 1.7E+308 /end CHARACTERISTIC
/begin CHARACTERISTIC FCC1ARINC_cal_impl.Decode5_P7 "" VALUE 0x0080A828 Scalar_FLOAT64_IEEE 0 FCC1ARINC_CM_double -1.7E+308 1.7E+308 /end CHARACTERISTIC
/begin CHARACTERISTIC FCC1ARINC_cal_impl.Decode5_P8 "" VALUE 0x0080A840 Scalar_FLOAT64_IEEE 0 FCC1ARINC_CM_double -1.7E+308 1.7E+308 /end CHARACTERISTIC
/begin CHARACTERISTIC FCC1ARINC_cal_impl.Decode5_P9 "" VALUE 0x0080A858 Scalar_FLOAT64_IEEE 0 FCC1ARINC_CM_double -1.7E+308 1.7E+308 /end CHARACTERISTIC
/begin CHARACTERISTIC FCC1ARINC_cal_impl.Decode6_P1 "" VALUE 0x0080AAB8 Scalar_FLOAT64_IEEE 0 FCC1ARINC_CM_double -1.7E+308 1.7E+308 /end CHARACTERISTIC
/begin CHARACTERISTIC FCC1ARINC_cal_impl.Decode6_P10 "" VALUE 0x0080AB90 Scalar_FLOAT64_IEEE 0 FCC1ARINC_CM_double -1.7E+308 1.7E+308 /end CHARACTERISTIC
/begin CHARACTERISTIC FCC1ARINC_cal_impl.Decode6_P11 "" VALUE 0x0080ABA8 Scalar_FLOAT64_IEEE 0 FCC1ARINC_CM_double -1.7E+308 1.7E+308 /end CHARACTERISTIC
/begin CHARACTERISTIC FCC1ARINC_cal_impl.Decode6_P12 "" VALUE 0x0080ABC0 Scalar_FLOAT64_IEEE 0 FCC1ARINC_CM_double -1.7E+308 1.7E+308 /end CHARACTERISTIC
/begin CHARACTERISTIC FCC1ARINC_cal_impl.Decode6_P13 "" VALUE 0x0080ABD8 Scalar_FLOAT64_IEEE 0 FCC1ARINC_CM_double -1.7E+308 1.7E+308 /end CHARACTERISTIC
/begin CHARACTERISTIC FCC1ARINC_cal_impl.Decode6_P14 "" VALUE 0x0080ABF0 Scalar_FLOAT64_IEEE 0 FCC1ARINC_CM_double -1.7E+308 1.7E+308 /end CHARACTERISTIC
/begin CHARACTERISTIC FCC1ARINC_cal_impl.Decode6_P15 "" VALUE 0x0080AC08 Scalar_FLOAT64_IEEE 0 FCC1ARINC_CM_double -1.7E+308 1.7E+308 /end CHARACTERISTIC
/begin CHARACTERISTIC FCC1ARINC_cal_impl.Decode6_P16 "" VALUE 0x0080AC20 Scalar_FLOAT64_IEEE 0 FCC1ARINC_CM_double -1.7E+308 1.7E+308 /end CHARACTERISTIC
/begin CHARACTERISTIC FCC1ARINC_cal_impl.Decode6_P2 "" VALUE 0x0080AAD0 Scalar_FLOAT64_IEEE 0 FCC1ARINC_CM_double -1.7E+308 1.7E+308 /end CHARACTERISTIC
/begin CHARACTERISTIC FCC1ARINC_cal_impl.Decode6_P3 "" VALUE 0x0080AAE8 Scalar_FLOAT64_IEEE 0 FCC1ARINC_CM_double -1.7E+308 1.7E+308 /end CHARACTERISTIC
/begin CHARACTERISTIC FCC1ARINC_cal_impl.Decode6_P4 "" VALUE 0x0080AB00 Scalar_FLOAT64_IEEE 0 FCC1ARINC_CM_double -1.7E+308 1.7E+308 /end CHARACTERISTIC
/begin CHARACTERISTIC FCC1ARINC_cal_impl.Decode6_P5 "" VALUE 0x0080AB18 Scalar_FLOAT64_IEEE 0 FCC1ARINC_CM_double -1.7E+308 1.7E+308 /end CHARACTERISTIC
/begin CHARACTERISTIC FCC1ARINC_cal_impl.Decode6_P6 "" VALUE 0x0080AB30 Scalar_FLOAT64_IEEE 0 FCC1ARINC_CM_double -1.7E+308 1.7E+308 /end CHARACTERISTIC
/begin CHARACTERISTIC FCC1ARINC_cal_impl.Decode6_P7 "" VALUE 0x0080AB48 Scalar_FLOAT64_IEEE 0 FCC1ARINC_CM_double -1.7E+308 1.7E+308 /end CHARACTERISTIC
/begin CHARACTERISTIC FCC1ARINC_cal_impl.Decode6_P8 "" VALUE 0x0080AB60 Scalar_FLOAT64_IEEE 0 FCC1ARINC_CM_double -1.7E+308 1.7E+308 /end CHARACTERISTIC
/begin CHARACTERISTIC FCC1ARINC_cal_impl.Decode6_P9 "" VALUE 0x0080AB78 Scalar_FLOAT64_IEEE 0 FCC1ARINC_CM_double -1.7E+308 1.7E+308 /end CHARACTERISTIC
/begin CHARACTERISTIC FCC1ARINC_cal_impl.Decode7_P1 "" VALUE 0x0080AF38 Scalar_FLOAT64_IEEE 0 FCC1ARINC_CM_double -1.7E+308 1.7E+308 /end CHARACTERISTIC
/begin CHARACTERISTIC FCC1ARINC_cal_impl.Decode7_P10 "" VALUE 0x0080B010 Scalar_FLOAT64_IEEE 0 FCC1ARINC_CM_double -1.7E+308 1.7E+308 /end CHARACTERISTIC
/begin CHARACTERISTIC FCC1ARINC_cal_impl.Decode7_P11 "" VALUE 0x0080B028 Scalar_FLOAT64_IEEE 0 FCC1ARINC_CM_double -1.7E+308 1.7E+308 /end CHARACTERISTIC
/begin CHARACTERISTIC FCC1ARINC_cal_impl.Decode7_P12 "" VALUE 0x0080B040 Scalar_FLOAT64_IEEE 0 FCC1ARINC_CM_double -1.7E+308 1.7E+308 /end CHARACTERISTIC
/begin CHARACTERISTIC FCC1ARINC_cal_impl.Decode7_P13 "" VALUE 0x0080B058 Scalar_FLOAT64_IEEE 0 FCC1ARINC_CM_double -1.7E+308 1.7E+308 /end CHARACTERISTIC
/begin CHARACTERISTIC FCC1ARINC_cal_impl.Decode7_P14 "" VALUE 0x0080B070 Scalar_FLOAT64_IEEE 0 FCC1ARINC_CM_double -1.7E+308 1.7E+308 /end CHARACTERISTIC
/begin CHARACTERISTIC FCC1ARINC_cal_impl.Decode7_P15 "" VALUE 0x0080B088 Scalar_FLOAT64_IEEE 0 FCC1ARINC_CM_double -1.7E+308 1.7E+308 /end CHARACTERISTIC
/begin CHARACTERISTIC FCC1ARINC_cal_impl.Decode7_P16 "" VALUE 0x0080B0A0 Scalar_FLOAT64_IEEE 0 FCC1ARINC_CM_double -1.7E+308 1.7E+308 /end CHARACTERISTIC
/begin CHARACTERISTIC FCC1ARINC_cal_impl.Decode7_P2 "" VALUE 0x0080AF50 Scalar_FLOAT64_IEEE 0 FCC1ARINC_CM_double -1.7E+308 1.7E+308 /end CHARACTERISTIC
/begin CHARACTERISTIC FCC1ARINC_cal_impl.Decode7_P3 "" VALUE 0x0080AF68 Scalar_FLOAT64_IEEE 0 FCC1ARINC_CM_double -1.7E+308 1.7E+308 /end CHARACTERISTIC
/begin CHARACTERISTIC FCC1ARINC_cal_impl.Decode7_P4 "" VALUE 0x0080AF80 Scalar_FLOAT64_IEEE 0 FCC1ARINC_CM_double -1.7E+308 1.7E+308 /end CHARACTERISTIC
/begin CHARACTERISTIC FCC1ARINC_cal_impl.Decode7_P5 "" VALUE 0x0080AF98 Scalar_FLOAT64_IEEE 0 FCC1ARINC_CM_double -1.7E+308 1.7E+308 /end CHARACTERISTIC
/begin CHARACTERISTIC FCC1ARINC_cal_impl.Decode7_P6 "" VALUE 0x0080AFB0 Scalar_FLOAT64_IEEE 0 FCC1ARINC_CM_double -1.7E+308 1.7E+308 /end CHARACTERISTIC
/begin CHARACTERISTIC FCC1ARINC_cal_impl.Decode7_P7 "" VALUE 0x0080AFC8 Scalar_FLOAT64_IEEE 0 FCC1ARINC_CM_double -1.7E+308 1.7E+308 /end CHARACTERISTIC
/begin CHARACTERISTIC FCC1ARINC_cal_impl.Decode7_P8 "" VALUE 0x0080AFE0 Scalar_FLOAT64_IEEE 0 FCC1ARINC_CM_double -1.7E+308 1.7E+308 /end CHARACTERISTIC
/begin CHARACTERISTIC FCC1ARINC_cal_impl.Decode7_P9 "" VALUE 0x0080AFF8 Scalar_FLOAT64_IEEE 0 FCC1ARINC_CM_double -1.7E+308 1.7E+308 /end CHARACTERISTIC
/begin CHARACTERISTIC FCC1ARINC_cal_impl.Decode8_P1 "" VALUE 0x0080B0B8 Scalar_FLOAT64_IEEE 0 FCC1ARINC_CM_double -1.7E+308 1.7E+308 /end CHARACTERISTIC
/begin CHARACTERISTIC FCC1ARINC_cal_impl.Decode8_P10 "" VALUE 0x0080B190 Scalar_FLOAT64_IEEE 0 FCC1ARINC_CM_double -1.7E+308 1.7E+308 /end CHARACTERISTIC
/begin CHARACTERISTIC FCC1ARINC_cal_impl.Decode8_P11 "" VALUE 0x0080B1A8 Scalar_FLOAT64_IEEE 0 FCC1ARINC_CM_double -1.7E+308 1.7E+308 /end CHARACTERISTIC
/begin CHARACTERISTIC FCC1ARINC_cal_impl.Decode8_P12 "" VALUE 0x0080B1C0 Scalar_FLOAT64_IEEE 0 FCC1ARINC_CM_double -1.7E+308 1.7E+308 /end CHARACTERISTIC
/begin CHARACTERISTIC FCC1ARINC_cal_impl.Decode8_P13 "" VALUE 0x0080B1D8 Scalar_FLOAT64_IEEE 0 FCC1ARINC_CM_double -1.7E+308 1.7E+308 /end CHARACTERISTIC
/begin CHARACTERISTIC FCC1ARINC_cal_impl.Decode8_P14 "" VALUE 0x0080B1F0 Scalar_FLOAT64_IEEE 0 FCC1ARINC_CM_double -1.7E+308 1.7E+308 /end CHARACTERISTIC
/begin CHARACTERISTIC FCC1ARINC_cal_impl.Decode8_P15 "" VALUE 0x0080B208 Scalar_FLOAT64_IEEE 0 FCC1ARINC_CM_double -1.7E+308 1.7E+308 /end CHARACTERISTIC
/begin CHARACTERISTIC FCC1ARINC_cal_impl.Decode8_P16 "" VALUE 0x0080B220 Scalar_FLOAT64_IEEE 0 FCC1ARINC_CM_double -1.7E+308 1.7E+308 /end CHARACTERISTIC
/begin CHARACTERISTIC FCC1ARINC_cal_impl.Decode8_P2 "" VALUE 0x0080B0D0 Scalar_FLOAT64_IEEE 0 FCC1ARINC_CM_double -1.7E+308 1.7E+308 /end CHARACTERISTIC
/begin CHARACTERISTIC FCC1ARINC_cal_impl.Decode8_P3 "" VALUE 0x0080B0E8 Scalar_FLOAT64_IEEE 0 FCC1ARINC_CM_double -1.7E+308 1.7E+308 /end CHARACTERISTIC
/begin CHARACTERISTIC FCC1ARINC_cal_impl.Decode8_P4 "" VALUE 0x0080B100 Scalar_FLOAT64_IEEE 0 FCC1ARINC_CM_double -1.7E+308 1.7E+308 /end CHARACTERISTIC
/begin CHARACTERISTIC FCC1ARINC_cal_impl.Decode8_P5 "" VALUE 0x0080B118 Scalar_FLOAT64_IEEE 0 FCC1ARINC_CM_double -1.7E+308 1.7E+308 /end CHARACTERISTIC
/begin CHARACTERISTIC FCC1ARINC_cal_impl.Decode8_P6 "" VALUE 0x0080B130 Scalar_FLOAT64_IEEE 0 FCC1ARINC_CM_double -1.7E+308 1.7E+308 /end CHARACTERISTIC
/begin CHARACTERISTIC FCC1ARINC_cal_impl.Decode8_P7 "" VALUE 0x0080B148 Scalar_FLOAT64_IEEE 0 FCC1ARINC_CM_double -1.7E+308 1.7E+308 /end CHARACTERISTIC
/begin CHARACTERISTIC FCC1ARINC_cal_impl.Decode8_P8 "" VALUE 0x0080B160 Scalar_FLOAT64_IEEE 0 FCC1ARINC_CM_double -1.7E+308 1.7E+308 /end CHARACTERISTIC
/begin CHARACTERISTIC FCC1ARINC_cal_impl.Decode8_P9 "" VALUE 0x0080B178 Scalar_FLOAT64_IEEE 0 FCC1ARINC_CM_double -1.7E+308 1.7E+308 /end CHARACTERISTIC
/begin CHARACTERISTIC FCC1ARINC_cal_impl.Decode9_P1 "" VALUE 0x0080B238 Scalar_FLOAT64_IEEE 0 FCC1ARINC_CM_double -1.7E+308 1.7E+308 /end CHARACTERISTIC
/begin CHARACTERISTIC FCC1ARINC_cal_impl.Decode9_P10 "" VALUE 0x0080B310 Scalar_FLOAT64_IEEE 0 FCC1ARINC_CM_double -1.7E+308 1.7E+308 /end CHARACTERISTIC
/begin CHARACTERISTIC FCC1ARINC_cal_impl.Decode9_P11 "" VALUE 0x0080B328 Scalar_FLOAT64_IEEE 0 FCC1ARINC_CM_double -1.7E+308 1.7E+308 /end CHARACTERISTIC
/begin CHARACTERISTIC FCC1ARINC_cal_impl.Decode9_P12 "" VALUE 0x0080B340 Scalar_FLOAT64_IEEE 0 FCC1ARINC_CM_double -1.7E+308 1.7E+308 /end CHARACTERISTIC
/begin CHARACTERISTIC FCC1ARINC_cal_impl.Decode9_P13 "" VALUE 0x0080B358 Scalar_FLOAT64_IEEE 0 FCC1ARINC_CM_double -1.7E+308 1.7E+308 /end CHARACTERISTIC
/begin CHARACTERISTIC FCC1ARINC_cal_impl.Decode9_P14 "" VALUE 0x0080B370 Scalar_FLOAT64_IEEE 0 FCC1ARINC_CM_double -1.7E+308 1.7E+308 /end CHARACTERISTIC
/begin CHARACTERISTIC FCC1ARINC_cal_impl.Decode9_P15 "" VALUE 0x0080B388 Scalar_FLOAT64_IEEE 0 FCC1ARINC_CM_double -1.7E+308 1.7E+308 /end CHARACTERISTIC
/begin CHARACTERISTIC FCC1ARINC_cal_impl.Decode9_P16 "" VALUE 0x0080B3A0 Scalar_FLOAT64_IEEE 0 FCC1ARINC_CM_double -1.7E+308 1.7E+308 /end CHARACTERISTIC
/begin CHARACTERISTIC FCC1ARINC_cal_impl.Decode9_P2 "" VALUE 0x0080B250 Scalar_FLOAT64_IEEE 0 FCC1ARINC_CM_double -1.7E+308 1.7E+308 /end CHARACTERISTIC
/begin CHARACTERISTIC FCC1ARINC_cal_impl.Decode9_P3 "" VALUE 0x0080B268 Scalar_FLOAT64_IEEE 0 FCC1ARINC_CM_double -1.7E+308 1.7E+308 /end CHARACTERISTIC
/begin CHARACTERISTIC FCC1ARINC_cal_impl.Decode9_P4 "" VALUE 0x0080B280 Scalar_FLOAT64_IEEE 0 FCC1ARINC_CM_double -1.7E+308 1.7E+308 /end CHARACTERISTIC
/begin CHARACTERISTIC FCC1ARINC_cal_impl.Decode9_P5 "" VALUE 0x0080B298 Scalar_FLOAT64_IEEE 0 FCC1ARINC_CM_double -1.7E+308 1.7E+308 /end CHARACTERISTIC
/begin CHARACTERISTIC FCC1ARINC_cal_impl.Decode9_P6 "" VALUE 0x0080B2B0 Scalar_FLOAT64_IEEE 0 FCC1ARINC_CM_double -1.7E+308 1.7E+308 /end CHARACTERISTIC
/begin CHARACTERISTIC FCC1ARINC_cal_impl.Decode9_P7 "" VALUE 0x0080B2C8 Scalar_FLOAT64_IEEE 0 FCC1ARINC_CM_double -1.7E+308 1.7E+308 /end CHARACTERISTIC
/begin CHARACTERISTIC FCC1ARINC_cal_impl.Decode9_P8 "" VALUE 0x0080B2E0 Scalar_FLOAT64_IEEE 0 FCC1ARINC_CM_double -1.7E+308 1.7E+308 /end CHARACTERISTIC
/begin CHARACTERISTIC FCC1ARINC_cal_impl.Decode9_P9 "" VALUE 0x0080B2F8 Scalar_FLOAT64_IEEE 0 FCC1ARINC_CM_double -1.7E+308 1.7E+308 /end CHARACTERISTIC
/begin CHARACTERISTIC FCC1ARINC_cal_impl.Receivev2_P1 "" VALUE 0x0080A588 Scalar_FLOAT64_IEEE 0 FCC1ARINC_CM_double -1.7E+308 1.7E+308 /end CHARACTERISTIC
/begin CHARACTERISTIC FCC1ARINC_cal_impl.Receivev2_P2 "" VALUE 0x0080A5A0 Scalar_FLOAT64_IEEE 0 FCC1ARINC_CM_double -1.7E+308 1.7E+308 /end CHARACTERISTIC
/begin CHARACTERISTIC FCC1ARINC_cal_impl.Receivev2_P3 "" VALUE 0x0080A5B8 Scalar_FLOAT64_IEEE 0 FCC1ARINC_CM_double -1.7E+308 1.7E+308 /end CHARACTERISTIC
/begin CHARACTERISTIC FCC1ARINC_cal_impl.Receivev2_P4 "" VALUE 0x0080A5D0 Scalar_FLOAT64_IEEE 0 FCC1ARINC_CM_double -1.7E+308 1.7E+308 /end CHARACTERISTIC
/begin CHARACTERISTIC FCC1ARINC_cal_impl.Receivev2_P5 "" VALUE 0x0080A5E8 Scalar_FLOAT64_IEEE 0 FCC1ARINC_CM_double -1.7E+308 1.7E+308 /end CHARACTERISTIC
/begin CHARACTERISTIC FCC1ARINC_cal_impl.Setupv2_P1 "" VALUE 0x0080A058 Scalar_FLOAT64_IEEE 0 FCC1ARINC_CM_double -1.7E+308 1.7E+308 /end CHARACTERISTIC
/begin CHARACTERISTIC FCC1ARINC_cal_impl.Setupv2_P2 "" VALUE 0x0080A070 Scalar_FLOAT64_IEEE 0 FCC1ARINC_CM_double -1.7E+308 1.7E+308 /end CHARACTERISTIC
/begin CHARACTERISTIC FCC1ARINC_cal_impl.Setupv2_P3 "" VALUE 0x0080A088 Scalar_FLOAT64_IEEE 0 FCC1ARINC_CM_double -1.7E+308 1.7E+308 /end CHARACTERISTIC
/begin CHARACTERISTIC FCC1ARINC_cal_impl.Setupv2_P4 "" VALUE 0x0080A0A0 Scalar_FLOAT64_IEEE 0 FCC1ARINC_CM_double -1.7E+308 1.7E+308 /end CHARACTERISTIC
/begin CHARACTERISTIC FCC1ARINC_cal_impl.Setupv2_P5 "" VALUE 0x0080A0B8 Scalar_FLOAT64_IEEE 0 FCC1ARINC_CM_double -1.7E+308 1.7E+308 /end CHARACTERISTIC
/begin CHARACTERISTIC FCC1ARINC_cal_impl.Setupv2_P6 "" VALUE 0x0080A0D0 Scalar_FLOAT64_IEEE 0 FCC1ARINC_CM_double -1.7E+308 1.7E+308 /end CHARACTERISTIC
/begin CHARACTERISTIC FCC1ARINC_cal_impl.Setupv2_P7 "" VAL_BLK 0x0080A0E8 Scalar_FLOAT64_IEEE 0 FCC1ARINC_CM_double -1.7E+308 1.7E+308 MATRIX_DIM 5 16 /end CHARACTERISTIC
/begin CHARACTERISTIC FCC1ARINC_cal_impl.Setupv2_P8 "" VAL_BLK 0x0080A378 Scalar_FLOAT64_IEEE 0 FCC1ARINC_CM_double -1.7E+308 1.7E+308 MATRIX_DIM 4 16 /end CHARACTERISTIC
/begin MEASUREMENT FCC1ARINC_B.BusAssignment.FCC1_ACExxxA_GEARING_ROLL "" FLOAT32_IEEE FCC1ARINC_CM_single 0 0 -3.4E+38 3.4E+38 ECU_ADDRESS 0x008132C0 /end MEASUREMENT
/begin MEASUREMENT FCC1ARINC_B.BusAssignment.FCC1_ACExxxA_GEARING_ROLL_FAIL "" UBYTE FCC1ARINC_CM_logical 0 0 0 1 ECU_ADDRESS 0x008132C4 /end MEASUREMENT
/begin MEASUREMENT FCC1ARINC_B.BusAssignment.FCC1_ACExxxA_ROLL_INCREMENTAL_DEM_FAIL "" UBYTE FCC1ARINC_CM_logical 0 0 0 1 ECU_ADDRESS 0x008132C5 /end MEASUREMENT
/begin MEASUREMENT FCC1ARINC_B.BusAssignment.FCC1_ACExxxA_ROLL_INCREMENTAL_DEM_LH "" FLOAT32_IEEE FCC1ARINC_CM_single 0 0 -3.4E+38 3.4E+38 ECU_ADDRESS 0x008132D0 /end MEASUREMENT
/begin MEASUREMENT FCC1ARINC_B.BusAssignment.FCC1_ACExxxA_ROLL_INCREMENTAL_DEM_RH "" FLOAT32_IEEE FCC1ARINC_CM_single 0 0 -3.4E+38 3.4E+38 ECU_ADDRESS 0x008132E0 /end MEASUREMENT
/begin MEASUREMENT FCC1ARINC_B.BusAssignment.FCC1_ACExxxA_SUR_POS_1_AIL "" FLOAT32_IEEE FCC1ARINC_CM_single 0 0 -3.4E+38 3.4E+38 ECU_ADDRESS 0x008132DC /end MEASUREMENT
/begin MEASUREMENT FCC1ARINC_B.BusAssignment.FCC1_ACExxxA_SUR_POS_1_AIL_FAIL "" UBYTE FCC1ARINC_CM_logical 0 0 0 1 ECU_ADDRESS 0x008132C8 /end MEASUREMENT
/begin MEASUREMENT FCC1ARINC_B.BusAssignment.FCC1_ACExxxA_TBI_FAIL "" UBYTE FCC1ARINC_CM_logical 0 0 0 1 ECU_ADDRESS 0x008132C6 /end MEASUREMENT
/begin MEASUREMENT FCC1ARINC_B.BusAssignment.FCC1_ACExxxA_TBI_LH "" FLOAT32_IEEE FCC1ARINC_CM_single 0 0 -3.4E+38 3.4E+38 ECU_ADDRESS 0x008132CC /end MEASUREMENT
/begin MEASUREMENT FCC1ARINC_B.BusAssignment.FCC1_ACExxxA_TBI_RH "" FLOAT32_IEEE FCC1ARINC_CM_single 0 0 -3.4E+38 3.4E+38 ECU_ADDRESS 0x008132D4 /end MEASUREMENT
/begin MEASUREMENT FCC1ARINC_B.BusAssignment.FCC1_ACExxxA_WHEEL_POS_1 "" FLOAT32_IEEE FCC1ARINC_CM_single 0 0 -3.4E+38 3.4E+38 ECU_ADDRESS 0x008132D8 /end MEASUREMENT
/begin MEASUREMENT FCC1ARINC_B.BusAssignment.FCC1_ACExxxA_WHEEL_POS_1_FAIL "" UBYTE FCC1ARINC_CM_logical 0 0 0 1 ECU_ADDRESS 0x008132C7 /end MEASUREMENT
/begin MEASUREMENT FCC1ARINC_B.CCCodeBlock "" FLOAT64_IEEE FCC1ARINC_CM_double 0 0 -1.7E+308 1.7E+308 ECU_ADDRESS 0x00813340 /end MEASUREMENT
/begin MEASUREMENT FCC1ARINC_B.CCCodeBlock1 "" FLOAT64_IEEE FCC1ARINC_CM_double 0 0 -1.7E+308 1.7E+308 ECU_ADDRESS 0x00813360 /end MEASUREMENT
/begin MEASUREMENT FCC1ARINC_B.CCCodeBlock2 "" FLOAT64_IEEE FCC1ARINC_CM_double 0 0 -1.7E+308 1.7E+308 ECU_ADDRESS 0x00813358 /end MEASUREMENT
/begin MEASUREMENT FCC1ARINC_B.CCCodeBlock4 "" FLOAT64_IEEE FCC1ARINC_CM_double 0 0 -1.7E+308 1.7E+308 ECU_ADDRESS 0x00813348 /end MEASUREMENT
/begin MEASUREMENT FCC1ARINC_B.CCCodeBlock5 "" FLOAT64_IEEE FCC1ARINC_CM_double 0 0 -1.7E+308 1.7E+308 ECU_ADDRESS 0x00813350 /end MEASUREMENT
/begin MEASUREMENT FCC1ARINC_B.CCCodeBlock6 "" FLOAT64_IEEE FCC1ARINC_CM_double 0 0 -1.7E+308 1.7E+308 ECU_ADDRESS 0x00813368 /end MEASUREMENT
/begin MEASUREMENT FCC1ARINC_B.CCCodeBlock7 "" FLOAT64_IEEE FCC1ARINC_CM_double 0 0 -1.7E+308 1.7E+308 ECU_ADDRESS 0x00813370 /end MEASUREMENT
/begin MEASUREMENT FCC1ARINC_B.Decode1 "" ULONG FCC1ARINC_CM_uint32 0 0 0 2147483646 ECU_ADDRESS 0x00813378 /end MEASUREMENT
/begin MEASUREMENT FCC1ARINC_B.Decode10 "" ULONG FCC1ARINC_CM_uint32 0 0 0 2147483646 ECU_ADDRESS 0x00813388 /end MEASUREMENT
/begin MEASUREMENT FCC1ARINC_B.Decode11 "" ULONG FCC1ARINC_CM_uint32 0 0 0 2147483646 ECU_ADDRESS 0x0081338C /end MEASUREMENT
/begin MEASUREMENT FCC1ARINC_B.Decode12 "" ULONG FCC1ARINC_CM_uint32 0 0 0 2147483646 ECU_ADDRESS 0x00813390 /end MEASUREMENT
/begin MEASUREMENT FCC1ARINC_B.Decode2 "" ULONG FCC1ARINC_CM_uint32 0 0 0 2147483646 ECU_ADDRESS 0x00813380 /end MEASUREMENT
/begin MEASUREMENT FCC1ARINC_B.Decode3 "" UBYTE FCC1ARINC_CM_logical 0 0 0 1 ECU_ADDRESS 0x008133CE /end MEASUREMENT
/begin MEASUREMENT FCC1ARINC_B.Decode4 "" UBYTE FCC1ARINC_CM_logical 0 0 0 1 ECU_ADDRESS 0x008133D0 /end MEASUREMENT
/begin MEASUREMENT FCC1ARINC_B.Decode5 "" ULONG FCC1ARINC_CM_uint32 0 0 0 2147483646 ECU_ADDRESS 0x0081337C /end MEASUREMENT
/begin MEASUREMENT FCC1ARINC_B.Decode6 "" UBYTE FCC1ARINC_CM_logical 0 0 0 1 ECU_ADDRESS 0x008133CC /end MEASUREMENT
/begin MEASUREMENT FCC1ARINC_B.Decode7 "" UBYTE FCC1ARINC_CM_logical 0 0 0 1 ECU_ADDRESS 0x008133D2 /end MEASUREMENT
/begin MEASUREMENT FCC1ARINC_B.Decode8 "" UBYTE FCC1ARINC_CM_logical 0 0 0 1 ECU_ADDRESS 0x008133D4 /end MEASUREMENT
/begin MEASUREMENT FCC1ARINC_B.Decode9 "" ULONG FCC1ARINC_CM_uint32 0 0 0 2147483646 ECU_ADDRESS 0x00813384 /end MEASUREMENT
/begin MEASUREMENT FCC1ARINC_B.FCC1_ACExxxA_GEARING_ROLL "" FLOAT32_IEEE FCC1ARINC_CM_single 0 0 -3.4E+38 3.4E+38 ECU_ADDRESS 0x0081339C /end MEASUREMENT
/begin MEASUREMENT FCC1ARINC_B.FCC1_ACExxxA_GEARING_ROLL_FAIL "" UBYTE FCC1ARINC_CM_logical 0 0 0 1 ECU_ADDRESS 0x008133CD /end MEASUREMENT
/begin MEASUREMENT FCC1ARINC_B.FCC1_ACExxxA_GEARING_ROLL_FAI_e "" UBYTE FCC1ARINC_CM_logical 0 0 0 1 ECU_ADDRESS 0x008133D6 /end MEASUREMENT
/begin MEASUREMENT FCC1ARINC_B.FCC1_ACExxxA_GEARING_ROLL_a "" FLOAT32_IEEE FCC1ARINC_CM_single 0 0 -3.4E+38 3.4E+38 ECU_ADDRESS 0x008133B0 /end MEASUREMENT
/begin MEASUREMENT FCC1ARINC_B.FCC1_ACExxxA_ROLL_INCREMENTAL_D "" FLOAT32_IEEE FCC1ARINC_CM_single 0 0 -3.4E+38 3.4E+38 ECU_ADDRESS 0x008133A4 /end MEASUREMENT
/begin MEASUREMENT FCC1ARINC_B.FCC1_ACExxxA_ROLL_INCREMENTAL_i "" FLOAT32_IEEE FCC1ARINC_CM_single 0 0 -3.4E+38 3.4E+38 ECU_ADDRESS 0x008133AC /end MEASUREMENT
/begin MEASUREMENT FCC1ARINC_B.FCC1_ACExxxA_ROLL_INCREMENTAL_k "" FLOAT32_IEEE FCC1ARINC_CM_single 0 0 -3.4E+38 3.4E+38 ECU_ADDRESS 0x008133C0 /end MEASUREMENT
/begin MEASUREMENT FCC1ARINC_B.FCC1_ACExxxA_ROLL_INCREMENTAL_m "" FLOAT32_IEEE FCC1ARINC_CM_single 0 0 -3.4E+38 3.4E+38 ECU_ADDRESS 0x008133B8 /end MEASUREMENT
/begin MEASUREMENT FCC1ARINC_B.FCC1_ACExxxA_ROLL_INCREMENTAL_p "" UBYTE FCC1ARINC_CM_logical 0 0 0 1 ECU_ADDRESS 0x008133CF /end MEASUREMENT
/begin MEASUREMENT FCC1ARINC_B.FCC1_ACExxxA_ROLL_INCREMENTA_kk "" UBYTE FCC1ARINC_CM_logical 0 0 0 1 ECU_ADDRESS 0x008133D7 /end MEASUREMENT
/begin MEASUREMENT FCC1ARINC_B.FCC1_ACExxxA_SUR_POS_1_AIL "" FLOAT32_IEEE FCC1ARINC_CM_single 0 0 -3.4E+38 3.4E+38 ECU_ADDRESS 0x00813398 /end MEASUREMENT
/begin MEASUREMENT FCC1ARINC_B.FCC1_ACExxxA_SUR_POS_1_AIL_FAIL "" UBYTE FCC1ARINC_CM_logical 0 0 0 1 ECU_ADDRESS 0x008133D5 /end MEASUREMENT
/begin MEASUREMENT FCC1ARINC_B.FCC1_ACExxxA_SUR_POS_1_AIL_FA_f "" UBYTE FCC1ARINC_CM_logical 0 0 0 1 ECU_ADDRESS 0x008133DA /end MEASUREMENT
/begin MEASUREMENT FCC1ARINC_B.FCC1_ACExxxA_SUR_POS_1_AIL_d "" FLOAT32_IEEE FCC1ARINC_CM_single 0 0 -3.4E+38 3.4E+38 ECU_ADDRESS 0x008133B4 /end MEASUREMENT
/begin MEASUREMENT FCC1ARINC_B.FCC1_ACExxxA_TBI_FAIL "" UBYTE FCC1ARINC_CM_logical 0 0 0 1 ECU_ADDRESS 0x008133D1 /end MEASUREMENT
/begin MEASUREMENT FCC1ARINC_B.FCC1_ACExxxA_TBI_FAIL_d "" UBYTE FCC1ARINC_CM_logical 0 0 0 1 ECU_ADDRESS 0x008133D8 /end MEASUREMENT
/begin MEASUREMENT FCC1ARINC_B.FCC1_ACExxxA_TBI_LH "" FLOAT32_IEEE FCC1ARINC_CM_single 0 0 -3.4E+38 3.4E+38 ECU_ADDRESS 0x008133A0 /end MEASUREMENT
/begin MEASUREMENT FCC1ARINC_B.FCC1_ACExxxA_TBI_LH_m "" FLOAT32_IEEE FCC1ARINC_CM_single 0 0 -3.4E+38 3.4E+38 ECU_ADDRESS 0x008133BC /end MEASUREMENT
/begin MEASUREMENT FCC1ARINC_B.FCC1_ACExxxA_TBI_RH "" FLOAT32_IEEE FCC1ARINC_CM_single 0 0 -3.4E+38 3.4E+38 ECU_ADDRESS 0x008133A8 /end MEASUREMENT
/begin MEASUREMENT FCC1ARINC_B.FCC1_ACExxxA_TBI_RH_o "" FLOAT32_IEEE FCC1ARINC_CM_single 0 0 -3.4E+38 3.4E+38 ECU_ADDRESS 0x008133C4 /end MEASUREMENT
/begin MEASUREMENT FCC1ARINC_B.FCC1_ACExxxA_WHEEL_POS_1 "" FLOAT32_IEEE FCC1ARINC_CM_single 0 0 -3.4E+38 3.4E+38 ECU_ADDRESS 0x00813394 /end MEASUREMENT
/begin MEASUREMENT FCC1ARINC_B.FCC1_ACExxxA_WHEEL_POS_1_FAIL "" UBYTE FCC1ARINC_CM_logical 0 0 0 1 ECU_ADDRESS 0x008133D3 /end MEASUREMENT
/begin MEASUREMENT FCC1ARINC_B.FCC1_ACExxxA_WHEEL_POS_1_FAIL_e "" UBYTE FCC1ARINC_CM_logical 0 0 0 1 ECU_ADDRESS 0x008133D9 /end MEASUREMENT
/begin MEASUREMENT FCC1ARINC_B.FCC1_ACExxxA_WHEEL_POS_1_l "" FLOAT32_IEEE FCC1ARINC_CM_single 0 0 -3.4E+38 3.4E+38 ECU_ADDRESS 0x008133C8 /end MEASUREMENT
/begin MEASUREMENT FCC1ARINC_B.Receivev2 "" FLOAT64_IEEE FCC1ARINC_CM_double 0 0 -1.7E+308 1.7E+308 LAYOUT COLUMN_DIR MATRIX_DIM 11 ECU_ADDRESS 0x008132E8 /end MEASUREMENT
/begin COMPU_METHOD FCC1ARINC_CM_double "" IDENTICAL "%15.10" "" /end COMPU_METHOD
/begin COMPU_METHOD FCC1ARINC_CM_logical "" IDENTICAL "%1.0" "" /end COMPU_METHOD
/begin COMPU_METHOD FCC1ARINC_CM_single "" IDENTICAL "%8.6" "" /end COMPU_METHOD
/begin COMPU_METHOD FCC1ARINC_CM_uint32 "" IDENTICAL "%10.0" "" /end COMPU_METHOD
/begin RECORD_LAYOUT Scalar_BOOLEAN FNC_VALUES 1 UBYTE COLUMN_DIR DIRECT /end RECORD_LAYOUT
/begin RECORD_LAYOUT Scalar_FLOAT32_IEEE FNC_VALUES 1 FLOAT32_IEEE COLUMN_DIR DIRECT /end RECORD_LAYOUT
/begin RECORD_LAYOUT Scalar_FLOAT64_IEEE FNC_VALUES 1 FLOAT64_IEEE COLUMN_DIR DIRECT /end RECORD_LAYOUT
/begin RECORD_LAYOUT Scalar_ULONG FNC_VALUES 1 ULONG COLUMN_DIR DIRECT /end RECORD_LAYOUT
/begin GROUP FCC1ARINC "FCC1ARINC" ROOT
 /begin SUB_GROUP FCC1ARINC_cal_impl.Constant_Value FCC1ARINC_B.BusAssignment FCC1ARINC_Decode_Channel_1 /end SUB_GROUP
 /begin REF_CHARACTERISTIC FCC1ARINC_cal_impl.Receivev2_P1 FCC1ARINC_cal_impl.Receivev2_P2 FCC1ARINC_cal_impl.Receivev2_P3 FCC1ARINC_cal_impl.Receivev2_P4 FCC1ARINC_cal_impl.Receivev2_P5 FCC1ARINC_cal_impl.Setupv2_P1 FCC1ARINC_cal_impl.Setupv2_P2 FCC1ARINC_cal_impl.Setupv2_P3 FCC1ARINC_cal_impl.Setupv2_P4 FCC1ARINC_cal_impl.Setupv2_P5 FCC1ARINC_cal_impl.Setupv2_P6 FCC1ARINC_cal_impl.Setupv2_P7 FCC1ARINC_cal_impl.Setupv2_P8 /end REF_CHARACTERISTIC
 /begin REF_MEASUREMENT FCC1ARINC_B.FCC1_ACExxxA_GEARING_ROLL_FAI_e FCC1ARINC_B.FCC1_ACExxxA_GEARING_ROLL_a FCC1ARINC_B.FCC1_ACExxxA_ROLL_INCREMENTAL_k FCC1ARINC_B.FCC1_ACExxxA_ROLL_INCREMENTAL_m FCC1ARINC_B.FCC1_ACExxxA_ROLL_INCREMENTA_kk FCC1ARINC_B.FCC1_ACExxxA_SUR_POS_1_AIL_FA_f FCC1ARINC_B.FCC1_ACExxxA_SUR_POS_1_AIL_d FCC1ARINC_B.FCC1_ACExxxA_TBI_FAIL_d FCC1ARINC_B.FCC1_ACExxxA_TBI_LH_m FCC1ARINC_B.FCC1_ACExxxA_TBI_RH_o FCC1ARINC_B.FCC1_ACExxxA_WHEEL_POS_1_FAIL_e FCC1ARINC_B.FCC1_ACExxxA_WHEEL_POS_1_l FCC1ARINC_B.Receivev2 FCC1ARINC_DW.Receivev2_PWORK FCC1ARINC_DW.Setupv2_PWORK /end REF_MEASUREMENT
/end GROUP
/begin GROUP FCC1ARINC_B.BusAssignment ""
 /begin REF_MEASUREMENT FCC1ARINC_B.BusAssignment.FCC1_ACExxxA_GEARING_ROLL FCC1ARINC_B.BusAssignment.FCC1_ACExxxA_GEARING_ROLL_FAIL FCC1ARINC_B.BusAssignment.FCC1_ACExxxA_ROLL_INCREMENTAL_DEM_FAIL FCC1ARINC_B.BusAssignment.FCC1_ACExxxA_TBI_FAIL FCC1ARINC_B.BusAssignment.FCC1_ACExxxA_WHEEL_POS_1_FAIL FCC1ARINC_B.BusAssignment.FCC1_ACExxxA_SUR_POS_1_AIL_FAIL FCC1ARINC_B.BusAssignment.FCC1_ACExxxA_TBI_LH FCC1ARINC_B.BusAssignment.FCC1_ACExxxA_ROLL_INCREMENTAL_DEM_LH FCC1ARINC_B.BusAssignment.FCC1_ACExxxA_TBI_RH FCC1ARINC_B.BusAssignment.FCC1_ACExxxA_WHEEL_POS_1 FCC1ARINC_B.BusAssignment.FCC1_ACExxxA_SUR_POS_1_AIL FCC1ARINC_B.BusAssignment.FCC1_ACExxxA_ROLL_INCREMENTAL_DEM_RH /end REF_MEASUREMENT
/end GROUP
/begin GROUP FCC1ARINC_Decode_Channel_1 "FCC1ARINC/Decode Channel 1"
 /begin REF_CHARACTERISTIC FCC1ARINC_cal_impl.CCCodeBlock1_P1 FCC1ARINC_cal_impl.CCCodeBlock1_P2 FCC1ARINC_cal_impl.CCCodeBlock1_P3 FCC1ARINC_cal_impl.CCCodeBlock1_P4 FCC1ARINC_cal_impl.CCCodeBlock1_P5 FCC1ARINC_cal_impl.CCCodeBlock2_P1 FCC1ARINC_cal_impl.CCCodeBlock2_P2 FCC1ARINC_cal_impl.CCCodeBlock2_P3 FCC1ARINC_cal_impl.CCCodeBlock2_P4 FCC1ARINC_cal_impl.CCCodeBlock2_P5 FCC1ARINC_cal_impl.CCCodeBlock4_P1 FCC1ARINC_cal_impl.CCCodeBlock4_P2 FCC1ARINC_cal_impl.CCCodeBlock4_P3 FCC1ARINC_cal_impl.CCCodeBlock4_P4 FCC1ARINC_cal_impl.CCCodeBlock4_P5 FCC1ARINC_cal_impl.CCCodeBlock5_P1 FCC1ARINC_cal_impl.CCCodeBlock5_P2 FCC1ARINC_cal_impl.CCCodeBlock5_P3 FCC1ARINC_cal_impl.CCCodeBlock5_P4 FCC1ARINC_cal_impl.CCCodeBlock5_P5 FCC1ARINC_cal_impl.CCCodeBlock6_P1 FCC1ARINC_cal_impl.CCCodeBlock6_P2 FCC1ARINC_cal_impl.CCCodeBlock6_P3 FCC1ARINC_cal_impl.CCCodeBlock6_P4 FCC1ARINC_cal_impl.CCCodeBlock6_P5 FCC1ARINC_cal_impl.CCCodeBlock7_P1 FCC1ARINC_cal_impl.CCCodeBlock7_P2 FCC1ARINC_cal_impl.CCCodeBlock7_P3 FCC1ARINC_cal_impl.CCCodeBlock7_P4 FCC1ARINC_cal_impl.CCCodeBlock7_P5 FCC1ARINC_cal_impl.CCCodeBlock_P1 FCC1ARINC_cal_impl.CCCodeBlock_P2 FCC1ARINC_cal_impl.CCCodeBlock_P3 FCC1ARINC_cal_impl.CCCodeBlock_P4 FCC1ARINC_cal_impl.CCCodeBlock_P5 FCC1ARINC_cal_impl.Decode10_P1 FCC1ARINC_cal_impl.Decode10_P10 FCC1ARINC_cal_impl.Decode10_P11 FCC1ARINC_cal_impl.Decode10_P12 FCC1ARINC_cal_impl.Decode10_P13 FCC1ARINC_cal_impl.Decode10_P14 FCC1ARINC_cal_impl.Decode10_P15 FCC1ARINC_cal_impl.Decode10_P16 FCC1ARINC_cal_impl.Decode10_P2 FCC1ARINC_cal_impl.Decode10_P3 FCC1ARINC_cal_impl.Decode10_P4 FCC1ARINC_cal_impl.Decode10_P5 FCC1ARINC_cal_impl.Decode10_P6 FCC1ARINC_cal_impl.Decode10_P7 FCC1ARINC_cal_impl.Decode10_P8 FCC1ARINC_cal_impl.Decode10_P9 FCC1ARINC_cal_impl.Decode11_P1 FCC1ARINC_cal_impl.Decode11_P10 FCC1ARINC_cal_impl.Decode11_P11 FCC1ARINC_cal_impl.Decode11_P12 FCC1ARINC_cal_impl.Decode11_P13 FCC1ARINC_cal_impl.Decode11_P14 FCC1ARINC_cal_impl.Decode11_P15 FCC1ARINC_cal_impl.Decode11_P16 FCC1ARINC_cal_impl.Decode11_P2 FCC1ARINC_cal_impl.Decode11_P3 FCC1ARINC_cal_impl.Decode11_P4 FCC1ARINC_cal_impl.Decode11_P5 FCC1ARINC_cal_impl.Decode11_P6 FCC1ARINC_cal_impl.Decode11_P7 FCC1ARINC_cal_impl.Decode11_P8 FCC1ARINC_cal_impl.Decode11_P9 FCC1ARINC_cal_impl.Decode12_P1 FCC1ARINC_cal_impl.Decode12_P10 FCC1ARINC_cal_impl.Decode12_P11 FCC1ARINC_cal_impl.Decode12_P12 FCC1ARINC_cal_impl.Decode12_P13 FCC1ARINC_cal_impl.Decode12_P14 FCC1ARINC_cal_impl.Decode12_P15 FCC1ARINC_cal_impl.Decode12_P16 FCC1ARINC_cal_impl.Decode12_P2 FCC1ARINC_cal_impl.Decode12_P3 FCC1ARINC_cal_impl.Decode12_P4 FCC1ARINC_cal_impl.Decode12_P5 FCC1ARINC_cal_impl.Decode12_P6 FCC1ARINC_cal_impl.Decode12_P7 FCC1ARINC_cal_impl.Decode12_P8 FCC1ARINC_cal_impl.Decode12_P9 FCC1ARINC_cal_impl.Decode1_P1 FCC1ARINC_cal_impl.Decode1_P10 FCC1ARINC_cal_impl.Decode1_P11 FCC1ARINC_cal_impl.Decode1_P12 FCC1ARINC_cal_impl.Decode1_P13 FCC1ARINC_cal_impl.Decode1_P14 FCC1ARINC_cal_impl.Decode1_P15 FCC1ARINC_cal_impl.Decode1_P16 FCC1ARINC_cal_impl.Decode1_P2 FCC1ARINC_cal_impl.Decode1_P3 FCC1ARINC_cal_impl.Decode1_P4 FCC1ARINC_cal_impl.Decode1_P5 FCC1ARINC_cal_impl.Decode1_P6 FCC1ARINC_cal_impl.Decode1_P7 FCC1ARINC_cal_impl.Decode1_P8 FCC1ARINC_cal_impl.Decode1_P9 FCC1ARINC_cal_impl.Decode2_P1 FCC1ARINC_cal_impl.Decode2_P10 FCC1ARINC_cal_impl.Decode2_P11 FCC1ARINC_cal_impl.Decode2_P12 FCC1ARINC_cal_impl.Decode2_P13 FCC1ARINC_cal_impl.Decode2_P14 FCC1ARINC_cal_impl.Decode2_P15 FCC1ARINC_cal_impl.Decode2_P16 FCC1ARINC_cal_impl.Decode2_P2 FCC1ARINC_cal_impl.Decode2_P3 FCC1ARINC_cal_impl.Decode2_P4 FCC1ARINC_cal_impl.Decode2_P5 FCC1ARINC_cal_impl.Decode2_P6 FCC1ARINC_cal_impl.Decode2_P7 FCC1ARINC_cal_impl.Decode2_P8 FCC1ARINC_cal_impl.Decode2_P9 FCC1ARINC_cal_impl.Decode3_P1 FCC1ARINC_cal_impl.Decode3_P10 FCC1ARINC_cal_impl.Decode3_P11 FCC1ARINC_cal_impl.Decode3_P12 FCC1ARINC_cal_impl.Decode3_P13 FCC1ARINC_cal_impl.Decode3_P14 FCC1ARINC_cal_impl.Decode3_P15 FCC1ARINC_cal_impl.Decode3_P16 FCC1ARINC_cal_impl.Decode3_P2 FCC1ARINC_cal_impl.Decode3_P3 FCC1ARINC_cal_impl.Decode3_P4 FCC1ARINC_cal_impl.Decode3_P5 FCC1ARINC_cal_impl.Decode3_P6 FCC1ARINC_cal_impl.Decode3_P7 FCC1ARINC_cal_impl.Decode3_P8 FCC1ARINC_cal_impl.Decode3_P9 FCC1ARINC_cal_impl.Decode4_P1 FCC1ARINC_cal_impl.Decode4_P10 FCC1ARINC_cal_impl.Decode4_P11 FCC1ARINC_cal_impl.Decode4_P12 FCC1ARINC_cal_impl.Decode4_P13 FCC1ARINC_cal_impl.Decode4_P14 FCC1ARINC_cal_impl.Decode4_P15 FCC1ARINC_cal_impl.Decode4_P16 FCC1ARINC_cal_impl.Decode4_P2 FCC1ARINC_cal_impl.Decode4_P3 FCC1ARINC_cal_impl.Decode4_P4 FCC1ARINC_cal_impl.Decode4_P5 FCC1ARINC_cal_impl.Decode4_P6 FCC1ARINC_cal_impl.Decode4_P7 FCC1ARINC_cal_impl.Decode4_P8 FCC1ARINC_cal_impl.Decode4_P9 FCC1ARINC_cal_impl.Decode5_P1 FCC1ARINC_cal_impl.Decode5_P10 FCC1ARINC_cal_impl.Decode5_P11 FCC1ARINC_cal_impl.Decode5_P12 FCC1ARINC_cal_impl.Decode5_P13 FCC1ARINC_cal_impl.Decode5_P14 FCC1ARINC_cal_impl.Decode5_P15 FCC1ARINC_cal_impl.Decode5_P16 FCC1ARINC_cal_impl.Decode5_P2 FCC1ARINC_cal_impl.Decode5_P3 FCC1ARINC_cal_impl.Decode5_P4 FCC1ARINC_cal_impl.Decode5_P5 FCC1ARINC_cal_impl.Decode5_P6 FCC1ARINC_cal_impl.Decode5_P7 FCC1ARINC_cal_impl.Decode5_P8 FCC1ARINC_cal_impl.Decode5_P9 FCC1ARINC_cal_impl.Decode6_P1 FCC1ARINC_cal_impl.Decode6_P10 FCC1ARINC_cal_impl.Decode6_P11 FCC1ARINC_cal_impl.Decode6_P12 FCC1ARINC_cal_impl.Decode6_P13 FCC1ARINC_cal_impl.Decode6_P14 FCC1ARINC_cal_impl.Decode6_P15 FCC1ARINC_cal_impl.Decode6_P16 FCC1ARINC_cal_impl.Decode6_P2 FCC1ARINC_cal_impl.Decode6_P3 FCC1ARINC_cal_impl.Decode6_P4 FCC1ARINC_cal_impl.Decode6_P5 FCC1ARINC_cal_impl.Decode6_P6 FCC1ARINC_cal_impl.Decode6_P7 FCC1ARINC_cal_impl.Decode6_P8 FCC1ARINC_cal_impl.Decode6_P9 FCC1ARINC_cal_impl.Decode7_P1 FCC1ARINC_cal_impl.Decode7_P10 FCC1ARINC_cal_impl.Decode7_P11 FCC1ARINC_cal_impl.Decode7_P12 FCC1ARINC_cal_impl.Decode7_P13 FCC1ARINC_cal_impl.Decode7_P14 FCC1ARINC_cal_impl.Decode7_P15 FCC1ARINC_cal_impl.Decode7_P16 FCC1ARINC_cal_impl.Decode7_P2 FCC1ARINC_cal_impl.Decode7_P3 FCC1ARINC_cal_impl.Decode7_P4 FCC1ARINC_cal_impl.Decode7_P5 FCC1ARINC_cal_impl.Decode7_P6 FCC1ARINC_cal_impl.Decode7_P7 FCC1ARINC_cal_impl.Decode7_P8 FCC1ARINC_cal_impl.Decode7_P9 FCC1ARINC_cal_impl.Decode8_P1 FCC1ARINC_cal_impl.Decode8_P10 FCC1ARINC_cal_impl.Decode8_P11 FCC1ARINC_cal_impl.Decode8_P12 FCC1ARINC_cal_impl.Decode8_P13 FCC1ARINC_cal_impl.Decode8_P14 FCC1ARINC_cal_impl.Decode8_P15 FCC1ARINC_cal_impl.Decode8_P16 FCC1ARINC_cal_impl.Decode8_P2 FCC1ARINC_cal_impl.Decode8_P3 FCC1ARINC_cal_impl.Decode8_P4 FCC1ARINC_cal_impl.Decode8_P5 FCC1ARINC_cal_impl.Decode8_P6 FCC1ARINC_cal_impl.Decode8_P7 FCC1ARINC_cal_impl.Decode8_P8 FCC1ARINC_cal_impl.Decode8_P9 FCC1ARINC_cal_impl.Decode9_P1 FCC1ARINC_cal_impl.Decode9_P10 FCC1ARINC_cal_impl.Decode9_P11 FCC1ARINC_cal_impl.Decode9_P12 FCC1ARINC_cal_impl.Decode9_P13 FCC1ARINC_cal_impl.Decode9_P14 FCC1ARINC_cal_impl.Decode9_P15 FCC1ARINC_cal_impl.Decode9_P16 FCC1ARINC_cal_impl.Decode9_P2 FCC1ARINC_cal_impl.Decode9_P3 FCC1ARINC_cal_impl.Decode9_P4 FCC1ARINC_cal_impl.Decode9_P5 FCC1ARINC_cal_impl.Decode9_P6 FCC1ARINC_cal_impl.Decode9_P7 FCC1ARINC_cal_impl.Decode9_P8 FCC1ARINC_cal_impl.Decode9_P9 /end REF_CHARACTERISTIC
 /begin REF_MEASUREMENT FCC1ARINC_B.CCCodeBlock FCC1ARINC_B.CCCodeBlock1 FCC1ARINC_B.CCCodeBlock2 FCC1ARINC_B.CCCodeBlock4 FCC1ARINC_B.CCCodeBlock5 FCC1ARINC_B.CCCodeBlock6 FCC1ARINC_B.CCCodeBlock7 FCC1ARINC_B.Decode1 FCC1ARINC_B.Decode10 FCC1ARINC_B.Decode11 FCC1ARINC_B.Decode12 FCC1ARINC_B.Decode2 FCC1ARINC_B.Decode3 FCC1ARINC_B.Decode4 FCC1ARINC_B.Decode5 FCC1ARINC_B.Decode6 FCC1ARINC_B.Decode7 FCC1ARINC_B.Decode8 FCC1ARINC_B.Decode9 FCC1ARINC_B.FCC1_ACExxxA_GEARING_ROLL FCC1ARINC_B.FCC1_ACExxxA_GEARING_ROLL_FAIL FCC1ARINC_B.FCC1_ACExxxA_ROLL_INCREMENTAL_D FCC1ARINC_B.FCC1_ACExxxA_ROLL_INCREMENTAL_i FCC1ARINC_B.FCC1_ACExxxA_ROLL_INCREMENTAL_p FCC1ARINC_B.FCC1_ACExxxA_SUR_POS_1_AIL FCC1ARINC_B.FCC1_ACExxxA_SUR_POS_1_AIL_FAIL FCC1ARINC_B.FCC1_ACExxxA_TBI_FAIL FCC1ARINC_B.FCC1_ACExxxA_TBI_LH FCC1ARINC_B.FCC1_ACExxxA_TBI_RH FCC1ARINC_B.FCC1_ACExxxA_WHEEL_POS_1 FCC1ARINC_B.FCC1_ACExxxA_WHEEL_POS_1_FAIL FCC1ARINC_B.Receivev2 /end REF_MEASUREMENT
/end GROUP
/begin GROUP FCC1ARINC_cal_impl.Constant_Value ""
 /begin REF_CHARACTERISTIC FCC1ARINC_cal_impl.Constant_Value.FCC1_ACExxxA_GEARING_ROLL FCC1ARINC_cal_impl.Constant_Value.FCC1_ACExxxA_GEARING_ROLL_FAIL FCC1ARINC_cal_impl.Constant_Value.FCC1_ACExxxA_ROLL_INCREMENTAL_DEM_FAIL FCC1ARINC_cal_impl.Constant_Value.FCC1_ACExxxA_TBI_FAIL FCC1ARINC_cal_impl.Constant_Value.FCC1_ACExxxA_WHEEL_POS_1_FAIL FCC1ARINC_cal_impl.Constant_Value.FCC1_ACExxxA_SUR_POS_1_AIL_FAIL FCC1ARINC_cal_impl.Constant_Value.FCC1_ACExxxA_TBI_LH FCC1ARINC_cal_impl.Constant_Value.FCC1_ACExxxA_ROLL_INCREMENTAL_DEM_LH FCC1ARINC_cal_impl.Constant_Value.FCC1_ACExxxA_TBI_RH FCC1ARINC_cal_impl.Constant_Value.FCC1_ACExxxA_WHEEL_POS_1 FCC1ARINC_cal_impl.Constant_Value.FCC1_ACExxxA_SUR_POS_1_AIL FCC1ARINC_cal_impl.Constant_Value.FCC1_ACExxxA_ROLL_INCREMENTAL_DEM_RH /end REF_CHARACTERISTIC
/end GROUP
/end MODULE
/end PROJECT
